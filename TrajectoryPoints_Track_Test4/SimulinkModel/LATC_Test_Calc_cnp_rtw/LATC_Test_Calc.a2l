/* * Vector CANape/vSignalyzer Target */
/* * Code generation for model "LATC_Test_Calc". */
/* * ASAP2 file name:             LATC_Test_Calc.a2l */
/* * Model version:               3.98 */
/* * Simulink Coder version:      9.6 (R2021b) 14-May-2021 */
/* * C source code generated on:  Tue Mar  1 14:24:04 2022 */
/* * Target selection:            cnp.tlc */
/* * Target version:              14.0.2 */ ASAP2_VERSION 1 51
/begin PROJECT ProjectName "Project Comment Goes Here"
/begin HEADER "Header Comments go here" /end HEADER
/begin MODULE ModuleName "Module Comment Goes Here"
/begin MOD_PAR "MOD PAR Comment Goes Here" /end MOD_PAR
/begin MOD_COMMON "Mod Common Comment Here" BYTE_ORDER MSB_LAST ALIGNMENT_BYTE 1 ALIGNMENT_WORD 2 ALIGNMENT_LONG 4 ALIGNMENT_FLOAT32_IEEE 4 ALIGNMENT_FLOAT64_IEEE 8 /end MOD_COMMON
/begin IF_DATA XCP
 /begin PROTOCOL_LAYER 0x0100 0x03E8 0x2710 0x00 0x00 0x00 0x00 0x00 0xFF 0xFF BYTE_ORDER_MSB_LAST ADDRESS_GRANULARITY_BYTE COMMUNICATION_MODE_SUPPORTED BLOCK MASTER 0x2B 0x00 SEED_AND_KEY_EXTERNAL_FUNCTION "SeedNKeyXcp.dll" /end PROTOCOL_LAYER
 /begin DAQ DYNAMIC 0x00 0x06 0x00 OPTIMISATION_TYPE_DEFAULT ADDRESS_EXTENSION_FREE IDENTIFICATION_FIELD_TYPE_RELATIVE_BYTE GRANULARITY_ODT_ENTRY_SIZE_DAQ_BYTE 0x06 OVERLOAD_INDICATION_PID PRESCALER_SUPPORTED /begin TIMESTAMP_SUPPORTED 0x01 SIZE_DWORD UNIT_100US /end TIMESTAMP_SUPPORTED
  /begin EVENT "on LATC_Test_Calc calculated" "" 0x00 DAQ 0xFF 0x00 0x06 0x00 /end EVENT
 /end DAQ
 /begin XCP_ON_SIMULINK MODEL_NAME "LATC_Test_Calc" /end XCP_ON_SIMULINK
/end IF_DATA
/begin CHARACTERISTIC P_Global_SteerAngleOffsetFilterTime "" VALUE 0x118000 Scalar_FLOAT64_IEEE 0 LATC_Test_Calc_CM_double -1.7976931348623157E+308 1.7976931348623157E+308 /end CHARACTERISTIC
/begin MEASUREMENT RTTarget.ModelExecutionCounter "Internal CANape RT-Target DLL counter" ULONG NO_COMPU_METHOD 0 0 0 4294967295 ECU_ADDRESS 0x18A770 FORMAT "%.1"
 /begin IF_DATA XCP
  /begin DAQ_EVENT FIXED_EVENT_LIST EVENT 0x00 /end DAQ_EVENT
 /end IF_DATA
/end MEASUREMENT
/begin MEASUREMENT RTTarget.ModelStepTime "Internal CANape RT-Target DLL model step execution time" ULONG RTTarget.ModelStepTime.CONVERSION.MICROSECOND_UNIT 0 0 0 4294967295 ECU_ADDRESS 0x1370D8
 /begin IF_DATA XCP
  /begin DAQ_EVENT FIXED_EVENT_LIST EVENT 0x00 /end DAQ_EVENT
 /end IF_DATA
/end MEASUREMENT
/begin COMPU_METHOD LATC_Test_Calc_CM_double "Q = V" RAT_FUNC "%15.10" "" COEFFS 0 1 0 0 0 1 /end COMPU_METHOD
/begin COMPU_METHOD RTTarget.ModelStepTime.CONVERSION.MICROSECOND_UNIT "Microsecond unit for model step execution time" RAT_FUNC "%.1" "祍" COEFFS 0 1 0 0 0 1 /end COMPU_METHOD
/begin RECORD_LAYOUT Lookup1D_BOOLEAN FNC_VALUES 1 UBYTE COLUMN_DIR DIRECT /end RECORD_LAYOUT
/begin RECORD_LAYOUT Lookup1D_BYTE FNC_VALUES 1 SBYTE COLUMN_DIR DIRECT /end RECORD_LAYOUT
/begin RECORD_LAYOUT Lookup1D_FLOAT32_IEEE FNC_VALUES 1 FLOAT32_IEEE COLUMN_DIR DIRECT /end RECORD_LAYOUT
/begin RECORD_LAYOUT Lookup1D_FLOAT64_IEEE FNC_VALUES 1 FLOAT64_IEEE COLUMN_DIR DIRECT /end RECORD_LAYOUT
/begin RECORD_LAYOUT Lookup1D_SLONG FNC_VALUES 1 SLONG COLUMN_DIR DIRECT /end RECORD_LAYOUT
/begin RECORD_LAYOUT Lookup1D_UBYTE FNC_VALUES 1 UBYTE COLUMN_DIR DIRECT /end RECORD_LAYOUT
/begin RECORD_LAYOUT Lookup1D_ULONG FNC_VALUES 1 ULONG COLUMN_DIR DIRECT /end RECORD_LAYOUT
/begin RECORD_LAYOUT Lookup1D_UWORD FNC_VALUES 1 UWORD COLUMN_DIR DIRECT /end RECORD_LAYOUT
/begin RECORD_LAYOUT Lookup1D_WORD FNC_VALUES 1 SWORD COLUMN_DIR DIRECT /end RECORD_LAYOUT
/begin RECORD_LAYOUT Lookup1D_X_BOOLEAN AXIS_PTS_X 1 UBYTE INDEX_INCR DIRECT /end RECORD_LAYOUT
/begin RECORD_LAYOUT Lookup1D_X_BYTE AXIS_PTS_X 1 SBYTE INDEX_INCR DIRECT /end RECORD_LAYOUT
/begin RECORD_LAYOUT Lookup1D_X_FLOAT32_IEEE AXIS_PTS_X 1 FLOAT32_IEEE INDEX_INCR DIRECT /end RECORD_LAYOUT
/begin RECORD_LAYOUT Lookup1D_X_FLOAT64_IEEE AXIS_PTS_X 1 FLOAT64_IEEE INDEX_INCR DIRECT /end RECORD_LAYOUT
/begin RECORD_LAYOUT Lookup1D_X_LONG AXIS_PTS_X 1 SLONG INDEX_INCR DIRECT /end RECORD_LAYOUT
/begin RECORD_LAYOUT Lookup1D_X_UBYTE AXIS_PTS_X 1 UBYTE INDEX_INCR DIRECT /end RECORD_LAYOUT
/begin RECORD_LAYOUT Lookup1D_X_ULONG AXIS_PTS_X 1 ULONG INDEX_INCR DIRECT /end RECORD_LAYOUT
/begin RECORD_LAYOUT Lookup1D_X_UWORD AXIS_PTS_X 1 UWORD INDEX_INCR DIRECT /end RECORD_LAYOUT
/begin RECORD_LAYOUT Lookup1D_X_WORD AXIS_PTS_X 1 SWORD INDEX_INCR DIRECT /end RECORD_LAYOUT
/begin RECORD_LAYOUT Lookup2D_BOOLEAN FNC_VALUES 1 UBYTE COLUMN_DIR DIRECT /end RECORD_LAYOUT
/begin RECORD_LAYOUT Lookup2D_BYTE FNC_VALUES 1 SBYTE COLUMN_DIR DIRECT /end RECORD_LAYOUT
/begin RECORD_LAYOUT Lookup2D_FLOAT32_IEEE FNC_VALUES 1 FLOAT32_IEEE COLUMN_DIR DIRECT /end RECORD_LAYOUT
/begin RECORD_LAYOUT Lookup2D_FLOAT64_IEEE FNC_VALUES 1 FLOAT64_IEEE COLUMN_DIR DIRECT /end RECORD_LAYOUT
/begin RECORD_LAYOUT Lookup2D_LONG FNC_VALUES 1 SLONG COLUMN_DIR DIRECT /end RECORD_LAYOUT
/begin RECORD_LAYOUT Lookup2D_UBYTE FNC_VALUES 1 UBYTE COLUMN_DIR DIRECT /end RECORD_LAYOUT
/begin RECORD_LAYOUT Lookup2D_ULONG FNC_VALUES 1 ULONG COLUMN_DIR DIRECT /end RECORD_LAYOUT
/begin RECORD_LAYOUT Lookup2D_UWORD FNC_VALUES 1 UWORD COLUMN_DIR DIRECT /end RECORD_LAYOUT
/begin RECORD_LAYOUT Lookup2D_WORD FNC_VALUES 1 SWORD COLUMN_DIR DIRECT /end RECORD_LAYOUT
/begin RECORD_LAYOUT Lookup2D_X_BOOLEAN AXIS_PTS_X 1 UBYTE INDEX_INCR DIRECT /end RECORD_LAYOUT
/begin RECORD_LAYOUT Lookup2D_X_BYTE AXIS_PTS_X 1 SBYTE INDEX_INCR DIRECT /end RECORD_LAYOUT
/begin RECORD_LAYOUT Lookup2D_X_FLOAT32_IEEE AXIS_PTS_X 1 FLOAT32_IEEE INDEX_INCR DIRECT /end RECORD_LAYOUT
/begin RECORD_LAYOUT Lookup2D_X_FLOAT64_IEEE AXIS_PTS_X 1 FLOAT64_IEEE INDEX_INCR DIRECT /end RECORD_LAYOUT
/begin RECORD_LAYOUT Lookup2D_X_LONG AXIS_PTS_X 1 SLONG INDEX_INCR DIRECT /end RECORD_LAYOUT
/begin RECORD_LAYOUT Lookup2D_X_UBYTE AXIS_PTS_X 1 UBYTE INDEX_INCR DIRECT /end RECORD_LAYOUT
/begin RECORD_LAYOUT Lookup2D_X_ULONG AXIS_PTS_X 1 ULONG INDEX_INCR DIRECT /end RECORD_LAYOUT
/begin RECORD_LAYOUT Lookup2D_X_UWORD AXIS_PTS_X 1 UWORD INDEX_INCR DIRECT /end RECORD_LAYOUT
/begin RECORD_LAYOUT Lookup2D_X_WORD AXIS_PTS_X 1 SWORD INDEX_INCR DIRECT /end RECORD_LAYOUT
/begin RECORD_LAYOUT Scalar_BOOLEAN FNC_VALUES 1 UBYTE COLUMN_DIR DIRECT /end RECORD_LAYOUT
/begin RECORD_LAYOUT Scalar_BYTE FNC_VALUES 1 SBYTE COLUMN_DIR DIRECT /end RECORD_LAYOUT
/begin RECORD_LAYOUT Scalar_FLOAT32_IEEE FNC_VALUES 1 FLOAT32_IEEE COLUMN_DIR DIRECT /end RECORD_LAYOUT
/begin RECORD_LAYOUT Scalar_FLOAT64_IEEE FNC_VALUES 1 FLOAT64_IEEE COLUMN_DIR DIRECT /end RECORD_LAYOUT
/begin RECORD_LAYOUT Scalar_LONG FNC_VALUES 1 SLONG COLUMN_DIR DIRECT /end RECORD_LAYOUT
/begin RECORD_LAYOUT Scalar_SWORD FNC_VALUES 1 SWORD COLUMN_DIR DIRECT /end RECORD_LAYOUT
/begin RECORD_LAYOUT Scalar_UBYTE FNC_VALUES 1 UBYTE COLUMN_DIR DIRECT /end RECORD_LAYOUT
/begin RECORD_LAYOUT Scalar_ULONG FNC_VALUES 1 ULONG COLUMN_DIR DIRECT /end RECORD_LAYOUT
/begin RECORD_LAYOUT Scalar_UWORD FNC_VALUES 1 UWORD COLUMN_DIR DIRECT /end RECORD_LAYOUT
/begin GROUP LATC_Test_Calc "LATC_Test_Calc" ROOT /begin SUB_GROUP Root_LFunc /end SUB_GROUP /end GROUP
/begin GROUP Root_LFunc "LATC_Test_Calc/LFunc" /begin SUB_GROUP S2_EVI /end SUB_GROUP /end GROUP
/begin GROUP S2_EVI "LATC_Test_Calc/LFunc/EVI" /begin SUB_GROUP S50_VehicleStsCalc1 /end SUB_GROUP /end GROUP
/begin GROUP S50_VehicleStsCalc1 "LATC_Test_Calc/LFunc/EVI/VehicleStsCalc1" /begin SUB_GROUP S58_VxvRef_Calc /end SUB_GROUP /end GROUP
/begin GROUP S58_VxvRef_Calc "LATC_Test_Calc/LFunc/EVI/VehicleStsCalc1/VxvRef_Calc" /begin SUB_GROUP S63_VxvRef_Calc /end SUB_GROUP /end GROUP
/begin GROUP S63_VxvRef_Calc "LATC_Test_Calc/LFunc/EVI/VehicleStsCalc1/VxvRef_Calc/VxvRef_Calc" /begin SUB_GROUP S74_Enabled_Subsystem /end SUB_GROUP /end GROUP
/begin GROUP S74_Enabled_Subsystem "LATC_Test_Calc/LFunc/EVI/VehicleStsCalc1/VxvRef_Calc/VxvRef_Calc/Enabled Subsystem" /begin REF_CHARACTERISTIC P_Global_SteerAngleOffsetFilterTime /end REF_CHARACTERISTIC /end GROUP
/begin GROUP _RTTarget_internals "CANape RT-Target DLL internal diagnostic objects" ROOT /begin REF_MEASUREMENT RTTarget.ModelExecutionCounter RTTarget.ModelStepTime /end REF_MEASUREMENT /end GROUP
/begin GROUP _[Parameters] "All Parameters" /begin REF_CHARACTERISTIC P_Global_SteerAngleOffsetFilterTime /end REF_CHARACTERISTIC /end GROUP
/begin FUNCTION InputSignal1 "" /begin SUB_FUNCTION InputSignal1.CANapeIO_Veh_icleRX_AD2 /end SUB_FUNCTION /end FUNCTION
/begin FUNCTION InputSignal1.CANapeIO_Veh_icleRX_AD2 ""
 /begin SUB_FUNCTION InputSignal1.CANapeIO_Veh_icleRX_AD2.ABSActive InputSignal1.CANapeIO_Veh_icleRX_AD2.ABSFailSts InputSignal1.CANapeIO_Veh_icleRX_AD2.BTCActive InputSignal1.CANapeIO_Veh_icleRX_AD2.EBDFailSts InputSignal1.CANapeIO_Veh_icleRX_AD2.EPS_DrvInputTrqValue InputSignal1.CANapeIO_Veh_icleRX_AD2.EPS_FailSts InputSignal1.CANapeIO_Veh_icleRX_AD2.EPS_LKATorqOvrlDlvd InputSignal1.CANapeIO_Veh_icleRX_AD2.EPS_LKATorqOvrlDlvdValid InputSignal1.CANapeIO_Veh_icleRX_AD2.EPS_LKATrqOvlDlvdSts InputSignal1.CANapeIO_Veh_icleRX_AD2.EPS_LKATrqOvlDlvdSts1 InputSignal1.CANapeIO_Veh_icleRX_AD2.EPS_LKATrqOvlDlvdSts3 InputSignal1.CANapeIO_Veh_icleRX_AD2.EPS_LKATrqOvlDlvdSts4 InputSignal1.CANapeIO_Veh_icleRX_AD2.EPS_LKATrqOvlDlvdSts5 InputSignal1.CANapeIO_Veh_icleRX_AD2.EPS_SteerMod InputSignal1.CANapeIO_Veh_icleRX_AD2.ESPFailSts InputSignal1.CANapeIO_Veh_icleRX_AD2.ESP_MasterCylindBrakePress InputSignal1.CANapeIO_Veh_icleRX_AD2.ESP_MasterCylindBrakePressValid InputSignal1.CANapeIO_Veh_icleRX_AD2.FLWheelDriveDirection InputSignal1.CANapeIO_Veh_icleRX_AD2.FLWheelSpd InputSignal1.CANapeIO_Veh_icleRX_AD2.FLWheelSpdValid InputSignal1.CANapeIO_Veh_icleRX_AD2.FRWheelDriveDirection InputSignal1.CANapeIO_Veh_icleRX_AD2.FRWheelSpd InputSignal1.CANapeIO_Veh_icleRX_AD2.FRWheelSpdValid InputSignal1.CANapeIO_Veh_icleRX_AD2.LateralAcce InputSignal1.CANapeIO_Veh_icleRX_AD2.LateralAcceValid InputSignal1.CANapeIO_Veh_icleRX_AD2.LongitudeAcc InputSignal1.CANapeIO_Veh_icleRX_AD2.LongitudeAccValid InputSignal1.CANapeIO_Veh_icleRX_AD2.MSRActive InputSignal1.CANapeIO_Veh_icleRX_AD2.NoBrakeForce InputSignal1.CANapeIO_Veh_icleRX_AD2.PTCActive InputSignal1.CANapeIO_Veh_icleRX_AD2.RLWheelDriveDirection InputSignal1.CANapeIO_Veh_icleRX_AD2.RLWheelSpd InputSignal1.CANapeIO_Veh_icleRX_AD2.RLWheelSpdValid InputSignal1.CANapeIO_Veh_icleRX_AD2.RRWheelDriveDirection InputSignal1.CANapeIO_Veh_icleRX_AD2.RRWheelSpd InputSignal1.CANapeIO_Veh_icleRX_AD2.RRWheelSpdValid InputSignal1.CANapeIO_Veh_icleRX_AD2.SteerWheelAngle InputSignal1.CANapeIO_Veh_icleRX_AD2.SteerWheelAngleSign InputSignal1.CANapeIO_Veh_icleRX_AD2.SteerWheelSpd InputSignal1.CANapeIO_Veh_icleRX_AD2.SteerWheelSpdSign InputSignal1.CANapeIO_Veh_icleRX_AD2.VDCActive InputSignal1.CANapeIO_Veh_icleRX_AD2.VehDynYawRate InputSignal1.CANapeIO_Veh_icleRX_AD2.VehDynYawRateValid InputSignal1.CANapeIO_Veh_icleRX_AD2.VehicleSpd InputSignal1.CANapeIO_Veh_icleRX_AD2.VehicleSpdValid InputSignal1.CANapeIO_Veh_icleRX_AD2.VehicleStandstill /end SUB_FUNCTION
/end FUNCTION
/begin FUNCTION InputSignal1.CANapeIO_Veh_icleRX_AD2.ABSActive "" /end FUNCTION
/begin FUNCTION InputSignal1.CANapeIO_Veh_icleRX_AD2.ABSFailSts "" /end FUNCTION
/begin FUNCTION InputSignal1.CANapeIO_Veh_icleRX_AD2.BTCActive "" /end FUNCTION
/begin FUNCTION InputSignal1.CANapeIO_Veh_icleRX_AD2.EBDFailSts "" /end FUNCTION
/begin FUNCTION InputSignal1.CANapeIO_Veh_icleRX_AD2.EPS_DrvInputTrqValue "" /end FUNCTION
/begin FUNCTION InputSignal1.CANapeIO_Veh_icleRX_AD2.EPS_FailSts "" /end FUNCTION
/begin FUNCTION InputSignal1.CANapeIO_Veh_icleRX_AD2.EPS_LKATorqOvrlDlvd "" /end FUNCTION
/begin FUNCTION InputSignal1.CANapeIO_Veh_icleRX_AD2.EPS_LKATorqOvrlDlvdValid "" /end FUNCTION
/begin FUNCTION InputSignal1.CANapeIO_Veh_icleRX_AD2.EPS_LKATrqOvlDlvdSts "" /end FUNCTION
/begin FUNCTION InputSignal1.CANapeIO_Veh_icleRX_AD2.EPS_LKATrqOvlDlvdSts1 "" /end FUNCTION
/begin FUNCTION InputSignal1.CANapeIO_Veh_icleRX_AD2.EPS_LKATrqOvlDlvdSts3 "" /end FUNCTION
/begin FUNCTION InputSignal1.CANapeIO_Veh_icleRX_AD2.EPS_LKATrqOvlDlvdSts4 "" /end FUNCTION
/begin FUNCTION InputSignal1.CANapeIO_Veh_icleRX_AD2.EPS_LKATrqOvlDlvdSts5 "" /end FUNCTION
/begin FUNCTION InputSignal1.CANapeIO_Veh_icleRX_AD2.EPS_SteerMod "" /end FUNCTION
/begin FUNCTION InputSignal1.CANapeIO_Veh_icleRX_AD2.ESPFailSts "" /end FUNCTION
/begin FUNCTION InputSignal1.CANapeIO_Veh_icleRX_AD2.ESP_MasterCylindBrakePress "" /end FUNCTION
/begin FUNCTION InputSignal1.CANapeIO_Veh_icleRX_AD2.ESP_MasterCylindBrakePressValid "" /end FUNCTION
/begin FUNCTION InputSignal1.CANapeIO_Veh_icleRX_AD2.FLWheelDriveDirection "" /end FUNCTION
/begin FUNCTION InputSignal1.CANapeIO_Veh_icleRX_AD2.FLWheelSpd "" /end FUNCTION
/begin FUNCTION InputSignal1.CANapeIO_Veh_icleRX_AD2.FLWheelSpdValid "" /end FUNCTION
/begin FUNCTION InputSignal1.CANapeIO_Veh_icleRX_AD2.FRWheelDriveDirection "" /end FUNCTION
/begin FUNCTION InputSignal1.CANapeIO_Veh_icleRX_AD2.FRWheelSpd "" /end FUNCTION
/begin FUNCTION InputSignal1.CANapeIO_Veh_icleRX_AD2.FRWheelSpdValid "" /end FUNCTION
/begin FUNCTION InputSignal1.CANapeIO_Veh_icleRX_AD2.LateralAcce "" /end FUNCTION
/begin FUNCTION InputSignal1.CANapeIO_Veh_icleRX_AD2.LateralAcceValid "" /end FUNCTION
/begin FUNCTION InputSignal1.CANapeIO_Veh_icleRX_AD2.LongitudeAcc "" /end FUNCTION
/begin FUNCTION InputSignal1.CANapeIO_Veh_icleRX_AD2.LongitudeAccValid "" /end FUNCTION
/begin FUNCTION InputSignal1.CANapeIO_Veh_icleRX_AD2.MSRActive "" /end FUNCTION
/begin FUNCTION InputSignal1.CANapeIO_Veh_icleRX_AD2.NoBrakeForce "" /end FUNCTION
/begin FUNCTION InputSignal1.CANapeIO_Veh_icleRX_AD2.PTCActive "" /end FUNCTION
/begin FUNCTION InputSignal1.CANapeIO_Veh_icleRX_AD2.RLWheelDriveDirection "" /end FUNCTION
/begin FUNCTION InputSignal1.CANapeIO_Veh_icleRX_AD2.RLWheelSpd "" /end FUNCTION
/begin FUNCTION InputSignal1.CANapeIO_Veh_icleRX_AD2.RLWheelSpdValid "" /end FUNCTION
/begin FUNCTION InputSignal1.CANapeIO_Veh_icleRX_AD2.RRWheelDriveDirection "" /end FUNCTION
/begin FUNCTION InputSignal1.CANapeIO_Veh_icleRX_AD2.RRWheelSpd "" /end FUNCTION
/begin FUNCTION InputSignal1.CANapeIO_Veh_icleRX_AD2.RRWheelSpdValid "" /end FUNCTION
/begin FUNCTION InputSignal1.CANapeIO_Veh_icleRX_AD2.SteerWheelAngle "" /end FUNCTION
/begin FUNCTION InputSignal1.CANapeIO_Veh_icleRX_AD2.SteerWheelAngleSign "" /end FUNCTION
/begin FUNCTION InputSignal1.CANapeIO_Veh_icleRX_AD2.SteerWheelSpd "" /end FUNCTION
/begin FUNCTION InputSignal1.CANapeIO_Veh_icleRX_AD2.SteerWheelSpdSign "" /end FUNCTION
/begin FUNCTION InputSignal1.CANapeIO_Veh_icleRX_AD2.VDCActive "" /end FUNCTION
/begin FUNCTION InputSignal1.CANapeIO_Veh_icleRX_AD2.VehDynYawRate "" /end FUNCTION
/begin FUNCTION InputSignal1.CANapeIO_Veh_icleRX_AD2.VehDynYawRateValid "" /end FUNCTION
/begin FUNCTION InputSignal1.CANapeIO_Veh_icleRX_AD2.VehicleSpd "" /end FUNCTION
/begin FUNCTION InputSignal1.CANapeIO_Veh_icleRX_AD2.VehicleSpdValid "" /end FUNCTION
/begin FUNCTION InputSignal1.CANapeIO_Veh_icleRX_AD2.VehicleStandstill "" /end FUNCTION
/begin FUNCTION LFunc ""
 /begin SUB_FUNCTION LFunc.EVI LFunc.Trigger_Init LFunc.Trigger_Init1 LFunc.Trigger_Init2 LFunc.Trigger_Init3 LFunc.Trigger_Init4 LFunc.Trigger_Init5 LFunc.U_Road_Create /end SUB_FUNCTION
/end FUNCTION
/begin FUNCTION LFunc.EVI "" /begin SUB_FUNCTION LFunc.EVI.VehicleStsCalc1 /end SUB_FUNCTION /end FUNCTION
/begin FUNCTION LFunc.EVI.VehicleStsCalc1 ""
 /begin SUB_FUNCTION LFunc.EVI.VehicleStsCalc1.AxRef LFunc.EVI.VehicleStsCalc1.Compare_To_Constant1 LFunc.EVI.VehicleStsCalc1.FloatMeanValue LFunc.EVI.VehicleStsCalc1.Gain1 LFunc.EVI.VehicleStsCalc1.Memory2 LFunc.EVI.VehicleStsCalc1.Memory4 LFunc.EVI.VehicleStsCalc1.PsiDtStandstillCalc LFunc.EVI.VehicleStsCalc1.Sum3 LFunc.EVI.VehicleStsCalc1.VxvRef_Calc LFunc.EVI.VehicleStsCalc1.W LFunc.EVI.VehicleStsCalc1.alpSumSlideCurveness /end SUB_FUNCTION
/end FUNCTION
/begin FUNCTION LFunc.EVI.VehicleStsCalc1.AxRef ""
 /begin SUB_FUNCTION LFunc.EVI.VehicleStsCalc1.AxRef.LP_filter LFunc.EVI.VehicleStsCalc1.AxRef.axvRoadSlope_calc /end SUB_FUNCTION
/end FUNCTION
/begin FUNCTION LFunc.EVI.VehicleStsCalc1.AxRef.LP_filter "" /end FUNCTION
/begin FUNCTION LFunc.EVI.VehicleStsCalc1.AxRef.axvRoadSlope_calc ""
 /begin SUB_FUNCTION LFunc.EVI.VehicleStsCalc1.AxRef.axvRoadSlope_calc.Gain16 LFunc.EVI.VehicleStsCalc1.AxRef.axvRoadSlope_calc.LP_filter LFunc.EVI.VehicleStsCalc1.AxRef.axvRoadSlope_calc.Sum1 LFunc.EVI.VehicleStsCalc1.AxRef.axvRoadSlope_calc.Sum7 LFunc.EVI.VehicleStsCalc1.AxRef.axvRoadSlope_calc.t_FiltaxvRoadSlope /end SUB_FUNCTION
/end FUNCTION
/begin FUNCTION LFunc.EVI.VehicleStsCalc1.AxRef.axvRoadSlope_calc.Gain16 "" /end FUNCTION
/begin FUNCTION LFunc.EVI.VehicleStsCalc1.AxRef.axvRoadSlope_calc.LP_filter "" /end FUNCTION
/begin FUNCTION LFunc.EVI.VehicleStsCalc1.AxRef.axvRoadSlope_calc.Sum1 "" /end FUNCTION
/begin FUNCTION LFunc.EVI.VehicleStsCalc1.AxRef.axvRoadSlope_calc.Sum7 "" /end FUNCTION
/begin FUNCTION LFunc.EVI.VehicleStsCalc1.AxRef.axvRoadSlope_calc.t_FiltaxvRoadSlope "" /end FUNCTION
/begin FUNCTION LFunc.EVI.VehicleStsCalc1.Compare_To_Constant1 "" /end FUNCTION
/begin FUNCTION LFunc.EVI.VehicleStsCalc1.FloatMeanValue "" /begin SUB_FUNCTION LFunc.EVI.VehicleStsCalc1.FloatMeanValue.Gain /end SUB_FUNCTION /end FUNCTION
/begin FUNCTION LFunc.EVI.VehicleStsCalc1.FloatMeanValue.Gain "" /end FUNCTION
/begin FUNCTION LFunc.EVI.VehicleStsCalc1.Gain1 "" /end FUNCTION
/begin FUNCTION LFunc.EVI.VehicleStsCalc1.Memory2 "" /end FUNCTION
/begin FUNCTION LFunc.EVI.VehicleStsCalc1.Memory4 "" /end FUNCTION
/begin FUNCTION LFunc.EVI.VehicleStsCalc1.PsiDtStandstillCalc "" /end FUNCTION
/begin FUNCTION LFunc.EVI.VehicleStsCalc1.Sum3 "" /end FUNCTION
/begin FUNCTION LFunc.EVI.VehicleStsCalc1.VxvRef_Calc ""
 /begin SUB_FUNCTION LFunc.EVI.VehicleStsCalc1.VxvRef_Calc.DriveDirection LFunc.EVI.VehicleStsCalc1.VxvRef_Calc.DriveDirection1 LFunc.EVI.VehicleStsCalc1.VxvRef_Calc.DriveDirection2 LFunc.EVI.VehicleStsCalc1.VxvRef_Calc.DriveDirection3 LFunc.EVI.VehicleStsCalc1.VxvRef_Calc.Product6 LFunc.EVI.VehicleStsCalc1.VxvRef_Calc.VxvRef_Calc LFunc.EVI.VehicleStsCalc1.VxvRef_Calc.t_tauAxvRef /end SUB_FUNCTION
/end FUNCTION
/begin FUNCTION LFunc.EVI.VehicleStsCalc1.VxvRef_Calc.DriveDirection ""
 /begin SUB_FUNCTION LFunc.EVI.VehicleStsCalc1.VxvRef_Calc.DriveDirection.Switch_Case_Action_Subsystem LFunc.EVI.VehicleStsCalc1.VxvRef_Calc.DriveDirection.Switch_Case_Action_Subsystem1 LFunc.EVI.VehicleStsCalc1.VxvRef_Calc.DriveDirection.Switch_Case_Action_Subsystem2 LFunc.EVI.VehicleStsCalc1.VxvRef_Calc.DriveDirection.Switch_Case_Action_Subsystem3 /end SUB_FUNCTION
/end FUNCTION
/begin FUNCTION LFunc.EVI.VehicleStsCalc1.VxvRef_Calc.DriveDirection.Switch_Case_Action_Subsystem "" /end FUNCTION
/begin FUNCTION LFunc.EVI.VehicleStsCalc1.VxvRef_Calc.DriveDirection.Switch_Case_Action_Subsystem1 "" /end FUNCTION
/begin FUNCTION LFunc.EVI.VehicleStsCalc1.VxvRef_Calc.DriveDirection.Switch_Case_Action_Subsystem2 "" /end FUNCTION
/begin FUNCTION LFunc.EVI.VehicleStsCalc1.VxvRef_Calc.DriveDirection.Switch_Case_Action_Subsystem3 "" /end FUNCTION
/begin FUNCTION LFunc.EVI.VehicleStsCalc1.VxvRef_Calc.DriveDirection1 ""
 /begin SUB_FUNCTION LFunc.EVI.VehicleStsCalc1.VxvRef_Calc.DriveDirection1.Switch_Case_Action_Subsystem LFunc.EVI.VehicleStsCalc1.VxvRef_Calc.DriveDirection1.Switch_Case_Action_Subsystem1 LFunc.EVI.VehicleStsCalc1.VxvRef_Calc.DriveDirection1.Switch_Case_Action_Subsystem2 LFunc.EVI.VehicleStsCalc1.VxvRef_Calc.DriveDirection1.Switch_Case_Action_Subsystem3 /end SUB_FUNCTION
/end FUNCTION
/begin FUNCTION LFunc.EVI.VehicleStsCalc1.VxvRef_Calc.DriveDirection1.Switch_Case_Action_Subsystem "" /end FUNCTION
/begin FUNCTION LFunc.EVI.VehicleStsCalc1.VxvRef_Calc.DriveDirection1.Switch_Case_Action_Subsystem1 "" /end FUNCTION
/begin FUNCTION LFunc.EVI.VehicleStsCalc1.VxvRef_Calc.DriveDirection1.Switch_Case_Action_Subsystem2 "" /end FUNCTION
/begin FUNCTION LFunc.EVI.VehicleStsCalc1.VxvRef_Calc.DriveDirection1.Switch_Case_Action_Subsystem3 "" /end FUNCTION
/begin FUNCTION LFunc.EVI.VehicleStsCalc1.VxvRef_Calc.DriveDirection2 ""
 /begin SUB_FUNCTION LFunc.EVI.VehicleStsCalc1.VxvRef_Calc.DriveDirection2.Switch_Case_Action_Subsystem LFunc.EVI.VehicleStsCalc1.VxvRef_Calc.DriveDirection2.Switch_Case_Action_Subsystem1 LFunc.EVI.VehicleStsCalc1.VxvRef_Calc.DriveDirection2.Switch_Case_Action_Subsystem2 LFunc.EVI.VehicleStsCalc1.VxvRef_Calc.DriveDirection2.Switch_Case_Action_Subsystem3 /end SUB_FUNCTION
/end FUNCTION
/begin FUNCTION LFunc.EVI.VehicleStsCalc1.VxvRef_Calc.DriveDirection2.Switch_Case_Action_Subsystem "" /end FUNCTION
/begin FUNCTION LFunc.EVI.VehicleStsCalc1.VxvRef_Calc.DriveDirection2.Switch_Case_Action_Subsystem1 "" /end FUNCTION
/begin FUNCTION LFunc.EVI.VehicleStsCalc1.VxvRef_Calc.DriveDirection2.Switch_Case_Action_Subsystem2 "" /end FUNCTION
/begin FUNCTION LFunc.EVI.VehicleStsCalc1.VxvRef_Calc.DriveDirection2.Switch_Case_Action_Subsystem3 "" /end FUNCTION
/begin FUNCTION LFunc.EVI.VehicleStsCalc1.VxvRef_Calc.DriveDirection3 ""
 /begin SUB_FUNCTION LFunc.EVI.VehicleStsCalc1.VxvRef_Calc.DriveDirection3.Switch_Case_Action_Subsystem LFunc.EVI.VehicleStsCalc1.VxvRef_Calc.DriveDirection3.Switch_Case_Action_Subsystem1 LFunc.EVI.VehicleStsCalc1.VxvRef_Calc.DriveDirection3.Switch_Case_Action_Subsystem2 LFunc.EVI.VehicleStsCalc1.VxvRef_Calc.DriveDirection3.Switch_Case_Action_Subsystem3 /end SUB_FUNCTION
/end FUNCTION
/begin FUNCTION LFunc.EVI.VehicleStsCalc1.VxvRef_Calc.DriveDirection3.Switch_Case_Action_Subsystem "" /end FUNCTION
/begin FUNCTION LFunc.EVI.VehicleStsCalc1.VxvRef_Calc.DriveDirection3.Switch_Case_Action_Subsystem1 "" /end FUNCTION
/begin FUNCTION LFunc.EVI.VehicleStsCalc1.VxvRef_Calc.DriveDirection3.Switch_Case_Action_Subsystem2 "" /end FUNCTION
/begin FUNCTION LFunc.EVI.VehicleStsCalc1.VxvRef_Calc.DriveDirection3.Switch_Case_Action_Subsystem3 "" /end FUNCTION
/begin FUNCTION LFunc.EVI.VehicleStsCalc1.VxvRef_Calc.Product6 "" /end FUNCTION
/begin FUNCTION LFunc.EVI.VehicleStsCalc1.VxvRef_Calc.VxvRef_Calc ""
 /begin SUB_FUNCTION LFunc.EVI.VehicleStsCalc1.VxvRef_Calc.VxvRef_Calc.Compare_To_Constant1 LFunc.EVI.VehicleStsCalc1.VxvRef_Calc.VxvRef_Calc.Compare_To_Constant2 LFunc.EVI.VehicleStsCalc1.VxvRef_Calc.VxvRef_Calc.Compare_To_Constant3 LFunc.EVI.VehicleStsCalc1.VxvRef_Calc.VxvRef_Calc.Compare_To_Constant5 LFunc.EVI.VehicleStsCalc1.VxvRef_Calc.VxvRef_Calc.Compare_To_Constant6 LFunc.EVI.VehicleStsCalc1.VxvRef_Calc.VxvRef_Calc.Enabled_Subsystem /end SUB_FUNCTION
/end FUNCTION
/begin FUNCTION LFunc.EVI.VehicleStsCalc1.VxvRef_Calc.VxvRef_Calc.Compare_To_Constant1 "" /end FUNCTION
/begin FUNCTION LFunc.EVI.VehicleStsCalc1.VxvRef_Calc.VxvRef_Calc.Compare_To_Constant2 "" /end FUNCTION
/begin FUNCTION LFunc.EVI.VehicleStsCalc1.VxvRef_Calc.VxvRef_Calc.Compare_To_Constant3 "" /end FUNCTION
/begin FUNCTION LFunc.EVI.VehicleStsCalc1.VxvRef_Calc.VxvRef_Calc.Compare_To_Constant5 "" /end FUNCTION
/begin FUNCTION LFunc.EVI.VehicleStsCalc1.VxvRef_Calc.VxvRef_Calc.Compare_To_Constant6 "" /end FUNCTION
/begin FUNCTION LFunc.EVI.VehicleStsCalc1.VxvRef_Calc.VxvRef_Calc.Enabled_Subsystem ""
 /begin SUB_FUNCTION LFunc.EVI.VehicleStsCalc1.VxvRef_Calc.VxvRef_Calc.Enabled_Subsystem.FilterTime1 /end SUB_FUNCTION
/end FUNCTION
/begin FUNCTION LFunc.EVI.VehicleStsCalc1.VxvRef_Calc.VxvRef_Calc.Enabled_Subsystem.FilterTime1 "" /begin DEF_CHARACTERISTIC P_Global_SteerAngleOffsetFilterTime /end DEF_CHARACTERISTIC /end FUNCTION
/begin FUNCTION LFunc.EVI.VehicleStsCalc1.VxvRef_Calc.t_tauAxvRef "" /end FUNCTION
/begin FUNCTION LFunc.EVI.VehicleStsCalc1.W "" /end FUNCTION
/begin FUNCTION LFunc.EVI.VehicleStsCalc1.alpSumSlideCurveness "" /end FUNCTION
/begin FUNCTION LFunc.Trigger_Init "" /end FUNCTION
/begin FUNCTION LFunc.Trigger_Init1 "" /end FUNCTION
/begin FUNCTION LFunc.Trigger_Init2 "" /end FUNCTION
/begin FUNCTION LFunc.Trigger_Init3 "" /end FUNCTION
/begin FUNCTION LFunc.Trigger_Init4 "" /end FUNCTION
/begin FUNCTION LFunc.Trigger_Init5 "" /end FUNCTION
/begin FUNCTION LFunc.U_Road_Create ""
 /begin SUB_FUNCTION LFunc.U_Road_Create.Output6 LFunc.U_Road_Create.Output7 LFunc.U_Road_Create.RoadCreate1 LFunc.U_Road_Create.Trigger_Init1 LFunc.U_Road_Create.Trigger_Init2 LFunc.U_Road_Create.Trigger_Init3 /end SUB_FUNCTION
/end FUNCTION
/begin FUNCTION LFunc.U_Road_Create.Output6 "" /end FUNCTION
/begin FUNCTION LFunc.U_Road_Create.Output7 "" /end FUNCTION
/begin FUNCTION LFunc.U_Road_Create.RoadCreate1 "" /end FUNCTION
/begin FUNCTION LFunc.U_Road_Create.Trigger_Init1 "" /end FUNCTION
/begin FUNCTION LFunc.U_Road_Create.Trigger_Init2 "" /end FUNCTION
/begin FUNCTION LFunc.U_Road_Create.Trigger_Init3 "" /end FUNCTION
/end MODULE
/end PROJECT
