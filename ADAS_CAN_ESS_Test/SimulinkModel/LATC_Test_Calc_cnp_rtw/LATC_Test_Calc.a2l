/* * Vector CANape/vSignalyzer Target */
/* * Code generation for model "LATC_Test_Calc". */
/* * ASAP2 file name:             LATC_Test_Calc.a2l */
/* * Model version:               3.55 */
/* * Simulink Coder version:      9.6 (R2021b) 14-May-2021 */
/* * C source code generated on:  Fri Dec 31 09:15:34 2021 */
/* * Target selection:            cnp.tlc */
/* * Target version:              14.0.2 */ ASAP2_VERSION 1 51
/begin PROJECT ProjectName "Project Comment Goes Here"
/begin HEADER "Header Comments go here" /end HEADER
/begin MODULE ModuleName "Module Comment Goes Here"
/begin MOD_PAR "MOD PAR Comment Goes Here" /end MOD_PAR
/begin MOD_COMMON "Mod Common Comment Here" BYTE_ORDER MSB_LAST ALIGNMENT_BYTE 1 ALIGNMENT_WORD 2 ALIGNMENT_LONG 4 ALIGNMENT_FLOAT32_IEEE 4 ALIGNMENT_FLOAT64_IEEE 8 /end MOD_COMMON
/begin IF_DATA XCP
 /begin PROTOCOL_LAYER 0x0100 0x03E8 0x2710 0x00 0x00 0x00 0x00 0x00 0xFF 0xFF BYTE_ORDER_MSB_LAST ADDRESS_GRANULARITY_BYTE COMMUNICATION_MODE_SUPPORTED BLOCK MASTER 0x2B 0x00 SEED_AND_KEY_EXTERNAL_FUNCTION "SeedNKeyXcp.dll" /end PROTOCOL_LAYER
 /begin DAQ DYNAMIC 0x00 0x06 0x00 OPTIMISATION_TYPE_DEFAULT ADDRESS_EXTENSION_FREE IDENTIFICATION_FIELD_TYPE_RELATIVE_BYTE GRANULARITY_ODT_ENTRY_SIZE_DAQ_BYTE 0x06 OVERLOAD_INDICATION_PID PRESCALER_SUPPORTED /begin TIMESTAMP_SUPPORTED 0x01 SIZE_DWORD UNIT_100US /end TIMESTAMP_SUPPORTED
  /begin EVENT "on LATC_Test_Calc calculated" "" 0x00 DAQ 0xFF 0x00 0x06 0x00 /end EVENT
 /end DAQ
 /begin XCP_ON_SIMULINK MODEL_NAME "LATC_Test_Calc" /end XCP_ON_SIMULINK
/end IF_DATA
/begin MEASUREMENT LCS_A2_LatAcc "" FLOAT32_IEEE LATC_Test_Calc_CM_single 0 0 -3.4028234660000002E+38 3.4028234660000002E+38 ECU_ADDRESS 0x168FC0
 /begin IF_DATA XCP
  /begin DAQ_EVENT FIXED_EVENT_LIST EVENT 0x00 /end DAQ_EVENT
 /end IF_DATA
/end MEASUREMENT
/begin MEASUREMENT LCS_A2_LatAccFac "" FLOAT32_IEEE LATC_Test_Calc_CM_single 0 0 -3.4028234660000002E+38 3.4028234660000002E+38 ECU_ADDRESS 0x168FBC
 /begin IF_DATA XCP
  /begin DAQ_EVENT FIXED_EVENT_LIST EVENT 0x00 /end DAQ_EVENT
 /end IF_DATA
/end MEASUREMENT
/begin MEASUREMENT LCS_AngleSlope_Cnt "" UWORD LATC_Test_Calc_CM_uint16 0 0 0 65535 ECU_ADDRESS 0x168F5E
 /begin IF_DATA XCP
  /begin DAQ_EVENT FIXED_EVENT_LIST EVENT 0x00 /end DAQ_EVENT
 /end IF_DATA
/end MEASUREMENT
/begin MEASUREMENT LCS_AngleSlope_Flg "" UBYTE LATC_Test_Calc_CM_uint8 0 0 0 255 ECU_ADDRESS 0x168F5A
 /begin IF_DATA XCP
  /begin DAQ_EVENT FIXED_EVENT_LIST EVENT 0x00 /end DAQ_EVENT
 /end IF_DATA
/end MEASUREMENT
/begin MEASUREMENT LCS_CurSteerAngle_deg "" FLOAT32_IEEE LATC_Test_Calc_CM_single 0 0 -3.4028234660000002E+38 3.4028234660000002E+38 ECU_ADDRESS 0x168FFC
 /begin IF_DATA XCP
  /begin DAQ_EVENT FIXED_EVENT_LIST EVENT 0x00 /end DAQ_EVENT
 /end IF_DATA
/end MEASUREMENT
/begin MEASUREMENT LCS_DeltaAngle "" FLOAT64_IEEE LATC_Test_Calc_CM_double 0 0 -1.7976931348623157E+308 1.7976931348623157E+308 ECU_ADDRESS 0x169010
 /begin IF_DATA XCP
  /begin DAQ_EVENT FIXED_EVENT_LIST EVENT 0x00 /end DAQ_EVENT
 /end IF_DATA
/end MEASUREMENT
/begin MEASUREMENT LCS_DisplaySpd_kph "" FLOAT32_IEEE LATC_Test_Calc_CM_single 0 0 -3.4028234660000002E+38 3.4028234660000002E+38 ECU_ADDRESS 0x169008
 /begin IF_DATA XCP
  /begin DAQ_EVENT FIXED_EVENT_LIST EVENT 0x00 /end DAQ_EVENT
 /end IF_DATA
/end MEASUREMENT
/begin MEASUREMENT LCS_ESS_TarAngle2 "" FLOAT32_IEEE LATC_Test_Calc_CM_single 0 0 -3.4028234660000002E+38 3.4028234660000002E+38 ECU_ADDRESS 0x168F78
 /begin IF_DATA XCP
  /begin DAQ_EVENT FIXED_EVENT_LIST EVENT 0x00 /end DAQ_EVENT
 /end IF_DATA
/end MEASUREMENT
/begin MEASUREMENT LCS_EqA0 "" FLOAT32_IEEE LATC_Test_Calc_CM_single 0 0 -3.4028234660000002E+38 3.4028234660000002E+38 ECU_ADDRESS 0x168FE4
 /begin IF_DATA XCP
  /begin DAQ_EVENT FIXED_EVENT_LIST EVENT 0x00 /end DAQ_EVENT
 /end IF_DATA
/end MEASUREMENT
/begin MEASUREMENT LCS_HoldTime "" FLOAT64_IEEE LATC_Test_Calc_CM_double 0 0 -1.7976931348623157E+308 1.7976931348623157E+308 ECU_ADDRESS 0x169018
 /begin IF_DATA XCP
  /begin DAQ_EVENT FIXED_EVENT_LIST EVENT 0x00 /end DAQ_EVENT
 /end IF_DATA
/end MEASUREMENT
/begin MEASUREMENT LCS_IN_CurSteerAngle_deg "" FLOAT32_IEEE LATC_Test_Calc_CM_single 0 0 -3.4028234660000002E+38 3.4028234660000002E+38 ECU_ADDRESS 0x169000
 /begin IF_DATA XCP
  /begin DAQ_EVENT FIXED_EVENT_LIST EVENT 0x00 /end DAQ_EVENT
 /end IF_DATA
/end MEASUREMENT
/begin MEASUREMENT LCS_IN_SteerAngleSpd_degs "" FLOAT32_IEEE LATC_Test_Calc_CM_single 0 0 -3.4028234660000002E+38 3.4028234660000002E+38 ECU_ADDRESS 0x169004
 /begin IF_DATA XCP
  /begin DAQ_EVENT FIXED_EVENT_LIST EVENT 0x00 /end DAQ_EVENT
 /end IF_DATA
/end MEASUREMENT
/begin MEASUREMENT LCS_IN_TarDangerLevel "" UBYTE LATC_Test_Calc_CM_uint8 0 0 0 255 ECU_ADDRESS 0x168F5C
 /begin IF_DATA XCP
  /begin DAQ_EVENT FIXED_EVENT_LIST EVENT 0x00 /end DAQ_EVENT
 /end IF_DATA
/end MEASUREMENT
/begin MEASUREMENT LCS_IN_TarDangerlLevel "" UBYTE LATC_Test_Calc_CM_uint8 0 0 0 255 ECU_ADDRESS 0x168F5D
 /begin IF_DATA XCP
  /begin DAQ_EVENT FIXED_EVENT_LIST EVENT 0x00 /end DAQ_EVENT
 /end IF_DATA
/end MEASUREMENT
/begin MEASUREMENT LCS_IN_desLaneA0 "" FLOAT32_IEEE LATC_Test_Calc_CM_single 0 0 -3.4028234660000002E+38 3.4028234660000002E+38 ECU_ADDRESS 0x168FF8
 /begin IF_DATA XCP
  /begin DAQ_EVENT FIXED_EVENT_LIST EVENT 0x00 /end DAQ_EVENT
 /end IF_DATA
/end MEASUREMENT
/begin MEASUREMENT LCS_IN_desLaneA1 "" FLOAT32_IEEE LATC_Test_Calc_CM_single 0 0 -3.4028234660000002E+38 3.4028234660000002E+38 ECU_ADDRESS 0x168FF0
 /begin IF_DATA XCP
  /begin DAQ_EVENT FIXED_EVENT_LIST EVENT 0x00 /end DAQ_EVENT
 /end IF_DATA
/end MEASUREMENT
/begin MEASUREMENT LCS_IN_desLaneA2 "" FLOAT32_IEEE LATC_Test_Calc_CM_single 0 0 -3.4028234660000002E+38 3.4028234660000002E+38 ECU_ADDRESS 0x168FF4
 /begin IF_DATA XCP
  /begin DAQ_EVENT FIXED_EVENT_LIST EVENT 0x00 /end DAQ_EVENT
 /end IF_DATA
/end MEASUREMENT
/begin MEASUREMENT LCS_IN_desLaneA3 "" FLOAT32_IEEE LATC_Test_Calc_CM_single 0 0 -3.4028234660000002E+38 3.4028234660000002E+38 ECU_ADDRESS 0x168FEC
 /begin IF_DATA XCP
  /begin DAQ_EVENT FIXED_EVENT_LIST EVENT 0x00 /end DAQ_EVENT
 /end IF_DATA
/end MEASUREMENT
/begin MEASUREMENT LCS_IN_desLaneValid "" UBYTE LATC_Test_Calc_CM_boolean 0 0 0 1 ECU_ADDRESS 0x168F59
 /begin IF_DATA XCP
  /begin DAQ_EVENT FIXED_EVENT_LIST EVENT 0x00 /end DAQ_EVENT
 /end IF_DATA
/end MEASUREMENT
/begin MEASUREMENT LCS_IsOverRide "" UBYTE LATC_Test_Calc_CM_boolean 0 0 0 1 ECU_ADDRESS 0x168F58
 /begin IF_DATA XCP
  /begin DAQ_EVENT FIXED_EVENT_LIST EVENT 0x00 /end DAQ_EVENT
 /end IF_DATA
/end MEASUREMENT
/begin MEASUREMENT LCS_LCKPredis "" FLOAT32_IEEE LATC_Test_Calc_CM_single 0 0 -3.4028234660000002E+38 3.4028234660000002E+38 ECU_ADDRESS 0x168FAC
 /begin IF_DATA XCP
  /begin DAQ_EVENT FIXED_EVENT_LIST EVENT 0x00 /end DAQ_EVENT
 /end IF_DATA
/end MEASUREMENT
/begin MEASUREMENT LCS_LCKPredisFac "" FLOAT32_IEEE LATC_Test_Calc_CM_single 0 0 -3.4028234660000002E+38 3.4028234660000002E+38 ECU_ADDRESS 0x168FC4
 /begin IF_DATA XCP
  /begin DAQ_EVENT FIXED_EVENT_LIST EVENT 0x00 /end DAQ_EVENT
 /end IF_DATA
/end MEASUREMENT
/begin MEASUREMENT LCS_LCK_CurveFac "" FLOAT32_IEEE LATC_Test_Calc_CM_single 0 0 -3.4028234660000002E+38 3.4028234660000002E+38 ECU_ADDRESS 0x168FB0
 /begin IF_DATA XCP
  /begin DAQ_EVENT FIXED_EVENT_LIST EVENT 0x00 /end DAQ_EVENT
 /end IF_DATA
/end MEASUREMENT
/begin MEASUREMENT LCS_LCType "" UBYTE LATC_Test_Calc_CM_uint8 0 0 0 255 ECU_ADDRESS 0x168F5B
 /begin IF_DATA XCP
  /begin DAQ_EVENT FIXED_EVENT_LIST EVENT 0x00 /end DAQ_EVENT
 /end IF_DATA
/end MEASUREMENT
/begin MEASUREMENT LCS_LC_AESPredisFac "" FLOAT32_IEEE LATC_Test_Calc_CM_single 0 0 -3.4028234660000002E+38 3.4028234660000002E+38 ECU_ADDRESS 0x168F90
 /begin IF_DATA XCP
  /begin DAQ_EVENT FIXED_EVENT_LIST EVENT 0x00 /end DAQ_EVENT
 /end IF_DATA
/end MEASUREMENT
/begin MEASUREMENT LCS_LC_Complete_PreDisFac "" FLOAT32_IEEE LATC_Test_Calc_CM_single 0 0 -3.4028234660000002E+38 3.4028234660000002E+38 ECU_ADDRESS 0x168FC8
 /begin IF_DATA XCP
  /begin DAQ_EVENT FIXED_EVENT_LIST EVENT 0x00 /end DAQ_EVENT
 /end IF_DATA
/end MEASUREMENT
/begin MEASUREMENT LCS_LC_ELKPredis "" FLOAT32_IEEE LATC_Test_Calc_CM_single 0 0 -3.4028234660000002E+38 3.4028234660000002E+38 ECU_ADDRESS 0x168FA4
 /begin IF_DATA XCP
  /begin DAQ_EVENT FIXED_EVENT_LIST EVENT 0x00 /end DAQ_EVENT
 /end IF_DATA
/end MEASUREMENT
/begin MEASUREMENT LCS_LC_ELKPredisFac "" FLOAT32_IEEE LATC_Test_Calc_CM_single 0 0 -3.4028234660000002E+38 3.4028234660000002E+38 ECU_ADDRESS 0x168FA8
 /begin IF_DATA XCP
  /begin DAQ_EVENT FIXED_EVENT_LIST EVENT 0x00 /end DAQ_EVENT
 /end IF_DATA
/end MEASUREMENT
/begin MEASUREMENT LCS_LC_ESSPredis "" FLOAT32_IEEE LATC_Test_Calc_CM_single 0 0 -3.4028234660000002E+38 3.4028234660000002E+38 ECU_ADDRESS 0x168F9C
 /begin IF_DATA XCP
  /begin DAQ_EVENT FIXED_EVENT_LIST EVENT 0x00 /end DAQ_EVENT
 /end IF_DATA
/end MEASUREMENT
/begin MEASUREMENT LCS_LC_ESSPredisFac "" FLOAT32_IEEE LATC_Test_Calc_CM_single 0 0 -3.4028234660000002E+38 3.4028234660000002E+38 ECU_ADDRESS 0x168FA0
 /begin IF_DATA XCP
  /begin DAQ_EVENT FIXED_EVENT_LIST EVENT 0x00 /end DAQ_EVENT
 /end IF_DATA
/end MEASUREMENT
/begin MEASUREMENT LCS_LC_EcoPredis "" FLOAT32_IEEE LATC_Test_Calc_CM_single 0 0 -3.4028234660000002E+38 3.4028234660000002E+38 ECU_ADDRESS 0x168FD4
 /begin IF_DATA XCP
  /begin DAQ_EVENT FIXED_EVENT_LIST EVENT 0x00 /end DAQ_EVENT
 /end IF_DATA
/end MEASUREMENT
/begin MEASUREMENT LCS_LC_EcoPredisFac "" FLOAT32_IEEE LATC_Test_Calc_CM_single 0 0 -3.4028234660000002E+38 3.4028234660000002E+38 ECU_ADDRESS 0x168FD8
 /begin IF_DATA XCP
  /begin DAQ_EVENT FIXED_EVENT_LIST EVENT 0x00 /end DAQ_EVENT
 /end IF_DATA
/end MEASUREMENT
/begin MEASUREMENT LCS_LC_LCPredis "" FLOAT32_IEEE LATC_Test_Calc_CM_single 0 0 -3.4028234660000002E+38 3.4028234660000002E+38 ECU_ADDRESS 0x168F94
 /begin IF_DATA XCP
  /begin DAQ_EVENT FIXED_EVENT_LIST EVENT 0x00 /end DAQ_EVENT
 /end IF_DATA
/end MEASUREMENT
/begin MEASUREMENT LCS_LC_LCPredisFac "" FLOAT32_IEEE LATC_Test_Calc_CM_single 0 0 -3.4028234660000002E+38 3.4028234660000002E+38 ECU_ADDRESS 0x168F98
 /begin IF_DATA XCP
  /begin DAQ_EVENT FIXED_EVENT_LIST EVENT 0x00 /end DAQ_EVENT
 /end IF_DATA
/end MEASUREMENT
/begin MEASUREMENT LCS_LC_NomalPredis "" FLOAT32_IEEE LATC_Test_Calc_CM_single 0 0 -3.4028234660000002E+38 3.4028234660000002E+38 ECU_ADDRESS 0x168FDC
 /begin IF_DATA XCP
  /begin DAQ_EVENT FIXED_EVENT_LIST EVENT 0x00 /end DAQ_EVENT
 /end IF_DATA
/end MEASUREMENT
/begin MEASUREMENT LCS_LC_NomalPredisFac "" FLOAT32_IEEE LATC_Test_Calc_CM_single 0 0 -3.4028234660000002E+38 3.4028234660000002E+38 ECU_ADDRESS 0x168FE0
 /begin IF_DATA XCP
  /begin DAQ_EVENT FIXED_EVENT_LIST EVENT 0x00 /end DAQ_EVENT
 /end IF_DATA
/end MEASUREMENT
/begin MEASUREMENT LCS_LC_SportPredis "" FLOAT32_IEEE LATC_Test_Calc_CM_single 0 0 -3.4028234660000002E+38 3.4028234660000002E+38 ECU_ADDRESS 0x168FCC
 /begin IF_DATA XCP
  /begin DAQ_EVENT FIXED_EVENT_LIST EVENT 0x00 /end DAQ_EVENT
 /end IF_DATA
/end MEASUREMENT
/begin MEASUREMENT LCS_LC_SportPredisFac "" FLOAT32_IEEE LATC_Test_Calc_CM_single 0 0 -3.4028234660000002E+38 3.4028234660000002E+38 ECU_ADDRESS 0x168FD0
 /begin IF_DATA XCP
  /begin DAQ_EVENT FIXED_EVENT_LIST EVENT 0x00 /end DAQ_EVENT
 /end IF_DATA
/end MEASUREMENT
/begin MEASUREMENT LCS_OUT_ReqEPSTrgAngle "" FLOAT32_IEEE LATC_Test_Calc_CM_single 0 0 -3.4028234660000002E+38 3.4028234660000002E+38 ECU_ADDRESS 0x168F6C
 /begin IF_DATA XCP
  /begin DAQ_EVENT FIXED_EVENT_LIST EVENT 0x00 /end DAQ_EVENT
 /end IF_DATA
/end MEASUREMENT
/begin MEASUREMENT LCS_Predis_BaseDis "" FLOAT32_IEEE LATC_Test_Calc_CM_single 0 0 -3.4028234660000002E+38 3.4028234660000002E+38 ECU_ADDRESS 0x168FE8
 /begin IF_DATA XCP
  /begin DAQ_EVENT FIXED_EVENT_LIST EVENT 0x00 /end DAQ_EVENT
 /end IF_DATA
/end MEASUREMENT
/begin MEASUREMENT LCS_Predis_Curve "" FLOAT32_IEEE LATC_Test_Calc_CM_single 0 0 -3.4028234660000002E+38 3.4028234660000002E+38 ECU_ADDRESS 0x168FB8
 /begin IF_DATA XCP
  /begin DAQ_EVENT FIXED_EVENT_LIST EVENT 0x00 /end DAQ_EVENT
 /end IF_DATA
/end MEASUREMENT
/begin MEASUREMENT LCS_Predis_CurveFac "" FLOAT32_IEEE LATC_Test_Calc_CM_single 0 0 -3.4028234660000002E+38 3.4028234660000002E+38 ECU_ADDRESS 0x168FB4
 /begin IF_DATA XCP
  /begin DAQ_EVENT FIXED_EVENT_LIST EVENT 0x00 /end DAQ_EVENT
 /end IF_DATA
/end MEASUREMENT
/begin MEASUREMENT LCS_Q "" FLOAT32_IEEE LATC_Test_Calc_CM_single 0 0 -3.4028234660000002E+38 3.4028234660000002E+38 ECU_ADDRESS 0x168F88
 /begin IF_DATA XCP
  /begin DAQ_EVENT FIXED_EVENT_LIST EVENT 0x00 /end DAQ_EVENT
 /end IF_DATA
/end MEASUREMENT
/begin MEASUREMENT LCS_ReqEPSTrgAngle "" FLOAT32_IEEE LATC_Test_Calc_CM_single 0 0 -3.4028234660000002E+38 3.4028234660000002E+38 ECU_ADDRESS 0x168F70
 /begin IF_DATA XCP
  /begin DAQ_EVENT FIXED_EVENT_LIST EVENT 0x00 /end DAQ_EVENT
 /end IF_DATA
/end MEASUREMENT
/begin MEASUREMENT LCS_StateActive_AngleSlope "" FLOAT32_IEEE LATC_Test_Calc_CM_single 0 0 -3.4028234660000002E+38 3.4028234660000002E+38 ECU_ADDRESS 0x168F84
 /begin IF_DATA XCP
  /begin DAQ_EVENT FIXED_EVENT_LIST EVENT 0x00 /end DAQ_EVENT
 /end IF_DATA
/end MEASUREMENT
/begin MEASUREMENT LCS_State_AngleSlope "" FLOAT32_IEEE LATC_Test_Calc_CM_single 0 0 -3.4028234660000002E+38 3.4028234660000002E+38 ECU_ADDRESS 0x168F80
 /begin IF_DATA XCP
  /begin DAQ_EVENT FIXED_EVENT_LIST EVENT 0x00 /end DAQ_EVENT
 /end IF_DATA
/end MEASUREMENT
/begin MEASUREMENT LCS_TarSteerAngle "" FLOAT32_IEEE LATC_Test_Calc_CM_single 0 0 -3.4028234660000002E+38 3.4028234660000002E+38 ECU_ADDRESS 0x168F68
 /begin IF_DATA XCP
  /begin DAQ_EVENT FIXED_EVENT_LIST EVENT 0x00 /end DAQ_EVENT
 /end IF_DATA
/end MEASUREMENT
/begin MEASUREMENT LCS_TarSteerAngleCalc_Num "" FLOAT32_IEEE LATC_Test_Calc_CM_single 0 0 -3.4028234660000002E+38 3.4028234660000002E+38 ECU_ADDRESS 0x168F60
 /begin IF_DATA XCP
  /begin DAQ_EVENT FIXED_EVENT_LIST EVENT 0x00 /end DAQ_EVENT
 /end IF_DATA
/end MEASUREMENT
/begin MEASUREMENT LCS_TarSteerAngleEnd "" FLOAT32_IEEE LATC_Test_Calc_CM_single 0 0 -3.4028234660000002E+38 3.4028234660000002E+38 ECU_ADDRESS 0x168F64
 /begin IF_DATA XCP
  /begin DAQ_EVENT FIXED_EVENT_LIST EVENT 0x00 /end DAQ_EVENT
 /end IF_DATA
/end MEASUREMENT
/begin MEASUREMENT LCS_TarSteerAngleSlope "" FLOAT32_IEEE LATC_Test_Calc_CM_single 0 0 -3.4028234660000002E+38 3.4028234660000002E+38 ECU_ADDRESS 0x168F7C
 /begin IF_DATA XCP
  /begin DAQ_EVENT FIXED_EVENT_LIST EVENT 0x00 /end DAQ_EVENT
 /end IF_DATA
/end MEASUREMENT
/begin MEASUREMENT LCS_TarSteerAngle_Filter "" FLOAT32_IEEE LATC_Test_Calc_CM_single 0 0 -3.4028234660000002E+38 3.4028234660000002E+38 ECU_ADDRESS 0x168F74
 /begin IF_DATA XCP
  /begin DAQ_EVENT FIXED_EVENT_LIST EVENT 0x00 /end DAQ_EVENT
 /end IF_DATA
/end MEASUREMENT
/begin MEASUREMENT LCS_finalPredis "" FLOAT32_IEEE LATC_Test_Calc_CM_single 0 0 -3.4028234660000002E+38 3.4028234660000002E+38 ECU_ADDRESS 0x168F8C
 /begin IF_DATA XCP
  /begin DAQ_EVENT FIXED_EVENT_LIST EVENT 0x00 /end DAQ_EVENT
 /end IF_DATA
/end MEASUREMENT
/begin AXIS_PTS P_LCS_A0_Dis_BP "" 0x102080 LCS_EqA0 Lookup2D_X_FLOAT32_IEEE 0 LATC_Test_Calc_CM_single 19 -3.4E+38 3.4E+38 /end AXIS_PTS
/begin CHARACTERISTIC P_LCS_A2S_FliterTime "" VALUE 0x102078 Scalar_FLOAT32_IEEE 0 LATC_Test_Calc_CM_single -3.4028234660000002E+38 3.4028234660000002E+38 /end CHARACTERISTIC
/begin AXIS_PTS P_LCS_A2_Curve_BP "" 0x1020D0 LCS_Predis_Curve Lookup1D_X_FLOAT32_IEEE 0 LATC_Test_Calc_CM_single 10 -3.4E+38 3.4E+38 /end AXIS_PTS
/begin AXIS_PTS P_LCS_A2_LatAcc_BP "" 0x1020F8 LCS_A2_LatAcc Lookup1D_X_FLOAT32_IEEE 0 LATC_Test_Calc_CM_single 5 -3.4E+38 3.4E+38 /end AXIS_PTS
/begin CHARACTERISTIC P_LCS_A2_Pretime "" VALUE 0x10207C Scalar_FLOAT32_IEEE 0 LATC_Test_Calc_CM_single -3.4028234660000002E+38 3.4028234660000002E+38 /end CHARACTERISTIC
/begin CHARACTERISTIC P_LCS_AngleFilterTime "" VALUE 0x1020CC Scalar_FLOAT32_IEEE 0 LATC_Test_Calc_CM_single -3.4028234660000002E+38 3.4028234660000002E+38 /end CHARACTERISTIC
/begin CHARACTERISTIC P_LCS_AngleSlope_AES_Active "" MAP 0x102110 Lookup2D_FLOAT32_IEEE 0 LATC_Test_Calc_CM_single -3.4E+38 3.4E+38
 /begin AXIS_DESCR COM_AXIS LCS_DisplaySpd_kph LATC_Test_Calc_CM_single 12 -3.4E+38 3.4E+38 AXIS_PTS_REF P_LCS_AngleSlope_Spd_BP /end AXIS_DESCR
 /begin AXIS_DESCR COM_AXIS LCS_EqA0 LATC_Test_Calc_CM_single 19 -3.4E+38 3.4E+38 AXIS_PTS_REF P_LCS_A0_Dis_BP /end AXIS_DESCR
/end CHARACTERISTIC
/begin CHARACTERISTIC P_LCS_AngleSlope_ELK "" MAP 0x1024A0 Lookup2D_FLOAT32_IEEE 0 LATC_Test_Calc_CM_single -3.4E+38 3.4E+38
 /begin AXIS_DESCR COM_AXIS LCS_DisplaySpd_kph LATC_Test_Calc_CM_single 12 -3.4E+38 3.4E+38 AXIS_PTS_REF P_LCS_AngleSlope_Spd_BP /end AXIS_DESCR
 /begin AXIS_DESCR COM_AXIS NO_INPUT_QUANTITY LATC_Test_Calc_CM_single 19 -3.4E+38 3.4E+38 AXIS_PTS_REF P_LCS_A0_Dis_BP /end AXIS_DESCR
/end CHARACTERISTIC
/begin CHARACTERISTIC P_LCS_AngleSlope_ESS "" MAP 0x102830 Lookup2D_FLOAT32_IEEE 0 LATC_Test_Calc_CM_single -3.4E+38 3.4E+38
 /begin AXIS_DESCR COM_AXIS LCS_DisplaySpd_kph LATC_Test_Calc_CM_single 12 -3.4E+38 3.4E+38 AXIS_PTS_REF P_LCS_AngleSlope_Spd_BP /end AXIS_DESCR
 /begin AXIS_DESCR COM_AXIS LCS_EqA0 LATC_Test_Calc_CM_single 19 -3.4E+38 3.4E+38 AXIS_PTS_REF P_LCS_A0_Dis_BP /end AXIS_DESCR
/end CHARACTERISTIC
/begin CHARACTERISTIC P_LCS_AngleSlope_ESS_Add "" MAP 0x102BC0 Lookup2D_FLOAT32_IEEE 0 LATC_Test_Calc_CM_single -3.4E+38 3.4E+38
 /begin AXIS_DESCR COM_AXIS LCS_DisplaySpd_kph LATC_Test_Calc_CM_single 12 -3.4E+38 3.4E+38 AXIS_PTS_REF P_LCS_AngleSlope_Spd_BP /end AXIS_DESCR
 /begin AXIS_DESCR COM_AXIS LCS_EqA0 LATC_Test_Calc_CM_single 19 -3.4E+38 3.4E+38 AXIS_PTS_REF P_LCS_A0_Dis_BP /end AXIS_DESCR
/end CHARACTERISTIC
/begin CHARACTERISTIC P_LCS_AngleSlope_LCK "" MAP 0x102F50 Lookup2D_FLOAT32_IEEE 0 LATC_Test_Calc_CM_single -3.4E+38 3.4E+38
 /begin AXIS_DESCR COM_AXIS LCS_DisplaySpd_kph LATC_Test_Calc_CM_single 12 -3.4E+38 3.4E+38 AXIS_PTS_REF P_LCS_AngleSlope_Spd_BP /end AXIS_DESCR
 /begin AXIS_DESCR COM_AXIS NO_INPUT_QUANTITY LATC_Test_Calc_CM_single 19 -3.4E+38 3.4E+38 AXIS_PTS_REF P_LCS_A0_Dis_BP /end AXIS_DESCR
/end CHARACTERISTIC
/begin CHARACTERISTIC P_LCS_AngleSlope_LCKIE "" MAP 0x1032E0 Lookup2D_FLOAT32_IEEE 0 LATC_Test_Calc_CM_single -3.4E+38 3.4E+38
 /begin AXIS_DESCR COM_AXIS LCS_DisplaySpd_kph LATC_Test_Calc_CM_single 12 -3.4E+38 3.4E+38 AXIS_PTS_REF P_LCS_AngleSlope_Spd_BP /end AXIS_DESCR
 /begin AXIS_DESCR COM_AXIS NO_INPUT_QUANTITY LATC_Test_Calc_CM_single 19 -3.4E+38 3.4E+38 AXIS_PTS_REF P_LCS_A0_Dis_BP /end AXIS_DESCR
/end CHARACTERISTIC
/begin CHARACTERISTIC P_LCS_AngleSlope_LCK_Curve_Fac "" CURVE 0x103670 Lookup1D_FLOAT32_IEEE 0 LATC_Test_Calc_CM_single -3.4E+38 3.4E+38
 /begin AXIS_DESCR COM_AXIS LCS_Predis_Curve LATC_Test_Calc_CM_single 10 -3.4E+38 3.4E+38 AXIS_PTS_REF P_LCS_A2_Curve_BP /end AXIS_DESCR
/end CHARACTERISTIC
/begin CHARACTERISTIC P_LCS_AngleSlope_LC_Cancel "" MAP 0x1036B0 Lookup2D_FLOAT32_IEEE 0 LATC_Test_Calc_CM_single -3.4E+38 3.4E+38
 /begin AXIS_DESCR COM_AXIS LCS_DisplaySpd_kph LATC_Test_Calc_CM_single 12 -3.4E+38 3.4E+38 AXIS_PTS_REF P_LCS_AngleSlope_Spd_BP /end AXIS_DESCR
 /begin AXIS_DESCR COM_AXIS LCS_EqA0 LATC_Test_Calc_CM_single 19 -3.4E+38 3.4E+38 AXIS_PTS_REF P_LCS_A0_Dis_BP /end AXIS_DESCR
/end CHARACTERISTIC
/begin CHARACTERISTIC P_LCS_AngleSlope_LC_Eco "" MAP 0x103A40 Lookup2D_FLOAT32_IEEE 0 LATC_Test_Calc_CM_single -3.4E+38 3.4E+38
 /begin AXIS_DESCR COM_AXIS LCS_DisplaySpd_kph LATC_Test_Calc_CM_single 12 -3.4E+38 3.4E+38 AXIS_PTS_REF P_LCS_AngleSlope_Spd_BP /end AXIS_DESCR
 /begin AXIS_DESCR COM_AXIS LCS_EqA0 LATC_Test_Calc_CM_single 19 -3.4E+38 3.4E+38 AXIS_PTS_REF P_LCS_A0_Dis_BP /end AXIS_DESCR
/end CHARACTERISTIC
/begin CHARACTERISTIC P_LCS_AngleSlope_LC_Nomal "" MAP 0x103DD0 Lookup2D_FLOAT32_IEEE 0 LATC_Test_Calc_CM_single -3.4E+38 3.4E+38
 /begin AXIS_DESCR COM_AXIS LCS_DisplaySpd_kph LATC_Test_Calc_CM_single 12 -3.4E+38 3.4E+38 AXIS_PTS_REF P_LCS_AngleSlope_Spd_BP /end AXIS_DESCR
 /begin AXIS_DESCR COM_AXIS LCS_EqA0 LATC_Test_Calc_CM_single 19 -3.4E+38 3.4E+38 AXIS_PTS_REF P_LCS_A0_Dis_BP /end AXIS_DESCR
/end CHARACTERISTIC
/begin CHARACTERISTIC P_LCS_AngleSlope_LC_Sport "" MAP 0x104160 Lookup2D_FLOAT32_IEEE 0 LATC_Test_Calc_CM_single -3.4E+38 3.4E+38
 /begin AXIS_DESCR COM_AXIS LCS_DisplaySpd_kph LATC_Test_Calc_CM_single 12 -3.4E+38 3.4E+38 AXIS_PTS_REF P_LCS_AngleSlope_Spd_BP /end AXIS_DESCR
 /begin AXIS_DESCR COM_AXIS LCS_EqA0 LATC_Test_Calc_CM_single 19 -3.4E+38 3.4E+38 AXIS_PTS_REF P_LCS_A0_Dis_BP /end AXIS_DESCR
/end CHARACTERISTIC
/begin CHARACTERISTIC P_LCS_AngleSlope_LKA "" MAP 0x1044F0 Lookup2D_FLOAT32_IEEE 0 LATC_Test_Calc_CM_single -3.4E+38 3.4E+38
 /begin AXIS_DESCR COM_AXIS LCS_DisplaySpd_kph LATC_Test_Calc_CM_single 12 -3.4E+38 3.4E+38 AXIS_PTS_REF P_LCS_AngleSlope_Spd_BP /end AXIS_DESCR
 /begin AXIS_DESCR COM_AXIS NO_INPUT_QUANTITY LATC_Test_Calc_CM_single 19 -3.4E+38 3.4E+38 AXIS_PTS_REF P_LCS_A0_Dis_BP /end AXIS_DESCR
/end CHARACTERISTIC
/begin AXIS_PTS P_LCS_AngleSlope_Spd_BP "" 0x104880 LCS_DisplaySpd_kph Lookup2D_X_FLOAT32_IEEE 0 LATC_Test_Calc_CM_single 12 -3.4E+38 3.4E+38 /end AXIS_PTS
/begin AXIS_PTS P_LCS_DeltaEps_SpdBp "" 0x1048B0 LCS_DisplaySpd_kph Lookup1D_X_FLOAT32_IEEE 0 LATC_Test_Calc_CM_single 16 -3.4E+38 3.4E+38 /end AXIS_PTS
/begin CHARACTERISTIC P_LCS_DeltaEps_TimeVal "" CURVE 0x1048F0 Lookup1D_FLOAT32_IEEE 0 LATC_Test_Calc_CM_single -3.4E+38 3.4E+38
 /begin AXIS_DESCR COM_AXIS LCS_DisplaySpd_kph LATC_Test_Calc_CM_single 16 -3.4E+38 3.4E+38 AXIS_PTS_REF P_LCS_DeltaEps_SpdBp /end AXIS_DESCR
/end CHARACTERISTIC
/begin CHARACTERISTIC P_LCS_ESSAngSlope_SW "" VALUE 0x1083E0 Scalar_FLOAT64_IEEE 0 LATC_Test_Calc_CM_double -1.7976931348623157E+308 1.7976931348623157E+308 /end CHARACTERISTIC
/begin CHARACTERISTIC P_LCS_ESSAngleSW "" VALUE 0x1088B0 Scalar_BOOLEAN 0 LATC_Test_Calc_CM_boolean 0 1 /end CHARACTERISTIC
/begin CHARACTERISTIC P_LCS_ESSAngleSW2 "" VALUE 0x1083E8 Scalar_FLOAT64_IEEE 0 LATC_Test_Calc_CM_double -1.7976931348623157E+308 1.7976931348623157E+308 /end CHARACTERISTIC
/begin CHARACTERISTIC P_LCS_ESS_AngleSlope_Limit "" VALUE 0x10210C Scalar_FLOAT32_IEEE 0 LATC_Test_Calc_CM_single -3.4028234660000002E+38 3.4028234660000002E+38 /end CHARACTERISTIC
/begin CHARACTERISTIC P_LCS_ESS_preDis_Nomal "" CURVE 0x104930 Lookup1D_FLOAT32_IEEE 0 LATC_Test_Calc_CM_single -3.4E+38 3.4E+38
 /begin AXIS_DESCR COM_AXIS LCS_DisplaySpd_kph LATC_Test_Calc_CM_single 16 -3.4E+38 3.4E+38 AXIS_PTS_REF P_LCS_preDis_spd /end AXIS_DESCR
/end CHARACTERISTIC
/begin CHARACTERISTIC P_LCS_LCK_preDis_Nomal "" CURVE 0x104970 Lookup1D_FLOAT32_IEEE 0 LATC_Test_Calc_CM_single -3.4E+38 3.4E+38
 /begin AXIS_DESCR COM_AXIS LCS_DisplaySpd_kph LATC_Test_Calc_CM_single 16 -3.4E+38 3.4E+38 AXIS_PTS_REF P_LCS_preDis_spd /end AXIS_DESCR
/end CHARACTERISTIC
/begin CHARACTERISTIC P_LCS_LC_Complete_PreDisFac "" MAP 0x1049B0 Lookup2D_FLOAT32_IEEE 0 LATC_Test_Calc_CM_single -3.4E+38 3.4E+38
 /begin AXIS_DESCR COM_AXIS LCS_HoldTime LATC_Test_Calc_CM_double 15 -1.6999999999999999E+308 1.6999999999999999E+308 AXIS_PTS_REF P_LCS_StateActive_HoldTime_BP /end AXIS_DESCR
 /begin AXIS_DESCR COM_AXIS LCS_AngleSlope_Flg LATC_Test_Calc_CM_uint8 4 0 255 AXIS_PTS_REF P_LCS_StateCompleteFlg_BP /end AXIS_DESCR
/end CHARACTERISTIC
/begin CHARACTERISTIC P_LCS_LatAcc2CurveSW "" VALUE 0x1088B1 Scalar_UBYTE 0 LATC_Test_Calc_CM_uint8 0 255 /end CHARACTERISTIC
/begin CHARACTERISTIC P_LCS_StateActiv_AngleSlope "" MAP 0x104AA0 Lookup2D_FLOAT32_IEEE 0 LATC_Test_Calc_CM_single -3.4E+38 3.4E+38
 /begin AXIS_DESCR COM_AXIS LCS_HoldTime LATC_Test_Calc_CM_double 15 -1.6999999999999999E+308 1.6999999999999999E+308 AXIS_PTS_REF P_LCS_StateActive_HoldTime_BP /end AXIS_DESCR
 /begin AXIS_DESCR COM_AXIS LCS_AngleSlope_Flg LATC_Test_Calc_CM_uint8 6 0 255 AXIS_PTS_REF P_LCS_StateActiveFlg_BP /end AXIS_DESCR
/end CHARACTERISTIC
/begin AXIS_PTS P_LCS_StateActiveFlg_BP "" 0x1069E0 LCS_AngleSlope_Flg Lookup2D_X_UBYTE 0 LATC_Test_Calc_CM_uint8 6 0 255 /end AXIS_PTS
/begin AXIS_PTS P_LCS_StateActive_HoldTime_BP "" 0x102000 LCS_HoldTime Lookup2D_X_FLOAT64_IEEE 0 LATC_Test_Calc_CM_double 15 -1.6999999999999999E+308 1.6999999999999999E+308 /end AXIS_PTS
/begin AXIS_PTS P_LCS_StateCompleteFlg_BP "" 0x1069E8 LCS_AngleSlope_Flg Lookup2D_X_UBYTE 0 LATC_Test_Calc_CM_uint8 4 0 255 /end AXIS_PTS
/begin CHARACTERISTIC P_LCS_StateComplete_AngleSlope "" MAP 0x104C30 Lookup2D_FLOAT32_IEEE 0 LATC_Test_Calc_CM_single -3.4E+38 3.4E+38
 /begin AXIS_DESCR COM_AXIS LCS_HoldTime LATC_Test_Calc_CM_double 15 -1.6999999999999999E+308 1.6999999999999999E+308 AXIS_PTS_REF P_LCS_StateActive_HoldTime_BP /end AXIS_DESCR
 /begin AXIS_DESCR COM_AXIS LCS_AngleSlope_Flg LATC_Test_Calc_CM_uint8 4 0 255 AXIS_PTS_REF P_LCS_StateCompleteFlg_BP /end AXIS_DESCR
/end CHARACTERISTIC
/begin CHARACTERISTIC P_LCS_StateHold_time "" VALUE 0x1036AC Scalar_UWORD 0 LATC_Test_Calc_CM_uint16 0 65535 /end CHARACTERISTIC
/begin CHARACTERISTIC P_LCS_preDis_AES_Fac "" MAP 0x104D20 Lookup2D_FLOAT32_IEEE 0 LATC_Test_Calc_CM_single -3.4E+38 3.4E+38
 /begin AXIS_DESCR COM_AXIS LCS_DisplaySpd_kph LATC_Test_Calc_CM_single 16 -3.4E+38 3.4E+38 AXIS_PTS_REF P_LCS_preDis_spd /end AXIS_DESCR
 /begin AXIS_DESCR COM_AXIS LCS_EqA0 LATC_Test_Calc_CM_single 19 -3.4E+38 3.4E+38 AXIS_PTS_REF P_LCS_A0_Dis_BP /end AXIS_DESCR
/end CHARACTERISTIC
/begin CHARACTERISTIC P_LCS_preDis_ELK_Fac "" MAP 0x1051E0 Lookup2D_FLOAT32_IEEE 0 LATC_Test_Calc_CM_single -3.4E+38 3.4E+38
 /begin AXIS_DESCR COM_AXIS LCS_DisplaySpd_kph LATC_Test_Calc_CM_single 16 -3.4E+38 3.4E+38 AXIS_PTS_REF P_LCS_preDis_spd /end AXIS_DESCR
 /begin AXIS_DESCR COM_AXIS LCS_EqA0 LATC_Test_Calc_CM_single 19 -3.4E+38 3.4E+38 AXIS_PTS_REF P_LCS_A0_Dis_BP /end AXIS_DESCR
/end CHARACTERISTIC
/begin CHARACTERISTIC P_LCS_preDis_ESS_Fac "" MAP 0x1056A0 Lookup2D_FLOAT32_IEEE 0 LATC_Test_Calc_CM_single -3.4E+38 3.4E+38
 /begin AXIS_DESCR COM_AXIS LCS_DisplaySpd_kph LATC_Test_Calc_CM_single 16 -3.4E+38 3.4E+38 AXIS_PTS_REF P_LCS_preDis_spd /end AXIS_DESCR
 /begin AXIS_DESCR COM_AXIS LCS_EqA0 LATC_Test_Calc_CM_single 19 -3.4E+38 3.4E+38 AXIS_PTS_REF P_LCS_A0_Dis_BP /end AXIS_DESCR
/end CHARACTERISTIC
/begin CHARACTERISTIC P_LCS_preDis_LCK_A2Curve_Fac "" CURVE 0x103698 Lookup1D_FLOAT32_IEEE 0 LATC_Test_Calc_CM_single -3.4E+38 3.4E+38
 /begin AXIS_DESCR COM_AXIS LCS_A2_LatAcc LATC_Test_Calc_CM_single 5 -3.4E+38 3.4E+38 AXIS_PTS_REF P_LCS_A2_LatAcc_BP /end AXIS_DESCR
/end CHARACTERISTIC
/begin CHARACTERISTIC P_LCS_preDis_LCK_A2Curve_Fac2 "" CURVE 0x104C08 Lookup1D_FLOAT32_IEEE 0 LATC_Test_Calc_CM_single -3.4E+38 3.4E+38
 /begin AXIS_DESCR COM_AXIS LCS_Predis_Curve LATC_Test_Calc_CM_single 10 -3.4E+38 3.4E+38 AXIS_PTS_REF P_LCS_A2_Curve_BP /end AXIS_DESCR
/end CHARACTERISTIC
/begin CHARACTERISTIC P_LCS_preDis_LCK_Fac "" MAP 0x1083F0 Lookup2D_FLOAT32_IEEE 0 LATC_Test_Calc_CM_single -3.4E+38 3.4E+38
 /begin AXIS_DESCR COM_AXIS LCS_DisplaySpd_kph LATC_Test_Calc_CM_single 16 -3.4E+38 3.4E+38 AXIS_PTS_REF P_LCS_preDis_spd /end AXIS_DESCR
 /begin AXIS_DESCR COM_AXIS NO_INPUT_QUANTITY LATC_Test_Calc_CM_single 19 -3.4E+38 3.4E+38 AXIS_PTS_REF P_LCS_A0_Dis_BP /end AXIS_DESCR
/end CHARACTERISTIC
/begin CHARACTERISTIC P_LCS_preDis_LC_Eco_Fac "" MAP 0x105B60 Lookup2D_FLOAT32_IEEE 0 LATC_Test_Calc_CM_single -3.4E+38 3.4E+38
 /begin AXIS_DESCR COM_AXIS LCS_DisplaySpd_kph LATC_Test_Calc_CM_single 16 -3.4E+38 3.4E+38 AXIS_PTS_REF P_LCS_preDis_spd /end AXIS_DESCR
 /begin AXIS_DESCR COM_AXIS LCS_EqA0 LATC_Test_Calc_CM_single 19 -3.4E+38 3.4E+38 AXIS_PTS_REF P_LCS_A0_Dis_BP /end AXIS_DESCR
/end CHARACTERISTIC
/begin CHARACTERISTIC P_LCS_preDis_LC_Nomal_Fac "" MAP 0x106020 Lookup2D_FLOAT32_IEEE 0 LATC_Test_Calc_CM_single -3.4E+38 3.4E+38
 /begin AXIS_DESCR COM_AXIS LCS_DisplaySpd_kph LATC_Test_Calc_CM_single 16 -3.4E+38 3.4E+38 AXIS_PTS_REF P_LCS_preDis_spd /end AXIS_DESCR
 /begin AXIS_DESCR COM_AXIS LCS_EqA0 LATC_Test_Calc_CM_single 19 -3.4E+38 3.4E+38 AXIS_PTS_REF P_LCS_A0_Dis_BP /end AXIS_DESCR
/end CHARACTERISTIC
/begin CHARACTERISTIC P_LCS_preDis_LC_Sport_Fac "" MAP 0x1064E0 Lookup2D_FLOAT32_IEEE 0 LATC_Test_Calc_CM_single -3.4E+38 3.4E+38
 /begin AXIS_DESCR COM_AXIS LCS_DisplaySpd_kph LATC_Test_Calc_CM_single 16 -3.4E+38 3.4E+38 AXIS_PTS_REF P_LCS_preDis_spd /end AXIS_DESCR
 /begin AXIS_DESCR COM_AXIS LCS_EqA0 LATC_Test_Calc_CM_single 19 -3.4E+38 3.4E+38 AXIS_PTS_REF P_LCS_A0_Dis_BP /end AXIS_DESCR
/end CHARACTERISTIC
/begin AXIS_PTS P_LCS_preDis_spd "" 0x1069A0 LCS_DisplaySpd_kph Lookup2D_X_FLOAT32_IEEE 0 LATC_Test_Calc_CM_single 16 -3.4E+38 3.4E+38 /end AXIS_PTS
/begin MEASUREMENT RTTarget.ModelExecutionCounter "Internal CANape RT-Target DLL counter" ULONG NO_COMPU_METHOD 0 0 0 4294967295 ECU_ADDRESS 0x168F30 FORMAT "%.1"
 /begin IF_DATA XCP
  /begin DAQ_EVENT FIXED_EVENT_LIST EVENT 0x00 /end DAQ_EVENT
 /end IF_DATA
/end MEASUREMENT
/begin MEASUREMENT RTTarget.ModelStepTime "Internal CANape RT-Target DLL model step execution time" ULONG RTTarget.ModelStepTime.CONVERSION.MICROSECOND_UNIT 0 0 0 4294967295 ECU_ADDRESS 0x115898
 /begin IF_DATA XCP
  /begin DAQ_EVENT FIXED_EVENT_LIST EVENT 0x00 /end DAQ_EVENT
 /end IF_DATA
/end MEASUREMENT
/begin COMPU_METHOD LATC_Test_Calc_CM_boolean "Q = V" RAT_FUNC "%1.0" "" COEFFS 0 1 0 0 0 1 /end COMPU_METHOD
/begin COMPU_METHOD LATC_Test_Calc_CM_double "Q = V" RAT_FUNC "%15.10" "" COEFFS 0 1 0 0 0 1 /end COMPU_METHOD
/begin COMPU_METHOD LATC_Test_Calc_CM_single "Q = V" RAT_FUNC "%8.6" "" COEFFS 0 1 0 0 0 1 /end COMPU_METHOD
/begin COMPU_METHOD LATC_Test_Calc_CM_uint16 "Q = V" RAT_FUNC "%5.0" "" COEFFS 0 1 0 0 0 1 /end COMPU_METHOD
/begin COMPU_METHOD LATC_Test_Calc_CM_uint8 "Q = V" RAT_FUNC "%3.0" "" COEFFS 0 1 0 0 0 1 /end COMPU_METHOD
/begin COMPU_METHOD RTTarget.ModelStepTime.CONVERSION.MICROSECOND_UNIT "Microsecond unit for model step execution time" RAT_FUNC "%.1" "祍" COEFFS 0 1 0 0 0 1 /end COMPU_METHOD
/begin RECORD_LAYOUT Lookup1D_BOOLEAN FNC_VALUES 1 UBYTE COLUMN_DIR DIRECT /end RECORD_LAYOUT
/begin RECORD_LAYOUT Lookup1D_BYTE FNC_VALUES 1 SBYTE COLUMN_DIR DIRECT /end RECORD_LAYOUT
/begin RECORD_LAYOUT Lookup1D_FLOAT32_IEEE FNC_VALUES 1 FLOAT32_IEEE COLUMN_DIR DIRECT /end RECORD_LAYOUT
/begin RECORD_LAYOUT Lookup1D_FLOAT64_IEEE FNC_VALUES 1 FLOAT64_IEEE COLUMN_DIR DIRECT /end RECORD_LAYOUT
/begin RECORD_LAYOUT Lookup1D_SLONG FNC_VALUES 1 SLONG COLUMN_DIR DIRECT /end RECORD_LAYOUT
/begin RECORD_LAYOUT Lookup1D_UBYTE FNC_VALUES 1 UBYTE COLUMN_DIR DIRECT /end RECORD_LAYOUT
/begin RECORD_LAYOUT Lookup1D_ULONG FNC_VALUES 1 ULONG COLUMN_DIR DIRECT /end RECORD_LAYOUT
/begin RECORD_LAYOUT Lookup1D_UWORD FNC_VALUES 1 UWORD COLUMN_DIR DIRECT /end RECORD_LAYOUT
/begin RECORD_LAYOUT Lookup1D_WORD FNC_VALUES 1 SWORD COLUMN_DIR DIRECT /end RECORD_LAYOUT
/begin RECORD_LAYOUT Lookup1D_X_BOOLEAN AXIS_PTS_X 1 UBYTE INDEX_INCR DIRECT /end RECORD_LAYOUT
/begin RECORD_LAYOUT Lookup1D_X_BYTE AXIS_PTS_X 1 SBYTE INDEX_INCR DIRECT /end RECORD_LAYOUT
/begin RECORD_LAYOUT Lookup1D_X_FLOAT32_IEEE AXIS_PTS_X 1 FLOAT32_IEEE INDEX_INCR DIRECT /end RECORD_LAYOUT
/begin RECORD_LAYOUT Lookup1D_X_FLOAT64_IEEE AXIS_PTS_X 1 FLOAT64_IEEE INDEX_INCR DIRECT /end RECORD_LAYOUT
/begin RECORD_LAYOUT Lookup1D_X_LONG AXIS_PTS_X 1 SLONG INDEX_INCR DIRECT /end RECORD_LAYOUT
/begin RECORD_LAYOUT Lookup1D_X_UBYTE AXIS_PTS_X 1 UBYTE INDEX_INCR DIRECT /end RECORD_LAYOUT
/begin RECORD_LAYOUT Lookup1D_X_ULONG AXIS_PTS_X 1 ULONG INDEX_INCR DIRECT /end RECORD_LAYOUT
/begin RECORD_LAYOUT Lookup1D_X_UWORD AXIS_PTS_X 1 UWORD INDEX_INCR DIRECT /end RECORD_LAYOUT
/begin RECORD_LAYOUT Lookup1D_X_WORD AXIS_PTS_X 1 SWORD INDEX_INCR DIRECT /end RECORD_LAYOUT
/begin RECORD_LAYOUT Lookup2D_BOOLEAN FNC_VALUES 1 UBYTE COLUMN_DIR DIRECT /end RECORD_LAYOUT
/begin RECORD_LAYOUT Lookup2D_BYTE FNC_VALUES 1 SBYTE COLUMN_DIR DIRECT /end RECORD_LAYOUT
/begin RECORD_LAYOUT Lookup2D_FLOAT32_IEEE FNC_VALUES 1 FLOAT32_IEEE COLUMN_DIR DIRECT /end RECORD_LAYOUT
/begin RECORD_LAYOUT Lookup2D_FLOAT64_IEEE FNC_VALUES 1 FLOAT64_IEEE COLUMN_DIR DIRECT /end RECORD_LAYOUT
/begin RECORD_LAYOUT Lookup2D_LONG FNC_VALUES 1 SLONG COLUMN_DIR DIRECT /end RECORD_LAYOUT
/begin RECORD_LAYOUT Lookup2D_UBYTE FNC_VALUES 1 UBYTE COLUMN_DIR DIRECT /end RECORD_LAYOUT
/begin RECORD_LAYOUT Lookup2D_ULONG FNC_VALUES 1 ULONG COLUMN_DIR DIRECT /end RECORD_LAYOUT
/begin RECORD_LAYOUT Lookup2D_UWORD FNC_VALUES 1 UWORD COLUMN_DIR DIRECT /end RECORD_LAYOUT
/begin RECORD_LAYOUT Lookup2D_WORD FNC_VALUES 1 SWORD COLUMN_DIR DIRECT /end RECORD_LAYOUT
/begin RECORD_LAYOUT Lookup2D_X_BOOLEAN AXIS_PTS_X 1 UBYTE INDEX_INCR DIRECT /end RECORD_LAYOUT
/begin RECORD_LAYOUT Lookup2D_X_BYTE AXIS_PTS_X 1 SBYTE INDEX_INCR DIRECT /end RECORD_LAYOUT
/begin RECORD_LAYOUT Lookup2D_X_FLOAT32_IEEE AXIS_PTS_X 1 FLOAT32_IEEE INDEX_INCR DIRECT /end RECORD_LAYOUT
/begin RECORD_LAYOUT Lookup2D_X_FLOAT64_IEEE AXIS_PTS_X 1 FLOAT64_IEEE INDEX_INCR DIRECT /end RECORD_LAYOUT
/begin RECORD_LAYOUT Lookup2D_X_LONG AXIS_PTS_X 1 SLONG INDEX_INCR DIRECT /end RECORD_LAYOUT
/begin RECORD_LAYOUT Lookup2D_X_UBYTE AXIS_PTS_X 1 UBYTE INDEX_INCR DIRECT /end RECORD_LAYOUT
/begin RECORD_LAYOUT Lookup2D_X_ULONG AXIS_PTS_X 1 ULONG INDEX_INCR DIRECT /end RECORD_LAYOUT
/begin RECORD_LAYOUT Lookup2D_X_UWORD AXIS_PTS_X 1 UWORD INDEX_INCR DIRECT /end RECORD_LAYOUT
/begin RECORD_LAYOUT Lookup2D_X_WORD AXIS_PTS_X 1 SWORD INDEX_INCR DIRECT /end RECORD_LAYOUT
/begin RECORD_LAYOUT Scalar_BOOLEAN FNC_VALUES 1 UBYTE COLUMN_DIR DIRECT /end RECORD_LAYOUT
/begin RECORD_LAYOUT Scalar_BYTE FNC_VALUES 1 SBYTE COLUMN_DIR DIRECT /end RECORD_LAYOUT
/begin RECORD_LAYOUT Scalar_FLOAT32_IEEE FNC_VALUES 1 FLOAT32_IEEE COLUMN_DIR DIRECT /end RECORD_LAYOUT
/begin RECORD_LAYOUT Scalar_FLOAT64_IEEE FNC_VALUES 1 FLOAT64_IEEE COLUMN_DIR DIRECT /end RECORD_LAYOUT
/begin RECORD_LAYOUT Scalar_LONG FNC_VALUES 1 SLONG COLUMN_DIR DIRECT /end RECORD_LAYOUT
/begin RECORD_LAYOUT Scalar_SWORD FNC_VALUES 1 SWORD COLUMN_DIR DIRECT /end RECORD_LAYOUT
/begin RECORD_LAYOUT Scalar_UBYTE FNC_VALUES 1 UBYTE COLUMN_DIR DIRECT /end RECORD_LAYOUT
/begin RECORD_LAYOUT Scalar_ULONG FNC_VALUES 1 ULONG COLUMN_DIR DIRECT /end RECORD_LAYOUT
/begin RECORD_LAYOUT Scalar_UWORD FNC_VALUES 1 UWORD COLUMN_DIR DIRECT /end RECORD_LAYOUT
/begin GROUP LATC_Test_Calc "LATC_Test_Calc" ROOT /begin SUB_GROUP Root_LCS_Angle /end SUB_GROUP /end GROUP
/begin GROUP Root_LCS_Angle "LATC_Test_Calc/LCS_Angle"
 /begin REF_CHARACTERISTIC P_LCS_A2S_FliterTime P_LCS_A2_Pretime P_LCS_ESS_AngleSlope_Limit P_LCS_ESS_preDis_Nomal P_LCS_LCK_preDis_Nomal P_LCS_LatAcc2CurveSW P_LCS_preDis_AES_Fac P_LCS_preDis_ELK_Fac P_LCS_preDis_ESS_Fac P_LCS_preDis_LCK_A2Curve_Fac P_LCS_preDis_LCK_A2Curve_Fac2 P_LCS_preDis_LCK_Fac P_LCS_preDis_LC_Eco_Fac P_LCS_preDis_LC_Nomal_Fac P_LCS_preDis_LC_Sport_Fac /end REF_CHARACTERISTIC
 /begin SUB_GROUP S18_AngSlopeCalc S18_TargetSteerAngleCalc /end SUB_GROUP
/end GROUP
/begin GROUP S18_AngSlopeCalc "LATC_Test_Calc/LCS_Angle/AngSlopeCalc"
 /begin REF_CHARACTERISTIC P_LCS_AngleSlope_AES_Active P_LCS_AngleSlope_ELK P_LCS_AngleSlope_ESS P_LCS_AngleSlope_LCK P_LCS_AngleSlope_LCKIE P_LCS_AngleSlope_LCK_Curve_Fac P_LCS_AngleSlope_LC_Cancel P_LCS_AngleSlope_LC_Eco P_LCS_AngleSlope_LC_Nomal P_LCS_AngleSlope_LC_Sport P_LCS_AngleSlope_LKA P_LCS_StateHold_time /end REF_CHARACTERISTIC
 /begin SUB_GROUP S20_Switch_Case_Action_Subsystem S20_Switch_Case_Action_Subsystem2 /end SUB_GROUP
/end GROUP
/begin GROUP S18_TargetSteerAngleCalc "LATC_Test_Calc/LCS_Angle/TargetSteerAngleCalc"
 /begin REF_CHARACTERISTIC P_LCS_AngleFilterTime P_LCS_AngleSlope_ESS_Add P_LCS_DeltaEps_TimeVal P_LCS_ESSAngSlope_SW P_LCS_ESSAngleSW P_LCS_ESSAngleSW2 /end REF_CHARACTERISTIC
/end GROUP
/begin GROUP S20_Switch_Case_Action_Subsystem "LATC_Test_Calc/LCS_Angle/AngSlopeCalc/Switch Case Action Subsystem" /begin REF_CHARACTERISTIC P_LCS_StateActiv_AngleSlope /end REF_CHARACTERISTIC /end GROUP
/begin GROUP S20_Switch_Case_Action_Subsystem2 "LATC_Test_Calc/LCS_Angle/AngSlopeCalc/Switch Case Action Subsystem2" /begin REF_CHARACTERISTIC P_LCS_LC_Complete_PreDisFac P_LCS_StateComplete_AngleSlope /end REF_CHARACTERISTIC /end GROUP
/begin GROUP _RTTarget_internals "CANape RT-Target DLL internal diagnostic objects" ROOT /begin REF_MEASUREMENT RTTarget.ModelExecutionCounter RTTarget.ModelStepTime /end REF_MEASUREMENT /end GROUP
/begin GROUP _[Parameters] "All Parameters"
 /begin REF_CHARACTERISTIC LATC_Test_Calc_P.P_LCS_DetNoOverRide_DrvTrq_TH LATC_Test_Calc_P.P_LCS_DetOverRide_DrvTrq_TH LATC_Test_Calc_P.P_LCS_NoOverRideTime_TH_s LATC_Test_Calc_P.P_LCS_OverRideTime_TH_s P_LCS_A0_Dis_BP P_LCS_A2S_FliterTime P_LCS_A2_Curve_BP P_LCS_A2_LatAcc_BP P_LCS_A2_Pretime P_LCS_AngleFilterTime P_LCS_AngleSlope_AES_Active P_LCS_AngleSlope_ELK P_LCS_AngleSlope_ESS P_LCS_AngleSlope_ESS_Add P_LCS_AngleSlope_LCK P_LCS_AngleSlope_LCKIE P_LCS_AngleSlope_LCK_Curve_Fac P_LCS_AngleSlope_LC_Cancel P_LCS_AngleSlope_LC_Eco P_LCS_AngleSlope_LC_Nomal P_LCS_AngleSlope_LC_Sport P_LCS_AngleSlope_LKA P_LCS_AngleSlope_Spd_BP P_LCS_DeltaEps_SpdBp P_LCS_DeltaEps_TimeVal P_LCS_ESSAngSlope_SW P_LCS_ESSAngleSW P_LCS_ESSAngleSW2 P_LCS_ESS_AngleSlope_Limit P_LCS_ESS_preDis_Nomal P_LCS_LCK_preDis_Nomal P_LCS_LC_Complete_PreDisFac P_LCS_LatAcc2CurveSW P_LCS_StateActiv_AngleSlope P_LCS_StateActiveFlg_BP P_LCS_StateActive_HoldTime_BP P_LCS_StateCompleteFlg_BP P_LCS_StateComplete_AngleSlope P_LCS_StateHold_time P_LCS_preDis_AES_Fac P_LCS_preDis_ELK_Fac P_LCS_preDis_ESS_Fac P_LCS_preDis_LCK_A2Curve_Fac P_LCS_preDis_LCK_A2Curve_Fac2 P_LCS_preDis_LCK_Fac P_LCS_preDis_LC_Eco_Fac P_LCS_preDis_LC_Nomal_Fac P_LCS_preDis_LC_Sport_Fac P_LCS_preDis_spd /end REF_CHARACTERISTIC
/end GROUP
/begin FUNCTION Input1 "" /end FUNCTION
/begin FUNCTION Input10 "" /end FUNCTION
/begin FUNCTION Input11 "" /end FUNCTION
/begin FUNCTION Input12 "" /end FUNCTION
/begin FUNCTION Input13 "" /end FUNCTION
/begin FUNCTION Input14 "" /end FUNCTION
/begin FUNCTION Input15 "" /end FUNCTION
/begin FUNCTION Input16 "" /end FUNCTION
/begin FUNCTION Input17 "" /end FUNCTION
/begin FUNCTION Input2 "" /end FUNCTION
/begin FUNCTION Input3 "" /end FUNCTION
/begin FUNCTION Input4 "" /end FUNCTION
/begin FUNCTION Input5 "" /end FUNCTION
/begin FUNCTION Input6 "" /end FUNCTION
/begin FUNCTION Input7 "" /end FUNCTION
/begin FUNCTION Input8 "" /end FUNCTION
/begin FUNCTION Input9 "" /end FUNCTION
/begin FUNCTION LCS_Angle ""
 /begin SUB_FUNCTION LCS_Angle.2_D_Lookup_Table1 LCS_Angle.2_D_Lookup_Table2 LCS_Angle.Abs1 LCS_Angle.Add1 LCS_Angle.Add6 LCS_Angle.AngSlopeCalc LCS_Angle.Compare_To_Constant1 LCS_Angle.Constant15 LCS_Angle.Constant16 LCS_Angle.Constant2 LCS_Angle.Constant20 LCS_Angle.Constant21 LCS_Angle.Direct_Lookup_Table_[n_D] LCS_Angle.Divide LCS_Angle.Gain LCS_Angle.LCS_LC_ELK_preDis_TB LCS_Angle.LCS_LC_ELK_preDis_TB1 LCS_Angle.LCS_LC_ESSAES_preDis_TB LCS_Angle.LCS_LC_ESSAES_preDis_TB1 LCS_Angle.LCS_LC_Emergent_preDis_TB LCS_Angle.LC_Medium_preDis_Fac_TB LCS_Angle.LP_filter LCS_Angle.Multiport_Switch4 LCS_Angle.Output1 LCS_Angle.Output2 LCS_Angle.OverRideDetect LCS_Angle.Product1 LCS_Angle.Product12 LCS_Angle.Product15 LCS_Angle.Product2 LCS_Angle.Product3 LCS_Angle.Product4 LCS_Angle.Product5 LCS_Angle.Product6 LCS_Angle.Product7 LCS_Angle.Product8 LCS_Angle.Product9 LCS_Angle.Signal_Copy LCS_Angle.Subsystem5 LCS_Angle.Sum LCS_Angle.Switch LCS_Angle.TargetSteerAngleCalc LCS_Angle.preDisMin_TB LCS_Angle.preDisMin_TB1 LCS_Angle.preDisMin_TB2 LCS_Angle.preDisMin_TB3 LCS_Angle.preDisMin_TB4 LCS_Angle.preDisMin_TB5 LCS_Angle.predis_ayFac1 LCS_Angle.predis_ayFac4 /end SUB_FUNCTION
/end FUNCTION
/begin FUNCTION LCS_Angle.2_D_Lookup_Table1 "" /begin DEF_CHARACTERISTIC P_LCS_A0_Dis_BP P_LCS_preDis_LC_Nomal_Fac P_LCS_preDis_spd /end DEF_CHARACTERISTIC /end FUNCTION
/begin FUNCTION LCS_Angle.2_D_Lookup_Table2 "" /begin DEF_CHARACTERISTIC P_LCS_A0_Dis_BP P_LCS_preDis_LCK_Fac P_LCS_preDis_spd /end DEF_CHARACTERISTIC /end FUNCTION
/begin FUNCTION LCS_Angle.Abs1 "" /end FUNCTION
/begin FUNCTION LCS_Angle.Add1 "" /end FUNCTION
/begin FUNCTION LCS_Angle.Add6 "" /end FUNCTION
/begin FUNCTION LCS_Angle.AngSlopeCalc ""
 /begin SUB_FUNCTION LCS_Angle.AngSlopeCalc.Constant2 LCS_Angle.AngSlopeCalc.ELK_Active LCS_Angle.AngSlopeCalc.ESS_AES_Active LCS_Angle.AngSlopeCalc.LCKIE_Active LCS_Angle.AngSlopeCalc.LCKIE_TO_LC_Eco LCS_Angle.AngSlopeCalc.LCKIE_TO_LC_Nomal LCS_Angle.AngSlopeCalc.LCKIE_TO_LC_Sport LCS_Angle.AngSlopeCalc.LCKIE_TO_LC_Sport1 LCS_Angle.AngSlopeCalc.LCK_A2_Fac LCS_Angle.AngSlopeCalc.LC_Cancel LCS_Angle.AngSlopeCalc.LKA_Active LCS_Angle.AngSlopeCalc.Merge LCS_Angle.AngSlopeCalc.Multiport_Switch1 LCS_Angle.AngSlopeCalc.No_Function_2_LCK LCS_Angle.AngSlopeCalc.Product LCS_Angle.AngSlopeCalc.Switch_Case LCS_Angle.AngSlopeCalc.Switch_Case1 LCS_Angle.AngSlopeCalc.Switch_Case_Action_Subsystem LCS_Angle.AngSlopeCalc.Switch_Case_Action_Subsystem1 LCS_Angle.AngSlopeCalc.Switch_Case_Action_Subsystem2 LCS_Angle.AngSlopeCalc.Switch_Case_Action_Subsystem3 LCS_Angle.AngSlopeCalc.Unit_Delay3 LCS_Angle.AngSlopeCalc.Unit_Delay4 /end SUB_FUNCTION
/end FUNCTION
/begin FUNCTION LCS_Angle.AngSlopeCalc.Constant2 "" /begin DEF_CHARACTERISTIC P_LCS_StateHold_time /end DEF_CHARACTERISTIC /end FUNCTION
/begin FUNCTION LCS_Angle.AngSlopeCalc.ELK_Active ""
 /begin DEF_CHARACTERISTIC P_LCS_A0_Dis_BP P_LCS_AngleSlope_ELK P_LCS_AngleSlope_Spd_BP /end DEF_CHARACTERISTIC
/end FUNCTION
/begin FUNCTION LCS_Angle.AngSlopeCalc.ESS_AES_Active ""
 /begin DEF_CHARACTERISTIC P_LCS_A0_Dis_BP P_LCS_AngleSlope_ESS P_LCS_AngleSlope_Spd_BP /end DEF_CHARACTERISTIC
/end FUNCTION
/begin FUNCTION LCS_Angle.AngSlopeCalc.LCKIE_Active ""
 /begin DEF_CHARACTERISTIC P_LCS_A0_Dis_BP P_LCS_AngleSlope_LCKIE P_LCS_AngleSlope_Spd_BP /end DEF_CHARACTERISTIC
/end FUNCTION
/begin FUNCTION LCS_Angle.AngSlopeCalc.LCKIE_TO_LC_Eco ""
 /begin DEF_CHARACTERISTIC P_LCS_A0_Dis_BP P_LCS_AngleSlope_LC_Eco P_LCS_AngleSlope_Spd_BP /end DEF_CHARACTERISTIC
/end FUNCTION
/begin FUNCTION LCS_Angle.AngSlopeCalc.LCKIE_TO_LC_Nomal ""
 /begin DEF_CHARACTERISTIC P_LCS_A0_Dis_BP P_LCS_AngleSlope_LC_Nomal P_LCS_AngleSlope_Spd_BP /end DEF_CHARACTERISTIC
/end FUNCTION
/begin FUNCTION LCS_Angle.AngSlopeCalc.LCKIE_TO_LC_Sport ""
 /begin DEF_CHARACTERISTIC P_LCS_A0_Dis_BP P_LCS_AngleSlope_LC_Sport P_LCS_AngleSlope_Spd_BP /end DEF_CHARACTERISTIC
/end FUNCTION
/begin FUNCTION LCS_Angle.AngSlopeCalc.LCKIE_TO_LC_Sport1 ""
 /begin DEF_CHARACTERISTIC P_LCS_A0_Dis_BP P_LCS_AngleSlope_AES_Active P_LCS_AngleSlope_Spd_BP /end DEF_CHARACTERISTIC
/end FUNCTION
/begin FUNCTION LCS_Angle.AngSlopeCalc.LCK_A2_Fac "" /begin DEF_CHARACTERISTIC P_LCS_A2_Curve_BP P_LCS_AngleSlope_LCK_Curve_Fac /end DEF_CHARACTERISTIC /end FUNCTION
/begin FUNCTION LCS_Angle.AngSlopeCalc.LC_Cancel ""
 /begin DEF_CHARACTERISTIC P_LCS_A0_Dis_BP P_LCS_AngleSlope_LC_Cancel P_LCS_AngleSlope_Spd_BP /end DEF_CHARACTERISTIC
/end FUNCTION
/begin FUNCTION LCS_Angle.AngSlopeCalc.LKA_Active ""
 /begin DEF_CHARACTERISTIC P_LCS_A0_Dis_BP P_LCS_AngleSlope_LKA P_LCS_AngleSlope_Spd_BP /end DEF_CHARACTERISTIC
/end FUNCTION
/begin FUNCTION LCS_Angle.AngSlopeCalc.Merge "" /end FUNCTION
/begin FUNCTION LCS_Angle.AngSlopeCalc.Multiport_Switch1 "" /end FUNCTION
/begin FUNCTION LCS_Angle.AngSlopeCalc.No_Function_2_LCK ""
 /begin DEF_CHARACTERISTIC P_LCS_A0_Dis_BP P_LCS_AngleSlope_LCK P_LCS_AngleSlope_Spd_BP /end DEF_CHARACTERISTIC
/end FUNCTION
/begin FUNCTION LCS_Angle.AngSlopeCalc.Product "" /end FUNCTION
/begin FUNCTION LCS_Angle.AngSlopeCalc.Switch_Case "" /end FUNCTION
/begin FUNCTION LCS_Angle.AngSlopeCalc.Switch_Case1 "" /end FUNCTION
/begin FUNCTION LCS_Angle.AngSlopeCalc.Switch_Case_Action_Subsystem ""
 /begin SUB_FUNCTION LCS_Angle.AngSlopeCalc.Switch_Case_Action_Subsystem.LC_start_slope /end SUB_FUNCTION
/end FUNCTION
/begin FUNCTION LCS_Angle.AngSlopeCalc.Switch_Case_Action_Subsystem.LC_start_slope ""
 /begin DEF_CHARACTERISTIC P_LCS_StateActiv_AngleSlope P_LCS_StateActiveFlg_BP P_LCS_StateActive_HoldTime_BP /end DEF_CHARACTERISTIC
/end FUNCTION
/begin FUNCTION LCS_Angle.AngSlopeCalc.Switch_Case_Action_Subsystem1 "" /end FUNCTION
/begin FUNCTION LCS_Angle.AngSlopeCalc.Switch_Case_Action_Subsystem2 ""
 /begin SUB_FUNCTION LCS_Angle.AngSlopeCalc.Switch_Case_Action_Subsystem2.LC_Complete_slope LCS_Angle.AngSlopeCalc.Switch_Case_Action_Subsystem2.LC_Complete_slope1 /end SUB_FUNCTION
/end FUNCTION
/begin FUNCTION LCS_Angle.AngSlopeCalc.Switch_Case_Action_Subsystem2.LC_Complete_slope ""
 /begin DEF_CHARACTERISTIC P_LCS_StateActive_HoldTime_BP P_LCS_StateCompleteFlg_BP P_LCS_StateComplete_AngleSlope /end DEF_CHARACTERISTIC
/end FUNCTION
/begin FUNCTION LCS_Angle.AngSlopeCalc.Switch_Case_Action_Subsystem2.LC_Complete_slope1 ""
 /begin DEF_CHARACTERISTIC P_LCS_LC_Complete_PreDisFac P_LCS_StateActive_HoldTime_BP P_LCS_StateCompleteFlg_BP /end DEF_CHARACTERISTIC
/end FUNCTION
/begin FUNCTION LCS_Angle.AngSlopeCalc.Switch_Case_Action_Subsystem3 "" /end FUNCTION
/begin FUNCTION LCS_Angle.AngSlopeCalc.Unit_Delay3 "" /end FUNCTION
/begin FUNCTION LCS_Angle.AngSlopeCalc.Unit_Delay4 "" /end FUNCTION
/begin FUNCTION LCS_Angle.Compare_To_Constant1 "" /end FUNCTION
/begin FUNCTION LCS_Angle.Constant15 "" /end FUNCTION
/begin FUNCTION LCS_Angle.Constant16 "" /begin DEF_CHARACTERISTIC P_LCS_ESS_AngleSlope_Limit /end DEF_CHARACTERISTIC /end FUNCTION
/begin FUNCTION LCS_Angle.Constant2 "" /begin DEF_CHARACTERISTIC P_LCS_LatAcc2CurveSW /end DEF_CHARACTERISTIC /end FUNCTION
/begin FUNCTION LCS_Angle.Constant20 "" /begin DEF_CHARACTERISTIC P_LCS_A2S_FliterTime /end DEF_CHARACTERISTIC /end FUNCTION
/begin FUNCTION LCS_Angle.Constant21 "" /begin DEF_CHARACTERISTIC P_LCS_A2_Pretime /end DEF_CHARACTERISTIC /end FUNCTION
/begin FUNCTION LCS_Angle.Direct_Lookup_Table_[n_D] "" /end FUNCTION
/begin FUNCTION LCS_Angle.Divide "" /end FUNCTION
/begin FUNCTION LCS_Angle.Gain "" /end FUNCTION
/begin FUNCTION LCS_Angle.LCS_LC_ELK_preDis_TB "" /begin DEF_CHARACTERISTIC P_LCS_A0_Dis_BP P_LCS_preDis_ELK_Fac P_LCS_preDis_spd /end DEF_CHARACTERISTIC /end FUNCTION
/begin FUNCTION LCS_Angle.LCS_LC_ELK_preDis_TB1 "" /begin DEF_CHARACTERISTIC P_LCS_A0_Dis_BP P_LCS_preDis_spd /end DEF_CHARACTERISTIC /end FUNCTION
/begin FUNCTION LCS_Angle.LCS_LC_ESSAES_preDis_TB "" /begin DEF_CHARACTERISTIC P_LCS_A0_Dis_BP P_LCS_preDis_ESS_Fac P_LCS_preDis_spd /end DEF_CHARACTERISTIC /end FUNCTION
/begin FUNCTION LCS_Angle.LCS_LC_ESSAES_preDis_TB1 "" /begin DEF_CHARACTERISTIC P_LCS_A0_Dis_BP P_LCS_preDis_AES_Fac P_LCS_preDis_spd /end DEF_CHARACTERISTIC /end FUNCTION
/begin FUNCTION LCS_Angle.LCS_LC_Emergent_preDis_TB "" /begin DEF_CHARACTERISTIC P_LCS_A0_Dis_BP P_LCS_preDis_LC_Sport_Fac P_LCS_preDis_spd /end DEF_CHARACTERISTIC /end FUNCTION
/begin FUNCTION LCS_Angle.LC_Medium_preDis_Fac_TB "" /begin DEF_CHARACTERISTIC P_LCS_A0_Dis_BP P_LCS_preDis_LC_Eco_Fac P_LCS_preDis_spd /end DEF_CHARACTERISTIC /end FUNCTION
/begin FUNCTION LCS_Angle.LP_filter "" /end FUNCTION
/begin FUNCTION LCS_Angle.Multiport_Switch4 "" /end FUNCTION
/begin FUNCTION LCS_Angle.Output1 "" /end FUNCTION
/begin FUNCTION LCS_Angle.Output2 "" /end FUNCTION
/begin FUNCTION LCS_Angle.OverRideDetect ""
 /begin SUB_FUNCTION LCS_Angle.OverRideDetect.Compare_To_Constant1 LCS_Angle.OverRideDetect.Compare_To_Constant2 LCS_Angle.OverRideDetect.Compare_To_Constant3 LCS_Angle.OverRideDetect.Compare_To_Constant4 LCS_Angle.OverRideDetect.LP_filter4 LCS_Angle.OverRideDetect.Subsystem17 LCS_Angle.OverRideDetect.Subsystem4 /end SUB_FUNCTION
/end FUNCTION
/begin FUNCTION LCS_Angle.OverRideDetect.Compare_To_Constant1 "" /begin SUB_FUNCTION LCS_Angle.OverRideDetect.Compare_To_Constant1.Constant /end SUB_FUNCTION /end FUNCTION
/begin FUNCTION LCS_Angle.OverRideDetect.Compare_To_Constant1.Constant "" /begin DEF_CHARACTERISTIC LATC_Test_Calc_P.P_LCS_OverRideTime_TH_s /end DEF_CHARACTERISTIC /end FUNCTION
/begin FUNCTION LCS_Angle.OverRideDetect.Compare_To_Constant2 "" /begin SUB_FUNCTION LCS_Angle.OverRideDetect.Compare_To_Constant2.Constant /end SUB_FUNCTION /end FUNCTION
/begin FUNCTION LCS_Angle.OverRideDetect.Compare_To_Constant2.Constant "" /begin DEF_CHARACTERISTIC LATC_Test_Calc_P.P_LCS_NoOverRideTime_TH_s /end DEF_CHARACTERISTIC /end FUNCTION
/begin FUNCTION LCS_Angle.OverRideDetect.Compare_To_Constant3 "" /begin SUB_FUNCTION LCS_Angle.OverRideDetect.Compare_To_Constant3.Constant /end SUB_FUNCTION /end FUNCTION
/begin FUNCTION LCS_Angle.OverRideDetect.Compare_To_Constant3.Constant "" /begin DEF_CHARACTERISTIC LATC_Test_Calc_P.P_LCS_DetOverRide_DrvTrq_TH /end DEF_CHARACTERISTIC /end FUNCTION
/begin FUNCTION LCS_Angle.OverRideDetect.Compare_To_Constant4 "" /begin SUB_FUNCTION LCS_Angle.OverRideDetect.Compare_To_Constant4.Constant /end SUB_FUNCTION /end FUNCTION
/begin FUNCTION LCS_Angle.OverRideDetect.Compare_To_Constant4.Constant "" /begin DEF_CHARACTERISTIC LATC_Test_Calc_P.P_LCS_DetNoOverRide_DrvTrq_TH /end DEF_CHARACTERISTIC /end FUNCTION
/begin FUNCTION LCS_Angle.OverRideDetect.LP_filter4 "" /end FUNCTION
/begin FUNCTION LCS_Angle.OverRideDetect.Subsystem17 "" /end FUNCTION
/begin FUNCTION LCS_Angle.OverRideDetect.Subsystem4 "" /end FUNCTION
/begin FUNCTION LCS_Angle.Product1 "" /end FUNCTION
/begin FUNCTION LCS_Angle.Product12 "" /end FUNCTION
/begin FUNCTION LCS_Angle.Product15 "" /end FUNCTION
/begin FUNCTION LCS_Angle.Product2 "" /end FUNCTION
/begin FUNCTION LCS_Angle.Product3 "" /end FUNCTION
/begin FUNCTION LCS_Angle.Product4 "" /end FUNCTION
/begin FUNCTION LCS_Angle.Product5 "" /end FUNCTION
/begin FUNCTION LCS_Angle.Product6 "" /end FUNCTION
/begin FUNCTION LCS_Angle.Product7 "" /end FUNCTION
/begin FUNCTION LCS_Angle.Product8 "" /end FUNCTION
/begin FUNCTION LCS_Angle.Product9 "" /end FUNCTION
/begin FUNCTION LCS_Angle.Signal_Copy "" /end FUNCTION
/begin FUNCTION LCS_Angle.Subsystem5 "" /end FUNCTION
/begin FUNCTION LCS_Angle.Sum "" /end FUNCTION
/begin FUNCTION LCS_Angle.Switch "" /end FUNCTION
/begin FUNCTION LCS_Angle.TargetSteerAngleCalc ""
 /begin SUB_FUNCTION LCS_Angle.TargetSteerAngleCalc.Add LCS_Angle.TargetSteerAngleCalc.Compare_To_Constant LCS_Angle.TargetSteerAngleCalc.Compare_To_Constant1 LCS_Angle.TargetSteerAngleCalc.Constant LCS_Angle.TargetSteerAngleCalc.Constant2 LCS_Angle.TargetSteerAngleCalc.Constant3 LCS_Angle.TargetSteerAngleCalc.Constant4 LCS_Angle.TargetSteerAngleCalc.ESS_AES_Active LCS_Angle.TargetSteerAngleCalc.LP_filter LCS_Angle.TargetSteerAngleCalc.Output1 LCS_Angle.TargetSteerAngleCalc.Output2 LCS_Angle.TargetSteerAngleCalc.Output3 LCS_Angle.TargetSteerAngleCalc.Output4 LCS_Angle.TargetSteerAngleCalc.Output5 LCS_Angle.TargetSteerAngleCalc.Output6 LCS_Angle.TargetSteerAngleCalc.Q1 LCS_Angle.TargetSteerAngleCalc.Sign LCS_Angle.TargetSteerAngleCalc.tDeltaEpsTable LCS_Angle.TargetSteerAngleCalc.tDeltaEpsTable1 /end SUB_FUNCTION
/end FUNCTION
/begin FUNCTION LCS_Angle.TargetSteerAngleCalc.Add "" /end FUNCTION
/begin FUNCTION LCS_Angle.TargetSteerAngleCalc.Compare_To_Constant "" /end FUNCTION
/begin FUNCTION LCS_Angle.TargetSteerAngleCalc.Compare_To_Constant1 "" /end FUNCTION
/begin FUNCTION LCS_Angle.TargetSteerAngleCalc.Constant "" /begin DEF_CHARACTERISTIC P_LCS_AngleFilterTime /end DEF_CHARACTERISTIC /end FUNCTION
/begin FUNCTION LCS_Angle.TargetSteerAngleCalc.Constant2 "" /begin DEF_CHARACTERISTIC P_LCS_ESSAngSlope_SW /end DEF_CHARACTERISTIC /end FUNCTION
/begin FUNCTION LCS_Angle.TargetSteerAngleCalc.Constant3 "" /begin DEF_CHARACTERISTIC P_LCS_ESSAngleSW /end DEF_CHARACTERISTIC /end FUNCTION
/begin FUNCTION LCS_Angle.TargetSteerAngleCalc.Constant4 "" /begin DEF_CHARACTERISTIC P_LCS_ESSAngleSW2 /end DEF_CHARACTERISTIC /end FUNCTION
/begin FUNCTION LCS_Angle.TargetSteerAngleCalc.ESS_AES_Active ""
 /begin DEF_CHARACTERISTIC P_LCS_A0_Dis_BP P_LCS_AngleSlope_ESS_Add P_LCS_AngleSlope_Spd_BP /end DEF_CHARACTERISTIC
/end FUNCTION
/begin FUNCTION LCS_Angle.TargetSteerAngleCalc.LP_filter "" /end FUNCTION
/begin FUNCTION LCS_Angle.TargetSteerAngleCalc.Output1 "" /end FUNCTION
/begin FUNCTION LCS_Angle.TargetSteerAngleCalc.Output2 "" /end FUNCTION
/begin FUNCTION LCS_Angle.TargetSteerAngleCalc.Output3 "" /end FUNCTION
/begin FUNCTION LCS_Angle.TargetSteerAngleCalc.Output4 "" /end FUNCTION
/begin FUNCTION LCS_Angle.TargetSteerAngleCalc.Output5 "" /end FUNCTION
/begin FUNCTION LCS_Angle.TargetSteerAngleCalc.Output6 "" /end FUNCTION
/begin FUNCTION LCS_Angle.TargetSteerAngleCalc.Q1 "" /end FUNCTION
/begin FUNCTION LCS_Angle.TargetSteerAngleCalc.Sign "" /end FUNCTION
/begin FUNCTION LCS_Angle.TargetSteerAngleCalc.tDeltaEpsTable "" /begin DEF_CHARACTERISTIC P_LCS_DeltaEps_SpdBp P_LCS_DeltaEps_TimeVal /end DEF_CHARACTERISTIC /end FUNCTION
/begin FUNCTION LCS_Angle.TargetSteerAngleCalc.tDeltaEpsTable1 "" /end FUNCTION
/begin FUNCTION LCS_Angle.preDisMin_TB "" /begin DEF_CHARACTERISTIC P_LCS_LCK_preDis_Nomal P_LCS_preDis_spd /end DEF_CHARACTERISTIC /end FUNCTION
/begin FUNCTION LCS_Angle.preDisMin_TB1 "" /begin DEF_CHARACTERISTIC P_LCS_LCK_preDis_Nomal P_LCS_preDis_spd /end DEF_CHARACTERISTIC /end FUNCTION
/begin FUNCTION LCS_Angle.preDisMin_TB2 "" /begin DEF_CHARACTERISTIC P_LCS_LCK_preDis_Nomal P_LCS_preDis_spd /end DEF_CHARACTERISTIC /end FUNCTION
/begin FUNCTION LCS_Angle.preDisMin_TB3 "" /begin DEF_CHARACTERISTIC P_LCS_LCK_preDis_Nomal P_LCS_preDis_spd /end DEF_CHARACTERISTIC /end FUNCTION
/begin FUNCTION LCS_Angle.preDisMin_TB4 "" /begin DEF_CHARACTERISTIC P_LCS_LCK_preDis_Nomal P_LCS_preDis_spd /end DEF_CHARACTERISTIC /end FUNCTION
/begin FUNCTION LCS_Angle.preDisMin_TB5 "" /begin DEF_CHARACTERISTIC P_LCS_ESS_preDis_Nomal P_LCS_preDis_spd /end DEF_CHARACTERISTIC /end FUNCTION
/begin FUNCTION LCS_Angle.predis_ayFac1 "" /begin DEF_CHARACTERISTIC P_LCS_A2_Curve_BP P_LCS_preDis_LCK_A2Curve_Fac2 /end DEF_CHARACTERISTIC /end FUNCTION
/begin FUNCTION LCS_Angle.predis_ayFac4 "" /begin DEF_CHARACTERISTIC P_LCS_A2_LatAcc_BP P_LCS_preDis_LCK_A2Curve_Fac /end DEF_CHARACTERISTIC /end FUNCTION
/begin FUNCTION Output1 "" /end FUNCTION
/end MODULE
/end PROJECT
