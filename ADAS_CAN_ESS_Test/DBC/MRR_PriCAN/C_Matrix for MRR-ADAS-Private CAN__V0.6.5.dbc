VERSION ""

NS_ :

BS_:

BU_: MRR IDC_L2

BO_ 3221225472 VECTOR__INDEPENDENT_SIG_MSG: 0 Vector__XXX
 SG_ Destination_HC_NM : 0|8@0+ (1,0) [0|63] "" Vector__XXX
 SG_ OpCode_HC_NM : 0|8@0+ (1,0) [0|63] "" Vector__XXX
 SG_ Destination_GW_NM : 0|8@0+ (1,0) [0|63] "" Vector__XXX
 SG_ OpCode_GW_NM : 0|8@0+ (1,0) [0|63] "" Vector__XXX
 SG_ DiagFuncReq : 0|64@0+ (1,0) [0|1.84467440737096E+019] "" Vector__XXX
 SG_ GW_Phy_Req : 0|64@0+ (1,0) [0|1.84467440737096E+019] "" Vector__XXX
 SG_ RSDS_L_Phy_Req : 0|64@0+ (1,0) [0|1.84467440737096E+019] "" Vector__XXX
 SG_ RSDS_R_Phy_Req : 0|64@0+ (1,0) [0|1.84467440737096E+019] "" Vector__XXX
 SG_ IFC_Phy_Req : 0|64@0+ (1,0) [0|1.84467440737096E+019] "" Vector__XXX
 SG_ HC_Phy_Req : 0|64@0+ (1,0) [0|1.84467440737096E+019] "" Vector__XXX
 SG_ HAP_IPAS_Phy_Req : 0|64@0+ (1,0) [0|1.84467440737096E+019] "" Vector__XXX
 SG_ GW_Phy_Resp : 0|64@0+ (1,0) [0|1.84467440737096E+019] "" Vector__XXX
 SG_ RSDS_L_Phy_Resp : 0|64@0+ (1,0) [0|1.84467440737096E+019] "" Vector__XXX
 SG_ RSDS_R_Phy_Resp : 0|64@0+ (1,0) [0|1.84467440737096E+019] "" Vector__XXX
 SG_ IFC_Phy_Resp : 0|64@0+ (1,0) [0|1.84467440737096E+019] "" Vector__XXX
 SG_ HC_Phy_Resp : 0|64@0+ (1,0) [0|1.84467440737096E+019] "" Vector__XXX
 SG_ HAP_IPAS_Phy_Resp : 0|64@0+ (1,0) [0|1.84467440737096E+019] "" Vector__XXX
 SG_ MRR_SAS_ErrorStatus : 0|1@0+ (1,0) [0|1] "" Vector__XXX

BO_ 1136 ADAS_AD1: 16 IDC_L2
 SG_ Sync_CRC : 15|8@0+ (1,0) [0|255] ""  MRR
 SG_ Sync_OVS : 25|2@0+ (1,0) [0|3] ""  MRR
 SG_ Sync_Resd : 31|5@0+ (1,0) [0|31] ""  MRR
 SG_ Sync_Counter : 19|4@0+ (1,0) [0|15] ""  MRR
 SG_ Sync_SGW : 26|1@0+ (1,0) [0|1] ""  MRR
 SG_ Sync_SyncTime : 39|32@0+ (1,0) [0|4294967295] ""  MRR
 SG_ Sync_TimeDomain : 23|4@0+ (1,0) [0|15] ""  MRR
 SG_ Sync_Type : 7|8@0+ (1,0) [0|255] ""  MRR

BO_ 1072 MRRAD1: 64 MRR
 SG_ MRR_BLIND : 465|2@0+ (1,0) [0|3] ""  IDC_L2
 SG_ MRR_ObjMeasured_1 : 473|2@0+ (1,0) [0|3] ""  IDC_L2
 SG_ MRR_hdr_AutoSarTimeStamp : 487|26@0+ (1,0) [0|67108863] "ms"  IDC_L2
 SG_ MRR_hdr_ErrorStatus : 213|4@0+ (1,0) [0|15] ""  IDC_L2
 SG_ MRR_hdr_TimeStamp : 223|27@0+ (0.00097,0) [0|65536] "s"  IDC_L2
 SG_ MRR_ObjID_1 : 15|8@0+ (1,0) [0|255] ""  IDC_L2
 SG_ MRR_ObjExistProb_1 : 23|5@0+ (0.03125,0) [0|0.96875] ""  IDC_L2
 SG_ MRR_ObjObstacleProb_1 : 18|5@0+ (0.03125,0) [0|0.96875] ""  IDC_L2
 SG_ MRR_ObjDistX_1 : 29|12@0+ (0.0625,0) [0|254.9375] "m"  IDC_L2
 SG_ MRR_ObjDistY_1 : 33|11@0+ (0.125,-128) [-128|127.875] "m"  IDC_L2
 SG_ MRR_ObjRelVelX_1 : 79|13@0+ (0.0312,-128) [-128|126.9976] "mps"  IDC_L2
 SG_ MRR_ObjRelVelY_1 : 82|13@0+ (0.0312,-128) [-128|126.9976] "mps"  IDC_L2
 SG_ MRR_ObjRelAccelX_1 : 54|10@0+ (0.03125,-16) [-16|15.96875] "mps2"  IDC_L2
 SG_ MRR_ObjRelAccelY_1 : 101|10@0+ (0.03125,-16) [-16|15.96875] "mps2"  IDC_L2
 SG_ MRR_ObjDistXStd_1 : 107|6@0+ (0.1,0) [0|6] "m"  IDC_L2
 SG_ MRR_ObjDistYStd_1 : 117|6@0+ (0.1,0) [0|6] "m"  IDC_L2
 SG_ MRR_ObjRelVelXStd_1 : 143|6@0+ (0.0625,0) [0|3.9375] "mps"  IDC_L2
 SG_ MRR_ObjRelVelYStd_1 : 137|6@0+ (0.0625,0) [0|3.9375] "mps"  IDC_L2
 SG_ MRR_ObjRAccelXStd_1 : 147|6@0+ (0.0625,0) [0|3.9375] "mps2"  IDC_L2
 SG_ MRR_ObjRAccelYStd_1 : 157|6@0+ (0.0625,0) [0|3.9375] "mps2"  IDC_L2
 SG_ MRR_ObjType_1 : 127|4@0+ (1,0) [0|15] ""  IDC_L2
 SG_ MRR_ObjMotionType_1 : 167|3@0+ (1,0) [0|7] ""  IDC_L2
 SG_ VFC_ObjWidth_1 : 164|10@0+ (0.01,0) [0|5] "m"  IDC_L2
 SG_ VFC_ObjLength_1 : 170|10@0+ (0.05,0) [0|20] "m"  IDC_L2
 SG_ VFC_ObjHeight_1 : 207|10@0+ (0.01,0) [0|6] "m"  IDC_L2
 SG_ VFC_ObjMotionDirection_1 : 176|3@0+ (1,0) [0|7] ""  IDC_L2
 SG_ MRR_ObjID_2 : 271|8@0+ (1,0) [0|255] ""  IDC_L2
 SG_ MRR_ObjExistProb_2 : 279|5@0+ (0.03125,0) [0|0.96875] ""  IDC_L2
 SG_ MRR_ObjObstacleProb_2 : 274|5@0+ (0.03125,0) [0|0.96875] ""  IDC_L2
 SG_ MRR_ObjDistX_2 : 285|12@0+ (0.0625,0) [0|254.9375] "m"  IDC_L2
 SG_ MRR_ObjDistY_2 : 289|11@0+ (0.125,-128) [-128|127.875] "m"  IDC_L2
 SG_ MRR_ObjRelVelX_2 : 335|13@0+ (0.0312,-128) [-128|126.9976] "mps"  IDC_L2
 SG_ MRR_ObjRelVelY_2 : 338|13@0+ (0.0312,-128) [-128|126.9976] "mps"  IDC_L2
 SG_ MRR_ObjRelAccelX_2 : 310|10@0+ (0.03125,-16) [-16|15.96875] "mps2"  IDC_L2
 SG_ MRR_ObjRelAccelY_2 : 357|10@0+ (0.03125,-16) [-16|15.96875] "mps2"  IDC_L2
 SG_ MRR_ObjDistXStd_2 : 363|6@0+ (0.1,0) [0|6] "m"  IDC_L2
 SG_ MRR_ObjDistYStd_2 : 373|6@0+ (0.1,0) [0|6] "m"  IDC_L2
 SG_ MRR_ObjRelVelXStd_2 : 399|6@0+ (0.0625,0) [0|3.9375] "mps"  IDC_L2
 SG_ MRR_ObjRelVelYStd_2 : 393|6@0+ (0.0625,0) [0|3.9375] "mps"  IDC_L2
 SG_ MRR_ObjRAccelXStd_2 : 403|6@0+ (0.0625,0) [0|3.9375] "mps2"  IDC_L2
 SG_ MRR_ObjRAccelYStd_2 : 413|6@0+ (0.0625,0) [0|3.9375] "mps2"  IDC_L2
 SG_ MRR_ObjType_2 : 383|4@0+ (1,0) [0|15] ""  IDC_L2
 SG_ MRR_ObjMotionType_2 : 423|3@0+ (1,0) [0|7] ""  IDC_L2
 SG_ VFC_ObjWidth_2 : 420|10@0+ (0.01,0) [0|5] "m"  IDC_L2
 SG_ VFC_ObjLength_2 : 426|10@0+ (0.05,0) [0|20] "m"  IDC_L2
 SG_ VFC_ObjHeight_2 : 463|10@0+ (0.01,0) [0|6] "m"  IDC_L2
 SG_ VFC_ObjMotionDirection_2 : 432|3@0+ (1,0) [0|7] ""  IDC_L2
 SG_ Checksum1 : 7|8@0+ (1,0) [0|255] ""  IDC_L2
 SG_ Checksum2 : 71|8@0+ (1,0) [0|255] ""  IDC_L2
 SG_ Checksum3 : 135|8@0+ (1,0) [0|255] ""  IDC_L2
 SG_ Checksum4 : 199|8@0+ (1,0) [0|255] ""  IDC_L2
 SG_ Checksum5 : 263|8@0+ (1,0) [0|255] ""  IDC_L2
 SG_ Checksum6 : 327|8@0+ (1,0) [0|255] ""  IDC_L2
 SG_ Checksum7 : 391|8@0+ (1,0) [0|255] ""  IDC_L2
 SG_ Checksum8 : 455|8@0+ (1,0) [0|255] ""  IDC_L2
 SG_ RollingCounter1 : 59|4@0+ (1,0) [0|15] ""  IDC_L2
 SG_ RollingCounter2 : 123|4@0+ (1,0) [0|15] ""  IDC_L2
 SG_ RollingCounter3 : 187|4@0+ (1,0) [0|15] ""  IDC_L2
 SG_ RollingCounter4 : 251|4@0+ (1,0) [0|15] ""  IDC_L2
 SG_ RollingCounter5 : 315|4@0+ (1,0) [0|15] ""  IDC_L2
 SG_ RollingCounter6 : 379|4@0+ (1,0) [0|15] ""  IDC_L2
 SG_ RollingCounter7 : 443|4@0+ (1,0) [0|15] ""  IDC_L2
 SG_ RollingCounter8 : 507|4@0+ (1,0) [0|15] ""  IDC_L2
 SG_ MRR_hdr_TimerStempStatus : 244|8@0+ (1,0) [0|255] ""  IDC_L2
 SG_ BlockCounter1 : 469|4@0+ (1,0) [0|15] ""  IDC_L2

BO_ 1081 MRRAD10: 64 MRR
 SG_ MRR_ObjMeasured_10 : 497|2@0+ (1,0) [0|3] "" Vector__XXX
 SG_ MRR_ObjID_19 : 15|8@0+ (1,0) [0|255] ""  IDC_L2
 SG_ MRR_ObjExistProb_19 : 23|5@0+ (0.03125,0) [0|0.96875] ""  IDC_L2
 SG_ MRR_ObjObstacleProb_19 : 18|5@0+ (0.03125,0) [0|0.96875] ""  IDC_L2
 SG_ MRR_ObjDistX_19 : 29|12@0+ (0.0625,0) [0|254.9375] "m"  IDC_L2
 SG_ MRR_ObjDistY_19 : 33|11@0+ (0.125,-128) [-128|127.875] "m"  IDC_L2
 SG_ MRR_ObjRelVelX_19 : 79|13@0+ (0.0312,-128) [-128|126.9976] "mps"  IDC_L2
 SG_ MRR_ObjRelVelY_19 : 82|13@0+ (0.0312,-128) [-128|126.9976] "mps"  IDC_L2
 SG_ MRR_ObjRelAccelX_19 : 54|10@0+ (0.03125,-16) [-16|15.96875] "mps2"  IDC_L2
 SG_ MRR_ObjRelAccelY_19 : 101|10@0+ (0.03125,-16) [-16|15.96875] "mps2"  IDC_L2
 SG_ MRR_ObjDistXStd_19 : 107|6@0+ (0.1,0) [0|6] "m"  IDC_L2
 SG_ MRR_ObjDistYStd_19 : 117|6@0+ (0.1,0) [0|6] "m"  IDC_L2
 SG_ MRR_ObjRelVelXStd_19 : 143|6@0+ (0.0625,0) [0|3.9375] "mps"  IDC_L2
 SG_ MRR_ObjRelVelYStd_19 : 137|6@0+ (0.0625,0) [0|3.9375] "mps"  IDC_L2
 SG_ MRR_ObjRAccelXStd_19 : 147|6@0+ (0.0625,0) [0|3.9375] "mps2"  IDC_L2
 SG_ MRR_ObjRAccelYStd_19 : 157|6@0+ (0.0625,0) [0|3.9375] "mps2"  IDC_L2
 SG_ MRR_ObjType_19 : 127|4@0+ (1,0) [0|15] ""  IDC_L2
 SG_ MRR_ObjMotionType_19 : 167|3@0+ (1,0) [0|7] ""  IDC_L2
 SG_ VFC_ObjWidth_19 : 164|10@0+ (0.01,0) [0|5] "m"  IDC_L2
 SG_ VFC_ObjLength_19 : 170|10@0+ (0.05,0) [0|20] "m"  IDC_L2
 SG_ VFC_ObjHeight_19 : 207|10@0+ (0.01,0) [0|6] "m"  IDC_L2
 SG_ VFC_ObjMotionDirection_19 : 176|3@0+ (1,0) [0|7] ""  IDC_L2
 SG_ MRR_ObjID_20 : 271|8@0+ (1,0) [0|255] ""  IDC_L2
 SG_ MRR_ObjExistProb_20 : 279|5@0+ (0.03125,0) [0|0.96875] ""  IDC_L2
 SG_ MRR_ObjObstacleProb_20 : 274|5@0+ (0.03125,0) [0|0.96875] ""  IDC_L2
 SG_ MRR_ObjDistX_20 : 285|12@0+ (0.0625,0) [0|254.9375] "m"  IDC_L2
 SG_ MRR_ObjDistY_20 : 289|11@0+ (0.125,-128) [-128|127.875] "m"  IDC_L2
 SG_ MRR_ObjRelVelX_20 : 335|13@0+ (0.0312,-128) [-128|126.9976] "mps"  IDC_L2
 SG_ MRR_ObjRelVelY_20 : 338|13@0+ (0.0312,-128) [-128|126.9976] "mps"  IDC_L2
 SG_ MRR_ObjRelAccelX_20 : 310|10@0+ (0.03125,-16) [-16|15.96875] "mps2"  IDC_L2
 SG_ MRR_ObjRelAccelY_20 : 357|10@0+ (0.03125,-16) [-16|15.96875] "mps2"  IDC_L2
 SG_ MRR_ObjDistXStd_20 : 363|6@0+ (0.1,0) [0|6] "m"  IDC_L2
 SG_ MRR_ObjDistYStd_20 : 373|6@0+ (0.1,0) [0|6] "m"  IDC_L2
 SG_ MRR_ObjRelVelXStd_20 : 399|6@0+ (0.0625,0) [0|3.9375] "mps"  IDC_L2
 SG_ MRR_ObjRelVelYStd_20 : 393|6@0+ (0.0625,0) [0|3.9375] "mps"  IDC_L2
 SG_ MRR_ObjRAccelXStd_20 : 403|6@0+ (0.0625,0) [0|3.9375] "mps2"  IDC_L2
 SG_ MRR_ObjRAccelYStd_20 : 413|6@0+ (0.0625,0) [0|3.9375] "mps2"  IDC_L2
 SG_ MRR_ObjType_20 : 383|4@0+ (1,0) [0|15] ""  IDC_L2
 SG_ MRR_ObjMotionType_20 : 423|3@0+ (1,0) [0|7] ""  IDC_L2
 SG_ VFC_ObjWidth_20 : 420|10@0+ (0.01,0) [0|5] "m"  IDC_L2
 SG_ VFC_ObjLength_20 : 426|10@0+ (0.05,0) [0|20] "m"  IDC_L2
 SG_ VFC_ObjHeight_20 : 463|10@0+ (0.01,0) [0|6] "m"  IDC_L2
 SG_ VFC_ObjMotionDirection_20 : 432|3@0+ (1,0) [0|7] ""  IDC_L2
 SG_ Checksum73 : 7|8@0+ (1,0) [0|255] ""  IDC_L2
 SG_ Checksum74 : 71|8@0+ (1,0) [0|255] ""  IDC_L2
 SG_ Checksum75 : 135|8@0+ (1,0) [0|255] ""  IDC_L2
 SG_ Checksum76 : 199|8@0+ (1,0) [0|255] ""  IDC_L2
 SG_ Checksum77 : 263|8@0+ (1,0) [0|255] ""  IDC_L2
 SG_ Checksum78 : 327|8@0+ (1,0) [0|255] ""  IDC_L2
 SG_ Checksum79 : 391|8@0+ (1,0) [0|255] ""  IDC_L2
 SG_ Checksum80 : 455|8@0+ (1,0) [0|255] ""  IDC_L2
 SG_ RollingCounter73 : 59|4@0+ (1,0) [0|15] ""  IDC_L2
 SG_ RollingCounter74 : 123|4@0+ (1,0) [0|15] ""  IDC_L2
 SG_ RollingCounter75 : 187|4@0+ (1,0) [0|15] ""  IDC_L2
 SG_ RollingCounter76 : 251|4@0+ (1,0) [0|15] ""  IDC_L2
 SG_ RollingCounter77 : 315|4@0+ (1,0) [0|15] ""  IDC_L2
 SG_ RollingCounter78 : 379|4@0+ (1,0) [0|15] ""  IDC_L2
 SG_ RollingCounter79 : 443|4@0+ (1,0) [0|15] ""  IDC_L2
 SG_ RollingCounter80 : 507|4@0+ (1,0) [0|15] ""  IDC_L2
 SG_ BlockCounter10 : 469|4@0+ (1,0) [0|15] ""  IDC_L2

BO_ 1082 MRRAD11: 64 MRR
 SG_ MRR_ObjMeasured_11 : 497|2@0+ (1,0) [0|3] ""  IDC_L2
 SG_ MRR_ObjID_21 : 15|8@0+ (1,0) [0|255] ""  IDC_L2
 SG_ MRR_ObjExistProb_21 : 23|5@0+ (0.03125,0) [0|0.96875] ""  IDC_L2
 SG_ MRR_ObjObstacleProb_21 : 18|5@0+ (0.03125,0) [0|0.96875] ""  IDC_L2
 SG_ MRR_ObjDistX_21 : 29|12@0+ (0.0625,0) [0|254.9375] "m"  IDC_L2
 SG_ MRR_ObjDistY_21 : 33|11@0+ (0.125,-128) [-128|127.875] "m"  IDC_L2
 SG_ MRR_ObjRelVelX_21 : 79|13@0+ (0.0312,-128) [-128|126.9976] "mps"  IDC_L2
 SG_ MRR_ObjRelVelY_21 : 82|13@0+ (0.0312,-128) [-128|126.9976] "mps"  IDC_L2
 SG_ MRR_ObjRelAccelX_21 : 54|10@0+ (0.03125,-16) [-16|15.96875] "mps2"  IDC_L2
 SG_ MRR_ObjRelAccelY_21 : 101|10@0+ (0.03125,-16) [-16|15.96875] "mps2"  IDC_L2
 SG_ MRR_ObjDistXStd_21 : 107|6@0+ (0.1,0) [0|6] "m"  IDC_L2
 SG_ MRR_ObjDistYStd_21 : 117|6@0+ (0.1,0) [0|6] "m"  IDC_L2
 SG_ MRR_ObjRelVelXStd_21 : 143|6@0+ (0.0625,0) [0|3.9375] "mps"  IDC_L2
 SG_ MRR_ObjRelVelYStd_21 : 137|6@0+ (0.0625,0) [0|3.9375] "mps"  IDC_L2
 SG_ MRR_ObjRAccelXStd_21 : 147|6@0+ (0.0625,0) [0|3.9375] "mps2"  IDC_L2
 SG_ MRR_ObjRAccelYStd_21 : 157|6@0+ (0.0625,0) [0|3.9375] "mps2"  IDC_L2
 SG_ MRR_ObjType_21 : 127|4@0+ (1,0) [0|15] ""  IDC_L2
 SG_ MRR_ObjMotionType_21 : 167|3@0+ (1,0) [0|7] ""  IDC_L2
 SG_ VFC_ObjWidth_21 : 164|10@0+ (0.01,0) [0|5] "m"  IDC_L2
 SG_ VFC_ObjLength_21 : 170|10@0+ (0.05,0) [0|20] "m"  IDC_L2
 SG_ VFC_ObjHeight_21 : 207|10@0+ (0.01,0) [0|6] "m"  IDC_L2
 SG_ VFC_ObjMotionDirection_21 : 176|3@0+ (1,0) [0|7] ""  IDC_L2
 SG_ MRR_ObjID_22 : 271|8@0+ (1,0) [0|255] ""  IDC_L2
 SG_ MRR_ObjExistProb_22 : 279|5@0+ (0.03125,0) [0|0.96875] ""  IDC_L2
 SG_ MRR_ObjObstacleProb_22 : 274|5@0+ (0.03125,0) [0|0.96875] ""  IDC_L2
 SG_ MRR_ObjDistX_22 : 285|12@0+ (0.0625,0) [0|254.9375] "m"  IDC_L2
 SG_ MRR_ObjDistY_22 : 289|11@0+ (0.125,-128) [-128|127.875] "m"  IDC_L2
 SG_ MRR_ObjRelVelX_22 : 335|13@0+ (0.0312,-128) [-128|126.9976] "mps"  IDC_L2
 SG_ MRR_ObjRelVelY_22 : 338|13@0+ (0.0312,-128) [-128|126.9976] "mps"  IDC_L2
 SG_ MRR_ObjRelAccelX_22 : 310|10@0+ (0.03125,-16) [-16|15.96875] "mps2"  IDC_L2
 SG_ MRR_ObjRelAccelY_22 : 357|10@0+ (0.03125,-16) [-16|15.96875] "mps2"  IDC_L2
 SG_ MRR_ObjDistXStd_22 : 363|6@0+ (0.1,0) [0|6] "m"  IDC_L2
 SG_ MRR_ObjDistYStd_22 : 373|6@0+ (0.1,0) [0|6] "m"  IDC_L2
 SG_ MRR_ObjRelVelXStd_22 : 399|6@0+ (0.0625,0) [0|3.9375] "mps"  IDC_L2
 SG_ MRR_ObjRelVelYStd_22 : 393|6@0+ (0.0625,0) [0|3.9375] "mps"  IDC_L2
 SG_ MRR_ObjRAccelXStd_22 : 403|6@0+ (0.0625,0) [0|3.9375] "mps2"  IDC_L2
 SG_ MRR_ObjRAccelYStd_22 : 413|6@0+ (0.0625,0) [0|3.9375] "mps2"  IDC_L2
 SG_ MRR_ObjType_22 : 383|4@0+ (1,0) [0|15] ""  IDC_L2
 SG_ MRR_ObjMotionType_22 : 423|3@0+ (1,0) [0|7] ""  IDC_L2
 SG_ VFC_ObjWidth_22 : 420|10@0+ (0.01,0) [0|5] "m"  IDC_L2
 SG_ VFC_ObjLength_22 : 426|10@0+ (0.05,0) [0|20] "m"  IDC_L2
 SG_ VFC_ObjHeight_22 : 463|10@0+ (0.01,0) [0|6] "m"  IDC_L2
 SG_ VFC_ObjMotionDirection_22 : 432|3@0+ (1,0) [0|7] ""  IDC_L2
 SG_ Checksum81 : 7|8@0+ (1,0) [0|255] ""  IDC_L2
 SG_ Checksum82 : 71|8@0+ (1,0) [0|255] ""  IDC_L2
 SG_ Checksum83 : 135|8@0+ (1,0) [0|255] ""  IDC_L2
 SG_ Checksum84 : 199|8@0+ (1,0) [0|255] ""  IDC_L2
 SG_ Checksum85 : 263|8@0+ (1,0) [0|255] ""  IDC_L2
 SG_ Checksum86 : 327|8@0+ (1,0) [0|255] ""  IDC_L2
 SG_ Checksum87 : 391|8@0+ (1,0) [0|255] ""  IDC_L2
 SG_ Checksum88 : 455|8@0+ (1,0) [0|255] ""  IDC_L2
 SG_ RollingCounter81 : 59|4@0+ (1,0) [0|15] ""  IDC_L2
 SG_ RollingCounter82 : 123|4@0+ (1,0) [0|15] ""  IDC_L2
 SG_ RollingCounter83 : 187|4@0+ (1,0) [0|15] ""  IDC_L2
 SG_ RollingCounter84 : 251|4@0+ (1,0) [0|15] ""  IDC_L2
 SG_ RollingCounter85 : 315|4@0+ (1,0) [0|15] ""  IDC_L2
 SG_ RollingCounter86 : 379|4@0+ (1,0) [0|15] ""  IDC_L2
 SG_ RollingCounter87 : 443|4@0+ (1,0) [0|15] ""  IDC_L2
 SG_ RollingCounter88 : 507|4@0+ (1,0) [0|15] ""  IDC_L2
 SG_ BlockCounter11 : 469|4@0+ (1,0) [0|15] ""  IDC_L2

BO_ 1083 MRRAD12: 64 MRR
 SG_ MRR_ObjMeasured_12 : 497|2@0+ (1,0) [0|3] ""  IDC_L2
 SG_ MRR_ObjID_23 : 15|8@0+ (1,0) [0|255] ""  IDC_L2
 SG_ MRR_ObjExistProb_23 : 23|5@0+ (0.03125,0) [0|0.96875] ""  IDC_L2
 SG_ MRR_ObjObstacleProb_23 : 18|5@0+ (0.03125,0) [0|0.96875] ""  IDC_L2
 SG_ MRR_ObjDistX_23 : 29|12@0+ (0.0625,0) [0|254.9375] "m"  IDC_L2
 SG_ MRR_ObjDistY_23 : 33|11@0+ (0.125,-128) [-128|127.875] "m"  IDC_L2
 SG_ MRR_ObjRelVelX_23 : 79|13@0+ (0.0312,-128) [-128|126.9976] "mps"  IDC_L2
 SG_ MRR_ObjRelVelY_23 : 82|13@0+ (0.0312,-128) [-128|126.9976] "mps"  IDC_L2
 SG_ MRR_ObjRelAccelX_23 : 54|10@0+ (0.03125,-16) [-16|15.96875] "mps2"  IDC_L2
 SG_ MRR_ObjRelAccelY_23 : 101|10@0+ (0.03125,-16) [-16|15.96875] "mps2"  IDC_L2
 SG_ MRR_ObjDistXStd_23 : 107|6@0+ (0.1,0) [0|6] "m"  IDC_L2
 SG_ MRR_ObjDistYStd_23 : 117|6@0+ (0.1,0) [0|6] "m"  IDC_L2
 SG_ MRR_ObjRelVelXStd_23 : 143|6@0+ (0.0625,0) [0|3.9375] "mps"  IDC_L2
 SG_ MRR_ObjRelVelYStd_23 : 137|6@0+ (0.0625,0) [0|3.9375] "mps"  IDC_L2
 SG_ MRR_ObjRAccelXStd_23 : 147|6@0+ (0.0625,0) [0|3.9375] "mps2"  IDC_L2
 SG_ MRR_ObjRAccelYStd_23 : 157|6@0+ (0.0625,0) [0|3.9375] "mps2"  IDC_L2
 SG_ MRR_ObjType_23 : 127|4@0+ (1,0) [0|15] ""  IDC_L2
 SG_ MRR_ObjMotionType_23 : 167|3@0+ (1,0) [0|7] ""  IDC_L2
 SG_ VFC_ObjWidth_23 : 164|10@0+ (0.01,0) [0|5] "m"  IDC_L2
 SG_ VFC_ObjLength_23 : 170|10@0+ (0.05,0) [0|20] "m"  IDC_L2
 SG_ VFC_ObjHeight_23 : 207|10@0+ (0.01,0) [0|6] "m"  IDC_L2
 SG_ VFC_ObjMotionDirection_23 : 176|3@0+ (1,0) [0|7] ""  IDC_L2
 SG_ MRR_ObjID_24 : 271|8@0+ (1,0) [0|255] ""  IDC_L2
 SG_ MRR_ObjExistProb_24 : 279|5@0+ (0.03125,0) [0|0.96875] ""  IDC_L2
 SG_ MRR_ObjObstacleProb_24 : 274|5@0+ (0.03125,0) [0|0.96875] ""  IDC_L2
 SG_ MRR_ObjDistX_24 : 285|12@0+ (0.0625,0) [0|254.9375] "m"  IDC_L2
 SG_ MRR_ObjDistY_24 : 289|11@0+ (0.125,-128) [-128|127.875] "m"  IDC_L2
 SG_ MRR_ObjRelVelX_24 : 335|13@0+ (0.0312,-128) [-128|126.9976] "mps"  IDC_L2
 SG_ MRR_ObjRelVelY_24 : 338|13@0+ (0.0312,-128) [-128|126.9976] "mps"  IDC_L2
 SG_ MRR_ObjRelAccelX_24 : 310|10@0+ (0.03125,-16) [-16|15.96875] "mps2"  IDC_L2
 SG_ MRR_ObjRelAccelY_24 : 357|10@0+ (0.03125,-16) [-16|15.96875] "mps2"  IDC_L2
 SG_ MRR_ObjDistXStd_24 : 363|6@0+ (0.1,0) [0|6] "m"  IDC_L2
 SG_ MRR_ObjDistYStd_24 : 373|6@0+ (0.1,0) [0|6] "m"  IDC_L2
 SG_ MRR_ObjRelVelXStd_24 : 399|6@0+ (0.0625,0) [0|3.9375] "mps"  IDC_L2
 SG_ MRR_ObjRelVelYStd_24 : 393|6@0+ (0.0625,0) [0|3.9375] "mps"  IDC_L2
 SG_ MRR_ObjRAccelXStd_24 : 403|6@0+ (0.0625,0) [0|3.9375] "mps2"  IDC_L2
 SG_ MRR_ObjRAccelYStd_24 : 413|6@0+ (0.0625,0) [0|3.9375] "mps2"  IDC_L2
 SG_ MRR_ObjType_24 : 383|4@0+ (1,0) [0|15] ""  IDC_L2
 SG_ MRR_ObjMotionType_24 : 423|3@0+ (1,0) [0|7] ""  IDC_L2
 SG_ VFC_ObjWidth_24 : 420|10@0+ (0.01,0) [0|5] "m"  IDC_L2
 SG_ VFC_ObjLength_24 : 426|10@0+ (0.05,0) [0|20] "m"  IDC_L2
 SG_ VFC_ObjHeight_24 : 463|10@0+ (0.01,0) [0|6] "m"  IDC_L2
 SG_ VFC_ObjMotionDirection_24 : 432|3@0+ (1,0) [0|7] ""  IDC_L2
 SG_ Checksum89 : 7|8@0+ (1,0) [0|255] ""  IDC_L2
 SG_ Checksum90 : 71|8@0+ (1,0) [0|255] ""  IDC_L2
 SG_ Checksum91 : 135|8@0+ (1,0) [0|255] ""  IDC_L2
 SG_ Checksum92 : 199|8@0+ (1,0) [0|255] ""  IDC_L2
 SG_ Checksum93 : 263|8@0+ (1,0) [0|255] ""  IDC_L2
 SG_ Checksum94 : 327|8@0+ (1,0) [0|255] ""  IDC_L2
 SG_ Checksum95 : 391|8@0+ (1,0) [0|255] ""  IDC_L2
 SG_ Checksum96 : 455|8@0+ (1,0) [0|255] ""  IDC_L2
 SG_ RollingCounter89 : 59|4@0+ (1,0) [0|15] ""  IDC_L2
 SG_ RollingCounter90 : 123|4@0+ (1,0) [0|15] ""  IDC_L2
 SG_ RollingCounter91 : 187|4@0+ (1,0) [0|15] ""  IDC_L2
 SG_ RollingCounter92 : 251|4@0+ (1,0) [0|15] ""  IDC_L2
 SG_ RollingCounter93 : 315|4@0+ (1,0) [0|15] ""  IDC_L2
 SG_ RollingCounter94 : 379|4@0+ (1,0) [0|15] ""  IDC_L2
 SG_ RollingCounter95 : 443|4@0+ (1,0) [0|15] ""  IDC_L2
 SG_ RollingCounter96 : 507|4@0+ (1,0) [0|15] ""  IDC_L2
 SG_ BlockCounter12 : 469|4@0+ (1,0) [0|15] ""  IDC_L2

BO_ 1084 MRRAD13: 64 MRR
 SG_ MRR_ObjMeasured_13 : 497|2@0+ (1,0) [0|3] ""  IDC_L2
 SG_ MRR_ObjID_25 : 15|8@0+ (1,0) [0|255] ""  IDC_L2
 SG_ MRR_ObjExistProb_25 : 23|5@0+ (0.03125,0) [0|0.96875] ""  IDC_L2
 SG_ MRR_ObjObstacleProb_25 : 18|5@0+ (0.03125,0) [0|0.96875] ""  IDC_L2
 SG_ MRR_ObjDistX_25 : 29|12@0+ (0.0625,0) [0|254.9375] "m"  IDC_L2
 SG_ MRR_ObjDistY_25 : 33|11@0+ (0.125,-128) [-128|127.875] "m"  IDC_L2
 SG_ MRR_ObjRelVelX_25 : 79|13@0+ (0.0312,-128) [-128|126.9976] "mps"  IDC_L2
 SG_ MRR_ObjRelVelY_25 : 82|13@0+ (0.0312,-128) [-128|126.9976] "mps"  IDC_L2
 SG_ MRR_ObjRelAccelX_25 : 54|10@0+ (0.03125,-16) [-16|15.96875] "mps2"  IDC_L2
 SG_ MRR_ObjRelAccelY_25 : 101|10@0+ (0.03125,-16) [-16|15.96875] "mps2"  IDC_L2
 SG_ MRR_ObjDistXStd_25 : 107|6@0+ (0.1,0) [0|6] "m"  IDC_L2
 SG_ MRR_ObjDistYStd_25 : 117|6@0+ (0.1,0) [0|6] "m"  IDC_L2
 SG_ MRR_ObjRelVelXStd_25 : 143|6@0+ (0.0625,0) [0|3.9375] "mps"  IDC_L2
 SG_ MRR_ObjRelVelYStd_25 : 137|6@0+ (0.0625,0) [0|3.9375] "mps"  IDC_L2
 SG_ MRR_ObjRAccelXStd_25 : 147|6@0+ (0.0625,0) [0|3.9375] "mps2"  IDC_L2
 SG_ MRR_ObjRAccelYStd_25 : 157|6@0+ (0.0625,0) [0|3.9375] "mps2"  IDC_L2
 SG_ MRR_ObjType_25 : 127|4@0+ (1,0) [0|15] ""  IDC_L2
 SG_ MRR_ObjMotionType_25 : 167|3@0+ (1,0) [0|7] ""  IDC_L2
 SG_ VFC_ObjWidth_25 : 164|10@0+ (0.01,0) [0|5] "m"  IDC_L2
 SG_ VFC_ObjLength_25 : 170|10@0+ (0.05,0) [0|20] "m"  IDC_L2
 SG_ VFC_ObjHeight_25 : 207|10@0+ (0.01,0) [0|6] "m"  IDC_L2
 SG_ VFC_ObjMotionDirection_25 : 176|3@0+ (1,0) [0|7] ""  IDC_L2
 SG_ MRR_ObjID_26 : 271|8@0+ (1,0) [0|255] ""  IDC_L2
 SG_ MRR_ObjExistProb_26 : 279|5@0+ (0.03125,0) [0|0.96875] ""  IDC_L2
 SG_ MRR_ObjObstacleProb_26 : 274|5@0+ (0.03125,0) [0|0.96875] ""  IDC_L2
 SG_ MRR_ObjDistX_26 : 285|12@0+ (0.0625,0) [0|254.9375] "m"  IDC_L2
 SG_ MRR_ObjDistY_26 : 289|11@0+ (0.125,-128) [-128|127.875] "m"  IDC_L2
 SG_ MRR_ObjRelVelX_26 : 335|13@0+ (0.0312,-128) [-128|126.9976] "mps"  IDC_L2
 SG_ MRR_ObjRelVelY_26 : 338|13@0+ (0.0312,-128) [-128|126.9976] "mps"  IDC_L2
 SG_ MRR_ObjRelAccelX_26 : 310|10@0+ (0.03125,-16) [-16|15.96875] "mps2"  IDC_L2
 SG_ MRR_ObjRelAccelY_26 : 357|10@0+ (0.03125,-16) [-16|15.96875] "mps2"  IDC_L2
 SG_ MRR_ObjDistXStd_26 : 363|6@0+ (0.1,0) [0|6] "m"  IDC_L2
 SG_ MRR_ObjDistYStd_26 : 373|6@0+ (0.1,0) [0|6] "m"  IDC_L2
 SG_ MRR_ObjRelVelXStd_26 : 399|6@0+ (0.0625,0) [0|3.9375] "mps"  IDC_L2
 SG_ MRR_ObjRelVelYStd_26 : 393|6@0+ (0.0625,0) [0|3.9375] "mps"  IDC_L2
 SG_ MRR_ObjRAccelXStd_26 : 403|6@0+ (0.0625,0) [0|3.9375] "mps2"  IDC_L2
 SG_ MRR_ObjRAccelYStd_26 : 413|6@0+ (0.0625,0) [0|3.9375] "mps2"  IDC_L2
 SG_ MRR_ObjType_26 : 383|4@0+ (1,0) [0|15] ""  IDC_L2
 SG_ MRR_ObjMotionType_26 : 423|3@0+ (1,0) [0|7] ""  IDC_L2
 SG_ VFC_ObjWidth_26 : 420|10@0+ (0.01,0) [0|5] "m"  IDC_L2
 SG_ VFC_ObjLength_26 : 426|10@0+ (0.05,0) [0|20] "m"  IDC_L2
 SG_ VFC_ObjHeight_26 : 463|10@0+ (0.01,0) [0|6] "m"  IDC_L2
 SG_ VFC_ObjMotionDirection_26 : 432|3@0+ (1,0) [0|7] ""  IDC_L2
 SG_ Checksum97 : 7|8@0+ (1,0) [0|255] ""  IDC_L2
 SG_ Checksum98 : 71|8@0+ (1,0) [0|255] ""  IDC_L2
 SG_ Checksum99 : 135|8@0+ (1,0) [0|255] ""  IDC_L2
 SG_ Checksum100 : 199|8@0+ (1,0) [0|255] ""  IDC_L2
 SG_ Checksum101 : 263|8@0+ (1,0) [0|255] ""  IDC_L2
 SG_ Checksum102 : 327|8@0+ (1,0) [0|255] ""  IDC_L2
 SG_ Checksum103 : 391|8@0+ (1,0) [0|255] ""  IDC_L2
 SG_ Checksum104 : 455|8@0+ (1,0) [0|255] ""  IDC_L2
 SG_ RollingCounter97 : 59|4@0+ (1,0) [0|15] ""  IDC_L2
 SG_ RollingCounter98 : 123|4@0+ (1,0) [0|15] ""  IDC_L2
 SG_ RollingCounter99 : 187|4@0+ (1,0) [0|15] ""  IDC_L2
 SG_ RollingCounter100 : 251|4@0+ (1,0) [0|15] ""  IDC_L2
 SG_ RollingCounter101 : 315|4@0+ (1,0) [0|15] ""  IDC_L2
 SG_ RollingCounter102 : 379|4@0+ (1,0) [0|15] ""  IDC_L2
 SG_ RollingCounter103 : 443|4@0+ (1,0) [0|15] ""  IDC_L2
 SG_ RollingCounter104 : 507|4@0+ (1,0) [0|15] ""  IDC_L2
 SG_ BlockCounter13 : 469|4@0+ (1,0) [0|15] ""  IDC_L2

BO_ 1085 MRRAD14: 64 MRR
 SG_ MRR_ObjMeasured_14 : 497|2@0+ (1,0) [0|3] ""  IDC_L2
 SG_ MRR_ObjID_27 : 15|8@0+ (1,0) [0|255] ""  IDC_L2
 SG_ MRR_ObjExistProb_27 : 23|5@0+ (0.03125,0) [0|0.96875] ""  IDC_L2
 SG_ MRR_ObjObstacleProb_27 : 18|5@0+ (0.03125,0) [0|0.96875] ""  IDC_L2
 SG_ MRR_ObjDistX_27 : 29|12@0+ (0.0625,0) [0|254.9375] "m"  IDC_L2
 SG_ MRR_ObjDistY_27 : 33|11@0+ (0.125,-128) [-128|127.875] "m"  IDC_L2
 SG_ MRR_ObjRelVelX_27 : 79|13@0+ (0.0312,-128) [-128|126.9976] "mps"  IDC_L2
 SG_ MRR_ObjRelVelY_27 : 82|13@0+ (0.0312,-128) [-128|126.9976] "mps"  IDC_L2
 SG_ MRR_ObjRelAccelX_27 : 54|10@0+ (0.03125,-16) [-16|15.96875] "mps2"  IDC_L2
 SG_ MRR_ObjRelAccelY_27 : 101|10@0+ (0.03125,-16) [-16|15.96875] "mps2"  IDC_L2
 SG_ MRR_ObjDistXStd_27 : 107|6@0+ (0.1,0) [0|6] "m"  IDC_L2
 SG_ MRR_ObjDistYStd_27 : 117|6@0+ (0.1,0) [0|6] "m"  IDC_L2
 SG_ MRR_ObjRelVelXStd_27 : 143|6@0+ (0.0625,0) [0|3.9375] "mps"  IDC_L2
 SG_ MRR_ObjRelVelYStd_27 : 137|6@0+ (0.0625,0) [0|3.9375] "mps"  IDC_L2
 SG_ MRR_ObjRAccelXStd_27 : 147|6@0+ (0.0625,0) [0|3.9375] "mps2"  IDC_L2
 SG_ MRR_ObjRAccelYStd_27 : 157|6@0+ (0.0625,0) [0|3.9375] "mps2"  IDC_L2
 SG_ MRR_ObjType_27 : 127|4@0+ (1,0) [0|15] ""  IDC_L2
 SG_ MRR_ObjMotionType_27 : 167|3@0+ (1,0) [0|7] ""  IDC_L2
 SG_ VFC_ObjWidth_27 : 164|10@0+ (0.01,0) [0|5] "m"  IDC_L2
 SG_ VFC_ObjLength_27 : 170|10@0+ (0.05,0) [0|20] "m"  IDC_L2
 SG_ VFC_ObjHeight_27 : 207|10@0+ (0.01,0) [0|6] "m"  IDC_L2
 SG_ VFC_ObjMotionDirection_27 : 176|3@0+ (1,0) [0|7] ""  IDC_L2
 SG_ MRR_ObjID_28 : 271|8@0+ (1,0) [0|255] ""  IDC_L2
 SG_ MRR_ObjExistProb_28 : 279|5@0+ (0.03125,0) [0|0.96875] ""  IDC_L2
 SG_ MRR_ObjObstacleProb_28 : 274|5@0+ (0.03125,0) [0|0.96875] ""  IDC_L2
 SG_ MRR_ObjDistX_28 : 285|12@0+ (0.0625,0) [0|254.9375] "m"  IDC_L2
 SG_ MRR_ObjDistY_28 : 289|11@0+ (0.125,-128) [-128|127.875] "m"  IDC_L2
 SG_ MRR_ObjRelVelX_28 : 335|13@0+ (0.0312,-128) [-128|126.9976] "mps"  IDC_L2
 SG_ MRR_ObjRelVelY_28 : 338|13@0+ (0.0312,-128) [-128|126.9976] "mps"  IDC_L2
 SG_ MRR_ObjRelAccelX_28 : 310|10@0+ (0.03125,-16) [-16|15.96875] "mps2"  IDC_L2
 SG_ MRR_ObjRelAccelY_28 : 357|10@0+ (0.03125,-16) [-16|15.96875] "mps2"  IDC_L2
 SG_ MRR_ObjDistXStd_28 : 363|6@0+ (0.1,0) [0|6] "m"  IDC_L2
 SG_ MRR_ObjDistYStd_28 : 373|6@0+ (0.1,0) [0|6] "m"  IDC_L2
 SG_ MRR_ObjRelVelXStd_28 : 399|6@0+ (0.0625,0) [0|3.9375] "mps"  IDC_L2
 SG_ MRR_ObjRelVelYStd_28 : 393|6@0+ (0.0625,0) [0|3.9375] "mps"  IDC_L2
 SG_ MRR_ObjRAccelXStd_28 : 403|6@0+ (0.0625,0) [0|3.9375] "mps2"  IDC_L2
 SG_ MRR_ObjRAccelYStd_28 : 413|6@0+ (0.0625,0) [0|3.9375] "mps2"  IDC_L2
 SG_ MRR_ObjType_28 : 383|4@0+ (1,0) [0|15] ""  IDC_L2
 SG_ MRR_ObjMotionType_28 : 423|3@0+ (1,0) [0|7] ""  IDC_L2
 SG_ VFC_ObjWidth_28 : 420|10@0+ (0.01,0) [0|5] "m"  IDC_L2
 SG_ VFC_ObjLength_28 : 426|10@0+ (0.05,0) [0|20] "m"  IDC_L2
 SG_ VFC_ObjHeight_28 : 463|10@0+ (0.01,0) [0|6] "m"  IDC_L2
 SG_ VFC_ObjMotionDirection_28 : 432|3@0+ (1,0) [0|7] ""  IDC_L2
 SG_ Checksum105 : 7|8@0+ (1,0) [0|255] ""  IDC_L2
 SG_ Checksum106 : 71|8@0+ (1,0) [0|255] ""  IDC_L2
 SG_ Checksum107 : 135|8@0+ (1,0) [0|255] ""  IDC_L2
 SG_ Checksum108 : 199|8@0+ (1,0) [0|255] ""  IDC_L2
 SG_ Checksum109 : 263|8@0+ (1,0) [0|255] ""  IDC_L2
 SG_ Checksum110 : 327|8@0+ (1,0) [0|255] ""  IDC_L2
 SG_ Checksum111 : 391|8@0+ (1,0) [0|255] ""  IDC_L2
 SG_ Checksum112 : 455|8@0+ (1,0) [0|255] ""  IDC_L2
 SG_ RollingCounter105 : 59|4@0+ (1,0) [0|15] ""  IDC_L2
 SG_ RollingCounter106 : 123|4@0+ (1,0) [0|15] ""  IDC_L2
 SG_ RollingCounter107 : 187|4@0+ (1,0) [0|15] ""  IDC_L2
 SG_ RollingCounter108 : 251|4@0+ (1,0) [0|15] ""  IDC_L2
 SG_ RollingCounter109 : 315|4@0+ (1,0) [0|15] ""  IDC_L2
 SG_ RollingCounter110 : 379|4@0+ (1,0) [0|15] ""  IDC_L2
 SG_ RollingCounter111 : 443|4@0+ (1,0) [0|15] ""  IDC_L2
 SG_ RollingCounter112 : 507|4@0+ (1,0) [0|15] ""  IDC_L2
 SG_ BlockCounter14 : 469|4@0+ (1,0) [0|15] ""  IDC_L2

BO_ 1086 MRRAD15: 64 MRR
 SG_ MRR_ObjMeasured_15 : 497|2@0+ (1,0) [0|3] ""  IDC_L2
 SG_ MRR_ObjID_29 : 15|8@0+ (1,0) [0|255] ""  IDC_L2
 SG_ MRR_ObjExistProb_29 : 23|5@0+ (0.03125,0) [0|0.96875] ""  IDC_L2
 SG_ MRR_ObjObstacleProb_29 : 18|5@0+ (0.03125,0) [0|0.96875] ""  IDC_L2
 SG_ MRR_ObjDistX_29 : 29|12@0+ (0.0625,0) [0|254.9375] "m"  IDC_L2
 SG_ MRR_ObjDistY_29 : 33|11@0+ (0.125,-128) [-128|127.875] "m"  IDC_L2
 SG_ MRR_ObjRelVelX_29 : 79|13@0+ (0.0312,-128) [-128|126.9976] "mps"  IDC_L2
 SG_ MRR_ObjRelVelY_29 : 82|13@0+ (0.0312,-128) [-128|126.9976] "mps"  IDC_L2
 SG_ MRR_ObjRelAccelX_29 : 54|10@0+ (0.03125,-16) [-16|15.96875] "mps2"  IDC_L2
 SG_ MRR_ObjRelAccelY_29 : 101|10@0+ (0.03125,-16) [-16|15.96875] "mps2"  IDC_L2
 SG_ MRR_ObjDistXStd_29 : 107|6@0+ (0.1,0) [0|6] "m"  IDC_L2
 SG_ MRR_ObjDistYStd_29 : 117|6@0+ (0.1,0) [0|6] "m"  IDC_L2
 SG_ MRR_ObjRelVelXStd_29 : 143|6@0+ (0.0625,0) [0|3.9375] "mps"  IDC_L2
 SG_ MRR_ObjRelVelYStd_29 : 137|6@0+ (0.0625,0) [0|3.9375] "mps"  IDC_L2
 SG_ MRR_ObjRAccelXStd_29 : 147|6@0+ (0.0625,0) [0|3.9375] "mps2"  IDC_L2
 SG_ MRR_ObjRAccelYStd_29 : 157|6@0+ (0.0625,0) [0|3.9375] "mps2"  IDC_L2
 SG_ MRR_ObjType_29 : 127|4@0+ (1,0) [0|15] ""  IDC_L2
 SG_ MRR_ObjMotionType_29 : 167|3@0+ (1,0) [0|7] ""  IDC_L2
 SG_ VFC_ObjWidth_29 : 164|10@0+ (0.01,0) [0|5] "m"  IDC_L2
 SG_ VFC_ObjLength_29 : 170|10@0+ (0.05,0) [0|20] "m"  IDC_L2
 SG_ VFC_ObjHeight_29 : 207|10@0+ (0.01,0) [0|6] "m"  IDC_L2
 SG_ VFC_ObjMotionDirection_29 : 176|3@0+ (1,0) [0|7] ""  IDC_L2
 SG_ MRR_ObjID_30 : 271|8@0+ (1,0) [0|255] ""  IDC_L2
 SG_ MRR_ObjExistProb_30 : 279|5@0+ (0.03125,0) [0|0.96875] ""  IDC_L2
 SG_ MRR_ObjObstacleProb_30 : 274|5@0+ (0.03125,0) [0|0.96875] ""  IDC_L2
 SG_ MRR_ObjDistX_30 : 285|12@0+ (0.0625,0) [0|254.9375] "m"  IDC_L2
 SG_ MRR_ObjDistY_30 : 289|11@0+ (0.125,-128) [-128|127.875] "m"  IDC_L2
 SG_ MRR_ObjRelVelX_30 : 335|13@0+ (0.0312,-128) [-128|126.9976] "mps"  IDC_L2
 SG_ MRR_ObjRelVelY_30 : 338|13@0+ (0.0312,-128) [-128|126.9976] "mps"  IDC_L2
 SG_ MRR_ObjRelAccelX_30 : 310|10@0+ (0.03125,-16) [-16|15.96875] "mps2"  IDC_L2
 SG_ MRR_ObjRelAccelY_30 : 357|10@0+ (0.03125,-16) [-16|15.96875] "mps2"  IDC_L2
 SG_ MRR_ObjDistXStd_30 : 363|6@0+ (0.1,0) [0|6] "m"  IDC_L2
 SG_ MRR_ObjDistYStd_30 : 373|6@0+ (0.1,0) [0|6] "m"  IDC_L2
 SG_ MRR_ObjRelVelXStd_30 : 399|6@0+ (0.0625,0) [0|3.9375] "mps"  IDC_L2
 SG_ MRR_ObjRelVelYStd_30 : 393|6@0+ (0.0625,0) [0|3.9375] "mps"  IDC_L2
 SG_ MRR_ObjRAccelXStd_30 : 403|6@0+ (0.0625,0) [0|3.9375] "mps2"  IDC_L2
 SG_ MRR_ObjRAccelYStd_30 : 413|6@0+ (0.0625,0) [0|3.9375] "mps2"  IDC_L2
 SG_ MRR_ObjType_30 : 383|4@0+ (1,0) [0|15] ""  IDC_L2
 SG_ MRR_ObjMotionType_30 : 423|3@0+ (1,0) [0|7] ""  IDC_L2
 SG_ VFC_ObjWidth_30 : 420|10@0+ (0.01,0) [0|5] "m"  IDC_L2
 SG_ VFC_ObjLength_30 : 426|10@0+ (0.05,0) [0|20] "m"  IDC_L2
 SG_ VFC_ObjHeight_30 : 463|10@0+ (0.01,0) [0|6] "m"  IDC_L2
 SG_ VFC_ObjMotionDirection_30 : 432|3@0+ (1,0) [0|7] ""  IDC_L2
 SG_ Checksum113 : 7|8@0+ (1,0) [0|255] ""  IDC_L2
 SG_ Checksum114 : 71|8@0+ (1,0) [0|255] ""  IDC_L2
 SG_ Checksum115 : 135|8@0+ (1,0) [0|255] ""  IDC_L2
 SG_ Checksum116 : 199|8@0+ (1,0) [0|255] ""  IDC_L2
 SG_ Checksum117 : 263|8@0+ (1,0) [0|255] ""  IDC_L2
 SG_ Checksum118 : 327|8@0+ (1,0) [0|255] ""  IDC_L2
 SG_ Checksum119 : 391|8@0+ (1,0) [0|255] ""  IDC_L2
 SG_ Checksum120 : 455|8@0+ (1,0) [0|255] ""  IDC_L2
 SG_ RollingCounter113 : 59|4@0+ (1,0) [0|15] ""  IDC_L2
 SG_ RollingCounter114 : 123|4@0+ (1,0) [0|15] ""  IDC_L2
 SG_ RollingCounter115 : 187|4@0+ (1,0) [0|15] ""  IDC_L2
 SG_ RollingCounter116 : 251|4@0+ (1,0) [0|15] ""  IDC_L2
 SG_ RollingCounter117 : 315|4@0+ (1,0) [0|15] ""  IDC_L2
 SG_ RollingCounter118 : 379|4@0+ (1,0) [0|15] ""  IDC_L2
 SG_ RollingCounter119 : 443|4@0+ (1,0) [0|15] ""  IDC_L2
 SG_ RollingCounter120 : 507|4@0+ (1,0) [0|15] ""  IDC_L2
 SG_ BlockCounter15 : 469|4@0+ (1,0) [0|15] ""  IDC_L2

BO_ 1087 MRRAD16: 64 MRR
 SG_ MRR_ObjMeasured_16 : 497|2@0+ (1,0) [0|3] ""  IDC_L2
 SG_ MRR_ObjID_31 : 15|8@0+ (1,0) [0|255] ""  IDC_L2
 SG_ MRR_ObjExistProb_31 : 23|5@0+ (0.03125,0) [0|0.96875] ""  IDC_L2
 SG_ MRR_ObjObstacleProb_31 : 18|5@0+ (0.03125,0) [0|0.96875] ""  IDC_L2
 SG_ MRR_ObjDistX_31 : 29|12@0+ (0.0625,0) [0|254.9375] "m"  IDC_L2
 SG_ MRR_ObjDistY_31 : 33|11@0+ (0.125,-128) [-128|127.875] "m"  IDC_L2
 SG_ MRR_ObjRelVelX_31 : 79|13@0+ (0.0312,-128) [-128|126.9976] "mps"  IDC_L2
 SG_ MRR_ObjRelVelY_31 : 82|13@0+ (0.0312,-128) [-128|126.9976] "mps"  IDC_L2
 SG_ MRR_ObjRelAccelX_31 : 54|10@0+ (0.03125,-16) [-16|15.96875] "mps2"  IDC_L2
 SG_ MRR_ObjRelAccelY_31 : 101|10@0+ (0.03125,-16) [-16|15.96875] "mps2"  IDC_L2
 SG_ MRR_ObjDistXStd_31 : 107|6@0+ (0.1,0) [0|6] "m"  IDC_L2
 SG_ MRR_ObjDistYStd_31 : 117|6@0+ (0.1,0) [0|6] "m"  IDC_L2
 SG_ MRR_ObjRelVelXStd_31 : 143|6@0+ (0.0625,0) [0|3.9375] "mps"  IDC_L2
 SG_ MRR_ObjRelVelYStd_31 : 137|6@0+ (0.0625,0) [0|3.9375] "mps"  IDC_L2
 SG_ MRR_ObjRAccelXStd_31 : 147|6@0+ (0.0625,0) [0|3.9375] "mps2"  IDC_L2
 SG_ MRR_ObjRAccelYStd_31 : 157|6@0+ (0.0625,0) [0|3.9375] "mps2"  IDC_L2
 SG_ MRR_ObjType_31 : 127|4@0+ (1,0) [0|15] ""  IDC_L2
 SG_ MRR_ObjMotionType_31 : 167|3@0+ (1,0) [0|7] ""  IDC_L2
 SG_ VFC_ObjWidth_31 : 164|10@0+ (0.01,0) [0|5] "m"  IDC_L2
 SG_ VFC_ObjLength_31 : 170|10@0+ (0.05,0) [0|20] "m"  IDC_L2
 SG_ VFC_ObjHeight_31 : 207|10@0+ (0.01,0) [0|6] "m"  IDC_L2
 SG_ VFC_ObjMotionDirection_31 : 176|3@0+ (1,0) [0|7] ""  IDC_L2
 SG_ MRR_ObjID_32 : 271|8@0+ (1,0) [0|255] ""  IDC_L2
 SG_ MRR_ObjExistProb_32 : 279|5@0+ (0.03125,0) [0|0.96875] ""  IDC_L2
 SG_ MRR_ObjObstacleProb_32 : 274|5@0+ (0.03125,0) [0|0.96875] ""  IDC_L2
 SG_ MRR_ObjDistX_32 : 285|12@0+ (0.0625,0) [0|254.9375] "m"  IDC_L2
 SG_ MRR_ObjDistY_32 : 289|11@0+ (0.125,-128) [-128|127.875] "m"  IDC_L2
 SG_ MRR_ObjRelVelX_32 : 335|13@0+ (0.0312,-128) [-128|126.9976] "mps"  IDC_L2
 SG_ MRR_ObjRelVelY_32 : 338|13@0+ (0.0312,-128) [-128|126.9976] "mps"  IDC_L2
 SG_ MRR_ObjRelAccelX_32 : 310|10@0+ (0.03125,-16) [-16|15.96875] "mps2"  IDC_L2
 SG_ MRR_ObjRelAccelY_32 : 357|10@0+ (0.03125,-16) [-16|15.96875] "mps2"  IDC_L2
 SG_ MRR_ObjDistXStd_32 : 363|6@0+ (0.1,0) [0|6] "m"  IDC_L2
 SG_ MRR_ObjDistYStd_32 : 373|6@0+ (0.1,0) [0|6] "m"  IDC_L2
 SG_ MRR_ObjRelVelXStd_32 : 399|6@0+ (0.0625,0) [0|3.9375] "mps"  IDC_L2
 SG_ MRR_ObjRelVelYStd_32 : 393|6@0+ (0.0625,0) [0|3.9375] "mps"  IDC_L2
 SG_ MRR_ObjRAccelXStd_32 : 403|6@0+ (0.0625,0) [0|3.9375] "mps2"  IDC_L2
 SG_ MRR_ObjRAccelYStd_32 : 413|6@0+ (0.0625,0) [0|3.9375] "mps2"  IDC_L2
 SG_ MRR_ObjType_32 : 383|4@0+ (1,0) [0|7] ""  IDC_L2
 SG_ MRR_ObjMotionType_32 : 423|3@0+ (1,0) [0|7] ""  IDC_L2
 SG_ VFC_ObjWidth_32 : 420|10@0+ (0.01,0) [0|5] "m"  IDC_L2
 SG_ VFC_ObjLength_32 : 426|10@0+ (0.05,0) [0|20] "m"  IDC_L2
 SG_ VFC_ObjHeight_32 : 463|10@0+ (0.01,0) [0|6] "m"  IDC_L2
 SG_ VFC_ObjMotionDirection_32 : 432|3@0+ (1,0) [0|7] ""  IDC_L2
 SG_ Checksum121 : 7|8@0+ (1,0) [0|255] ""  IDC_L2
 SG_ Checksum122 : 71|8@0+ (1,0) [0|255] ""  IDC_L2
 SG_ Checksum123 : 135|8@0+ (1,0) [0|255] ""  IDC_L2
 SG_ Checksum124 : 199|8@0+ (1,0) [0|255] ""  IDC_L2
 SG_ Checksum125 : 263|8@0+ (1,0) [0|255] ""  IDC_L2
 SG_ Checksum126 : 327|8@0+ (1,0) [0|255] ""  IDC_L2
 SG_ Checksum127 : 391|8@0+ (1,0) [0|255] ""  IDC_L2
 SG_ Checksum128 : 455|8@0+ (1,0) [0|255] ""  IDC_L2
 SG_ RollingCounter121 : 59|4@0+ (1,0) [0|15] ""  IDC_L2
 SG_ RollingCounter122 : 123|4@0+ (1,0) [0|15] ""  IDC_L2
 SG_ RollingCounter123 : 187|4@0+ (1,0) [0|15] ""  IDC_L2
 SG_ RollingCounter124 : 251|4@0+ (1,0) [0|15] ""  IDC_L2
 SG_ RollingCounter125 : 315|4@0+ (1,0) [0|15] ""  IDC_L2
 SG_ RollingCounter126 : 379|4@0+ (1,0) [0|15] ""  IDC_L2
 SG_ RollingCounter127 : 443|4@0+ (1,0) [0|15] ""  IDC_L2
 SG_ RollingCounter128 : 507|4@0+ (1,0) [0|15] ""  IDC_L2
 SG_ BlockCounter16 : 469|4@0+ (1,0) [0|15] ""  IDC_L2

BO_ 1073 MRRAD2: 64 MRR
 SG_ MRR_ObjMeasured_2 : 497|2@0+ (1,0) [0|3] ""  IDC_L2
 SG_ MRR_ObjID_3 : 15|8@0+ (1,0) [0|255] ""  IDC_L2
 SG_ MRR_ObjExistProb_3 : 23|5@0+ (0.03125,0) [0|0.96875] ""  IDC_L2
 SG_ MRR_ObjObstacleProb_3 : 18|5@0+ (0.03125,0) [0|0.96875] ""  IDC_L2
 SG_ MRR_ObjDistX_3 : 29|12@0+ (0.0625,0) [0|254.9375] "m"  IDC_L2
 SG_ MRR_ObjDistY_3 : 33|11@0+ (0.125,-128) [-128|127.875] "m"  IDC_L2
 SG_ MRR_ObjRelVelX_3 : 79|13@0+ (0.0312,-128) [-128|126.9976] "mps"  IDC_L2
 SG_ MRR_ObjRelVelY_3 : 82|13@0+ (0.0312,-128) [-128|126.9976] "mps"  IDC_L2
 SG_ MRR_ObjRelAccelX_3 : 54|10@0+ (0.03125,-16) [-16|15.96875] "mps2"  IDC_L2
 SG_ MRR_ObjRelAccelY_3 : 101|10@0+ (0.03125,-16) [-16|15.96875] "mps2"  IDC_L2
 SG_ MRR_ObjDistXStd_3 : 107|6@0+ (0.1,0) [0|6] "m"  IDC_L2
 SG_ MRR_ObjDistYStd_3 : 117|6@0+ (0.1,0) [0|6] "m"  IDC_L2
 SG_ MRR_ObjRelVelXStd_3 : 143|6@0+ (0.0625,0) [0|3.9375] "mps"  IDC_L2
 SG_ MRR_ObjRelVelYStd_3 : 137|6@0+ (0.0625,0) [0|3.9375] "mps"  IDC_L2
 SG_ MRR_ObjRAccelXStd_3 : 147|6@0+ (0.0625,0) [0|3.9375] "mps2"  IDC_L2
 SG_ MRR_ObjRAccelYStd_3 : 157|6@0+ (0.0625,0) [0|3.9375] "mps2"  IDC_L2
 SG_ MRR_ObjType_3 : 127|4@0+ (1,0) [0|15] ""  IDC_L2
 SG_ MRR_ObjMotionType_3 : 167|3@0+ (1,0) [0|7] ""  IDC_L2
 SG_ VFC_ObjWidth_3 : 164|10@0+ (0.01,0) [0|5] "m"  IDC_L2
 SG_ VFC_ObjLength_3 : 170|10@0+ (0.05,0) [0|20] "m"  IDC_L2
 SG_ VFC_ObjHeight_3 : 207|10@0+ (0.01,0) [0|6] "m"  IDC_L2
 SG_ VFC_ObjMotionDirection_3 : 176|3@0+ (1,0) [0|7] ""  IDC_L2
 SG_ MRR_ObjID_4 : 271|8@0+ (1,0) [0|255] ""  IDC_L2
 SG_ MRR_ObjExistProb_4 : 279|5@0+ (0.03125,0) [0|0.96875] ""  IDC_L2
 SG_ MRR_ObjObstacleProb_4 : 274|5@0+ (0.03125,0) [0|0.96875] ""  IDC_L2
 SG_ MRR_ObjDistX_4 : 285|12@0+ (0.0625,0) [0|254.9375] "m"  IDC_L2
 SG_ MRR_ObjDistY_4 : 289|11@0+ (0.125,-128) [-128|127.875] "m"  IDC_L2
 SG_ MRR_ObjRelVelX_4 : 335|13@0+ (0.0312,-128) [-128|126.9976] "mps"  IDC_L2
 SG_ MRR_ObjRelVelY_4 : 338|13@0+ (0.0312,-128) [-128|126.9976] "mps"  IDC_L2
 SG_ MRR_ObjRelAccelX_4 : 310|10@0+ (0.03125,-16) [-16|15.96875] "mps2"  IDC_L2
 SG_ MRR_ObjRelAccelY_4 : 357|10@0+ (0.03125,-16) [-16|15.96875] "mps2"  IDC_L2
 SG_ MRR_ObjDistXStd_4 : 363|6@0+ (0.1,0) [0|6] "m"  IDC_L2
 SG_ MRR_ObjDistYStd_4 : 373|6@0+ (0.1,0) [0|6] "m"  IDC_L2
 SG_ MRR_ObjRelVelXStd_4 : 399|6@0+ (0.0625,0) [0|3.9375] "mps"  IDC_L2
 SG_ MRR_ObjRelVelYStd_4 : 393|6@0+ (0.0625,0) [0|3.9375] "mps"  IDC_L2
 SG_ MRR_ObjRAccelXStd_4 : 403|6@0+ (0.0625,0) [0|3.9375] "mps2"  IDC_L2
 SG_ MRR_ObjRAccelYStd_4 : 413|6@0+ (0.0625,0) [0|3.9375] "mps2"  IDC_L2
 SG_ MRR_ObjType_4 : 383|4@0+ (1,0) [0|15] ""  IDC_L2
 SG_ MRR_ObjMotionType_4 : 423|3@0+ (1,0) [0|7] ""  IDC_L2
 SG_ VFC_ObjWidth_4 : 420|10@0+ (0.01,0) [0|5] "m"  IDC_L2
 SG_ VFC_ObjLength_4 : 426|10@0+ (0.05,0) [0|20] "m"  IDC_L2
 SG_ VFC_ObjHeight_4 : 463|10@0+ (0.01,0) [0|6] "m"  IDC_L2
 SG_ VFC_ObjMotionDirection_4 : 432|3@0+ (1,0) [0|7] ""  IDC_L2
 SG_ Checksum9 : 7|8@0+ (1,0) [0|255] ""  IDC_L2
 SG_ Checksum10 : 71|8@0+ (1,0) [0|255] ""  IDC_L2
 SG_ Checksum11 : 135|8@0+ (1,0) [0|255] ""  IDC_L2
 SG_ Checksum12 : 199|8@0+ (1,0) [0|255] ""  IDC_L2
 SG_ Checksum13 : 263|8@0+ (1,0) [0|255] ""  IDC_L2
 SG_ Checksum14 : 327|8@0+ (1,0) [0|255] ""  IDC_L2
 SG_ Checksum15 : 391|8@0+ (1,0) [0|255] ""  IDC_L2
 SG_ Checksum16 : 455|8@0+ (1,0) [0|255] ""  IDC_L2
 SG_ RollingCounter9 : 59|4@0+ (1,0) [0|15] ""  IDC_L2
 SG_ RollingCounter10 : 123|4@0+ (1,0) [0|15] ""  IDC_L2
 SG_ RollingCounter11 : 187|4@0+ (1,0) [0|15] ""  IDC_L2
 SG_ RollingCounter12 : 251|4@0+ (1,0) [0|15] ""  IDC_L2
 SG_ RollingCounter13 : 315|4@0+ (1,0) [0|15] ""  IDC_L2
 SG_ RollingCounter14 : 379|4@0+ (1,0) [0|15] ""  IDC_L2
 SG_ RollingCounter15 : 443|4@0+ (1,0) [0|15] ""  IDC_L2
 SG_ RollingCounter16 : 507|4@0+ (1,0) [0|15] ""  IDC_L2
 SG_ BlockCounter2 : 469|4@0+ (1,0) [0|15] ""  IDC_L2

BO_ 1074 MRRAD3: 64 MRR
 SG_ MRR_ObjMeasured_3 : 497|2@0+ (1,0) [0|3] ""  IDC_L2
 SG_ MRR_ObjID_5 : 15|8@0+ (1,0) [0|255] ""  IDC_L2
 SG_ MRR_ObjExistProb_5 : 23|5@0+ (0.03125,0) [0|0.96875] ""  IDC_L2
 SG_ MRR_ObjObstacleProb_5 : 18|5@0+ (0.03125,0) [0|0.96875] ""  IDC_L2
 SG_ MRR_ObjDistX_5 : 29|12@0+ (0.0625,0) [0|254.9375] "m"  IDC_L2
 SG_ MRR_ObjDistY_5 : 33|11@0+ (0.125,-128) [-128|127.875] "m"  IDC_L2
 SG_ MRR_ObjRelVelX_5 : 79|13@0+ (0.0312,-128) [-128|126.9976] "mps"  IDC_L2
 SG_ MRR_ObjRelVelY_5 : 82|13@0+ (0.0312,-128) [-128|126.9976] "mps"  IDC_L2
 SG_ MRR_ObjRelAccelX_5 : 54|10@0+ (0.03125,-16) [-16|15.96875] "mps2"  IDC_L2
 SG_ MRR_ObjRelAccelY_5 : 101|10@0+ (0.03125,-16) [-16|15.96875] "mps2"  IDC_L2
 SG_ MRR_ObjDistXStd_5 : 107|6@0+ (0.1,0) [0|6] "m"  IDC_L2
 SG_ MRR_ObjDistYStd_5 : 117|6@0+ (0.1,0) [0|6] "m"  IDC_L2
 SG_ MRR_ObjRelVelXStd_5 : 143|6@0+ (0.0625,0) [0|3.9375] "mps"  IDC_L2
 SG_ MRR_ObjRelVelYStd_5 : 137|6@0+ (0.0625,0) [0|3.9375] "mps"  IDC_L2
 SG_ MRR_ObjRAccelXStd_5 : 147|6@0+ (0.0625,0) [0|3.9375] "mps2"  IDC_L2
 SG_ MRR_ObjRAccelYStd_5 : 157|6@0+ (0.0625,0) [0|3.9375] "mps2"  IDC_L2
 SG_ MRR_ObjType_5 : 127|4@0+ (1,0) [0|15] ""  IDC_L2
 SG_ MRR_ObjMotionType_5 : 167|3@0+ (1,0) [0|7] ""  IDC_L2
 SG_ VFC_ObjWidth_5 : 164|10@0+ (0.01,0) [0|5] "m"  IDC_L2
 SG_ VFC_ObjLength_5 : 170|10@0+ (0.05,0) [0|20] "m"  IDC_L2
 SG_ VFC_ObjHeight_5 : 207|10@0+ (0.01,0) [0|6] "m"  IDC_L2
 SG_ VFC_ObjMotionDirection_5 : 176|3@0+ (1,0) [0|7] ""  IDC_L2
 SG_ MRR_ObjID_6 : 271|8@0+ (1,0) [0|255] ""  IDC_L2
 SG_ MRR_ObjExistProb_6 : 279|5@0+ (0.03125,0) [0|0.96875] ""  IDC_L2
 SG_ MRR_ObjObstacleProb_6 : 274|5@0+ (0.03125,0) [0|0.96875] ""  IDC_L2
 SG_ MRR_ObjDistX_6 : 285|12@0+ (0.0625,0) [0|254.9375] "m"  IDC_L2
 SG_ MRR_ObjDistY_6 : 289|11@0+ (0.125,-128) [-128|127.875] "m"  IDC_L2
 SG_ MRR_ObjRelVelX_6 : 335|13@0+ (0.0312,-128) [-128|126.9976] "mps"  IDC_L2
 SG_ MRR_ObjRelVelY_6 : 338|13@0+ (0.0312,-128) [-128|126.9976] "mps"  IDC_L2
 SG_ MRR_ObjRelAccelX_6 : 310|10@0+ (0.03125,-16) [-16|15.96875] "mps2"  IDC_L2
 SG_ MRR_ObjRelAccelY_6 : 357|10@0+ (0.03125,-16) [-16|15.96875] "mps2"  IDC_L2
 SG_ MRR_ObjDistXStd_6 : 363|6@0+ (0.1,0) [0|6] "m"  IDC_L2
 SG_ MRR_ObjDistYStd_6 : 373|6@0+ (0.1,0) [0|6] "m"  IDC_L2
 SG_ MRR_ObjRelVelXStd_6 : 399|6@0+ (0.0625,0) [0|3.9375] "mps"  IDC_L2
 SG_ MRR_ObjRelVelYStd_6 : 393|6@0+ (0.0625,0) [0|3.9375] "mps"  IDC_L2
 SG_ MRR_ObjRAccelXStd_6 : 403|6@0+ (0.0625,0) [0|3.9375] "mps2"  IDC_L2
 SG_ MRR_ObjRAccelYStd_6 : 413|6@0+ (0.0625,0) [0|3.9375] "mps2"  IDC_L2
 SG_ MRR_ObjType_6 : 383|4@0+ (1,0) [0|15] ""  IDC_L2
 SG_ MRR_ObjMotionType_6 : 423|3@0+ (1,0) [0|7] ""  IDC_L2
 SG_ VFC_ObjWidth_6 : 420|10@0+ (0.01,0) [0|5] "m"  IDC_L2
 SG_ VFC_ObjLength_6 : 426|10@0+ (0.05,0) [0|20] "m"  IDC_L2
 SG_ VFC_ObjHeight_6 : 463|10@0+ (0.01,0) [0|6] "m"  IDC_L2
 SG_ VFC_ObjMotionDirection_6 : 432|3@0+ (1,0) [0|7] ""  IDC_L2
 SG_ Checksum17 : 7|8@0+ (1,0) [0|255] ""  IDC_L2
 SG_ Checksum18 : 71|8@0+ (1,0) [0|255] ""  IDC_L2
 SG_ Checksum19 : 135|8@0+ (1,0) [0|255] ""  IDC_L2
 SG_ Checksum20 : 199|8@0+ (1,0) [0|255] ""  IDC_L2
 SG_ Checksum21 : 263|8@0+ (1,0) [0|255] ""  IDC_L2
 SG_ Checksum22 : 327|8@0+ (1,0) [0|255] ""  IDC_L2
 SG_ Checksum23 : 391|8@0+ (1,0) [0|255] ""  IDC_L2
 SG_ Checksum24 : 455|8@0+ (1,0) [0|255] ""  IDC_L2
 SG_ RollingCounter17 : 59|4@0+ (1,0) [0|15] ""  IDC_L2
 SG_ RollingCounter18 : 123|4@0+ (1,0) [0|15] ""  IDC_L2
 SG_ RollingCounter19 : 187|4@0+ (1,0) [0|15] ""  IDC_L2
 SG_ RollingCounter20 : 251|4@0+ (1,0) [0|15] ""  IDC_L2
 SG_ RollingCounter21 : 315|4@0+ (1,0) [0|15] ""  IDC_L2
 SG_ RollingCounter22 : 379|4@0+ (1,0) [0|15] ""  IDC_L2
 SG_ RollingCounter23 : 443|4@0+ (1,0) [0|15] ""  IDC_L2
 SG_ RollingCounter24 : 507|4@0+ (1,0) [0|15] ""  IDC_L2
 SG_ BlockCounter3 : 469|4@0+ (1,0) [0|15] ""  IDC_L2

BO_ 1075 MRRAD4: 64 MRR
 SG_ MRR_ObjMeasured_4 : 497|2@0+ (1,0) [0|3] ""  IDC_L2
 SG_ MRR_ObjID_7 : 15|8@0+ (1,0) [0|255] ""  IDC_L2
 SG_ MRR_ObjExistProb_7 : 23|5@0+ (0.03125,0) [0|0.96875] ""  IDC_L2
 SG_ MRR_ObjObstacleProb_7 : 18|5@0+ (0.03125,0) [0|0.96875] ""  IDC_L2
 SG_ MRR_ObjDistX_7 : 29|12@0+ (0.0625,0) [0|254.9375] "m"  IDC_L2
 SG_ MRR_ObjDistY_7 : 33|11@0+ (0.125,-128) [-128|127.875] "m"  IDC_L2
 SG_ MRR_ObjRelVelX_7 : 79|13@0+ (0.0312,-128) [-128|126.9976] "mps"  IDC_L2
 SG_ MRR_ObjRelVelY_7 : 82|13@0+ (0.0312,-128) [-128|126.9976] "mps"  IDC_L2
 SG_ MRR_ObjRelAccelX_7 : 54|10@0+ (0.03125,-16) [-16|15.96875] "mps2"  IDC_L2
 SG_ MRR_ObjRelAccelY_7 : 101|10@0+ (0.03125,-16) [-16|15.96875] "mps2"  IDC_L2
 SG_ MRR_ObjDistXStd_7 : 107|6@0+ (0.1,0) [0|6] "m"  IDC_L2
 SG_ MRR_ObjDistYStd_7 : 117|6@0+ (0.1,0) [0|6] "m"  IDC_L2
 SG_ MRR_ObjRelVelXStd_7 : 143|6@0+ (0.0625,0) [0|3.9375] "mps"  IDC_L2
 SG_ MRR_ObjRelVelYStd_7 : 137|6@0+ (0.0625,0) [0|3.9375] "mps"  IDC_L2
 SG_ MRR_ObjRAccelXStd_7 : 147|6@0+ (0.0625,0) [0|3.9375] "mps2"  IDC_L2
 SG_ MRR_ObjRAccelYStd_7 : 157|6@0+ (0.0625,0) [0|3.9375] "mps2"  IDC_L2
 SG_ MRR_ObjType_7 : 127|4@0+ (1,0) [0|15] ""  IDC_L2
 SG_ MRR_ObjMotionType_7 : 167|3@0+ (1,0) [0|7] ""  IDC_L2
 SG_ VFC_ObjWidth_7 : 164|10@0+ (0.01,0) [0|5] "m"  IDC_L2
 SG_ VFC_ObjLength_7 : 170|10@0+ (0.05,0) [0|20] "m"  IDC_L2
 SG_ VFC_ObjHeight_7 : 207|10@0+ (0.01,0) [0|6] "m"  IDC_L2
 SG_ VFC_ObjMotionDirection_7 : 176|3@0+ (1,0) [0|7] ""  IDC_L2
 SG_ MRR_ObjID_8 : 271|8@0+ (1,0) [0|255] ""  IDC_L2
 SG_ MRR_ObjExistProb_8 : 279|5@0+ (0.03125,0) [0|0.96875] ""  IDC_L2
 SG_ MRR_ObjObstacleProb_8 : 274|5@0+ (0.03125,0) [0|0.96875] ""  IDC_L2
 SG_ MRR_ObjDistX_8 : 285|12@0+ (0.0625,0) [0|254.9375] "m"  IDC_L2
 SG_ MRR_ObjDistY_8 : 289|11@0+ (0.125,-128) [-128|127.875] "m"  IDC_L2
 SG_ MRR_ObjRelVelX_8 : 335|13@0+ (0.0312,-128) [-128|126.9976] "mps"  IDC_L2
 SG_ MRR_ObjRelVelY_8 : 338|13@0+ (0.0312,-128) [-128|126.9976] "mps"  IDC_L2
 SG_ MRR_ObjRelAccelX_8 : 310|10@0+ (0.03125,-16) [-16|15.96875] "mps2"  IDC_L2
 SG_ MRR_ObjRelAccelY_8 : 357|10@0+ (0.03125,-16) [-16|15.96875] "mps2"  IDC_L2
 SG_ MRR_ObjDistXStd_8 : 363|6@0+ (0.1,0) [0|6] "m"  IDC_L2
 SG_ MRR_ObjDistYStd_8 : 373|6@0+ (0.1,0) [0|6] "m"  IDC_L2
 SG_ MRR_ObjRelVelXStd_8 : 399|6@0+ (0.0625,0) [0|3.9375] "mps"  IDC_L2
 SG_ MRR_ObjRelVelYStd_8 : 393|6@0+ (0.0625,0) [0|3.9375] "mps"  IDC_L2
 SG_ MRR_ObjRAccelXStd_8 : 403|6@0+ (0.0625,0) [0|3.9375] "mps2"  IDC_L2
 SG_ MRR_ObjRAccelYStd_8 : 413|6@0+ (0.0625,0) [0|3.9375] "mps2"  IDC_L2
 SG_ MRR_ObjType_8 : 383|4@0+ (1,0) [0|15] ""  IDC_L2
 SG_ MRR_ObjMotionType_8 : 423|3@0+ (1,0) [0|7] ""  IDC_L2
 SG_ VFC_ObjWidth_8 : 420|10@0+ (0.01,0) [0|5] "m"  IDC_L2
 SG_ VFC_ObjLength_8 : 426|10@0+ (0.05,0) [0|20] "m"  IDC_L2
 SG_ VFC_ObjHeight_8 : 463|10@0+ (0.01,0) [0|6] "m"  IDC_L2
 SG_ VFC_ObjMotionDirection_8 : 432|3@0+ (1,0) [0|7] ""  IDC_L2
 SG_ Checksum25 : 7|8@0+ (1,0) [0|255] ""  IDC_L2
 SG_ Checksum26 : 71|8@0+ (1,0) [0|255] ""  IDC_L2
 SG_ Checksum27 : 135|8@0+ (1,0) [0|255] ""  IDC_L2
 SG_ Checksum28 : 199|8@0+ (1,0) [0|255] ""  IDC_L2
 SG_ Checksum29 : 263|8@0+ (1,0) [0|255] ""  IDC_L2
 SG_ Checksum30 : 327|8@0+ (1,0) [0|255] ""  IDC_L2
 SG_ Checksum31 : 391|8@0+ (1,0) [0|255] ""  IDC_L2
 SG_ Checksum32 : 455|8@0+ (1,0) [0|255] ""  IDC_L2
 SG_ RollingCounter25 : 59|4@0+ (1,0) [0|15] ""  IDC_L2
 SG_ RollingCounter26 : 123|4@0+ (1,0) [0|15] ""  IDC_L2
 SG_ RollingCounter27 : 187|4@0+ (1,0) [0|15] ""  IDC_L2
 SG_ RollingCounter28 : 251|4@0+ (1,0) [0|15] ""  IDC_L2
 SG_ RollingCounter29 : 315|4@0+ (1,0) [0|15] ""  IDC_L2
 SG_ RollingCounter30 : 379|4@0+ (1,0) [0|15] ""  IDC_L2
 SG_ RollingCounter31 : 443|4@0+ (1,0) [0|15] ""  IDC_L2
 SG_ RollingCounter32 : 507|4@0+ (1,0) [0|15] ""  IDC_L2
 SG_ BlockCounter4 : 469|4@0+ (1,0) [0|15] ""  IDC_L2

BO_ 1076 MRRAD5: 64 MRR
 SG_ MRR_ObjMeasured_5 : 497|2@0+ (1,0) [0|3] ""  IDC_L2
 SG_ MRR_ObjID_9 : 15|8@0+ (1,0) [0|255] ""  IDC_L2
 SG_ MRR_ObjExistProb_9 : 23|5@0+ (0.03125,0) [0|0.96875] ""  IDC_L2
 SG_ MRR_ObjObstacleProb_9 : 18|5@0+ (0.03125,0) [0|0.96875] ""  IDC_L2
 SG_ MRR_ObjDistX_9 : 29|12@0+ (0.0625,0) [0|254.9375] "m"  IDC_L2
 SG_ MRR_ObjDistY_9 : 33|11@0+ (0.125,-128) [-128|127.875] "m"  IDC_L2
 SG_ MRR_ObjRelVelX_9 : 79|13@0+ (0.0312,-128) [-128|126.9976] "mps"  IDC_L2
 SG_ MRR_ObjRelVelY_9 : 82|13@0+ (0.0312,-128) [-128|126.9976] "mps"  IDC_L2
 SG_ MRR_ObjRelAccelX_9 : 54|10@0+ (0.03125,-16) [-16|15.96875] "mps2"  IDC_L2
 SG_ MRR_ObjRelAccelY_9 : 101|10@0+ (0.03125,-16) [-16|15.96875] "mps2"  IDC_L2
 SG_ MRR_ObjDistXStd_9 : 107|6@0+ (0.1,0) [0|6] "m"  IDC_L2
 SG_ MRR_ObjDistYStd_9 : 117|6@0+ (0.1,0) [0|6] "m"  IDC_L2
 SG_ MRR_ObjRelVelXStd_9 : 143|6@0+ (0.0625,0) [0|3.9375] "mps"  IDC_L2
 SG_ MRR_ObjRelVelYStd_9 : 137|6@0+ (0.0625,0) [0|3.9375] "mps"  IDC_L2
 SG_ MRR_ObjRAccelXStd_9 : 147|6@0+ (0.0625,0) [0|3.9375] "mps2"  IDC_L2
 SG_ MRR_ObjRAccelYStd_9 : 157|6@0+ (0.0625,0) [0|3.9375] "mps2"  IDC_L2
 SG_ MRR_ObjType_9 : 127|4@0+ (1,0) [0|15] ""  IDC_L2
 SG_ MRR_ObjMotionType_9 : 167|3@0+ (1,0) [0|7] ""  IDC_L2
 SG_ VFC_ObjWidth_9 : 164|10@0+ (0.01,0) [0|5] "m"  IDC_L2
 SG_ VFC_ObjLength_9 : 170|10@0+ (0.05,0) [0|20] "m"  IDC_L2
 SG_ VFC_ObjHeight_9 : 207|10@0+ (0.01,0) [0|6] "m"  IDC_L2
 SG_ VFC_ObjMotionDirection_9 : 176|3@0+ (1,0) [0|7] ""  IDC_L2
 SG_ MRR_ObjID_10 : 271|8@0+ (1,0) [0|255] ""  IDC_L2
 SG_ MRR_ObjExistProb_10 : 279|5@0+ (0.03125,0) [0|0.96875] ""  IDC_L2
 SG_ MRR_ObjObstacleProb_10 : 274|5@0+ (0.03125,0) [0|0.96875] ""  IDC_L2
 SG_ MRR_ObjDistX_10 : 285|12@0+ (0.0625,0) [0|254.9375] "m"  IDC_L2
 SG_ MRR_ObjDistY_10 : 289|11@0+ (0.125,-128) [-128|127.875] "m"  IDC_L2
 SG_ MRR_ObjRelVelX_10 : 335|13@0+ (0.0312,-128) [-128|126.9976] "mps"  IDC_L2
 SG_ MRR_ObjRelVelY_10 : 338|13@0+ (0.0312,-128) [-128|126.9976] "mps"  IDC_L2
 SG_ MRR_ObjRelAccelX_10 : 310|10@0+ (0.03125,-16) [-16|15.96875] "mps2"  IDC_L2
 SG_ MRR_ObjRelAccelY_10 : 357|10@0+ (0.03125,-16) [-16|15.96875] "mps2"  IDC_L2
 SG_ MRR_ObjDistXStd_10 : 363|6@0+ (0.1,0) [0|6] "m"  IDC_L2
 SG_ MRR_ObjDistYStd_10 : 373|6@0+ (0.1,0) [0|6] "m"  IDC_L2
 SG_ MRR_ObjRelVelXStd_10 : 399|6@0+ (0.0625,0) [0|3.9375] "mps"  IDC_L2
 SG_ MRR_ObjRelVelYStd_10 : 393|6@0+ (0.0625,0) [0|3.9375] "mps"  IDC_L2
 SG_ MRR_ObjRAccelXStd_10 : 403|6@0+ (0.0625,0) [0|3.9375] "mps2"  IDC_L2
 SG_ MRR_ObjRAccelYStd_10 : 413|6@0+ (0.0625,0) [0|3.9375] "mps2"  IDC_L2
 SG_ MRR_ObjType_10 : 383|4@0+ (1,0) [0|15] ""  IDC_L2
 SG_ MRR_ObjMotionType_10 : 423|3@0+ (1,0) [0|7] ""  IDC_L2
 SG_ VFC_ObjWidth_10 : 420|10@0+ (0.01,0) [0|5] "m"  IDC_L2
 SG_ VFC_ObjLength_10 : 426|10@0+ (0.05,0) [0|20] "m"  IDC_L2
 SG_ VFC_ObjHeight_10 : 463|10@0+ (0.01,0) [0|6] "m"  IDC_L2
 SG_ VFC_ObjMotionDirection_10 : 432|3@0+ (1,0) [0|7] ""  IDC_L2
 SG_ Checksum33 : 7|8@0+ (1,0) [0|255] ""  IDC_L2
 SG_ Checksum34 : 71|8@0+ (1,0) [0|255] ""  IDC_L2
 SG_ Checksum35 : 135|8@0+ (1,0) [0|255] ""  IDC_L2
 SG_ Checksum36 : 199|8@0+ (1,0) [0|255] ""  IDC_L2
 SG_ Checksum37 : 263|8@0+ (1,0) [0|255] ""  IDC_L2
 SG_ Checksum38 : 327|8@0+ (1,0) [0|255] ""  IDC_L2
 SG_ Checksum39 : 391|8@0+ (1,0) [0|255] ""  IDC_L2
 SG_ Checksum40 : 455|8@0+ (1,0) [0|255] ""  IDC_L2
 SG_ RollingCounter33 : 59|4@0+ (1,0) [0|15] ""  IDC_L2
 SG_ RollingCounter34 : 123|4@0+ (1,0) [0|15] ""  IDC_L2
 SG_ RollingCounter35 : 187|4@0+ (1,0) [0|15] ""  IDC_L2
 SG_ RollingCounter36 : 251|4@0+ (1,0) [0|15] ""  IDC_L2
 SG_ RollingCounter37 : 315|4@0+ (1,0) [0|15] ""  IDC_L2
 SG_ RollingCounter38 : 379|4@0+ (1,0) [0|15] ""  IDC_L2
 SG_ RollingCounter39 : 443|4@0+ (1,0) [0|15] ""  IDC_L2
 SG_ RollingCounter40 : 507|4@0+ (1,0) [0|15] ""  IDC_L2
 SG_ BlockCounter5 : 469|4@0+ (1,0) [0|15] ""  IDC_L2

BO_ 1077 MRRAD6: 64 MRR
 SG_ MRR_ObjMeasured_6 : 497|2@0+ (1,0) [0|3] ""  IDC_L2
 SG_ MRR_ObjID_11 : 15|8@0+ (1,0) [0|255] ""  IDC_L2
 SG_ MRR_ObjExistProb_11 : 23|5@0+ (0.03125,0) [0|0.96875] ""  IDC_L2
 SG_ MRR_ObjObstacleProb_11 : 18|5@0+ (0.03125,0) [0|0.96875] ""  IDC_L2
 SG_ MRR_ObjDistX_11 : 29|12@0+ (0.0625,0) [0|254.9375] "m"  IDC_L2
 SG_ MRR_ObjDistY_11 : 33|11@0+ (0.125,-128) [-128|127.875] "m"  IDC_L2
 SG_ MRR_ObjRelVelX_11 : 79|13@0+ (0.0312,-128) [-128|126.9976] "mps"  IDC_L2
 SG_ MRR_ObjRelVelY_11 : 82|13@0+ (0.0312,-128) [-128|126.9976] "mps"  IDC_L2
 SG_ MRR_ObjRelAccelX_11 : 54|10@0+ (0.03125,-16) [-16|15.96875] "mps2"  IDC_L2
 SG_ MRR_ObjRelAccelY_11 : 101|10@0+ (0.03125,-16) [-16|15.96875] "mps2"  IDC_L2
 SG_ MRR_ObjDistXStd_11 : 107|6@0+ (0.1,0) [0|6] "m"  IDC_L2
 SG_ MRR_ObjDistYStd_11 : 117|6@0+ (0.1,0) [0|6] "m"  IDC_L2
 SG_ MRR_ObjRelVelXStd_11 : 143|6@0+ (0.0625,0) [0|3.9375] "mps"  IDC_L2
 SG_ MRR_ObjRelVelYStd_11 : 137|6@0+ (0.0625,0) [0|3.9375] "mps"  IDC_L2
 SG_ MRR_ObjRAccelXStd_11 : 147|6@0+ (0.0625,0) [0|3.9375] "mps2"  IDC_L2
 SG_ MRR_ObjRAccelYStd_11 : 157|6@0+ (0.0625,0) [0|3.9375] "mps2"  IDC_L2
 SG_ MRR_ObjType_11 : 127|4@0+ (1,0) [0|15] ""  IDC_L2
 SG_ MRR_ObjMotionType_11 : 167|3@0+ (1,0) [0|7] ""  IDC_L2
 SG_ VFC_ObjWidth_11 : 164|10@0+ (0.01,0) [0|5] "m"  IDC_L2
 SG_ VFC_ObjLength_11 : 170|10@0+ (0.05,0) [0|20] "m"  IDC_L2
 SG_ VFC_ObjHeight_11 : 207|10@0+ (0.01,0) [0|6] "m"  IDC_L2
 SG_ VFC_ObjMotionDirection_11 : 176|3@0+ (1,0) [0|7] ""  IDC_L2
 SG_ MRR_ObjID_12 : 271|8@0+ (1,0) [0|255] ""  IDC_L2
 SG_ MRR_ObjExistProb_12 : 279|5@0+ (0.03125,0) [0|0.96875] ""  IDC_L2
 SG_ MRR_ObjObstacleProb_12 : 274|5@0+ (0.03125,0) [0|0.96875] ""  IDC_L2
 SG_ MRR_ObjDistX_12 : 285|12@0+ (0.0625,0) [0|254.9375] "m"  IDC_L2
 SG_ MRR_ObjDistY_12 : 289|11@0+ (0.125,-128) [-128|127.875] "m"  IDC_L2
 SG_ MRR_ObjRelVelX_12 : 335|13@0+ (0.0312,-128) [-128|126.9976] "mps"  IDC_L2
 SG_ MRR_ObjRelVelY_12 : 338|13@0+ (0.0312,-128) [-128|126.9976] "mps"  IDC_L2
 SG_ MRR_ObjRelAccelX_12 : 310|10@0+ (0.03125,-16) [-16|15.96875] "mps2"  IDC_L2
 SG_ MRR_ObjRelAccelY_12 : 357|10@0+ (0.03125,-16) [-16|15.96875] "mps2"  IDC_L2
 SG_ MRR_ObjDistXStd_12 : 363|6@0+ (0.1,0) [0|6] "m"  IDC_L2
 SG_ MRR_ObjDistYStd_12 : 373|6@0+ (0.1,0) [0|6] "m"  IDC_L2
 SG_ MRR_ObjRelVelXStd_12 : 399|6@0+ (0.0625,0) [0|3.9375] "mps"  IDC_L2
 SG_ MRR_ObjRelVelYStd_12 : 393|6@0+ (0.0625,0) [0|3.9375] "mps"  IDC_L2
 SG_ MRR_ObjRAccelXStd_12 : 403|6@0+ (0.0625,0) [0|3.9375] "mps2"  IDC_L2
 SG_ MRR_ObjRAccelYStd_12 : 413|6@0+ (0.0625,0) [0|3.9375] "mps2"  IDC_L2
 SG_ MRR_ObjType_12 : 383|4@0+ (1,0) [0|15] ""  IDC_L2
 SG_ MRR_ObjMotionType_12 : 423|3@0+ (1,0) [0|7] ""  IDC_L2
 SG_ VFC_ObjWidth_12 : 420|10@0+ (0.01,0) [0|5] "m"  IDC_L2
 SG_ VFC_ObjLength_12 : 426|10@0+ (0.05,0) [0|20] "m"  IDC_L2
 SG_ VFC_ObjHeight_12 : 463|10@0+ (0.01,0) [0|6] "m"  IDC_L2
 SG_ VFC_ObjMotionDirection_12 : 432|3@0+ (1,0) [0|7] ""  IDC_L2
 SG_ Checksum41 : 7|8@0+ (1,0) [0|255] ""  IDC_L2
 SG_ Checksum42 : 71|8@0+ (1,0) [0|255] ""  IDC_L2
 SG_ Checksum43 : 135|8@0+ (1,0) [0|255] ""  IDC_L2
 SG_ Checksum44 : 199|8@0+ (1,0) [0|255] ""  IDC_L2
 SG_ Checksum45 : 263|8@0+ (1,0) [0|255] ""  IDC_L2
 SG_ Checksum46 : 327|8@0+ (1,0) [0|255] ""  IDC_L2
 SG_ Checksum47 : 391|8@0+ (1,0) [0|255] ""  IDC_L2
 SG_ Checksum48 : 455|8@0+ (1,0) [0|255] ""  IDC_L2
 SG_ RollingCounter41 : 59|4@0+ (1,0) [0|15] ""  IDC_L2
 SG_ RollingCounter42 : 123|4@0+ (1,0) [0|15] ""  IDC_L2
 SG_ RollingCounter43 : 187|4@0+ (1,0) [0|15] ""  IDC_L2
 SG_ RollingCounter44 : 251|4@0+ (1,0) [0|15] ""  IDC_L2
 SG_ RollingCounter45 : 315|4@0+ (1,0) [0|15] ""  IDC_L2
 SG_ RollingCounter46 : 379|4@0+ (1,0) [0|15] ""  IDC_L2
 SG_ RollingCounter47 : 443|4@0+ (1,0) [0|15] ""  IDC_L2
 SG_ RollingCounter48 : 507|4@0+ (1,0) [0|15] ""  IDC_L2
 SG_ BlockCounter6 : 469|4@0+ (1,0) [0|15] ""  IDC_L2

BO_ 1078 MRRAD7: 64 MRR
 SG_ MRR_ObjMeasured_7 : 497|2@0+ (1,0) [0|3] ""  IDC_L2
 SG_ MRR_ObjID_13 : 15|8@0+ (1,0) [0|255] ""  IDC_L2
 SG_ MRR_ObjExistProb_13 : 23|5@0+ (0.03125,0) [0|0.96875] ""  IDC_L2
 SG_ MRR_ObjObstacleProb_13 : 18|5@0+ (0.03125,0) [0|0.96875] ""  IDC_L2
 SG_ MRR_ObjDistX_13 : 29|12@0+ (0.0625,0) [0|254.9375] "m"  IDC_L2
 SG_ MRR_ObjDistY_13 : 33|11@0+ (0.125,-128) [-128|127.875] "m"  IDC_L2
 SG_ MRR_ObjRelVelX_13 : 79|13@0+ (0.0312,-128) [-128|126.9976] "mps"  IDC_L2
 SG_ MRR_ObjRelVelY_13 : 82|13@0+ (0.0312,-128) [-128|126.9976] "mps"  IDC_L2
 SG_ MRR_ObjRelAccelX_13 : 54|10@0+ (0.03125,-16) [-16|15.96875] "mps2"  IDC_L2
 SG_ MRR_ObjRelAccelY_13 : 101|10@0+ (0.03125,-16) [-16|15.96875] "mps2"  IDC_L2
 SG_ MRR_ObjDistXStd_13 : 107|6@0+ (0.1,0) [0|6] "m"  IDC_L2
 SG_ MRR_ObjDistYStd_13 : 117|6@0+ (0.1,0) [0|6] "m"  IDC_L2
 SG_ MRR_ObjRelVelXStd_13 : 143|6@0+ (0.0625,0) [0|3.9375] "mps"  IDC_L2
 SG_ MRR_ObjRelVelYStd_13 : 137|6@0+ (0.0625,0) [0|3.9375] "mps"  IDC_L2
 SG_ MRR_ObjRAccelXStd_13 : 147|6@0+ (0.0625,0) [0|3.9375] "mps2"  IDC_L2
 SG_ MRR_ObjRAccelYStd_13 : 157|6@0+ (0.0625,0) [0|3.9375] "mps2"  IDC_L2
 SG_ MRR_ObjType_13 : 127|4@0+ (1,0) [0|15] ""  IDC_L2
 SG_ MRR_ObjMotionType_13 : 167|3@0+ (1,0) [0|7] ""  IDC_L2
 SG_ VFC_ObjWidth_13 : 164|10@0+ (0.01,0) [0|5] "m"  IDC_L2
 SG_ VFC_ObjLength_13 : 170|10@0+ (0.05,0) [0|20] "m"  IDC_L2
 SG_ VFC_ObjHeight_13 : 207|10@0+ (0.01,0) [0|6] "m"  IDC_L2
 SG_ VFC_ObjMotionDirection_13 : 176|3@0+ (1,0) [0|7] ""  IDC_L2
 SG_ MRR_ObjID_14 : 271|8@0+ (1,0) [0|255] ""  IDC_L2
 SG_ MRR_ObjExistProb_14 : 279|5@0+ (0.03125,0) [0|0.96875] ""  IDC_L2
 SG_ MRR_ObjObstacleProb_14 : 274|5@0+ (0.03125,0) [0|0.96875] ""  IDC_L2
 SG_ MRR_ObjDistX_14 : 285|12@0+ (0.0625,0) [0|254.9375] "m"  IDC_L2
 SG_ MRR_ObjDistY_14 : 289|11@0+ (0.125,-128) [-128|127.875] "m"  IDC_L2
 SG_ MRR_ObjRelVelX_14 : 335|13@0+ (0.0312,-128) [-128|126.9976] "mps"  IDC_L2
 SG_ MRR_ObjRelVelY_14 : 338|13@0+ (0.0312,-128) [-128|126.9976] "mps"  IDC_L2
 SG_ MRR_ObjRelAccelX_14 : 310|10@0+ (0.03125,-16) [-16|15.96875] "mps2"  IDC_L2
 SG_ MRR_ObjRelAccelY_14 : 357|10@0+ (0.03125,-16) [-16|15.96875] "mps2"  IDC_L2
 SG_ MRR_ObjDistXStd_14 : 363|6@0+ (0.1,0) [0|6] "m"  IDC_L2
 SG_ MRR_ObjDistYStd_14 : 373|6@0+ (0.1,0) [0|6] "m"  IDC_L2
 SG_ MRR_ObjRelVelXStd_14 : 399|6@0+ (0.0625,0) [0|3.9375] "mps"  IDC_L2
 SG_ MRR_ObjRelVelYStd_14 : 393|6@0+ (0.0625,0) [0|3.9375] "mps"  IDC_L2
 SG_ MRR_ObjRAccelXStd_14 : 403|6@0+ (0.0625,0) [0|3.9375] "mps2"  IDC_L2
 SG_ MRR_ObjRAccelYStd_14 : 413|6@0+ (0.0625,0) [0|3.9375] "mps2"  IDC_L2
 SG_ MRR_ObjType_14 : 383|4@0+ (1,0) [0|15] ""  IDC_L2
 SG_ MRR_ObjMotionType_14 : 423|3@0+ (1,0) [0|7] ""  IDC_L2
 SG_ VFC_ObjWidth_14 : 420|10@0+ (0.01,0) [0|5] "m"  IDC_L2
 SG_ VFC_ObjLength_14 : 426|10@0+ (0.05,0) [0|20] "m"  IDC_L2
 SG_ VFC_ObjHeight_14 : 463|10@0+ (0.01,0) [0|6] "m"  IDC_L2
 SG_ VFC_ObjMotionDirection_14 : 432|3@0+ (1,0) [0|7] ""  IDC_L2
 SG_ Checksum49 : 7|8@0+ (1,0) [0|255] ""  IDC_L2
 SG_ Checksum50 : 71|8@0+ (1,0) [0|255] ""  IDC_L2
 SG_ Checksum51 : 135|8@0+ (1,0) [0|255] ""  IDC_L2
 SG_ Checksum52 : 199|8@0+ (1,0) [0|255] ""  IDC_L2
 SG_ Checksum53 : 263|8@0+ (1,0) [0|255] ""  IDC_L2
 SG_ Checksum54 : 327|8@0+ (1,0) [0|255] ""  IDC_L2
 SG_ Checksum55 : 391|8@0+ (1,0) [0|255] ""  IDC_L2
 SG_ Checksum56 : 455|8@0+ (1,0) [0|255] ""  IDC_L2
 SG_ RollingCounter49 : 59|4@0+ (1,0) [0|15] ""  IDC_L2
 SG_ RollingCounter50 : 123|4@0+ (1,0) [0|15] ""  IDC_L2
 SG_ RollingCounter51 : 187|4@0+ (1,0) [0|15] ""  IDC_L2
 SG_ RollingCounter52 : 251|4@0+ (1,0) [0|15] ""  IDC_L2
 SG_ RollingCounter53 : 315|4@0+ (1,0) [0|15] ""  IDC_L2
 SG_ RollingCounter54 : 379|4@0+ (1,0) [0|15] ""  IDC_L2
 SG_ RollingCounter55 : 443|4@0+ (1,0) [0|15] ""  IDC_L2
 SG_ RollingCounter56 : 507|4@0+ (1,0) [0|15] ""  IDC_L2
 SG_ BlockCounter7 : 469|4@0+ (1,0) [0|15] ""  IDC_L2

BO_ 1079 MRRAD8: 64 MRR
 SG_ MRR_ObjMeasured_8 : 497|2@0+ (1,0) [0|3] ""  IDC_L2
 SG_ MRR_ObjID_15 : 15|8@0+ (1,0) [0|255] ""  IDC_L2
 SG_ MRR_ObjExistProb_15 : 23|5@0+ (0.03125,0) [0|0.96875] ""  IDC_L2
 SG_ MRR_ObjObstacleProb_15 : 18|5@0+ (0.03125,0) [0|0.96875] ""  IDC_L2
 SG_ MRR_ObjDistX_15 : 29|12@0+ (0.0625,0) [0|254.9375] "m"  IDC_L2
 SG_ MRR_ObjDistY_15 : 33|11@0+ (0.125,-128) [-128|127.875] "m"  IDC_L2
 SG_ MRR_ObjRelVelX_15 : 79|13@0+ (0.0312,-128) [-128|126.9976] "mps"  IDC_L2
 SG_ MRR_ObjRelVelY_15 : 82|13@0+ (0.0312,-128) [-128|126.9976] "mps"  IDC_L2
 SG_ MRR_ObjRelAccelX_15 : 54|10@0+ (0.03125,-16) [-16|15.96875] "mps2"  IDC_L2
 SG_ MRR_ObjRelAccelY_15 : 101|10@0+ (0.03125,-16) [-16|15.96875] "mps2"  IDC_L2
 SG_ MRR_ObjDistXStd_15 : 107|6@0+ (0.1,0) [0|6] "m"  IDC_L2
 SG_ MRR_ObjDistYStd_15 : 117|6@0+ (0.1,0) [0|6] "m"  IDC_L2
 SG_ MRR_ObjRelVelXStd_15 : 143|6@0+ (0.0625,0) [0|3.9375] "mps"  IDC_L2
 SG_ MRR_ObjRelVelYStd_15 : 137|6@0+ (0.0625,0) [0|3.9375] "mps"  IDC_L2
 SG_ MRR_ObjRAccelXStd_15 : 147|6@0+ (0.0625,0) [0|3.9375] "mps2"  IDC_L2
 SG_ MRR_ObjRAccelYStd_15 : 157|6@0+ (0.0625,0) [0|3.9375] "mps2"  IDC_L2
 SG_ MRR_ObjType_15 : 127|4@0+ (1,0) [0|15] ""  IDC_L2
 SG_ MRR_ObjMotionType_15 : 167|3@0+ (1,0) [0|7] ""  IDC_L2
 SG_ VFC_ObjWidth_15 : 164|10@0+ (0.01,0) [0|5] "m"  IDC_L2
 SG_ VFC_ObjLength_15 : 170|10@0+ (0.05,0) [0|20] "m"  IDC_L2
 SG_ VFC_ObjHeight_15 : 207|10@0+ (0.01,0) [0|6] "m"  IDC_L2
 SG_ VFC_ObjMotionDirection_15 : 176|3@0+ (1,0) [0|7] ""  IDC_L2
 SG_ MRR_ObjID_16 : 271|8@0+ (1,0) [0|255] ""  IDC_L2
 SG_ MRR_ObjExistProb_16 : 279|5@0+ (0.03125,0) [0|0.96875] ""  IDC_L2
 SG_ MRR_ObjObstacleProb_16 : 274|5@0+ (0.03125,0) [0|0.96875] ""  IDC_L2
 SG_ MRR_ObjDistX_16 : 285|12@0+ (0.0625,0) [0|254.9375] "m"  IDC_L2
 SG_ MRR_ObjDistY_16 : 289|11@0+ (0.125,-128) [-128|127.875] "m"  IDC_L2
 SG_ MRR_ObjRelVelX_16 : 335|13@0+ (0.0312,-128) [-128|126.9976] "mps"  IDC_L2
 SG_ MRR_ObjRelVelY_16 : 338|13@0+ (0.0312,-128) [-128|126.9976] "mps"  IDC_L2
 SG_ MRR_ObjRelAccelX_16 : 310|10@0+ (0.03125,-16) [-16|15.96875] "mps2"  IDC_L2
 SG_ MRR_ObjRelAccelY_16 : 357|10@0+ (0.03125,-16) [-16|15.96875] "mps2"  IDC_L2
 SG_ MRR_ObjDistXStd_16 : 363|6@0+ (0.1,0) [0|6] "m"  IDC_L2
 SG_ MRR_ObjDistYStd_16 : 373|6@0+ (0.1,0) [0|6] "m"  IDC_L2
 SG_ MRR_ObjRelVelXStd_16 : 399|6@0+ (0.0625,0) [0|3.9375] "mps"  IDC_L2
 SG_ MRR_ObjRelVelYStd_16 : 393|6@0+ (0.0625,0) [0|3.9375] "mps"  IDC_L2
 SG_ MRR_ObjRAccelXStd_16 : 403|6@0+ (0.0625,0) [0|3.9375] "mps2"  IDC_L2
 SG_ MRR_ObjRAccelYStd_16 : 413|6@0+ (0.0625,0) [0|3.9375] "mps2"  IDC_L2
 SG_ MRR_ObjType_16 : 383|4@0+ (1,0) [0|15] ""  IDC_L2
 SG_ MRR_ObjMotionType_16 : 423|3@0+ (1,0) [0|7] ""  IDC_L2
 SG_ VFC_ObjWidth_16 : 420|10@0+ (0.01,0) [0|5] "m"  IDC_L2
 SG_ VFC_ObjLength_16 : 426|10@0+ (0.05,0) [0|20] "m"  IDC_L2
 SG_ VFC_ObjHeight_16 : 463|10@0+ (0.01,0) [0|6] "m"  IDC_L2
 SG_ VFC_ObjMotionDirection_16 : 432|3@0+ (1,0) [0|7] ""  IDC_L2
 SG_ Checksum57 : 7|8@0+ (1,0) [0|255] ""  IDC_L2
 SG_ Checksum58 : 71|8@0+ (1,0) [0|255] ""  IDC_L2
 SG_ Checksum59 : 135|8@0+ (1,0) [0|255] ""  IDC_L2
 SG_ Checksum60 : 199|8@0+ (1,0) [0|255] ""  IDC_L2
 SG_ Checksum61 : 263|8@0+ (1,0) [0|255] ""  IDC_L2
 SG_ Checksum62 : 327|8@0+ (1,0) [0|255] ""  IDC_L2
 SG_ Checksum63 : 391|8@0+ (1,0) [0|255] ""  IDC_L2
 SG_ Checksum64 : 455|8@0+ (1,0) [0|255] ""  IDC_L2
 SG_ RollingCounter57 : 59|4@0+ (1,0) [0|15] ""  IDC_L2
 SG_ RollingCounter58 : 123|4@0+ (1,0) [0|15] ""  IDC_L2
 SG_ RollingCounter59 : 187|4@0+ (1,0) [0|15] ""  IDC_L2
 SG_ RollingCounter60 : 251|4@0+ (1,0) [0|15] ""  IDC_L2
 SG_ RollingCounter61 : 315|4@0+ (1,0) [0|15] ""  IDC_L2
 SG_ RollingCounter62 : 379|4@0+ (1,0) [0|15] ""  IDC_L2
 SG_ RollingCounter63 : 443|4@0+ (1,0) [0|15] ""  IDC_L2
 SG_ RollingCounter64 : 507|4@0+ (1,0) [0|15] ""  IDC_L2
 SG_ BlockCounter8 : 469|4@0+ (1,0) [0|15] ""  IDC_L2

BO_ 1080 MRRAD9: 64 MRR
 SG_ MRR_ObjMeasured_9 : 496|2@1- (1,0) [0|3] ""  IDC_L2
 SG_ MRR_ObjID_17 : 15|8@0+ (1,0) [0|255] ""  IDC_L2
 SG_ MRR_ObjExistProb_17 : 23|5@0+ (0.03125,0) [0|0.96875] ""  IDC_L2
 SG_ MRR_ObjObstacleProb_17 : 18|5@0+ (0.03125,0) [0|0.96875] ""  IDC_L2
 SG_ MRR_ObjDistX_17 : 29|12@0+ (0.0625,0) [0|254.9375] "m"  IDC_L2
 SG_ MRR_ObjDistY_17 : 33|11@0+ (0.125,-128) [-128|127.875] "m"  IDC_L2
 SG_ MRR_ObjRelVelX_17 : 79|13@0+ (0.0312,-128) [-128|126.9976] "mps"  IDC_L2
 SG_ MRR_ObjRelVelY_17 : 82|13@0+ (0.0312,-128) [-128|126.9976] "mps"  IDC_L2
 SG_ MRR_ObjRelAccelX_17 : 54|10@0+ (0.03125,-16) [-16|15.96875] "mps2"  IDC_L2
 SG_ MRR_ObjRelAccelY_17 : 101|10@0+ (0.03125,-16) [-16|15.96875] "mps2"  IDC_L2
 SG_ MRR_ObjDistXStd_17 : 107|6@0+ (0.1,0) [0|6] "m"  IDC_L2
 SG_ MRR_ObjDistYStd_17 : 117|6@0+ (0.1,0) [0|6] "m"  IDC_L2
 SG_ MRR_ObjRelVelXStd_17 : 143|6@0+ (0.0625,0) [0|3.9375] "mps"  IDC_L2
 SG_ MRR_ObjRelVelYStd_17 : 137|6@0+ (0.0625,0) [0|3.9375] "mps"  IDC_L2
 SG_ MRR_ObjRAccelXStd_17 : 147|6@0+ (0.0625,0) [0|3.9375] "mps2"  IDC_L2
 SG_ MRR_ObjRAccelYStd_17 : 157|6@0+ (0.0625,0) [0|3.9375] "mps2"  IDC_L2
 SG_ MRR_ObjType_17 : 127|4@0+ (1,0) [0|15] ""  IDC_L2
 SG_ MRR_ObjMotionType_17 : 167|3@0+ (1,0) [0|7] ""  IDC_L2
 SG_ VFC_ObjWidth_17 : 164|10@0+ (0.01,0) [0|5] "m"  IDC_L2
 SG_ VFC_ObjLength_17 : 170|10@0+ (0.05,0) [0|20] "m"  IDC_L2
 SG_ VFC_ObjHeight_17 : 207|10@0+ (0.01,0) [0|6] "m"  IDC_L2
 SG_ VFC_ObjMotionDirection_17 : 176|3@0+ (1,0) [0|7] ""  IDC_L2
 SG_ MRR_ObjID_18 : 271|8@0+ (1,0) [0|255] ""  IDC_L2
 SG_ MRR_ObjExistProb_18 : 279|5@0+ (0.03125,0) [0|0.96875] ""  IDC_L2
 SG_ MRR_ObjObstacleProb_18 : 274|5@0+ (0.03125,0) [0|0.96875] ""  IDC_L2
 SG_ MRR_ObjDistX_18 : 285|12@0+ (0.0625,0) [0|254.9375] "m"  IDC_L2
 SG_ MRR_ObjDistY_18 : 289|11@0+ (0.125,-128) [-128|127.875] "m"  IDC_L2
 SG_ MRR_ObjRelVelX_18 : 335|13@0+ (0.0312,-128) [-128|126.9976] "mps"  IDC_L2
 SG_ MRR_ObjRelVelY_18 : 338|13@0+ (0.0312,-128) [-128|126.9976] "mps"  IDC_L2
 SG_ MRR_ObjRelAccelX_18 : 310|10@0+ (0.03125,-16) [-16|15.96875] "mps2"  IDC_L2
 SG_ MRR_ObjRelAccelY_18 : 357|10@0+ (0.03125,-16) [-16|15.96875] "mps2"  IDC_L2
 SG_ MRR_ObjDistXStd_18 : 363|6@0+ (0.1,0) [0|6] "m"  IDC_L2
 SG_ MRR_ObjDistYStd_18 : 373|6@0+ (0.1,0) [0|6] "m"  IDC_L2
 SG_ MRR_ObjRelVelXStd_18 : 399|6@0+ (0.0625,0) [0|3.9375] "mps"  IDC_L2
 SG_ MRR_ObjRelVelYStd_18 : 393|6@0+ (0.0625,0) [0|3.9375] "mps"  IDC_L2
 SG_ MRR_ObjRAccelXStd_18 : 403|6@0+ (0.0625,0) [0|3.9375] "mps2"  IDC_L2
 SG_ MRR_ObjRAccelYStd_18 : 413|6@0+ (0.0625,0) [0|3.9375] "mps2"  IDC_L2
 SG_ MRR_ObjType_18 : 383|4@0+ (1,0) [0|15] ""  IDC_L2
 SG_ MRR_ObjMotionType_18 : 423|3@0+ (1,0) [0|7] ""  IDC_L2
 SG_ VFC_ObjWidth_18 : 420|10@0+ (0.01,0) [0|5] "m"  IDC_L2
 SG_ VFC_ObjLength_18 : 426|10@0+ (0.05,0) [0|20] "m"  IDC_L2
 SG_ VFC_ObjHeight_18 : 463|10@0+ (0.01,0) [0|6] "m"  IDC_L2
 SG_ VFC_ObjMotionDirection_18 : 432|3@0+ (1,0) [0|7] ""  IDC_L2
 SG_ Checksum65 : 7|8@0+ (1,0) [0|255] ""  IDC_L2
 SG_ Checksum66 : 71|8@0+ (1,0) [0|255] ""  IDC_L2
 SG_ Checksum67 : 135|8@0+ (1,0) [0|255] ""  IDC_L2
 SG_ Checksum68 : 199|8@0+ (1,0) [0|255] ""  IDC_L2
 SG_ Checksum69 : 263|8@0+ (1,0) [0|255] ""  IDC_L2
 SG_ Checksum70 : 327|8@0+ (1,0) [0|255] ""  IDC_L2
 SG_ Checksum71 : 391|8@0+ (1,0) [0|255] ""  IDC_L2
 SG_ Checksum72 : 455|8@0+ (1,0) [0|255] ""  IDC_L2
 SG_ RollingCounter65 : 59|4@0+ (1,0) [0|15] ""  IDC_L2
 SG_ RollingCounter66 : 123|4@0+ (1,0) [0|15] ""  IDC_L2
 SG_ RollingCounter67 : 187|4@0+ (1,0) [0|15] ""  IDC_L2
 SG_ RollingCounter68 : 251|4@0+ (1,0) [0|15] ""  IDC_L2
 SG_ RollingCounter69 : 315|4@0+ (1,0) [0|15] ""  IDC_L2
 SG_ RollingCounter70 : 379|4@0+ (1,0) [0|15] ""  IDC_L2
 SG_ RollingCounter71 : 443|4@0+ (1,0) [0|15] ""  IDC_L2
 SG_ RollingCounter72 : 507|4@0+ (1,0) [0|15] ""  IDC_L2
 SG_ BlockCounter9 : 469|4@0+ (1,0) [0|15] ""  IDC_L2

CM_ BO_ 3221225472 "This is a message for not used signals, created by Vector CANdb++ DBC OLE DB Provider.";
CM_ SG_ 1072 MRR_hdr_AutoSarTimeStamp "AutoSar TimeStamp";
CM_ SG_ 1072 MRR_hdr_TimerStempStatus "Bit 0:TIMEOUT
Bit 1:Reserved1
Bit 2:SYNC_TO_GATWAY
Bit 3:GLOBAL_TIME_BASE
Bit 4:TIMELEAP_FUTURE
Bit 5:TIMELAP_PAST
Bit 6:Reserved6
Bit 7:Extension:GENERAL_ERROR";
BA_DEF_  "Manufacturer" STRING ;
BA_DEF_  "DBName" STRING ;
BA_DEF_  "BusType" STRING ;
BA_DEF_  "GenEnvVarEndingDsp" STRING ;
BA_DEF_  "GenEnvVarEndingSnd" STRING ;
BA_DEF_  "GenEnvVarPrefix" STRING ;
BA_DEF_  "GenNWMApBusSleep" STRING ;
BA_DEF_  "GenNWMApCanNormal" STRING ;
BA_DEF_  "GenNWMApCanOff" STRING ;
BA_DEF_  "GenNWMApCanOn" STRING ;
BA_DEF_  "GenNWMApCanSleep" STRING ;
BA_DEF_  "GenNWMApCanWakeUp" STRING ;
BA_DEF_  "GenNWMGotoMode_Awake" STRING ;
BA_DEF_  "GenNWMGotoMode_BusSleep" STRING ;
BA_DEF_  "GenNWMTalkNM" STRING ;
BA_DEF_  "NmBaseAddress" HEX 1152 1279;
BA_DEF_ BU_  "NodeLayerModules" STRING ;
BA_DEF_ BU_  "NmCAN" INT 0 2;
BA_DEF_ BU_  "ILUsed" ENUM  "No","Yes";
BA_DEF_ BO_  "GenMsgILSupport" ENUM  "No","Yes";
BA_DEF_ BO_  "GenMsgCycleTime" INT 0 65535;
BA_DEF_ BO_  "GenMsgMinAcceptLength" INT 0 8;
BA_DEF_ BO_  "GenMsgSendType" ENUM  "Cyclic","CyclicAndSpontanX","Event";
BA_DEF_ BO_  "CANFD_BRS" ENUM  "0","1";
BA_DEF_ BO_  "VFrameFormat" ENUM  "StandardCAN","ExtendedCAN","reserved","reserved","reserved","reserved","reserved","reserved","reserved","reserved","reserved","reserved","reserved","reserved","StandardCAN_FD","ExtendedCAN_FD";
BA_DEF_ SG_  "GenSigEnvVarType" ENUM  "undef","int","float";
BA_DEF_ SG_  "GenSigSendType" ENUM  "Cyclic","OnWrite","OnWriteWithRepetition","OnChange","OnChangeWithRepetition","IfActive","IfActiveWithRepetition","NoSigSendType","NotUsed","NotUsed","NotUsed","NotUsed","NotUsed";
BA_DEF_ SG_  "GenSigStartValue" FLOAT 0 1215752192;
BA_DEF_DEF_  "Manufacturer" "GWM";
BA_DEF_DEF_  "DBName" "B30_001_021MM01 C_Matrix for ADAS_CAN__V1_2";
BA_DEF_DEF_  "BusType" "";
BA_DEF_DEF_  "GenEnvVarEndingDsp" "_d";
BA_DEF_DEF_  "GenEnvVarEndingSnd" "_s";
BA_DEF_DEF_  "GenEnvVarPrefix" "c";
BA_DEF_DEF_  "GenNWMApBusSleep" "apBusSleep()";
BA_DEF_DEF_  "GenNWMApCanNormal" "apCanNormal()";
BA_DEF_DEF_  "GenNWMApCanOff" "apCanOff()";
BA_DEF_DEF_  "GenNWMApCanOn" "apCanOn()";
BA_DEF_DEF_  "GenNWMApCanSleep" "apCanSleep()";
BA_DEF_DEF_  "GenNWMApCanWakeUp" "apCanWakeUp()";
BA_DEF_DEF_  "GenNWMGotoMode_Awake" "GotoMode_Awake()";
BA_DEF_DEF_  "GenNWMGotoMode_BusSleep" "GotoMode_BusSleep()";
BA_DEF_DEF_  "GenNWMTalkNM" "TalkNM()";
BA_DEF_DEF_  "NmBaseAddress" 1152;
BA_DEF_DEF_  "NodeLayerModules" "CANoeILNLVector.dll";
BA_DEF_DEF_  "NmCAN" 1;
BA_DEF_DEF_  "ILUsed" "Yes";
BA_DEF_DEF_  "GenMsgILSupport" "Yes";
BA_DEF_DEF_  "GenMsgCycleTime" 10;
BA_DEF_DEF_  "GenMsgMinAcceptLength" 8;
BA_DEF_DEF_  "GenMsgSendType" "Cyclic";
BA_DEF_DEF_  "CANFD_BRS" "1";
BA_DEF_DEF_  "VFrameFormat" "StandardCAN";
BA_DEF_DEF_  "GenSigEnvVarType" "undef";
BA_DEF_DEF_  "GenSigSendType" "Cyclic";
BA_DEF_DEF_  "GenSigStartValue" 0;
BA_ "BusType" "CAN FD";
BA_ "DBName" "B30_001_021MM01C_MatrixforADAS_C";
BA_ "GenMsgCycleTime" BO_ 1136 500;
BA_ "VFrameFormat" BO_ 1136 14;
BA_ "GenMsgCycleTime" BO_ 1072 50;
BA_ "VFrameFormat" BO_ 1072 14;
BA_ "GenMsgCycleTime" BO_ 1081 50;
BA_ "VFrameFormat" BO_ 1081 14;
BA_ "GenMsgCycleTime" BO_ 1082 50;
BA_ "VFrameFormat" BO_ 1082 14;
BA_ "GenMsgCycleTime" BO_ 1083 50;
BA_ "VFrameFormat" BO_ 1083 14;
BA_ "GenMsgCycleTime" BO_ 1084 50;
BA_ "VFrameFormat" BO_ 1084 14;
BA_ "GenMsgCycleTime" BO_ 1085 50;
BA_ "VFrameFormat" BO_ 1085 14;
BA_ "GenMsgCycleTime" BO_ 1086 50;
BA_ "VFrameFormat" BO_ 1086 14;
BA_ "GenMsgCycleTime" BO_ 1087 50;
BA_ "VFrameFormat" BO_ 1087 14;
BA_ "GenMsgCycleTime" BO_ 1073 50;
BA_ "VFrameFormat" BO_ 1073 14;
BA_ "GenMsgCycleTime" BO_ 1074 50;
BA_ "VFrameFormat" BO_ 1074 14;
BA_ "GenMsgCycleTime" BO_ 1075 50;
BA_ "VFrameFormat" BO_ 1075 14;
BA_ "GenMsgCycleTime" BO_ 1076 50;
BA_ "VFrameFormat" BO_ 1076 14;
BA_ "GenMsgCycleTime" BO_ 1077 50;
BA_ "VFrameFormat" BO_ 1077 14;
BA_ "GenMsgCycleTime" BO_ 1078 50;
BA_ "VFrameFormat" BO_ 1078 14;
BA_ "GenMsgCycleTime" BO_ 1079 50;
BA_ "VFrameFormat" BO_ 1079 14;
BA_ "GenMsgCycleTime" BO_ 1080 50;
BA_ "VFrameFormat" BO_ 1080 14;
BA_ "GenSigSendType" SG_ 3221225472 Destination_HC_NM 10;
BA_ "GenSigSendType" SG_ 3221225472 OpCode_HC_NM 10;
BA_ "GenSigSendType" SG_ 3221225472 Destination_GW_NM 10;
BA_ "GenSigSendType" SG_ 3221225472 OpCode_GW_NM 10;
BA_ "GenSigSendType" SG_ 3221225472 DiagFuncReq 10;
BA_ "GenSigSendType" SG_ 3221225472 GW_Phy_Req 10;
BA_ "GenSigSendType" SG_ 3221225472 RSDS_L_Phy_Req 10;
BA_ "GenSigSendType" SG_ 3221225472 RSDS_R_Phy_Req 10;
BA_ "GenSigSendType" SG_ 3221225472 IFC_Phy_Req 10;
BA_ "GenSigSendType" SG_ 3221225472 HC_Phy_Req 10;
BA_ "GenSigSendType" SG_ 3221225472 HAP_IPAS_Phy_Req 10;
BA_ "GenSigSendType" SG_ 3221225472 GW_Phy_Resp 10;
BA_ "GenSigSendType" SG_ 3221225472 RSDS_L_Phy_Resp 10;
BA_ "GenSigSendType" SG_ 3221225472 RSDS_R_Phy_Resp 10;
BA_ "GenSigSendType" SG_ 3221225472 IFC_Phy_Resp 10;
BA_ "GenSigSendType" SG_ 3221225472 HC_Phy_Resp 10;
BA_ "GenSigSendType" SG_ 3221225472 HAP_IPAS_Phy_Resp 10;
BA_ "GenSigStartValue" SG_ 1072 MRR_ObjDistY_1 1024;
BA_ "GenSigStartValue" SG_ 1072 MRR_ObjRelVelX_1 4102;
BA_ "GenSigStartValue" SG_ 1072 MRR_ObjRelVelY_1 4102;
BA_ "GenSigStartValue" SG_ 1072 MRR_ObjRelAccelX_1 512;
BA_ "GenSigStartValue" SG_ 1072 MRR_ObjRelAccelY_1 512;
BA_ "GenSigStartValue" SG_ 1072 MRR_ObjDistY_2 1024;
BA_ "GenSigStartValue" SG_ 1072 MRR_ObjRelVelX_2 4102;
BA_ "GenSigStartValue" SG_ 1072 MRR_ObjRelVelY_2 4102;
BA_ "GenSigStartValue" SG_ 1072 MRR_ObjRelAccelX_2 512;
BA_ "GenSigStartValue" SG_ 1072 MRR_ObjRelAccelY_2 512;
BA_ "GenSigStartValue" SG_ 1081 MRR_ObjDistY_19 1024;
BA_ "GenSigStartValue" SG_ 1081 MRR_ObjRelVelX_19 4102;
BA_ "GenSigStartValue" SG_ 1081 MRR_ObjRelVelY_19 4102;
BA_ "GenSigStartValue" SG_ 1081 MRR_ObjRelAccelX_19 512;
BA_ "GenSigStartValue" SG_ 1081 MRR_ObjRelAccelY_19 512;
BA_ "GenSigStartValue" SG_ 1081 MRR_ObjDistY_20 1024;
BA_ "GenSigStartValue" SG_ 1081 MRR_ObjRelVelX_20 4102;
BA_ "GenSigStartValue" SG_ 1081 MRR_ObjRelVelY_20 4102;
BA_ "GenSigStartValue" SG_ 1081 MRR_ObjRelAccelX_20 512;
BA_ "GenSigStartValue" SG_ 1081 MRR_ObjRelAccelY_20 512;
BA_ "GenSigStartValue" SG_ 1082 MRR_ObjDistY_21 1024;
BA_ "GenSigStartValue" SG_ 1082 MRR_ObjRelVelX_21 4102;
BA_ "GenSigStartValue" SG_ 1082 MRR_ObjRelVelY_21 4102;
BA_ "GenSigStartValue" SG_ 1082 MRR_ObjRelAccelX_21 512;
BA_ "GenSigStartValue" SG_ 1082 MRR_ObjRelAccelY_21 512;
BA_ "GenSigStartValue" SG_ 1082 MRR_ObjDistY_22 1024;
BA_ "GenSigStartValue" SG_ 1082 MRR_ObjRelVelX_22 4102;
BA_ "GenSigStartValue" SG_ 1082 MRR_ObjRelVelY_22 4102;
BA_ "GenSigStartValue" SG_ 1082 MRR_ObjRelAccelX_22 512;
BA_ "GenSigStartValue" SG_ 1082 MRR_ObjRelAccelY_22 512;
BA_ "GenSigStartValue" SG_ 1083 MRR_ObjDistY_23 1024;
BA_ "GenSigStartValue" SG_ 1083 MRR_ObjRelVelX_23 4102;
BA_ "GenSigStartValue" SG_ 1083 MRR_ObjRelVelY_23 4102;
BA_ "GenSigStartValue" SG_ 1083 MRR_ObjRelAccelX_23 512;
BA_ "GenSigStartValue" SG_ 1083 MRR_ObjRelAccelY_23 512;
BA_ "GenSigStartValue" SG_ 1083 MRR_ObjDistY_24 1024;
BA_ "GenSigStartValue" SG_ 1083 MRR_ObjRelVelX_24 4102;
BA_ "GenSigStartValue" SG_ 1083 MRR_ObjRelVelY_24 4102;
BA_ "GenSigStartValue" SG_ 1083 MRR_ObjRelAccelX_24 512;
BA_ "GenSigStartValue" SG_ 1083 MRR_ObjRelAccelY_24 512;
BA_ "GenSigStartValue" SG_ 1084 MRR_ObjDistY_25 1024;
BA_ "GenSigStartValue" SG_ 1084 MRR_ObjRelVelX_25 4102;
BA_ "GenSigStartValue" SG_ 1084 MRR_ObjRelVelY_25 4102;
BA_ "GenSigStartValue" SG_ 1084 MRR_ObjRelAccelX_25 512;
BA_ "GenSigStartValue" SG_ 1084 MRR_ObjRelAccelY_25 512;
BA_ "GenSigStartValue" SG_ 1084 MRR_ObjDistY_26 1024;
BA_ "GenSigStartValue" SG_ 1084 MRR_ObjRelVelX_26 4102;
BA_ "GenSigStartValue" SG_ 1084 MRR_ObjRelVelY_26 4102;
BA_ "GenSigStartValue" SG_ 1084 MRR_ObjRelAccelX_26 512;
BA_ "GenSigStartValue" SG_ 1084 MRR_ObjRelAccelY_26 512;
BA_ "GenSigStartValue" SG_ 1085 MRR_ObjDistY_27 1024;
BA_ "GenSigStartValue" SG_ 1085 MRR_ObjRelVelX_27 4102;
BA_ "GenSigStartValue" SG_ 1085 MRR_ObjRelVelY_27 4102;
BA_ "GenSigStartValue" SG_ 1085 MRR_ObjRelAccelX_27 512;
BA_ "GenSigStartValue" SG_ 1085 MRR_ObjRelAccelY_27 512;
BA_ "GenSigStartValue" SG_ 1085 MRR_ObjDistY_28 1024;
BA_ "GenSigStartValue" SG_ 1085 MRR_ObjRelVelX_28 4102;
BA_ "GenSigStartValue" SG_ 1085 MRR_ObjRelVelY_28 4102;
BA_ "GenSigStartValue" SG_ 1085 MRR_ObjRelAccelX_28 512;
BA_ "GenSigStartValue" SG_ 1085 MRR_ObjRelAccelY_28 512;
BA_ "GenSigStartValue" SG_ 1086 MRR_ObjDistY_29 1024;
BA_ "GenSigStartValue" SG_ 1086 MRR_ObjRelVelX_29 4102;
BA_ "GenSigStartValue" SG_ 1086 MRR_ObjRelVelY_29 4102;
BA_ "GenSigStartValue" SG_ 1086 MRR_ObjRelAccelX_29 512;
BA_ "GenSigStartValue" SG_ 1086 MRR_ObjRelAccelY_29 512;
BA_ "GenSigStartValue" SG_ 1086 MRR_ObjDistY_30 1024;
BA_ "GenSigStartValue" SG_ 1086 MRR_ObjRelVelX_30 4102;
BA_ "GenSigStartValue" SG_ 1086 MRR_ObjRelVelY_30 4102;
BA_ "GenSigStartValue" SG_ 1086 MRR_ObjRelAccelX_30 512;
BA_ "GenSigStartValue" SG_ 1086 MRR_ObjRelAccelY_30 512;
BA_ "GenSigStartValue" SG_ 1087 MRR_ObjDistY_31 1024;
BA_ "GenSigStartValue" SG_ 1087 MRR_ObjRelVelX_31 4102;
BA_ "GenSigStartValue" SG_ 1087 MRR_ObjRelVelY_31 4102;
BA_ "GenSigStartValue" SG_ 1087 MRR_ObjRelAccelX_31 512;
BA_ "GenSigStartValue" SG_ 1087 MRR_ObjRelAccelY_31 512;
BA_ "GenSigStartValue" SG_ 1087 MRR_ObjDistY_32 1024;
BA_ "GenSigStartValue" SG_ 1087 MRR_ObjRelVelX_32 4102;
BA_ "GenSigStartValue" SG_ 1087 MRR_ObjRelVelY_32 4102;
BA_ "GenSigStartValue" SG_ 1087 MRR_ObjRelAccelX_32 512;
BA_ "GenSigStartValue" SG_ 1087 MRR_ObjRelAccelY_32 512;
BA_ "GenSigStartValue" SG_ 1073 MRR_ObjDistY_3 1024;
BA_ "GenSigStartValue" SG_ 1073 MRR_ObjRelVelX_3 4102;
BA_ "GenSigStartValue" SG_ 1073 MRR_ObjRelVelY_3 4102;
BA_ "GenSigStartValue" SG_ 1073 MRR_ObjRelAccelX_3 512;
BA_ "GenSigStartValue" SG_ 1073 MRR_ObjRelAccelY_3 512;
BA_ "GenSigStartValue" SG_ 1073 MRR_ObjDistY_4 1024;
BA_ "GenSigStartValue" SG_ 1073 MRR_ObjRelVelX_4 4102;
BA_ "GenSigStartValue" SG_ 1073 MRR_ObjRelVelY_4 4102;
BA_ "GenSigStartValue" SG_ 1073 MRR_ObjRelAccelX_4 512;
BA_ "GenSigStartValue" SG_ 1073 MRR_ObjRelAccelY_4 512;
BA_ "GenSigStartValue" SG_ 1074 MRR_ObjDistY_5 1024;
BA_ "GenSigStartValue" SG_ 1074 MRR_ObjRelVelX_5 4102;
BA_ "GenSigStartValue" SG_ 1074 MRR_ObjRelVelY_5 4102;
BA_ "GenSigStartValue" SG_ 1074 MRR_ObjRelAccelX_5 512;
BA_ "GenSigStartValue" SG_ 1074 MRR_ObjRelAccelY_5 512;
BA_ "GenSigStartValue" SG_ 1074 MRR_ObjDistY_6 1024;
BA_ "GenSigStartValue" SG_ 1074 MRR_ObjRelVelX_6 4102;
BA_ "GenSigStartValue" SG_ 1074 MRR_ObjRelVelY_6 4102;
BA_ "GenSigStartValue" SG_ 1074 MRR_ObjRelAccelX_6 512;
BA_ "GenSigStartValue" SG_ 1074 MRR_ObjRelAccelY_6 512;
BA_ "GenSigStartValue" SG_ 1075 MRR_ObjDistY_7 1024;
BA_ "GenSigStartValue" SG_ 1075 MRR_ObjRelVelX_7 4102;
BA_ "GenSigStartValue" SG_ 1075 MRR_ObjRelVelY_7 4102;
BA_ "GenSigStartValue" SG_ 1075 MRR_ObjRelAccelX_7 512;
BA_ "GenSigStartValue" SG_ 1075 MRR_ObjRelAccelY_7 512;
BA_ "GenSigStartValue" SG_ 1075 MRR_ObjDistY_8 1024;
BA_ "GenSigStartValue" SG_ 1075 MRR_ObjRelVelX_8 4102;
BA_ "GenSigStartValue" SG_ 1075 MRR_ObjRelVelY_8 4102;
BA_ "GenSigStartValue" SG_ 1075 MRR_ObjRelAccelX_8 512;
BA_ "GenSigStartValue" SG_ 1075 MRR_ObjRelAccelY_8 512;
BA_ "GenSigStartValue" SG_ 1076 MRR_ObjDistY_9 1024;
BA_ "GenSigStartValue" SG_ 1076 MRR_ObjRelVelX_9 4102;
BA_ "GenSigStartValue" SG_ 1076 MRR_ObjRelVelY_9 4102;
BA_ "GenSigStartValue" SG_ 1076 MRR_ObjRelAccelX_9 512;
BA_ "GenSigStartValue" SG_ 1076 MRR_ObjRelAccelY_9 512;
BA_ "GenSigStartValue" SG_ 1076 MRR_ObjDistY_10 1024;
BA_ "GenSigStartValue" SG_ 1076 MRR_ObjRelVelX_10 4102;
BA_ "GenSigStartValue" SG_ 1076 MRR_ObjRelVelY_10 4102;
BA_ "GenSigStartValue" SG_ 1076 MRR_ObjRelAccelX_10 512;
BA_ "GenSigStartValue" SG_ 1076 MRR_ObjRelAccelY_10 512;
BA_ "GenSigStartValue" SG_ 1077 MRR_ObjDistY_11 1024;
BA_ "GenSigStartValue" SG_ 1077 MRR_ObjRelVelX_11 4102;
BA_ "GenSigStartValue" SG_ 1077 MRR_ObjRelVelY_11 4102;
BA_ "GenSigStartValue" SG_ 1077 MRR_ObjRelAccelX_11 512;
BA_ "GenSigStartValue" SG_ 1077 MRR_ObjRelAccelY_11 512;
BA_ "GenSigStartValue" SG_ 1077 MRR_ObjDistY_12 1024;
BA_ "GenSigStartValue" SG_ 1077 MRR_ObjRelVelX_12 4102;
BA_ "GenSigStartValue" SG_ 1077 MRR_ObjRelVelY_12 4102;
BA_ "GenSigStartValue" SG_ 1077 MRR_ObjRelAccelX_12 512;
BA_ "GenSigStartValue" SG_ 1077 MRR_ObjRelAccelY_12 512;
BA_ "GenSigStartValue" SG_ 1078 MRR_ObjDistY_13 1024;
BA_ "GenSigStartValue" SG_ 1078 MRR_ObjRelVelX_13 4102;
BA_ "GenSigStartValue" SG_ 1078 MRR_ObjRelVelY_13 4102;
BA_ "GenSigStartValue" SG_ 1078 MRR_ObjRelAccelX_13 512;
BA_ "GenSigStartValue" SG_ 1078 MRR_ObjRelAccelY_13 512;
BA_ "GenSigStartValue" SG_ 1078 MRR_ObjDistY_14 1024;
BA_ "GenSigStartValue" SG_ 1078 MRR_ObjRelVelX_14 4102;
BA_ "GenSigStartValue" SG_ 1078 MRR_ObjRelVelY_14 4102;
BA_ "GenSigStartValue" SG_ 1078 MRR_ObjRelAccelX_14 512;
BA_ "GenSigStartValue" SG_ 1078 MRR_ObjRelAccelY_14 512;
BA_ "GenSigStartValue" SG_ 1079 MRR_ObjDistY_15 1024;
BA_ "GenSigStartValue" SG_ 1079 MRR_ObjRelVelX_15 4102;
BA_ "GenSigStartValue" SG_ 1079 MRR_ObjRelVelY_15 4102;
BA_ "GenSigStartValue" SG_ 1079 MRR_ObjRelAccelX_15 512;
BA_ "GenSigStartValue" SG_ 1079 MRR_ObjRelAccelY_15 512;
BA_ "GenSigStartValue" SG_ 1079 MRR_ObjDistY_16 1024;
BA_ "GenSigStartValue" SG_ 1079 MRR_ObjRelVelX_16 4102;
BA_ "GenSigStartValue" SG_ 1079 MRR_ObjRelVelY_16 4102;
BA_ "GenSigStartValue" SG_ 1079 MRR_ObjRelAccelX_16 512;
BA_ "GenSigStartValue" SG_ 1079 MRR_ObjRelAccelY_16 512;
BA_ "GenSigStartValue" SG_ 1080 MRR_ObjDistY_17 1024;
BA_ "GenSigStartValue" SG_ 1080 MRR_ObjRelVelX_17 4102;
BA_ "GenSigStartValue" SG_ 1080 MRR_ObjRelVelY_17 4102;
BA_ "GenSigStartValue" SG_ 1080 MRR_ObjRelAccelX_17 512;
BA_ "GenSigStartValue" SG_ 1080 MRR_ObjRelAccelY_17 512;
BA_ "GenSigStartValue" SG_ 1080 MRR_ObjDistY_18 1024;
BA_ "GenSigStartValue" SG_ 1080 MRR_ObjRelVelX_18 4102;
BA_ "GenSigStartValue" SG_ 1080 MRR_ObjRelVelY_18 4102;
BA_ "GenSigStartValue" SG_ 1080 MRR_ObjRelAccelX_18 512;
BA_ "GenSigStartValue" SG_ 1080 MRR_ObjRelAccelY_18 512;
VAL_ 3221225472 Destination_HC_NM 1 "GW" 2 "PEPS" 3 "ESCL" 4 "LRSDS" 5 "RRSDS" 6 "BCM" 7 "Trailer" 8 "T-Box" 9 "CMS" 10 "AC" 11 "SCM" 12 "DSM" 13 "DDCM" 14 "PDCM" 15 "HUT" 16 "HCM" 17 "AC_RCP" 18 "TPMS" 32 "ACU" 33 "HCU" 34 "OBC" 35 "BMS" 36 "MCU" 37 "BSG" ;
VAL_ 3221225472 OpCode_HC_NM 1 "Alive" 2 "ring" 4 "limphome" 18 "ring_sleep_ind" 20 "limphome_sleep_ind" 50 "ring_sleep_ack" ;
VAL_ 3221225472 Destination_GW_NM 1 "GW" 2 "PEPS" 3 "ESCL" 4 "LRSDS" 5 "RRSDS" 6 "BCM" 7 "Trailer" 8 "T-Box" 9 "CMS" 10 "AC" 11 "SCM" 12 "DSM" 13 "DDCM" 14 "PDCM" 15 "HUT" 16 "HCM" 17 "AC_RCP" 18 "TPMS" 32 "ACU" 33 "HCU" 34 "OBC" 35 "BMS" 36 "MCU" 37 "BSG" ;
VAL_ 3221225472 OpCode_GW_NM 1 "Alive" 2 "ring" 4 "limphome" 18 "ring_sleep_ind" 20 "limphome_sleep_ind" 50 "ring_sleep_ack" ;
VAL_ 1136 Sync_CRC 0 " Valid value " ;
VAL_ 1136 Sync_OVS 0 " Valid value " ;
VAL_ 1136 Sync_Resd 0 " Valid value " ;
VAL_ 1136 Sync_Counter 0 " Valid value " ;
VAL_ 1136 Sync_SGW 0 " Valid value " ;
VAL_ 1136 Sync_SyncTime 0 " Valid value " ;
VAL_ 1136 Sync_TimeDomain 0 " Valid value " ;
VAL_ 1136 Sync_Type 0 " Valid value " ;
VAL_ 1072 MRR_BLIND 3 "Reserved" 2 "Reserved" 1 "Blindness" 0 "No Blindness" ;
VAL_ 1072 MRR_ObjMeasured_1 0 " int " 1 " unknown " 2 " Drive " 3 " Stopped " 4 " Stand " 5 " reserved " 6 " reserved " 7 " reserved " ;
VAL_ 1072 MRR_hdr_ErrorStatus 0 " No error " 1 "Not Defined" 2 " misalignment_elevation " 3 " misalignment_azimuth " 4 " temporary failure " 5 " permanent failure " 6 " Voltage_error " 7 " Production_mode " 8 " EOL_error " 9 " Calibration parameter_error " 10 " Reserved " ;
VAL_ 1072 MRR_hdr_TimeStamp 0 " Valid values " 67562888 " Reserved " ;
VAL_ 1072 MRR_ObjID_1 0 " Valid values " ;
VAL_ 1072 MRR_ObjExistProb_1 0 " Valid values " ;
VAL_ 1072 MRR_ObjObstacleProb_1 0 " Valid values " ;
VAL_ 1072 MRR_ObjDistX_1 0 " Valid values " 4080 " Reserved " ;
VAL_ 1072 MRR_ObjDistY_1 0 " Valid values " ;
VAL_ 1072 MRR_ObjRelVelX_1 0 " Valid values " 8174 " Reserved " ;
VAL_ 1072 MRR_ObjRelVelY_1 0 " Valid values " 8174 " Reserved " ;
VAL_ 1072 MRR_ObjRelAccelX_1 0 " Valid values " ;
VAL_ 1072 MRR_ObjRelAccelY_1 0 " Valid values " ;
VAL_ 1072 MRR_ObjDistXStd_1 0 " Valid values " ;
VAL_ 1072 MRR_ObjDistYStd_1 0 " Valid values " ;
VAL_ 1072 MRR_ObjRelVelXStd_1 0 " Valid values " ;
VAL_ 1072 MRR_ObjRelVelYStd_1 0 " Valid values " ;
VAL_ 1072 MRR_ObjRAccelXStd_1 0 " Valid values " ;
VAL_ 1072 MRR_ObjRAccelYStd_1 0 " Valid values " ;
VAL_ 1072 MRR_ObjType_1 0 " Unknown " 1 " Truck " 2 " Car " 3 " Pedestrian " 4 " Cyclist " 5 " Reserved " ;
VAL_ 1072 MRR_ObjMotionType_1 0 " int " 1 " unknown " 2 " Drive " 3 " Stopped " 4 " Stand " 5 " reserved " 6 " reserved " 7 " reserved " ;
VAL_ 1072 VFC_ObjWidth_1 0 " Valid values " 501 " Reserved " ;
VAL_ 1072 VFC_ObjLength_1 0 " Valid values " 401 " Reserved " ;
VAL_ 1072 VFC_ObjHeight_1 0 " Valid values " 601 " Reserved " ;
VAL_ 1072 VFC_ObjMotionDirection_1 0 " Init " 1 " Inverse direction " 2 " Same  direction " 3 " cross " 4 " reserved " 5 " reserved " 6 " reserved " 7 " reserved " ;
VAL_ 1072 MRR_ObjID_2 0 " Valid values " ;
VAL_ 1072 MRR_ObjExistProb_2 0 " Valid values " ;
VAL_ 1072 MRR_ObjObstacleProb_2 0 " Valid values " ;
VAL_ 1072 MRR_ObjDistX_2 0 " Valid values " 4080 " Reserved " ;
VAL_ 1072 MRR_ObjDistY_2 0 " Valid values " ;
VAL_ 1072 MRR_ObjRelVelX_2 0 " Valid values " 8174 " Reserved " ;
VAL_ 1072 MRR_ObjRelVelY_2 0 " Valid values " 8174 " Reserved " ;
VAL_ 1072 MRR_ObjRelAccelX_2 0 " Valid values " ;
VAL_ 1072 MRR_ObjRelAccelY_2 0 " Valid values " ;
VAL_ 1072 MRR_ObjDistXStd_2 0 " Valid values " ;
VAL_ 1072 MRR_ObjDistYStd_2 0 " Valid values " ;
VAL_ 1072 MRR_ObjRelVelXStd_2 0 " Valid values " ;
VAL_ 1072 MRR_ObjRelVelYStd_2 0 " Valid values " ;
VAL_ 1072 MRR_ObjRAccelXStd_2 0 " Valid values " ;
VAL_ 1072 MRR_ObjRAccelYStd_2 0 " Valid values " ;
VAL_ 1072 MRR_ObjType_2 0 " Unknown " 1 " Truck " 2 " Car " 3 " Pedestrian " 4 " Cyclist " 5 " Reserved " ;
VAL_ 1072 MRR_ObjMotionType_2 0 " int " 1 " unknown " 2 " Drive " 3 " Stopped " 4 " Stand " 5 " reserved " 6 " reserved " 7 " reserved " ;
VAL_ 1072 VFC_ObjWidth_2 0 " Valid values " 501 " Reserved " ;
VAL_ 1072 VFC_ObjLength_2 0 " Valid values " 401 " Reserved " ;
VAL_ 1072 VFC_ObjHeight_2 0 " Valid values " 601 " Reserved " ;
VAL_ 1072 VFC_ObjMotionDirection_2 0 " Init " 1 " Inverse direction " 2 " Same  direction " 3 " cross " 4 " reserved " 5 " reserved " 6 " reserved " 7 " reserved " ;
VAL_ 1072 Checksum1 0 " Valid value " ;
VAL_ 1072 Checksum2 0 " Valid value " ;
VAL_ 1072 Checksum3 0 " Valid value " ;
VAL_ 1072 Checksum4 0 " Valid value " ;
VAL_ 1072 Checksum5 0 " Valid value " ;
VAL_ 1072 Checksum6 0 " Valid value " ;
VAL_ 1072 Checksum7 0 " Valid value " ;
VAL_ 1072 Checksum8 0 " Valid value " ;
VAL_ 1072 RollingCounter1 0 " Valid value " 15 " Invalid value " ;
VAL_ 1072 RollingCounter2 0 " Valid value " 15 " Invalid value " ;
VAL_ 1072 RollingCounter3 0 " Valid value " 15 " Invalid value " ;
VAL_ 1072 RollingCounter4 0 " Valid value " 15 " Invalid value " ;
VAL_ 1072 RollingCounter5 0 " Valid value " 15 " Invalid value " ;
VAL_ 1072 RollingCounter6 0 " Valid value " 15 " Invalid value " ;
VAL_ 1072 RollingCounter7 0 " Valid value " 15 " Invalid value " ;
VAL_ 1072 RollingCounter8 0 " Valid value " 15 " Invalid value " ;
VAL_ 1072 BlockCounter1 3 "Reserved" 2 "Predicted" 1 "Measured" 0 "Init" ;
VAL_ 1081 MRR_ObjMeasured_10 3 "Reserved" 2 "Predicted" 1 "Measured" 0 "Init" ;
VAL_ 1081 MRR_ObjID_19 0 " Valid values " ;
VAL_ 1081 MRR_ObjExistProb_19 0 " Valid values " ;
VAL_ 1081 MRR_ObjObstacleProb_19 0 " Valid values " ;
VAL_ 1081 MRR_ObjDistX_19 0 " Valid values " 4080 " Reserved " ;
VAL_ 1081 MRR_ObjDistY_19 0 " Valid values " ;
VAL_ 1081 MRR_ObjRelVelX_19 0 " Valid values " 8174 " Reserved " ;
VAL_ 1081 MRR_ObjRelVelY_19 0 " Valid values " 8174 " Reserved " ;
VAL_ 1081 MRR_ObjRelAccelX_19 0 " Valid values " ;
VAL_ 1081 MRR_ObjRelAccelY_19 0 " Valid values " ;
VAL_ 1081 MRR_ObjDistXStd_19 0 " Valid values " ;
VAL_ 1081 MRR_ObjDistYStd_19 0 " Valid values " ;
VAL_ 1081 MRR_ObjRelVelXStd_19 0 " Valid values " ;
VAL_ 1081 MRR_ObjRelVelYStd_19 0 " Valid values " ;
VAL_ 1081 MRR_ObjRAccelXStd_19 0 " Valid values " ;
VAL_ 1081 MRR_ObjRAccelYStd_19 0 " Valid values " ;
VAL_ 1081 MRR_ObjType_19 0 " Unknown " 1 " Truck " 2 " Car " 3 " Pedestrian " 4 " Cyclist " 5 " Reserved " ;
VAL_ 1081 MRR_ObjMotionType_19 0 " int " 1 " unknown " 2 " Drive " 3 " Stopped " 4 " Stand " 5 " reserved " 6 " reserved " 7 " reserved " ;
VAL_ 1081 VFC_ObjWidth_19 0 " Valid values " 501 " Reserved " ;
VAL_ 1081 VFC_ObjLength_19 0 " Valid values " 401 " Reserved " ;
VAL_ 1081 VFC_ObjHeight_19 0 " Valid values " 601 " Reserved " ;
VAL_ 1081 VFC_ObjMotionDirection_19 0 " Init " 1 " Inverse direction " 2 " Same  direction " 3 " cross " 4 " reserved " 5 " reserved " 6 " reserved " 7 " reserved " ;
VAL_ 1081 MRR_ObjID_20 0 " Valid values " ;
VAL_ 1081 MRR_ObjExistProb_20 0 " Valid values " ;
VAL_ 1081 MRR_ObjObstacleProb_20 0 " Valid values " ;
VAL_ 1081 MRR_ObjDistX_20 0 " Valid values " 4080 " Reserved " ;
VAL_ 1081 MRR_ObjDistY_20 0 " Valid values " ;
VAL_ 1081 MRR_ObjRelVelX_20 0 " Valid values " 8174 " Reserved " ;
VAL_ 1081 MRR_ObjRelVelY_20 0 " Valid values " 8174 " Reserved " ;
VAL_ 1081 MRR_ObjRelAccelX_20 0 " Valid values " ;
VAL_ 1081 MRR_ObjRelAccelY_20 0 " Valid values " ;
VAL_ 1081 MRR_ObjDistXStd_20 0 " Valid values " ;
VAL_ 1081 MRR_ObjDistYStd_20 0 " Valid values " ;
VAL_ 1081 MRR_ObjRelVelXStd_20 0 " Valid values " ;
VAL_ 1081 MRR_ObjRelVelYStd_20 0 " Valid values " ;
VAL_ 1081 MRR_ObjRAccelXStd_20 0 " Valid values " ;
VAL_ 1081 MRR_ObjRAccelYStd_20 0 " Valid values " ;
VAL_ 1081 MRR_ObjType_20 0 " Unknown " 1 " Truck " 2 " Car " 3 " Pedestrian " 4 " Cyclist " 5 " Reserved " ;
VAL_ 1081 MRR_ObjMotionType_20 0 " int " 1 " unknown " 2 " Drive " 3 " Stopped " 4 " Stand " 5 " reserved " 6 " reserved " 7 " reserved " ;
VAL_ 1081 VFC_ObjWidth_20 0 " Valid values " 501 " Reserved " ;
VAL_ 1081 VFC_ObjLength_20 0 " Valid values " 401 " Reserved " ;
VAL_ 1081 VFC_ObjHeight_20 0 " Valid values " 601 " Reserved " ;
VAL_ 1081 VFC_ObjMotionDirection_20 0 " Init " 1 " Inverse direction " 2 " Same  direction " 3 " cross " 4 " reserved " 5 " reserved " 6 " reserved " 7 " reserved " ;
VAL_ 1081 Checksum73 0 " Valid value " ;
VAL_ 1081 Checksum74 0 " Valid value " ;
VAL_ 1081 Checksum75 0 " Valid value " ;
VAL_ 1081 Checksum76 0 " Valid value " ;
VAL_ 1081 Checksum77 0 " Valid value " ;
VAL_ 1081 Checksum78 0 " Valid value " ;
VAL_ 1081 Checksum79 0 " Valid value " ;
VAL_ 1081 Checksum80 0 " Valid value " ;
VAL_ 1081 RollingCounter73 0 " Valid value " 15 " Invalid value " ;
VAL_ 1081 RollingCounter74 0 " Valid value " 15 " Invalid value " ;
VAL_ 1081 RollingCounter75 0 " Valid value " 15 " Invalid value " ;
VAL_ 1081 RollingCounter76 0 " Valid value " 15 " Invalid value " ;
VAL_ 1081 RollingCounter77 0 " Valid value " 15 " Invalid value " ;
VAL_ 1081 RollingCounter78 0 " Valid value " 15 " Invalid value " ;
VAL_ 1081 RollingCounter79 0 " Valid value " 15 " Invalid value " ;
VAL_ 1081 RollingCounter80 0 " Valid value " 15 " Invalid value " ;
VAL_ 1081 BlockCounter10 0 " Valid value " ;
VAL_ 1082 MRR_ObjMeasured_11 3 "Reserved" 2 "Predicted" 1 "Measured" 0 "Init" ;
VAL_ 1082 MRR_ObjID_21 0 " Valid values " ;
VAL_ 1082 MRR_ObjExistProb_21 0 " Valid values " ;
VAL_ 1082 MRR_ObjObstacleProb_21 0 " Valid values " ;
VAL_ 1082 MRR_ObjDistX_21 0 " Valid values " 4080 " Reserved " ;
VAL_ 1082 MRR_ObjDistY_21 0 " Valid values " ;
VAL_ 1082 MRR_ObjRelVelX_21 0 " Valid values " 8174 " Reserved " ;
VAL_ 1082 MRR_ObjRelVelY_21 0 " Valid values " 8174 " Reserved " ;
VAL_ 1082 MRR_ObjRelAccelX_21 0 " Valid values " ;
VAL_ 1082 MRR_ObjRelAccelY_21 0 " Valid values " ;
VAL_ 1082 MRR_ObjDistXStd_21 0 " Valid values " ;
VAL_ 1082 MRR_ObjDistYStd_21 0 " Valid values " ;
VAL_ 1082 MRR_ObjRelVelXStd_21 0 " Valid values " ;
VAL_ 1082 MRR_ObjRelVelYStd_21 0 " Valid values " ;
VAL_ 1082 MRR_ObjRAccelXStd_21 0 " Valid values " ;
VAL_ 1082 MRR_ObjRAccelYStd_21 0 " Valid values " ;
VAL_ 1082 MRR_ObjType_21 0 " Unknown " 1 " Truck " 2 " Car " 3 " Pedestrian " 4 " Cyclist " 5 " Reserved " ;
VAL_ 1082 MRR_ObjMotionType_21 0 " int " 1 " unknown " 2 " Drive " 3 " Stopped " 4 " Stand " 5 " reserved " 6 " reserved " 7 " reserved " ;
VAL_ 1082 VFC_ObjWidth_21 0 " Valid values " 501 " Reserved " ;
VAL_ 1082 VFC_ObjLength_21 0 " Valid values " 401 " Reserved " ;
VAL_ 1082 VFC_ObjHeight_21 0 " Valid values " 601 " Reserved " ;
VAL_ 1082 VFC_ObjMotionDirection_21 0 " Init " 1 " Inverse direction " 2 " Same  direction " 3 " cross " 4 " reserved " 5 " reserved " 6 " reserved " 7 " reserved " ;
VAL_ 1082 MRR_ObjID_22 0 " Valid values " ;
VAL_ 1082 MRR_ObjExistProb_22 0 " Valid values " ;
VAL_ 1082 MRR_ObjObstacleProb_22 0 " Valid values " ;
VAL_ 1082 MRR_ObjDistX_22 0 " Valid values " 4080 " Reserved " ;
VAL_ 1082 MRR_ObjDistY_22 0 " Valid values " ;
VAL_ 1082 MRR_ObjRelVelX_22 0 " Valid values " 8174 " Reserved " ;
VAL_ 1082 MRR_ObjRelVelY_22 0 " Valid values " 8174 " Reserved " ;
VAL_ 1082 MRR_ObjRelAccelX_22 0 " Valid values " ;
VAL_ 1082 MRR_ObjRelAccelY_22 0 " Valid values " ;
VAL_ 1082 MRR_ObjDistXStd_22 0 " Valid values " ;
VAL_ 1082 MRR_ObjDistYStd_22 0 " Valid values " ;
VAL_ 1082 MRR_ObjRelVelXStd_22 0 " Valid values " ;
VAL_ 1082 MRR_ObjRelVelYStd_22 0 " Valid values " ;
VAL_ 1082 MRR_ObjRAccelXStd_22 0 " Valid values " ;
VAL_ 1082 MRR_ObjRAccelYStd_22 0 " Valid values " ;
VAL_ 1082 MRR_ObjType_22 0 " Unknown " 1 " Truck " 2 " Car " 3 " Pedestrian " 4 " Cyclist " 5 " Reserved " ;
VAL_ 1082 MRR_ObjMotionType_22 0 " int " 1 " unknown " 2 " Drive " 3 " Stopped " 4 " Stand " 5 " reserved " 6 " reserved " 7 " reserved " ;
VAL_ 1082 VFC_ObjWidth_22 0 " Valid values " 501 " Reserved " ;
VAL_ 1082 VFC_ObjLength_22 0 " Valid values " 401 " Reserved " ;
VAL_ 1082 VFC_ObjHeight_22 0 " Valid values " 601 " Reserved " ;
VAL_ 1082 VFC_ObjMotionDirection_22 0 " Init " 1 " Inverse direction " 2 " Same  direction " 3 " cross " 4 " reserved " 5 " reserved " 6 " reserved " 7 " reserved " ;
VAL_ 1082 Checksum81 0 " Valid value " ;
VAL_ 1082 Checksum82 0 " Valid value " ;
VAL_ 1082 Checksum83 0 " Valid value " ;
VAL_ 1082 Checksum84 0 " Valid value " ;
VAL_ 1082 Checksum85 0 " Valid value " ;
VAL_ 1082 Checksum86 0 " Valid value " ;
VAL_ 1082 Checksum87 0 " Valid value " ;
VAL_ 1082 Checksum88 0 " Valid value " ;
VAL_ 1082 RollingCounter81 0 " Valid value " 15 " Invalid value " ;
VAL_ 1082 RollingCounter82 0 " Valid value " 15 " Invalid value " ;
VAL_ 1082 RollingCounter83 0 " Valid value " 15 " Invalid value " ;
VAL_ 1082 RollingCounter84 0 " Valid value " 15 " Invalid value " ;
VAL_ 1082 RollingCounter85 0 " Valid value " 15 " Invalid value " ;
VAL_ 1082 RollingCounter86 0 " Valid value " 15 " Invalid value " ;
VAL_ 1082 RollingCounter87 0 " Valid value " 15 " Invalid value " ;
VAL_ 1082 RollingCounter88 0 " Valid value " 15 " Invalid value " ;
VAL_ 1082 BlockCounter11 0 " Valid value " ;
VAL_ 1083 MRR_ObjMeasured_12 3 "Reserved" 2 "Predicted" 1 "Measured" 0 "Init" ;
VAL_ 1083 MRR_ObjID_23 0 " Valid values " ;
VAL_ 1083 MRR_ObjExistProb_23 0 " Valid values " ;
VAL_ 1083 MRR_ObjObstacleProb_23 0 " Valid values " ;
VAL_ 1083 MRR_ObjDistX_23 0 " Valid values " 4080 " Reserved " ;
VAL_ 1083 MRR_ObjDistY_23 0 " Valid values " ;
VAL_ 1083 MRR_ObjRelVelX_23 0 " Valid values " 8174 " Reserved " ;
VAL_ 1083 MRR_ObjRelVelY_23 0 " Valid values " 8174 " Reserved " ;
VAL_ 1083 MRR_ObjRelAccelX_23 0 " Valid values " ;
VAL_ 1083 MRR_ObjRelAccelY_23 0 " Valid values " ;
VAL_ 1083 MRR_ObjDistXStd_23 0 " Valid values " ;
VAL_ 1083 MRR_ObjDistYStd_23 0 " Valid values " ;
VAL_ 1083 MRR_ObjRelVelXStd_23 0 " Valid values " ;
VAL_ 1083 MRR_ObjRelVelYStd_23 0 " Valid values " ;
VAL_ 1083 MRR_ObjRAccelXStd_23 0 " Valid values " ;
VAL_ 1083 MRR_ObjRAccelYStd_23 0 " Valid values " ;
VAL_ 1083 MRR_ObjType_23 0 " Unknown " 1 " Truck " 2 " Car " 3 " Pedestrian " 4 " Cyclist " 5 " Reserved " ;
VAL_ 1083 MRR_ObjMotionType_23 0 " int " 1 " unknown " 2 " Drive " 3 " Stopped " 4 " Stand " 5 " reserved " 6 " reserved " 7 " reserved " ;
VAL_ 1083 VFC_ObjWidth_23 0 " Valid values " 501 " Reserved " ;
VAL_ 1083 VFC_ObjLength_23 0 " Valid values " 401 " Reserved " ;
VAL_ 1083 VFC_ObjHeight_23 0 " Valid values " 601 " Reserved " ;
VAL_ 1083 VFC_ObjMotionDirection_23 0 " Init " 1 " Inverse direction " 2 " Same  direction " 3 " cross " 4 " reserved " 5 " reserved " 6 " reserved " 7 " reserved " ;
VAL_ 1083 MRR_ObjID_24 0 " Valid values " ;
VAL_ 1083 MRR_ObjExistProb_24 0 " Valid values " ;
VAL_ 1083 MRR_ObjObstacleProb_24 0 " Valid values " ;
VAL_ 1083 MRR_ObjDistX_24 0 " Valid values " 4080 " Reserved " ;
VAL_ 1083 MRR_ObjDistY_24 0 " Valid values " ;
VAL_ 1083 MRR_ObjRelVelX_24 0 " Valid values " 8174 " Reserved " ;
VAL_ 1083 MRR_ObjRelVelY_24 0 " Valid values " 8174 " Reserved " ;
VAL_ 1083 MRR_ObjRelAccelX_24 0 " Valid values " ;
VAL_ 1083 MRR_ObjRelAccelY_24 0 " Valid values " ;
VAL_ 1083 MRR_ObjDistXStd_24 0 " Valid values " ;
VAL_ 1083 MRR_ObjDistYStd_24 0 " Valid values " ;
VAL_ 1083 MRR_ObjRelVelXStd_24 0 " Valid values " ;
VAL_ 1083 MRR_ObjRelVelYStd_24 0 " Valid values " ;
VAL_ 1083 MRR_ObjRAccelXStd_24 0 " Valid values " ;
VAL_ 1083 MRR_ObjRAccelYStd_24 0 " Valid values " ;
VAL_ 1083 MRR_ObjType_24 0 " Unknown " 1 " Truck " 2 " Car " 3 " Pedestrian " 4 " Cyclist " 5 " Reserved " ;
VAL_ 1083 MRR_ObjMotionType_24 0 " int " 1 " unknown " 2 " Drive " 3 " Stopped " 4 " Stand " 5 " reserved " 6 " reserved " 7 " reserved " ;
VAL_ 1083 VFC_ObjWidth_24 0 " Valid values " 501 " Reserved " ;
VAL_ 1083 VFC_ObjLength_24 0 " Valid values " 401 " Reserved " ;
VAL_ 1083 VFC_ObjHeight_24 0 " Valid values " 601 " Reserved " ;
VAL_ 1083 VFC_ObjMotionDirection_24 0 " Init " 1 " Inverse direction " 2 " Same  direction " 3 " cross " 4 " reserved " 5 " reserved " 6 " reserved " 7 " reserved " ;
VAL_ 1083 Checksum89 0 " Valid value " ;
VAL_ 1083 Checksum90 0 " Valid value " ;
VAL_ 1083 Checksum91 0 " Valid value " ;
VAL_ 1083 Checksum92 0 " Valid value " ;
VAL_ 1083 Checksum93 0 " Valid value " ;
VAL_ 1083 Checksum94 0 " Valid value " ;
VAL_ 1083 Checksum95 0 " Valid value " ;
VAL_ 1083 Checksum96 0 " Valid value " ;
VAL_ 1083 RollingCounter89 0 " Valid value " 15 " Invalid value " ;
VAL_ 1083 RollingCounter90 0 " Valid value " 15 " Invalid value " ;
VAL_ 1083 RollingCounter91 0 " Valid value " 15 " Invalid value " ;
VAL_ 1083 RollingCounter92 0 " Valid value " 15 " Invalid value " ;
VAL_ 1083 RollingCounter93 0 " Valid value " 15 " Invalid value " ;
VAL_ 1083 RollingCounter94 0 " Valid value " 15 " Invalid value " ;
VAL_ 1083 RollingCounter95 0 " Valid value " 15 " Invalid value " ;
VAL_ 1083 RollingCounter96 0 " Valid value " 15 " Invalid value " ;
VAL_ 1083 BlockCounter12 0 " Valid value " ;
VAL_ 1084 MRR_ObjMeasured_13 3 "Reserved" 2 "Predicted" 1 "Measured" 0 "Init" ;
VAL_ 1084 MRR_ObjID_25 0 " Valid values " ;
VAL_ 1084 MRR_ObjExistProb_25 0 " Valid values " ;
VAL_ 1084 MRR_ObjObstacleProb_25 0 " Valid values " ;
VAL_ 1084 MRR_ObjDistX_25 0 " Valid values " 4080 " Reserved " ;
VAL_ 1084 MRR_ObjDistY_25 0 " Valid values " ;
VAL_ 1084 MRR_ObjRelVelX_25 0 " Valid values " 8174 " Reserved " ;
VAL_ 1084 MRR_ObjRelVelY_25 0 " Valid values " 8174 " Reserved " ;
VAL_ 1084 MRR_ObjRelAccelX_25 0 " Valid values " ;
VAL_ 1084 MRR_ObjRelAccelY_25 0 " Valid values " ;
VAL_ 1084 MRR_ObjDistXStd_25 0 " Valid values " ;
VAL_ 1084 MRR_ObjDistYStd_25 0 " Valid values " ;
VAL_ 1084 MRR_ObjRelVelXStd_25 0 " Valid values " ;
VAL_ 1084 MRR_ObjRelVelYStd_25 0 " Valid values " ;
VAL_ 1084 MRR_ObjRAccelXStd_25 0 " Valid values " ;
VAL_ 1084 MRR_ObjRAccelYStd_25 0 " Valid values " ;
VAL_ 1084 MRR_ObjType_25 0 " Unknown " 1 " Truck " 2 " Car " 3 " Pedestrian " 4 " Cyclist " 5 " Reserved " ;
VAL_ 1084 MRR_ObjMotionType_25 0 " int " 1 " unknown " 2 " Drive " 3 " Stopped " 4 " Stand " 5 " reserved " 6 " reserved " 7 " reserved " ;
VAL_ 1084 VFC_ObjWidth_25 0 " Valid values " 501 " Reserved " ;
VAL_ 1084 VFC_ObjLength_25 0 " Valid values " 401 " Reserved " ;
VAL_ 1084 VFC_ObjHeight_25 0 " Valid values " 601 " Reserved " ;
VAL_ 1084 VFC_ObjMotionDirection_25 0 " Init " 1 " Inverse direction " 2 " Same  direction " 3 " cross " 4 " reserved " 5 " reserved " 6 " reserved " 7 " reserved " ;
VAL_ 1084 MRR_ObjID_26 0 " Valid values " ;
VAL_ 1084 MRR_ObjExistProb_26 0 " Valid values " ;
VAL_ 1084 MRR_ObjObstacleProb_26 0 " Valid values " ;
VAL_ 1084 MRR_ObjDistX_26 0 " Valid values " 4080 " Reserved " ;
VAL_ 1084 MRR_ObjDistY_26 0 " Valid values " ;
VAL_ 1084 MRR_ObjRelVelX_26 0 " Valid values " 8174 " Reserved " ;
VAL_ 1084 MRR_ObjRelVelY_26 0 " Valid values " 8174 " Reserved " ;
VAL_ 1084 MRR_ObjRelAccelX_26 0 " Valid values " ;
VAL_ 1084 MRR_ObjRelAccelY_26 0 " Valid values " ;
VAL_ 1084 MRR_ObjDistXStd_26 0 " Valid values " ;
VAL_ 1084 MRR_ObjDistYStd_26 0 " Valid values " ;
VAL_ 1084 MRR_ObjRelVelXStd_26 0 " Valid values " ;
VAL_ 1084 MRR_ObjRelVelYStd_26 0 " Valid values " ;
VAL_ 1084 MRR_ObjRAccelXStd_26 0 " Valid values " ;
VAL_ 1084 MRR_ObjRAccelYStd_26 0 " Valid values " ;
VAL_ 1084 MRR_ObjType_26 0 " Unknown " 1 " Truck " 2 " Car " 3 " Pedestrian " 4 " Cyclist " 5 " Reserved " ;
VAL_ 1084 MRR_ObjMotionType_26 0 " int " 1 " unknown " 2 " Drive " 3 " Stopped " 4 " Stand " 5 " reserved " 6 " reserved " 7 " reserved " ;
VAL_ 1084 VFC_ObjWidth_26 0 " Valid values " 501 " Reserved " ;
VAL_ 1084 VFC_ObjLength_26 0 " Valid values " 401 " Reserved " ;
VAL_ 1084 VFC_ObjHeight_26 0 " Valid values " 601 " Reserved " ;
VAL_ 1084 VFC_ObjMotionDirection_26 0 " Init " 1 " Inverse direction " 2 " Same  direction " 3 " cross " 4 " reserved " 5 " reserved " 6 " reserved " 7 " reserved " ;
VAL_ 1084 Checksum97 0 " Valid value " ;
VAL_ 1084 Checksum98 0 " Valid value " ;
VAL_ 1084 Checksum99 0 " Valid value " ;
VAL_ 1084 Checksum100 0 " Valid value " ;
VAL_ 1084 Checksum101 0 " Valid value " ;
VAL_ 1084 Checksum102 0 " Valid value " ;
VAL_ 1084 Checksum103 0 " Valid value " ;
VAL_ 1084 Checksum104 0 " Valid value " ;
VAL_ 1084 RollingCounter97 0 " Valid value " 15 " Invalid value " ;
VAL_ 1084 RollingCounter98 0 " Valid value " 15 " Invalid value " ;
VAL_ 1084 RollingCounter99 0 " Valid value " 15 " Invalid value " ;
VAL_ 1084 RollingCounter100 0 " Valid value " 15 " Invalid value " ;
VAL_ 1084 RollingCounter101 0 " Valid value " 15 " Invalid value " ;
VAL_ 1084 RollingCounter102 0 " Valid value " 15 " Invalid value " ;
VAL_ 1084 RollingCounter103 0 " Valid value " 15 " Invalid value " ;
VAL_ 1084 RollingCounter104 0 " Valid value " 15 " Invalid value " ;
VAL_ 1084 BlockCounter13 0 " Valid value " ;
VAL_ 1085 MRR_ObjMeasured_14 3 "Reserved" 2 "Predicted" 1 "Measured" 0 "Init" ;
VAL_ 1085 MRR_ObjID_27 0 " Valid values " ;
VAL_ 1085 MRR_ObjExistProb_27 0 " Valid values " ;
VAL_ 1085 MRR_ObjObstacleProb_27 0 " Valid values " ;
VAL_ 1085 MRR_ObjDistX_27 0 " Valid values " 4080 " Reserved " ;
VAL_ 1085 MRR_ObjDistY_27 0 " Valid values " ;
VAL_ 1085 MRR_ObjRelVelX_27 0 " Valid values " 8174 " Reserved " ;
VAL_ 1085 MRR_ObjRelVelY_27 0 " Valid values " 8174 " Reserved " ;
VAL_ 1085 MRR_ObjRelAccelX_27 0 " Valid values " ;
VAL_ 1085 MRR_ObjRelAccelY_27 0 " Valid values " ;
VAL_ 1085 MRR_ObjDistXStd_27 0 " Valid values " ;
VAL_ 1085 MRR_ObjDistYStd_27 0 " Valid values " ;
VAL_ 1085 MRR_ObjRelVelXStd_27 0 " Valid values " ;
VAL_ 1085 MRR_ObjRelVelYStd_27 0 " Valid values " ;
VAL_ 1085 MRR_ObjRAccelXStd_27 0 " Valid values " ;
VAL_ 1085 MRR_ObjRAccelYStd_27 0 " Valid values " ;
VAL_ 1085 MRR_ObjType_27 0 " Unknown " 1 " Truck " 2 " Car " 3 " Pedestrian " 4 " Cyclist " 5 " Reserved " ;
VAL_ 1085 MRR_ObjMotionType_27 0 " int " 1 " unknown " 2 " Drive " 3 " Stopped " 4 " Stand " 5 " reserved " 6 " reserved " 7 " reserved " ;
VAL_ 1085 VFC_ObjWidth_27 0 " Valid values " 501 " Reserved " ;
VAL_ 1085 VFC_ObjLength_27 0 " Valid values " 401 " Reserved " ;
VAL_ 1085 VFC_ObjHeight_27 0 " Valid values " 601 " Reserved " ;
VAL_ 1085 VFC_ObjMotionDirection_27 0 " Init " 1 " Inverse direction " 2 " Same  direction " 3 " cross " 4 " reserved " 5 " reserved " 6 " reserved " 7 " reserved " ;
VAL_ 1085 MRR_ObjID_28 0 " Valid values " ;
VAL_ 1085 MRR_ObjExistProb_28 0 " Valid values " ;
VAL_ 1085 MRR_ObjObstacleProb_28 0 " Valid values " ;
VAL_ 1085 MRR_ObjDistX_28 0 " Valid values " 4080 " Reserved " ;
VAL_ 1085 MRR_ObjDistY_28 0 " Valid values " ;
VAL_ 1085 MRR_ObjRelVelX_28 0 " Valid values " 8174 " Reserved " ;
VAL_ 1085 MRR_ObjRelVelY_28 0 " Valid values " 8174 " Reserved " ;
VAL_ 1085 MRR_ObjRelAccelX_28 0 " Valid values " ;
VAL_ 1085 MRR_ObjRelAccelY_28 0 " Valid values " ;
VAL_ 1085 MRR_ObjDistXStd_28 0 " Valid values " ;
VAL_ 1085 MRR_ObjDistYStd_28 0 " Valid values " ;
VAL_ 1085 MRR_ObjRelVelXStd_28 0 " Valid values " ;
VAL_ 1085 MRR_ObjRelVelYStd_28 0 " Valid values " ;
VAL_ 1085 MRR_ObjRAccelXStd_28 0 " Valid values " ;
VAL_ 1085 MRR_ObjRAccelYStd_28 0 " Valid values " ;
VAL_ 1085 MRR_ObjType_28 0 " Unknown " 1 " Truck " 2 " Car " 3 " Pedestrian " 4 " Cyclist " 5 " Reserved " ;
VAL_ 1085 MRR_ObjMotionType_28 0 " int " 1 " unknown " 2 " Drive " 3 " Stopped " 4 " Stand " 5 " reserved " 6 " reserved " 7 " reserved " ;
VAL_ 1085 VFC_ObjWidth_28 0 " Valid values " 501 " Reserved " ;
VAL_ 1085 VFC_ObjLength_28 0 " Valid values " 401 " Reserved " ;
VAL_ 1085 VFC_ObjHeight_28 0 " Valid values " 601 " Reserved " ;
VAL_ 1085 VFC_ObjMotionDirection_28 0 " Init " 1 " Inverse direction " 2 " Same  direction " 3 " cross " 4 " reserved " 5 " reserved " 6 " reserved " 7 " reserved " ;
VAL_ 1085 Checksum105 0 " Valid value " ;
VAL_ 1085 Checksum106 0 " Valid value " ;
VAL_ 1085 Checksum107 0 " Valid value " ;
VAL_ 1085 Checksum108 0 " Valid value " ;
VAL_ 1085 Checksum109 0 " Valid value " ;
VAL_ 1085 Checksum110 0 " Valid value " ;
VAL_ 1085 Checksum111 0 " Valid value " ;
VAL_ 1085 Checksum112 0 " Valid value " ;
VAL_ 1085 RollingCounter105 0 " Valid value " 15 " Invalid value " ;
VAL_ 1085 RollingCounter106 0 " Valid value " 15 " Invalid value " ;
VAL_ 1085 RollingCounter107 0 " Valid value " 15 " Invalid value " ;
VAL_ 1085 RollingCounter108 0 " Valid value " 15 " Invalid value " ;
VAL_ 1085 RollingCounter109 0 " Valid value " 15 " Invalid value " ;
VAL_ 1085 RollingCounter110 0 " Valid value " 15 " Invalid value " ;
VAL_ 1085 RollingCounter111 0 " Valid value " 15 " Invalid value " ;
VAL_ 1085 RollingCounter112 0 " Valid value " 15 " Invalid value " ;
VAL_ 1085 BlockCounter14 0 " Valid value " ;
VAL_ 1086 MRR_ObjMeasured_15 3 "Reserved" 2 "Predicted" 1 "Measured" 0 "Init" ;
VAL_ 1086 MRR_ObjID_29 0 " Valid values " ;
VAL_ 1086 MRR_ObjExistProb_29 0 " Valid values " ;
VAL_ 1086 MRR_ObjObstacleProb_29 0 " Valid values " ;
VAL_ 1086 MRR_ObjDistX_29 0 " Valid values " 4080 " Reserved " ;
VAL_ 1086 MRR_ObjDistY_29 0 " Valid values " ;
VAL_ 1086 MRR_ObjRelVelX_29 0 " Valid values " 8174 " Reserved " ;
VAL_ 1086 MRR_ObjRelVelY_29 0 " Valid values " 8174 " Reserved " ;
VAL_ 1086 MRR_ObjRelAccelX_29 0 " Valid values " ;
VAL_ 1086 MRR_ObjRelAccelY_29 0 " Valid values " ;
VAL_ 1086 MRR_ObjDistXStd_29 0 " Valid values " ;
VAL_ 1086 MRR_ObjDistYStd_29 0 " Valid values " ;
VAL_ 1086 MRR_ObjRelVelXStd_29 0 " Valid values " ;
VAL_ 1086 MRR_ObjRelVelYStd_29 0 " Valid values " ;
VAL_ 1086 MRR_ObjRAccelXStd_29 0 " Valid values " ;
VAL_ 1086 MRR_ObjRAccelYStd_29 0 " Valid values " ;
VAL_ 1086 MRR_ObjType_29 0 " Unknown " 1 " Truck " 2 " Car " 3 " Pedestrian " 4 " Cyclist " 5 " Reserved " ;
VAL_ 1086 MRR_ObjMotionType_29 0 " int " 1 " unknown " 2 " Drive " 3 " Stopped " 4 " Stand " 5 " reserved " 6 " reserved " 7 " reserved " ;
VAL_ 1086 VFC_ObjWidth_29 0 " Valid values " 501 " Reserved " ;
VAL_ 1086 VFC_ObjLength_29 0 " Valid values " 401 " Reserved " ;
VAL_ 1086 VFC_ObjHeight_29 0 " Valid values " 601 " Reserved " ;
VAL_ 1086 VFC_ObjMotionDirection_29 0 " Init " 1 " Inverse direction " 2 " Same  direction " 3 " cross " 4 " reserved " 5 " reserved " 6 " reserved " 7 " reserved " ;
VAL_ 1086 MRR_ObjID_30 0 " Valid values " ;
VAL_ 1086 MRR_ObjExistProb_30 0 " Valid values " ;
VAL_ 1086 MRR_ObjObstacleProb_30 0 " Valid values " ;
VAL_ 1086 MRR_ObjDistX_30 0 " Valid values " 4080 " Reserved " ;
VAL_ 1086 MRR_ObjDistY_30 0 " Valid values " ;
VAL_ 1086 MRR_ObjRelVelX_30 0 " Valid values " 8174 " Reserved " ;
VAL_ 1086 MRR_ObjRelVelY_30 0 " Valid values " 8174 " Reserved " ;
VAL_ 1086 MRR_ObjRelAccelX_30 0 " Valid values " ;
VAL_ 1086 MRR_ObjRelAccelY_30 0 " Valid values " ;
VAL_ 1086 MRR_ObjDistXStd_30 0 " Valid values " ;
VAL_ 1086 MRR_ObjDistYStd_30 0 " Valid values " ;
VAL_ 1086 MRR_ObjRelVelXStd_30 0 " Valid values " ;
VAL_ 1086 MRR_ObjRelVelYStd_30 0 " Valid values " ;
VAL_ 1086 MRR_ObjRAccelXStd_30 0 " Valid values " ;
VAL_ 1086 MRR_ObjRAccelYStd_30 0 " Valid values " ;
VAL_ 1086 MRR_ObjType_30 0 " Unknown " 1 " Truck " 2 " Car " 3 " Pedestrian " 4 " Cyclist " 5 " Reserved " ;
VAL_ 1086 MRR_ObjMotionType_30 0 " int " 1 " unknown " 2 " Drive " 3 " Stopped " 4 " Stand " 5 " reserved " 6 " reserved " 7 " reserved " ;
VAL_ 1086 VFC_ObjWidth_30 0 " Valid values " 501 " Reserved " ;
VAL_ 1086 VFC_ObjLength_30 0 " Valid values " 401 " Reserved " ;
VAL_ 1086 VFC_ObjHeight_30 0 " Valid values " 601 " Reserved " ;
VAL_ 1086 VFC_ObjMotionDirection_30 0 " Init " 1 " Inverse direction " 2 " Same  direction " 3 " cross " 4 " reserved " 5 " reserved " 6 " reserved " 7 " reserved " ;
VAL_ 1086 Checksum113 0 " Valid value " ;
VAL_ 1086 Checksum114 0 " Valid value " ;
VAL_ 1086 Checksum115 0 " Valid value " ;
VAL_ 1086 Checksum116 0 " Valid value " ;
VAL_ 1086 Checksum117 0 " Valid value " ;
VAL_ 1086 Checksum118 0 " Valid value " ;
VAL_ 1086 Checksum119 0 " Valid value " ;
VAL_ 1086 Checksum120 0 " Valid value " ;
VAL_ 1086 RollingCounter113 0 " Valid value " 15 " Invalid value " ;
VAL_ 1086 RollingCounter114 0 " Valid value " 15 " Invalid value " ;
VAL_ 1086 RollingCounter115 0 " Valid value " 15 " Invalid value " ;
VAL_ 1086 RollingCounter116 0 " Valid value " 15 " Invalid value " ;
VAL_ 1086 RollingCounter117 0 " Valid value " 15 " Invalid value " ;
VAL_ 1086 RollingCounter118 0 " Valid value " 15 " Invalid value " ;
VAL_ 1086 RollingCounter119 0 " Valid value " 15 " Invalid value " ;
VAL_ 1086 RollingCounter120 0 " Valid value " 15 " Invalid value " ;
VAL_ 1086 BlockCounter15 0 " Valid value " ;
VAL_ 1087 MRR_ObjMeasured_16 3 "Reserved" 2 "Predicted" 1 "Measured" 0 "Init" ;
VAL_ 1087 MRR_ObjID_31 0 " Valid values " ;
VAL_ 1087 MRR_ObjExistProb_31 0 " Valid values " ;
VAL_ 1087 MRR_ObjObstacleProb_31 0 " Valid values " ;
VAL_ 1087 MRR_ObjDistX_31 0 " Valid values " 4080 " Reserved " ;
VAL_ 1087 MRR_ObjDistY_31 0 " Valid values " ;
VAL_ 1087 MRR_ObjRelVelX_31 0 " Valid values " 8174 " Reserved " ;
VAL_ 1087 MRR_ObjRelVelY_31 0 " Valid values " 8174 " Reserved " ;
VAL_ 1087 MRR_ObjRelAccelX_31 0 " Valid values " ;
VAL_ 1087 MRR_ObjRelAccelY_31 0 " Valid values " ;
VAL_ 1087 MRR_ObjDistXStd_31 0 " Valid values " ;
VAL_ 1087 MRR_ObjDistYStd_31 0 " Valid values " ;
VAL_ 1087 MRR_ObjRelVelXStd_31 0 " Valid values " ;
VAL_ 1087 MRR_ObjRelVelYStd_31 0 " Valid values " ;
VAL_ 1087 MRR_ObjRAccelXStd_31 0 " Valid values " ;
VAL_ 1087 MRR_ObjRAccelYStd_31 0 " Valid values " ;
VAL_ 1087 MRR_ObjType_31 0 " Unknown " 1 " Truck " 2 " Car " 3 " Pedestrian " 4 " Cyclist " 5 " Reserved " ;
VAL_ 1087 MRR_ObjMotionType_31 0 " int " 1 " unknown " 2 " Drive " 3 " Stopped " 4 " Stand " 5 " reserved " 6 " reserved " 7 " reserved " ;
VAL_ 1087 VFC_ObjWidth_31 0 " Valid values " 501 " Reserved " ;
VAL_ 1087 VFC_ObjLength_31 0 " Valid values " 401 " Reserved " ;
VAL_ 1087 VFC_ObjHeight_31 0 " Valid values " 601 " Reserved " ;
VAL_ 1087 VFC_ObjMotionDirection_31 0 " Init " 1 " Inverse direction " 2 " Same  direction " 3 " cross " 4 " reserved " 5 " reserved " 6 " reserved " 7 " reserved " ;
VAL_ 1087 MRR_ObjID_32 0 " Valid values " ;
VAL_ 1087 MRR_ObjExistProb_32 0 " Valid values " ;
VAL_ 1087 MRR_ObjObstacleProb_32 0 " Valid values " ;
VAL_ 1087 MRR_ObjDistX_32 0 " Valid values " 4080 " Reserved " ;
VAL_ 1087 MRR_ObjDistY_32 0 " Valid values " ;
VAL_ 1087 MRR_ObjRelVelX_32 0 " Valid values " 8174 " Reserved " ;
VAL_ 1087 MRR_ObjRelVelY_32 0 " Valid values " 8174 " Reserved " ;
VAL_ 1087 MRR_ObjRelAccelX_32 0 " Valid values " ;
VAL_ 1087 MRR_ObjRelAccelY_32 0 " Valid values " ;
VAL_ 1087 MRR_ObjDistXStd_32 0 " Valid values " ;
VAL_ 1087 MRR_ObjDistYStd_32 0 " Valid values " ;
VAL_ 1087 MRR_ObjRelVelXStd_32 0 " Valid values " ;
VAL_ 1087 MRR_ObjRelVelYStd_32 0 " Valid values " ;
VAL_ 1087 MRR_ObjRAccelXStd_32 0 " Valid values " ;
VAL_ 1087 MRR_ObjRAccelYStd_32 0 " Valid values " ;
VAL_ 1087 MRR_ObjType_32 0 " Unknown " 1 " Truck " 2 " Car " 3 " Pedestrian " 4 " Cyclist " 5 " Reserved " ;
VAL_ 1087 MRR_ObjMotionType_32 0 " int " 1 " unknown " 2 " Drive " 3 " Stopped " 4 " Stand " 5 " reserved " 6 " reserved " 7 " reserved " ;
VAL_ 1087 VFC_ObjWidth_32 0 " Valid values " 501 " Reserved " ;
VAL_ 1087 VFC_ObjLength_32 0 " Valid values " 401 " Reserved " ;
VAL_ 1087 VFC_ObjHeight_32 0 " Valid values " 601 " Reserved " ;
VAL_ 1087 VFC_ObjMotionDirection_32 0 " Init " 1 " Inverse direction " 2 " Same  direction " 3 " cross " 4 " reserved " 5 " reserved " 6 " reserved " 7 " reserved " ;
VAL_ 1087 Checksum121 0 " Valid value " ;
VAL_ 1087 Checksum122 0 " Valid value " ;
VAL_ 1087 Checksum123 0 " Valid value " ;
VAL_ 1087 Checksum124 0 " Valid value " ;
VAL_ 1087 Checksum125 0 " Valid value " ;
VAL_ 1087 Checksum126 0 " Valid value " ;
VAL_ 1087 Checksum127 0 " Valid value " ;
VAL_ 1087 Checksum128 0 " Valid value " ;
VAL_ 1087 RollingCounter121 0 " Valid value " 15 " Invalid value " ;
VAL_ 1087 RollingCounter122 0 " Valid value " 15 " Invalid value " ;
VAL_ 1087 RollingCounter123 0 " Valid value " 15 " Invalid value " ;
VAL_ 1087 RollingCounter124 0 " Valid value " 15 " Invalid value " ;
VAL_ 1087 RollingCounter125 0 " Valid value " 15 " Invalid value " ;
VAL_ 1087 RollingCounter126 0 " Valid value " 15 " Invalid value " ;
VAL_ 1087 RollingCounter127 0 " Valid value " 15 " Invalid value " ;
VAL_ 1087 RollingCounter128 0 " Valid value " ;
VAL_ 1087 BlockCounter16 0 " Valid value " ;
VAL_ 1073 MRR_ObjMeasured_2 3 "Reserved" 2 "Predicted" 1 "Measured" 0 "Init" ;
VAL_ 1073 MRR_ObjID_3 0 " Valid values " ;
VAL_ 1073 MRR_ObjExistProb_3 0 " Valid values " ;
VAL_ 1073 MRR_ObjObstacleProb_3 0 " Valid values " ;
VAL_ 1073 MRR_ObjDistX_3 0 " Valid values " 4080 " Reserved " ;
VAL_ 1073 MRR_ObjDistY_3 0 " Valid values " ;
VAL_ 1073 MRR_ObjRelVelX_3 0 " Valid values " 8174 " Reserved " ;
VAL_ 1073 MRR_ObjRelVelY_3 0 " Valid values " 8174 " Reserved " ;
VAL_ 1073 MRR_ObjRelAccelX_3 0 " Valid values " ;
VAL_ 1073 MRR_ObjRelAccelY_3 0 " Valid values " ;
VAL_ 1073 MRR_ObjDistXStd_3 0 " Valid values " ;
VAL_ 1073 MRR_ObjDistYStd_3 0 " Valid values " ;
VAL_ 1073 MRR_ObjRelVelXStd_3 0 " Valid values " ;
VAL_ 1073 MRR_ObjRelVelYStd_3 0 " Valid values " ;
VAL_ 1073 MRR_ObjRAccelXStd_3 0 " Valid values " ;
VAL_ 1073 MRR_ObjRAccelYStd_3 0 " Valid values " ;
VAL_ 1073 MRR_ObjType_3 0 " Unknown " 1 " Truck " 2 " Car " 3 " Pedestrian " 4 " Cyclist " 5 " Reserved " ;
VAL_ 1073 MRR_ObjMotionType_3 0 " int " 1 " unknown " 2 " Drive " 3 " Stopped " 4 " Stand " 5 " reserved " 6 " reserved " 7 " reserved " ;
VAL_ 1073 VFC_ObjWidth_3 0 " Valid values " 501 " Reserved " ;
VAL_ 1073 VFC_ObjLength_3 0 " Valid values " 401 " Reserved " ;
VAL_ 1073 VFC_ObjHeight_3 0 " Valid values " 601 " Reserved " ;
VAL_ 1073 VFC_ObjMotionDirection_3 0 " Init " 1 " Inverse direction " 2 " Same  direction " 3 " cross " 4 " reserved " 5 " reserved " 6 " reserved " 7 " reserved " ;
VAL_ 1073 MRR_ObjID_4 0 " Valid values " ;
VAL_ 1073 MRR_ObjExistProb_4 0 " Valid values " ;
VAL_ 1073 MRR_ObjObstacleProb_4 0 " Valid values " ;
VAL_ 1073 MRR_ObjDistX_4 0 " Valid values " 4080 " Reserved " ;
VAL_ 1073 MRR_ObjDistY_4 0 " Valid values " ;
VAL_ 1073 MRR_ObjRelVelX_4 0 " Valid values " 8174 " Reserved " ;
VAL_ 1073 MRR_ObjRelVelY_4 0 " Valid values " 8174 " Reserved " ;
VAL_ 1073 MRR_ObjRelAccelX_4 0 " Valid values " ;
VAL_ 1073 MRR_ObjRelAccelY_4 0 " Valid values " ;
VAL_ 1073 MRR_ObjDistXStd_4 0 " Valid values " ;
VAL_ 1073 MRR_ObjDistYStd_4 0 " Valid values " ;
VAL_ 1073 MRR_ObjRelVelXStd_4 0 " Valid values " ;
VAL_ 1073 MRR_ObjRelVelYStd_4 0 " Valid values " ;
VAL_ 1073 MRR_ObjRAccelXStd_4 0 " Valid values " ;
VAL_ 1073 MRR_ObjRAccelYStd_4 0 " Valid values " ;
VAL_ 1073 MRR_ObjType_4 0 " Unknown " 1 " Truck " 2 " Car " 3 " Pedestrian " 4 " Cyclist " 5 " Reserved " ;
VAL_ 1073 MRR_ObjMotionType_4 0 " int " 1 " unknown " 2 " Drive " 3 " Stopped " 4 " Stand " 5 " reserved " 6 " reserved " 7 " reserved " ;
VAL_ 1073 VFC_ObjWidth_4 0 " Valid values " 501 " Reserved " ;
VAL_ 1073 VFC_ObjLength_4 0 " Valid values " 401 " Reserved " ;
VAL_ 1073 VFC_ObjHeight_4 0 " Valid values " 601 " Reserved " ;
VAL_ 1073 VFC_ObjMotionDirection_4 0 " Init " 1 " Inverse direction " 2 " Same  direction " 3 " cross " 4 " reserved " 5 " reserved " 6 " reserved " 7 " reserved " ;
VAL_ 1073 Checksum9 0 " Valid value " ;
VAL_ 1073 Checksum10 0 " Valid value " ;
VAL_ 1073 Checksum11 0 " Valid value " ;
VAL_ 1073 Checksum12 0 " Valid value " ;
VAL_ 1073 Checksum13 0 " Valid value " ;
VAL_ 1073 Checksum14 0 " Valid value " ;
VAL_ 1073 Checksum15 0 " Valid value " ;
VAL_ 1073 Checksum16 0 " Valid value " ;
VAL_ 1073 RollingCounter9 0 " Valid value " 15 " Invalid value " ;
VAL_ 1073 RollingCounter10 0 " Valid value " 15 " Invalid value " ;
VAL_ 1073 RollingCounter11 0 " Valid value " 15 " Invalid value " ;
VAL_ 1073 RollingCounter12 0 " Valid value " 15 " Invalid value " ;
VAL_ 1073 RollingCounter13 0 " Valid value " 15 " Invalid value " ;
VAL_ 1073 RollingCounter14 0 " Valid value " 15 " Invalid value " ;
VAL_ 1073 RollingCounter15 0 " Valid value " 15 " Invalid value " ;
VAL_ 1073 RollingCounter16 0 " Valid value " 15 " Invalid value " ;
VAL_ 1073 BlockCounter2 0 " Valid value " ;
VAL_ 1074 MRR_ObjMeasured_3 3 "Reserved" 2 "Predicted" 1 "Measured" 0 "Init" ;
VAL_ 1074 MRR_ObjID_5 0 " Valid values " ;
VAL_ 1074 MRR_ObjExistProb_5 0 " Valid values " ;
VAL_ 1074 MRR_ObjObstacleProb_5 0 " Valid values " ;
VAL_ 1074 MRR_ObjDistX_5 0 " Valid values " 4080 " Reserved " ;
VAL_ 1074 MRR_ObjDistY_5 0 " Valid values " ;
VAL_ 1074 MRR_ObjRelVelX_5 0 " Valid values " 8174 " Reserved " ;
VAL_ 1074 MRR_ObjRelVelY_5 0 " Valid values " 8174 " Reserved " ;
VAL_ 1074 MRR_ObjRelAccelX_5 0 " Valid values " ;
VAL_ 1074 MRR_ObjRelAccelY_5 0 " Valid values " ;
VAL_ 1074 MRR_ObjDistXStd_5 0 " Valid values " ;
VAL_ 1074 MRR_ObjDistYStd_5 0 " Valid values " ;
VAL_ 1074 MRR_ObjRelVelXStd_5 0 " Valid values " ;
VAL_ 1074 MRR_ObjRelVelYStd_5 0 " Valid values " ;
VAL_ 1074 MRR_ObjRAccelXStd_5 0 " Valid values " ;
VAL_ 1074 MRR_ObjRAccelYStd_5 0 " Valid values " ;
VAL_ 1074 MRR_ObjType_5 0 " Unknown " 1 " Truck " 2 " Car " 3 " Pedestrian " 4 " Cyclist " 5 " Reserved " ;
VAL_ 1074 MRR_ObjMotionType_5 0 " int " 1 " unknown " 2 " Drive " 3 " Stopped " 4 " Stand " 5 " reserved " 6 " reserved " 7 " reserved " ;
VAL_ 1074 VFC_ObjWidth_5 0 " Valid values " 501 " Reserved " ;
VAL_ 1074 VFC_ObjLength_5 0 " Valid values " 401 " Reserved " ;
VAL_ 1074 VFC_ObjHeight_5 0 " Valid values " 601 " Reserved " ;
VAL_ 1074 VFC_ObjMotionDirection_5 0 " Init " 1 " Inverse direction " 2 " Same  direction " 3 " cross " 4 " reserved " 5 " reserved " 6 " reserved " 7 " reserved " ;
VAL_ 1074 MRR_ObjID_6 0 " Valid values " ;
VAL_ 1074 MRR_ObjExistProb_6 0 " Valid values " ;
VAL_ 1074 MRR_ObjObstacleProb_6 0 " Valid values " ;
VAL_ 1074 MRR_ObjDistX_6 0 " Valid values " 4080 " Reserved " ;
VAL_ 1074 MRR_ObjDistY_6 0 " Valid values " ;
VAL_ 1074 MRR_ObjRelVelX_6 0 " Valid values " 8174 " Reserved " ;
VAL_ 1074 MRR_ObjRelVelY_6 0 " Valid values " 8174 " Reserved " ;
VAL_ 1074 MRR_ObjRelAccelX_6 0 " Valid values " ;
VAL_ 1074 MRR_ObjRelAccelY_6 0 " Valid values " ;
VAL_ 1074 MRR_ObjDistXStd_6 0 " Valid values " ;
VAL_ 1074 MRR_ObjDistYStd_6 0 " Valid values " ;
VAL_ 1074 MRR_ObjRelVelXStd_6 0 " Valid values " ;
VAL_ 1074 MRR_ObjRelVelYStd_6 0 " Valid values " ;
VAL_ 1074 MRR_ObjRAccelXStd_6 0 " Valid values " ;
VAL_ 1074 MRR_ObjRAccelYStd_6 0 " Valid values " ;
VAL_ 1074 MRR_ObjType_6 0 " Unknown " 1 " Truck " 2 " Car " 3 " Pedestrian " 4 " Cyclist " 5 " Reserved " ;
VAL_ 1074 MRR_ObjMotionType_6 0 " int " 1 " unknown " 2 " Drive " 3 " Stopped " 4 " Stand " 5 " reserved " 6 " reserved " 7 " reserved " ;
VAL_ 1074 VFC_ObjWidth_6 0 " Valid values " 501 " Reserved " ;
VAL_ 1074 VFC_ObjLength_6 0 " Valid values " 401 " Reserved " ;
VAL_ 1074 VFC_ObjHeight_6 0 " Valid values " 601 " Reserved " ;
VAL_ 1074 VFC_ObjMotionDirection_6 0 " Init " 1 " Inverse direction " 2 " Same  direction " 3 " cross " 4 " reserved " 5 " reserved " 6 " reserved " 7 " reserved " ;
VAL_ 1074 Checksum17 0 " Valid value " ;
VAL_ 1074 Checksum18 0 " Valid value " ;
VAL_ 1074 Checksum19 0 " Valid value " ;
VAL_ 1074 Checksum20 0 " Valid value " ;
VAL_ 1074 Checksum21 0 " Valid value " ;
VAL_ 1074 Checksum22 0 " Valid value " ;
VAL_ 1074 Checksum23 0 " Valid value " ;
VAL_ 1074 Checksum24 0 " Valid value " ;
VAL_ 1074 RollingCounter17 0 " Valid value " 15 " Invalid value " ;
VAL_ 1074 RollingCounter18 0 " Valid value " 15 " Invalid value " ;
VAL_ 1074 RollingCounter19 0 " Valid value " 15 " Invalid value " ;
VAL_ 1074 RollingCounter20 0 " Valid value " 15 " Invalid value " ;
VAL_ 1074 RollingCounter21 0 " Valid value " 15 " Invalid value " ;
VAL_ 1074 RollingCounter22 0 " Valid value " 15 " Invalid value " ;
VAL_ 1074 RollingCounter23 0 " Valid value " 15 " Invalid value " ;
VAL_ 1074 RollingCounter24 0 " Valid value " 15 " Invalid value " ;
VAL_ 1074 BlockCounter3 0 " Valid value " ;
VAL_ 1075 MRR_ObjMeasured_4 3 "Reserved" 2 "Predicted" 1 "Measured" 0 "Init" ;
VAL_ 1075 MRR_ObjID_7 0 " Valid values " ;
VAL_ 1075 MRR_ObjExistProb_7 0 " Valid values " ;
VAL_ 1075 MRR_ObjObstacleProb_7 0 " Valid values " ;
VAL_ 1075 MRR_ObjDistX_7 0 " Valid values " 4080 " Reserved " ;
VAL_ 1075 MRR_ObjDistY_7 0 " Valid values " ;
VAL_ 1075 MRR_ObjRelVelX_7 0 " Valid values " 8174 " Reserved " ;
VAL_ 1075 MRR_ObjRelVelY_7 0 " Valid values " 8174 " Reserved " ;
VAL_ 1075 MRR_ObjRelAccelX_7 0 " Valid values " ;
VAL_ 1075 MRR_ObjRelAccelY_7 0 " Valid values " ;
VAL_ 1075 MRR_ObjDistXStd_7 0 " Valid values " ;
VAL_ 1075 MRR_ObjDistYStd_7 0 " Valid values " ;
VAL_ 1075 MRR_ObjRelVelXStd_7 0 " Valid values " ;
VAL_ 1075 MRR_ObjRelVelYStd_7 0 " Valid values " ;
VAL_ 1075 MRR_ObjRAccelXStd_7 0 " Valid values " ;
VAL_ 1075 MRR_ObjRAccelYStd_7 0 " Valid values " ;
VAL_ 1075 MRR_ObjType_7 0 " Unknown " 1 " Truck " 2 " Car " 3 " Pedestrian " 4 " Cyclist " 5 " Reserved " ;
VAL_ 1075 MRR_ObjMotionType_7 0 " int " 1 " unknown " 2 " Drive " 3 " Stopped " 4 " Stand " 5 " reserved " 6 " reserved " 7 " reserved " ;
VAL_ 1075 VFC_ObjWidth_7 0 " Valid values " 501 " Reserved " ;
VAL_ 1075 VFC_ObjLength_7 0 " Valid values " 401 " Reserved " ;
VAL_ 1075 VFC_ObjHeight_7 0 " Valid values " 601 " Reserved " ;
VAL_ 1075 VFC_ObjMotionDirection_7 0 " Init " 1 " Inverse direction " 2 " Same  direction " 3 " cross " 4 " reserved " 5 " reserved " 6 " reserved " 7 " reserved " ;
VAL_ 1075 MRR_ObjID_8 0 " Valid values " ;
VAL_ 1075 MRR_ObjExistProb_8 0 " Valid values " ;
VAL_ 1075 MRR_ObjObstacleProb_8 0 " Valid values " ;
VAL_ 1075 MRR_ObjDistX_8 0 " Valid values " 4080 " Reserved " ;
VAL_ 1075 MRR_ObjDistY_8 0 " Valid values " ;
VAL_ 1075 MRR_ObjRelVelX_8 0 " Valid values " 8174 " Reserved " ;
VAL_ 1075 MRR_ObjRelVelY_8 0 " Valid values " 8174 " Reserved " ;
VAL_ 1075 MRR_ObjRelAccelX_8 0 " Valid values " ;
VAL_ 1075 MRR_ObjRelAccelY_8 0 " Valid values " ;
VAL_ 1075 MRR_ObjDistXStd_8 0 " Valid values " ;
VAL_ 1075 MRR_ObjDistYStd_8 0 " Valid values " ;
VAL_ 1075 MRR_ObjRelVelXStd_8 0 " Valid values " ;
VAL_ 1075 MRR_ObjRelVelYStd_8 0 " Valid values " ;
VAL_ 1075 MRR_ObjRAccelXStd_8 0 " Valid values " ;
VAL_ 1075 MRR_ObjRAccelYStd_8 0 " Valid values " ;
VAL_ 1075 MRR_ObjType_8 0 " Unknown " 1 " Truck " 2 " Car " 3 " Pedestrian " 4 " Cyclist " 5 " Reserved " ;
VAL_ 1075 MRR_ObjMotionType_8 0 " int " 1 " unknown " 2 " Drive " 3 " Stopped " 4 " Stand " 5 " reserved " 6 " reserved " 7 " reserved " ;
VAL_ 1075 VFC_ObjWidth_8 0 " Valid values " 501 " Reserved " ;
VAL_ 1075 VFC_ObjLength_8 0 " Valid values " 401 " Reserved " ;
VAL_ 1075 VFC_ObjHeight_8 0 " Valid values " 601 " Reserved " ;
VAL_ 1075 VFC_ObjMotionDirection_8 0 " Init " 1 " Inverse direction " 2 " Same  direction " 3 " cross " 4 " reserved " 5 " reserved " 6 " reserved " 7 " reserved " ;
VAL_ 1075 Checksum25 0 " Valid value " ;
VAL_ 1075 Checksum26 0 " Valid value " ;
VAL_ 1075 Checksum27 0 " Valid value " ;
VAL_ 1075 Checksum28 0 " Valid value " ;
VAL_ 1075 Checksum29 0 " Valid value " ;
VAL_ 1075 Checksum30 0 " Valid value " ;
VAL_ 1075 Checksum31 0 " Valid value " ;
VAL_ 1075 Checksum32 0 " Valid value " ;
VAL_ 1075 RollingCounter25 0 " Valid value " 15 " Invalid value " ;
VAL_ 1075 RollingCounter26 0 " Valid value " 15 " Invalid value " ;
VAL_ 1075 RollingCounter27 0 " Valid value " 15 " Invalid value " ;
VAL_ 1075 RollingCounter28 0 " Valid value " 15 " Invalid value " ;
VAL_ 1075 RollingCounter29 0 " Valid value " 15 " Invalid value " ;
VAL_ 1075 RollingCounter30 0 " Valid value " 15 " Invalid value " ;
VAL_ 1075 RollingCounter31 0 " Valid value " 15 " Invalid value " ;
VAL_ 1075 RollingCounter32 0 " Valid value " 15 " Invalid value " ;
VAL_ 1075 BlockCounter4 0 " Valid value " ;
VAL_ 1076 MRR_ObjMeasured_5 3 "Reserved" 2 "Predicted" 1 "Measured" 0 "Init" ;
VAL_ 1076 MRR_ObjID_9 0 " Valid values " ;
VAL_ 1076 MRR_ObjExistProb_9 0 " Valid values " ;
VAL_ 1076 MRR_ObjObstacleProb_9 0 " Valid values " ;
VAL_ 1076 MRR_ObjDistX_9 0 " Valid values " 4080 " Reserved " ;
VAL_ 1076 MRR_ObjDistY_9 0 " Valid values " ;
VAL_ 1076 MRR_ObjRelVelX_9 0 " Valid values " 8174 " Reserved " ;
VAL_ 1076 MRR_ObjRelVelY_9 0 " Valid values " 8174 " Reserved " ;
VAL_ 1076 MRR_ObjRelAccelX_9 0 " Valid values " ;
VAL_ 1076 MRR_ObjRelAccelY_9 0 " Valid values " ;
VAL_ 1076 MRR_ObjDistXStd_9 0 " Valid values " ;
VAL_ 1076 MRR_ObjDistYStd_9 0 " Valid values " ;
VAL_ 1076 MRR_ObjRelVelXStd_9 0 " Valid values " ;
VAL_ 1076 MRR_ObjRelVelYStd_9 0 " Valid values " ;
VAL_ 1076 MRR_ObjRAccelXStd_9 0 " Valid values " ;
VAL_ 1076 MRR_ObjRAccelYStd_9 0 " Valid values " ;
VAL_ 1076 MRR_ObjType_9 0 " Unknown " 1 " Truck " 2 " Car " 3 " Pedestrian " 4 " Cyclist " 5 " Reserved " ;
VAL_ 1076 MRR_ObjMotionType_9 0 " int " 1 " unknown " 2 " Drive " 3 " Stopped " 4 " Stand " 5 " reserved " 6 " reserved " 7 " reserved " ;
VAL_ 1076 VFC_ObjWidth_9 0 " Valid values " 501 " Reserved " ;
VAL_ 1076 VFC_ObjLength_9 0 " Valid values " 401 " Reserved " ;
VAL_ 1076 VFC_ObjHeight_9 0 " Valid values " 601 " Reserved " ;
VAL_ 1076 VFC_ObjMotionDirection_9 0 " Init " 1 " Inverse direction " 2 " Same  direction " 3 " cross " 4 " reserved " 5 " reserved " 6 " reserved " 7 " reserved " ;
VAL_ 1076 MRR_ObjID_10 0 " Valid values " ;
VAL_ 1076 MRR_ObjExistProb_10 0 " Valid values " ;
VAL_ 1076 MRR_ObjObstacleProb_10 0 " Valid values " ;
VAL_ 1076 MRR_ObjDistX_10 0 " Valid values " 4080 " Reserved " ;
VAL_ 1076 MRR_ObjDistY_10 0 " Valid values " ;
VAL_ 1076 MRR_ObjRelVelX_10 0 " Valid values " 8174 " Reserved " ;
VAL_ 1076 MRR_ObjRelVelY_10 0 " Valid values " 8174 " Reserved " ;
VAL_ 1076 MRR_ObjRelAccelX_10 0 " Valid values " ;
VAL_ 1076 MRR_ObjRelAccelY_10 0 " Valid values " ;
VAL_ 1076 MRR_ObjDistXStd_10 0 " Valid values " ;
VAL_ 1076 MRR_ObjDistYStd_10 0 " Valid values " ;
VAL_ 1076 MRR_ObjRelVelXStd_10 0 " Valid values " ;
VAL_ 1076 MRR_ObjRelVelYStd_10 0 " Valid values " ;
VAL_ 1076 MRR_ObjRAccelXStd_10 0 " Valid values " ;
VAL_ 1076 MRR_ObjRAccelYStd_10 0 " Valid values " ;
VAL_ 1076 MRR_ObjType_10 0 " Unknown " 1 " Truck " 2 " Car " 3 " Pedestrian " 4 " Cyclist " 5 " Reserved " ;
VAL_ 1076 MRR_ObjMotionType_10 0 " int " 1 " unknown " 2 " Drive " 3 " Stopped " 4 " Stand " 5 " reserved " 6 " reserved " 7 " reserved " ;
VAL_ 1076 VFC_ObjWidth_10 0 " Valid values " 501 " Reserved " ;
VAL_ 1076 VFC_ObjLength_10 0 " Valid values " 401 " Reserved " ;
VAL_ 1076 VFC_ObjHeight_10 0 " Valid values " 601 " Reserved " ;
VAL_ 1076 VFC_ObjMotionDirection_10 0 " Init " 1 " Inverse direction " 2 " Same  direction " 3 " cross " 4 " reserved " 5 " reserved " 6 " reserved " 7 " reserved " ;
VAL_ 1076 Checksum33 0 " Valid value " ;
VAL_ 1076 Checksum34 0 " Valid value " ;
VAL_ 1076 Checksum35 0 " Valid value " ;
VAL_ 1076 Checksum36 0 " Valid value " ;
VAL_ 1076 Checksum37 0 " Valid value " ;
VAL_ 1076 Checksum38 0 " Valid value " ;
VAL_ 1076 Checksum39 0 " Valid value " ;
VAL_ 1076 Checksum40 0 " Valid value " ;
VAL_ 1076 RollingCounter33 0 " Valid value " 15 " Invalid value " ;
VAL_ 1076 RollingCounter34 0 " Valid value " 15 " Invalid value " ;
VAL_ 1076 RollingCounter35 0 " Valid value " 15 " Invalid value " ;
VAL_ 1076 RollingCounter36 0 " Valid value " 15 " Invalid value " ;
VAL_ 1076 RollingCounter37 0 " Valid value " 15 " Invalid value " ;
VAL_ 1076 RollingCounter38 0 " Valid value " 15 " Invalid value " ;
VAL_ 1076 RollingCounter39 0 " Valid value " 15 " Invalid value " ;
VAL_ 1076 RollingCounter40 0 " Valid value " 15 " Invalid value " ;
VAL_ 1076 BlockCounter5 0 " Valid value " ;
VAL_ 1077 MRR_ObjMeasured_6 3 "Reserved" 2 "Predicted" 1 "Measured" 0 "Init" ;
VAL_ 1077 MRR_ObjID_11 0 " Valid values " ;
VAL_ 1077 MRR_ObjExistProb_11 0 " Valid values " ;
VAL_ 1077 MRR_ObjObstacleProb_11 0 " Valid values " ;
VAL_ 1077 MRR_ObjDistX_11 0 " Valid values " 4080 " Reserved " ;
VAL_ 1077 MRR_ObjDistY_11 0 " Valid values " ;
VAL_ 1077 MRR_ObjRelVelX_11 0 " Valid values " 8174 " Reserved " ;
VAL_ 1077 MRR_ObjRelVelY_11 0 " Valid values " 8174 " Reserved " ;
VAL_ 1077 MRR_ObjRelAccelX_11 0 " Valid values " ;
VAL_ 1077 MRR_ObjRelAccelY_11 0 " Valid values " ;
VAL_ 1077 MRR_ObjDistXStd_11 0 " Valid values " ;
VAL_ 1077 MRR_ObjDistYStd_11 0 " Valid values " ;
VAL_ 1077 MRR_ObjRelVelXStd_11 0 " Valid values " ;
VAL_ 1077 MRR_ObjRelVelYStd_11 0 " Valid values " ;
VAL_ 1077 MRR_ObjRAccelXStd_11 0 " Valid values " ;
VAL_ 1077 MRR_ObjRAccelYStd_11 0 " Valid values " ;
VAL_ 1077 MRR_ObjType_11 0 " Unknown " 1 " Truck " 2 " Car " 3 " Pedestrian " 4 " Cyclist " 5 " Reserved " ;
VAL_ 1077 MRR_ObjMotionType_11 0 " int " 1 " unknown " 2 " Drive " 3 " Stopped " 4 " Stand " 5 " reserved " 6 " reserved " 7 " reserved " ;
VAL_ 1077 VFC_ObjWidth_11 0 " Valid values " 501 " Reserved " ;
VAL_ 1077 VFC_ObjLength_11 0 " Valid values " 401 " Reserved " ;
VAL_ 1077 VFC_ObjHeight_11 0 " Valid values " 601 " Reserved " ;
VAL_ 1077 VFC_ObjMotionDirection_11 0 " Init " 1 " Inverse direction " 2 " Same  direction " 3 " cross " 4 " reserved " 5 " reserved " 6 " reserved " 7 " reserved " ;
VAL_ 1077 MRR_ObjID_12 0 " Valid values " ;
VAL_ 1077 MRR_ObjExistProb_12 0 " Valid values " ;
VAL_ 1077 MRR_ObjObstacleProb_12 0 " Valid values " ;
VAL_ 1077 MRR_ObjDistX_12 0 " Valid values " 4080 " Reserved " ;
VAL_ 1077 MRR_ObjDistY_12 0 " Valid values " ;
VAL_ 1077 MRR_ObjRelVelX_12 0 " Valid values " 8174 " Reserved " ;
VAL_ 1077 MRR_ObjRelVelY_12 0 " Valid values " 8174 " Reserved " ;
VAL_ 1077 MRR_ObjRelAccelX_12 0 " Valid values " ;
VAL_ 1077 MRR_ObjRelAccelY_12 0 " Valid values " ;
VAL_ 1077 MRR_ObjDistXStd_12 0 " Valid values " ;
VAL_ 1077 MRR_ObjDistYStd_12 0 " Valid values " ;
VAL_ 1077 MRR_ObjRelVelXStd_12 0 " Valid values " ;
VAL_ 1077 MRR_ObjRelVelYStd_12 0 " Valid values " ;
VAL_ 1077 MRR_ObjRAccelXStd_12 0 " Valid values " ;
VAL_ 1077 MRR_ObjRAccelYStd_12 0 " Valid values " ;
VAL_ 1077 MRR_ObjType_12 0 " Unknown " 1 " Truck " 2 " Car " 3 " Pedestrian " 4 " Cyclist " 5 " Reserved " ;
VAL_ 1077 MRR_ObjMotionType_12 0 " int " 1 " unknown " 2 " Drive " 3 " Stopped " 4 " Stand " 5 " reserved " 6 " reserved " 7 " reserved " ;
VAL_ 1077 VFC_ObjWidth_12 0 " Valid values " 501 " Reserved " ;
VAL_ 1077 VFC_ObjLength_12 0 " Valid values " 401 " Reserved " ;
VAL_ 1077 VFC_ObjHeight_12 0 " Valid values " 601 " Reserved " ;
VAL_ 1077 VFC_ObjMotionDirection_12 0 " Init " 1 " Inverse direction " 2 " Same  direction " 3 " cross " 4 " reserved " 5 " reserved " 6 " reserved " 7 " reserved " ;
VAL_ 1077 Checksum41 0 " Valid value " ;
VAL_ 1077 Checksum42 0 " Valid value " ;
VAL_ 1077 Checksum43 0 " Valid value " ;
VAL_ 1077 Checksum44 0 " Valid value " ;
VAL_ 1077 Checksum45 0 " Valid value " ;
VAL_ 1077 Checksum46 0 " Valid value " ;
VAL_ 1077 Checksum47 0 " Valid value " ;
VAL_ 1077 Checksum48 0 " Valid value " ;
VAL_ 1077 RollingCounter41 0 " Valid value " 15 " Invalid value " ;
VAL_ 1077 RollingCounter42 0 " Valid value " 15 " Invalid value " ;
VAL_ 1077 RollingCounter43 0 " Valid value " 15 " Invalid value " ;
VAL_ 1077 RollingCounter44 0 " Valid value " 15 " Invalid value " ;
VAL_ 1077 RollingCounter45 0 " Valid value " 15 " Invalid value " ;
VAL_ 1077 RollingCounter46 0 " Valid value " 15 " Invalid value " ;
VAL_ 1077 RollingCounter47 0 " Valid value " 15 " Invalid value " ;
VAL_ 1077 RollingCounter48 0 " Valid value " 15 " Invalid value " ;
VAL_ 1077 BlockCounter6 0 " Valid value " ;
VAL_ 1078 MRR_ObjMeasured_7 3 "Reserved" 2 "Predicted" 1 "Measured" 0 "Init" ;
VAL_ 1078 MRR_ObjID_13 0 " Valid values " ;
VAL_ 1078 MRR_ObjExistProb_13 0 " Valid values " ;
VAL_ 1078 MRR_ObjObstacleProb_13 0 " Valid values " ;
VAL_ 1078 MRR_ObjDistX_13 0 " Valid values " 4080 " Reserved " ;
VAL_ 1078 MRR_ObjDistY_13 0 " Valid values " ;
VAL_ 1078 MRR_ObjRelVelX_13 0 " Valid values " 8174 " Reserved " ;
VAL_ 1078 MRR_ObjRelVelY_13 0 " Valid values " 8174 " Reserved " ;
VAL_ 1078 MRR_ObjRelAccelX_13 0 " Valid values " ;
VAL_ 1078 MRR_ObjRelAccelY_13 0 " Valid values " ;
VAL_ 1078 MRR_ObjDistXStd_13 0 " Valid values " ;
VAL_ 1078 MRR_ObjDistYStd_13 0 " Valid values " ;
VAL_ 1078 MRR_ObjRelVelXStd_13 0 " Valid values " ;
VAL_ 1078 MRR_ObjRelVelYStd_13 0 " Valid values " ;
VAL_ 1078 MRR_ObjRAccelXStd_13 0 " Valid values " ;
VAL_ 1078 MRR_ObjRAccelYStd_13 0 " Valid values " ;
VAL_ 1078 MRR_ObjType_13 0 " Unknown " 1 " Truck " 2 " Car " 3 " Pedestrian " 4 " Cyclist " 5 " Reserved " ;
VAL_ 1078 MRR_ObjMotionType_13 0 " int " 1 " unknown " 2 " Drive " 3 " Stopped " 4 " Stand " 5 " reserved " 6 " reserved " 7 " reserved " ;
VAL_ 1078 VFC_ObjWidth_13 0 " Valid values " 501 " Reserved " ;
VAL_ 1078 VFC_ObjLength_13 0 " Valid values " 401 " Reserved " ;
VAL_ 1078 VFC_ObjHeight_13 0 " Valid values " 601 " Reserved " ;
VAL_ 1078 VFC_ObjMotionDirection_13 0 " Init " 1 " Inverse direction " 2 " Same  direction " 3 " cross " 4 " reserved " 5 " reserved " 6 " reserved " 7 " reserved " ;
VAL_ 1078 MRR_ObjID_14 0 " Valid values " ;
VAL_ 1078 MRR_ObjExistProb_14 0 " Valid values " ;
VAL_ 1078 MRR_ObjObstacleProb_14 0 " Valid values " ;
VAL_ 1078 MRR_ObjDistX_14 0 " Valid values " 4080 " Reserved " ;
VAL_ 1078 MRR_ObjDistY_14 0 " Valid values " ;
VAL_ 1078 MRR_ObjRelVelX_14 0 " Valid values " 8174 " Reserved " ;
VAL_ 1078 MRR_ObjRelVelY_14 0 " Valid values " 8174 " Reserved " ;
VAL_ 1078 MRR_ObjRelAccelX_14 0 " Valid values " ;
VAL_ 1078 MRR_ObjRelAccelY_14 0 " Valid values " ;
VAL_ 1078 MRR_ObjDistXStd_14 0 " Valid values " ;
VAL_ 1078 MRR_ObjDistYStd_14 0 " Valid values " ;
VAL_ 1078 MRR_ObjRelVelXStd_14 0 " Valid values " ;
VAL_ 1078 MRR_ObjRelVelYStd_14 0 " Valid values " ;
VAL_ 1078 MRR_ObjRAccelXStd_14 0 " Valid values " ;
VAL_ 1078 MRR_ObjRAccelYStd_14 0 " Valid values " ;
VAL_ 1078 MRR_ObjType_14 0 " Unknown " 1 " Truck " 2 " Car " 3 " Pedestrian " 4 " Cyclist " 5 " Reserved " ;
VAL_ 1078 MRR_ObjMotionType_14 0 " int " 1 " unknown " 2 " Drive " 3 " Stopped " 4 " Stand " 5 " reserved " 6 " reserved " 7 " reserved " ;
VAL_ 1078 VFC_ObjWidth_14 0 " Valid values " 501 " Reserved " ;
VAL_ 1078 VFC_ObjLength_14 0 " Valid values " 401 " Reserved " ;
VAL_ 1078 VFC_ObjHeight_14 0 " Valid values " 601 " Reserved " ;
VAL_ 1078 VFC_ObjMotionDirection_14 0 " Init " 1 " Inverse direction " 2 " Same  direction " 3 " cross " 4 " reserved " 5 " reserved " 6 " reserved " 7 " reserved " ;
VAL_ 1078 Checksum49 0 " Valid value " ;
VAL_ 1078 Checksum50 0 " Valid value " ;
VAL_ 1078 Checksum51 0 " Valid value " ;
VAL_ 1078 Checksum52 0 " Valid value " ;
VAL_ 1078 Checksum53 0 " Valid value " ;
VAL_ 1078 Checksum54 0 " Valid value " ;
VAL_ 1078 Checksum55 0 " Valid value " ;
VAL_ 1078 Checksum56 0 " Valid value " ;
VAL_ 1078 RollingCounter49 0 " Valid value " 15 " Invalid value " ;
VAL_ 1078 RollingCounter50 0 " Valid value " 15 " Invalid value " ;
VAL_ 1078 RollingCounter51 0 " Valid value " 15 " Invalid value " ;
VAL_ 1078 RollingCounter52 0 " Valid value " 15 " Invalid value " ;
VAL_ 1078 RollingCounter53 0 " Valid value " 15 " Invalid value " ;
VAL_ 1078 RollingCounter54 0 " Valid value " 15 " Invalid value " ;
VAL_ 1078 RollingCounter55 0 " Valid value " 15 " Invalid value " ;
VAL_ 1078 RollingCounter56 0 " Valid value " 15 " Invalid value " ;
VAL_ 1078 BlockCounter7 0 " Valid value " ;
VAL_ 1079 MRR_ObjMeasured_8 3 "Reserved" 2 "Predicted" 1 "Measured" 0 "Init" ;
VAL_ 1079 MRR_ObjID_15 0 " Valid values " ;
VAL_ 1079 MRR_ObjExistProb_15 0 " Valid values " ;
VAL_ 1079 MRR_ObjObstacleProb_15 0 " Valid values " ;
VAL_ 1079 MRR_ObjDistX_15 0 " Valid values " 4080 " Reserved " ;
VAL_ 1079 MRR_ObjDistY_15 0 " Valid values " ;
VAL_ 1079 MRR_ObjRelVelX_15 0 " Valid values " 8174 " Reserved " ;
VAL_ 1079 MRR_ObjRelVelY_15 0 " Valid values " 8174 " Reserved " ;
VAL_ 1079 MRR_ObjRelAccelX_15 0 " Valid values " ;
VAL_ 1079 MRR_ObjRelAccelY_15 0 " Valid values " ;
VAL_ 1079 MRR_ObjDistXStd_15 0 " Valid values " ;
VAL_ 1079 MRR_ObjDistYStd_15 0 " Valid values " ;
VAL_ 1079 MRR_ObjRelVelXStd_15 0 " Valid values " ;
VAL_ 1079 MRR_ObjRelVelYStd_15 0 " Valid values " ;
VAL_ 1079 MRR_ObjRAccelXStd_15 0 " Valid values " ;
VAL_ 1079 MRR_ObjRAccelYStd_15 0 " Valid values " ;
VAL_ 1079 MRR_ObjType_15 0 " Unknown " 1 " Truck " 2 " Car " 3 " Pedestrian " 4 " Cyclist " 5 " Reserved " ;
VAL_ 1079 MRR_ObjMotionType_15 0 " int " 1 " unknown " 2 " Drive " 3 " Stopped " 4 " Stand " 5 " reserved " 6 " reserved " 7 " reserved " ;
VAL_ 1079 VFC_ObjWidth_15 0 " Valid values " 501 " Reserved " ;
VAL_ 1079 VFC_ObjLength_15 0 " Valid values " 401 " Reserved " ;
VAL_ 1079 VFC_ObjHeight_15 0 " Valid values " 601 " Reserved " ;
VAL_ 1079 VFC_ObjMotionDirection_15 0 " Init " 1 " Inverse direction " 2 " Same  direction " 3 " cross " 4 " reserved " 5 " reserved " 6 " reserved " 7 " reserved " ;
VAL_ 1079 MRR_ObjID_16 0 " Valid values " ;
VAL_ 1079 MRR_ObjExistProb_16 0 " Valid values " ;
VAL_ 1079 MRR_ObjObstacleProb_16 0 " Valid values " ;
VAL_ 1079 MRR_ObjDistX_16 0 " Valid values " 4080 " Reserved " ;
VAL_ 1079 MRR_ObjDistY_16 0 " Valid values " ;
VAL_ 1079 MRR_ObjRelVelX_16 0 " Valid values " 8174 " Reserved " ;
VAL_ 1079 MRR_ObjRelVelY_16 0 " Valid values " 8174 " Reserved " ;
VAL_ 1079 MRR_ObjRelAccelX_16 0 " Valid values " ;
VAL_ 1079 MRR_ObjRelAccelY_16 0 " Valid values " ;
VAL_ 1079 MRR_ObjDistXStd_16 0 " Valid values " ;
VAL_ 1079 MRR_ObjDistYStd_16 0 " Valid values " ;
VAL_ 1079 MRR_ObjRelVelXStd_16 0 " Valid values " ;
VAL_ 1079 MRR_ObjRelVelYStd_16 0 " Valid values " ;
VAL_ 1079 MRR_ObjRAccelXStd_16 0 " Valid values " ;
VAL_ 1079 MRR_ObjRAccelYStd_16 0 " Valid values " ;
VAL_ 1079 MRR_ObjType_16 0 " Unknown " 1 " Truck " 2 " Car " 3 " Pedestrian " 4 " Cyclist " 5 " Reserved " ;
VAL_ 1079 MRR_ObjMotionType_16 0 " int " 1 " unknown " 2 " Drive " 3 " Stopped " 4 " Stand " 5 " reserved " 6 " reserved " 7 " reserved " ;
VAL_ 1079 VFC_ObjWidth_16 0 " Valid values " 501 " Reserved " ;
VAL_ 1079 VFC_ObjLength_16 0 " Valid values " 401 " Reserved " ;
VAL_ 1079 VFC_ObjHeight_16 0 " Valid values " 601 " Reserved " ;
VAL_ 1079 VFC_ObjMotionDirection_16 0 " Init " 1 " Inverse direction " 2 " Same  direction " 3 " cross " 4 " reserved " 5 " reserved " 6 " reserved " 7 " reserved " ;
VAL_ 1079 Checksum57 0 " Valid value " ;
VAL_ 1079 Checksum58 0 " Valid value " ;
VAL_ 1079 Checksum59 0 " Valid value " ;
VAL_ 1079 Checksum60 0 " Valid value " ;
VAL_ 1079 Checksum61 0 " Valid value " ;
VAL_ 1079 Checksum62 0 " Valid value " ;
VAL_ 1079 Checksum63 0 " Valid value " ;
VAL_ 1079 Checksum64 0 " Valid value " ;
VAL_ 1079 RollingCounter57 0 " Valid value " 15 " Invalid value " ;
VAL_ 1079 RollingCounter58 0 " Valid value " 15 " Invalid value " ;
VAL_ 1079 RollingCounter59 0 " Valid value " 15 " Invalid value " ;
VAL_ 1079 RollingCounter60 0 " Valid value " 15 " Invalid value " ;
VAL_ 1079 RollingCounter61 0 " Valid value " 15 " Invalid value " ;
VAL_ 1079 RollingCounter62 0 " Valid value " 15 " Invalid value " ;
VAL_ 1079 RollingCounter63 0 " Valid value " 15 " Invalid value " ;
VAL_ 1079 RollingCounter64 0 " Valid value " 15 " Invalid value " ;
VAL_ 1079 BlockCounter8 0 " Valid value " ;
VAL_ 1080 MRR_ObjMeasured_9 3 "Reserved" 2 "Predicted" 1 "Measured" 0 "Init" ;
VAL_ 1080 MRR_ObjID_17 0 " Valid values " ;
VAL_ 1080 MRR_ObjExistProb_17 0 " Valid values " ;
VAL_ 1080 MRR_ObjObstacleProb_17 0 " Valid values " ;
VAL_ 1080 MRR_ObjDistX_17 0 " Valid values " 4080 " Reserved " ;
VAL_ 1080 MRR_ObjDistY_17 0 " Valid values " ;
VAL_ 1080 MRR_ObjRelVelX_17 0 " Valid values " 8174 " Reserved " ;
VAL_ 1080 MRR_ObjRelVelY_17 0 " Valid values " 8174 " Reserved " ;
VAL_ 1080 MRR_ObjRelAccelX_17 0 " Valid values " ;
VAL_ 1080 MRR_ObjRelAccelY_17 0 " Valid values " ;
VAL_ 1080 MRR_ObjDistXStd_17 0 " Valid values " ;
VAL_ 1080 MRR_ObjDistYStd_17 0 " Valid values " ;
VAL_ 1080 MRR_ObjRelVelXStd_17 0 " Valid values " ;
VAL_ 1080 MRR_ObjRelVelYStd_17 0 " Valid values " ;
VAL_ 1080 MRR_ObjRAccelXStd_17 0 " Valid values " ;
VAL_ 1080 MRR_ObjRAccelYStd_17 0 " Valid values " ;
VAL_ 1080 MRR_ObjType_17 0 " Unknown " 1 " Truck " 2 " Car " 3 " Pedestrian " 4 " Cyclist " 5 " Reserved " ;
VAL_ 1080 MRR_ObjMotionType_17 0 " int " 1 " unknown " 2 " Drive " 3 " Stopped " 4 " Stand " 5 " reserved " 6 " reserved " 7 " reserved " ;
VAL_ 1080 VFC_ObjWidth_17 0 " Valid values " 501 " Reserved " ;
VAL_ 1080 VFC_ObjLength_17 0 " Valid values " 401 " Reserved " ;
VAL_ 1080 VFC_ObjHeight_17 0 " Valid values " 601 " Reserved " ;
VAL_ 1080 VFC_ObjMotionDirection_17 0 " Init " 1 " Inverse direction " 2 " Same  direction " 3 " cross " 4 " reserved " 5 " reserved " 6 " reserved " 7 " reserved " ;
VAL_ 1080 MRR_ObjID_18 0 " Valid values " ;
VAL_ 1080 MRR_ObjExistProb_18 0 " Valid values " ;
VAL_ 1080 MRR_ObjObstacleProb_18 0 " Valid values " ;
VAL_ 1080 MRR_ObjDistX_18 0 " Valid values " 4080 " Reserved " ;
VAL_ 1080 MRR_ObjDistY_18 0 " Valid values " ;
VAL_ 1080 MRR_ObjRelVelX_18 0 " Valid values " 8174 " Reserved " ;
VAL_ 1080 MRR_ObjRelVelY_18 0 " Valid values " 8174 " Reserved " ;
VAL_ 1080 MRR_ObjRelAccelX_18 0 " Valid values " ;
VAL_ 1080 MRR_ObjRelAccelY_18 0 " Valid values " ;
VAL_ 1080 MRR_ObjDistXStd_18 0 " Valid values " ;
VAL_ 1080 MRR_ObjDistYStd_18 0 " Valid values " ;
VAL_ 1080 MRR_ObjRelVelXStd_18 0 " Valid values " ;
VAL_ 1080 MRR_ObjRelVelYStd_18 0 " Valid values " ;
VAL_ 1080 MRR_ObjRAccelXStd_18 0 " Valid values " ;
VAL_ 1080 MRR_ObjRAccelYStd_18 0 " Valid values " ;
VAL_ 1080 MRR_ObjType_18 0 " Unknown " 1 " Truck " 2 " Car " 3 " Pedestrian " 4 " Cyclist " 5 " Reserved " ;
VAL_ 1080 MRR_ObjMotionType_18 0 " int " 1 " unknown " 2 " Drive " 3 " Stopped " 4 " Stand " 5 " reserved " 6 " reserved " 7 " reserved " ;
VAL_ 1080 VFC_ObjWidth_18 0 " Valid values " 501 " Reserved " ;
VAL_ 1080 VFC_ObjLength_18 0 " Valid values " 401 " Reserved " ;
VAL_ 1080 VFC_ObjHeight_18 0 " Valid values " 601 " Reserved " ;
VAL_ 1080 VFC_ObjMotionDirection_18 0 " Init " 1 " Inverse direction " 2 " Same  direction " 3 " cross " 4 " reserved " 5 " reserved " 6 " reserved " 7 " reserved " ;
VAL_ 1080 Checksum65 0 " Valid value " ;
VAL_ 1080 Checksum66 0 " Valid value " ;
VAL_ 1080 Checksum67 0 " Valid value " ;
VAL_ 1080 Checksum68 0 " Valid value " ;
VAL_ 1080 Checksum69 0 " Valid value " ;
VAL_ 1080 Checksum70 0 " Valid value " ;
VAL_ 1080 Checksum71 0 " Valid value " ;
VAL_ 1080 Checksum72 0 " Valid value " ;
VAL_ 1080 RollingCounter65 0 " Valid value " 15 " Invalid value " ;
VAL_ 1080 RollingCounter66 0 " Valid value " 15 " Invalid value " ;
VAL_ 1080 RollingCounter67 0 " Valid value " 15 " Invalid value " ;
VAL_ 1080 RollingCounter68 0 " Valid value " 15 " Invalid value " ;
VAL_ 1080 RollingCounter69 0 " Valid value " 15 " Invalid value " ;
VAL_ 1080 RollingCounter70 0 " Valid value " 15 " Invalid value " ;
VAL_ 1080 RollingCounter71 0 " Valid value " 15 " Invalid value " ;
VAL_ 1080 RollingCounter72 0 " Valid value " 15 " Invalid value " ;
VAL_ 1080 BlockCounter9 0 " Valid value " ;
