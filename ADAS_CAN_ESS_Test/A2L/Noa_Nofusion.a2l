/* @@@@ File written by CANAPE_VERSION 18 0 22 @@@@ */
ASAP2_VERSION 1 61
/begin PROJECT Noa_Nofusion ""
/begin MODULE Noa_Nofusion ""
/begin MOD_COMMON "" DEPOSIT ABSOLUTE BYTE_ORDER MSB_LAST ALIGNMENT_BYTE 1 ALIGNMENT_WORD 2 ALIGNMENT_LONG 4 ALIGNMENT_INT64 1 ALIGNMENT_FLOAT32_IEEE 4 ALIGNMENT_FLOAT64_IEEE 8 /end MOD_COMMON
/begin IF_DATA XCPplus 0x0101
 /begin PROTOCOL_LAYER 0x0101 0x01F4 0x07D0 0x00 0x00 0x00 0x00 0x00 0xFC 0x0584 BYTE_ORDER_MSB_LAST ADDRESS_GRANULARITY_BYTE OPTIONAL_CMD WRITE_DAQ_MULTIPLE OPTIONAL_CMD ALLOC_ODT_ENTRY OPTIONAL_CMD ALLOC_ODT OPTIONAL_CMD ALLOC_DAQ OPTIONAL_CMD FREE_DAQ OPTIONAL_CMD READ_DAQ OPTIONAL_CMD GET_DAQ_CLOCK OPTIONAL_CMD START_STOP_SYNCH OPTIONAL_CMD START_STOP_DAQ_LIST OPTIONAL_CMD GET_DAQ_LIST_MODE OPTIONAL_CMD SET_DAQ_LIST_MODE OPTIONAL_CMD WRITE_DAQ OPTIONAL_CMD SET_DAQ_PTR OPTIONAL_CMD CLEAR_DAQ_LIST OPTIONAL_CMD MODIFY_BITS OPTIONAL_CMD DOWNLOAD_MAX OPTIONAL_CMD DOWNLOAD OPTIONAL_CMD BUILD_CHECKSUM OPTIONAL_CMD SHORT_UPLOAD OPTIONAL_CMD UPLOAD OPTIONAL_CMD SET_MTA OPTIONAL_CMD GET_COMM_MODE_INFO COMMUNICATION_MODE_SUPPORTED BLOCK SLAVE /end PROTOCOL_LAYER
 /begin DAQ DYNAMIC 0x00 0x01 0x00 OPTIMISATION_TYPE_DEFAULT ADDRESS_EXTENSION_FREE IDENTIFICATION_FIELD_TYPE_ABSOLUTE GRANULARITY_ODT_ENTRY_SIZE_DAQ_BYTE 0xFF OVERLOAD_INDICATION_PID PRESCALER_SUPPORTED /begin TIMESTAMP_SUPPORTED 0x01 SIZE_DWORD UNIT_1US /end TIMESTAMP_SUPPORTED
  /begin EVENT "Periodic Task 1" "Periodic " 0x00 DAQ_STIM 0xFF 0x01 0x07 0x00 /end EVENT
 /end DAQ
 /begin PAG 0x01 /end PAG
 /begin PGM PGM_MODE_ABSOLUTE 0x00 0x00 /end PGM
 /begin XCP_ON_TCP_IP 0x0100 0x04D4 ADDRESS "192.162.140.10" /end XCP_ON_TCP_IP
/end IF_DATA
/begin MOD_PAR "" SUPPLIER "" CUSTOMER "" USER "" PHONE_NO "" ECU "DS1403" CPU_TYPE "Noa_Nofusion" ADDR_EPK 0x3B47E0 EPK "7a605322-2432-43a6-9e70-2a660af847c6"
 /begin MEMORY_SEGMENT CalibrationData "" DATA RAM INTERN 0x3B4920 0x5648 -1 -1 -1 -1 -1
  /begin IF_DATA XCPplus 0x0101
   /begin SEGMENT 0x00 0x01 0x00 0x00 0x00
    /begin PAGE 0x00 ECU_ACCESS_DONT_CARE XCP_READ_ACCESS_DONT_CARE XCP_WRITE_ACCESS_DONT_CARE /end PAGE
   /end SEGMENT
  /end IF_DATA
 /end MEMORY_SEGMENT
/end MOD_PAR
/begin COMPU_METHOD Noa_Nofusion_CM_boolean "Q = V" IDENTICAL "%1.0" "" /end COMPU_METHOD
/begin COMPU_METHOD Noa_Nofusion_CM_double "Q = V" IDENTICAL "%15.10" "" /end COMPU_METHOD
/begin COMPU_METHOD Noa_Nofusion_CM_single "Q = V" IDENTICAL "%8.6" "" /end COMPU_METHOD
/begin COMPU_METHOD Noa_Nofusion_CM_single_m "Q = V" IDENTICAL "%8.6" "m" /end COMPU_METHOD
/begin COMPU_METHOD Noa_Nofusion_CM_uint8 "Q = V" IDENTICAL "%3.0" "" /end COMPU_METHOD
/begin COMPU_METHOD PubIfChassisHMI_MDL_CM_uint8 "Q = V" IDENTICAL "%3.0" "" /end COMPU_METHOD
/begin COMPU_METHOD PubIfCommonVIE_MDL_CM_uint32 "Q = V" IDENTICAL "%10.0" "" /end COMPU_METHOD
/begin COMPU_METHOD PubIfControlLATC_MDL_CM_double "Q = V" IDENTICAL "%15.10" "" /end COMPU_METHOD
/begin COMPU_METHOD PubIfControlLATC_MDL_CM_single "Q = V" IDENTICAL "%8.6" "" /end COMPU_METHOD
/begin COMPU_METHOD PubIfControlLATC_MDL_CM_single_m "Q = V" IDENTICAL "%8.6" "m" /end COMPU_METHOD
/begin COMPU_METHOD PubIfControlLATC_MDL_CM_single_m_s "Q = V" IDENTICAL "%8.6" "m/s" /end COMPU_METHOD
/begin COMPU_METHOD PubIfControlLATC_MDL_CM_uint8 "Q = V" IDENTICAL "%3.0" "" /end COMPU_METHOD
/begin COMPU_METHOD PubIfControlLONC_MDL_CM_uint32 "Q = V" IDENTICAL "%10.0" "" /end COMPU_METHOD
/begin COMPU_METHOD PubIfControlLONC_MDL_CM_uint8 "Q = V" IDENTICAL "%3.0" "" /end COMPU_METHOD
/begin COMPU_METHOD PubIfDecisionLSM_MDL_CM_double "Q = V" IDENTICAL "%15.10" "" /end COMPU_METHOD
/begin COMPU_METHOD PubIfDecisionLSM_MDL_CM_single "Q = V" IDENTICAL "%8.6" "" /end COMPU_METHOD
/begin COMPU_METHOD PubIfDecisionLSM_MDL_CM_uint8 "Q = V" IDENTICAL "%3.0" "" /end COMPU_METHOD
/begin COMPU_METHOD PubIfDecisionPLAN_MDL_CM_boolean "Q = V" IDENTICAL "%1.0" "" /end COMPU_METHOD
/begin COMPU_METHOD PubIfDecisionPLAN_MDL_CM_int8 "Q = V" IDENTICAL "%3.0" "" /end COMPU_METHOD
/begin COMPU_METHOD PubIfDecisionPLAN_MDL_CM_single "Q = V" IDENTICAL "%8.6" "" /end COMPU_METHOD
/begin COMPU_METHOD PubIfDecisionPLAN_MDL_CM_single_km_h "Q = V" IDENTICAL "%8.6" "km/h" /end COMPU_METHOD
/begin COMPU_METHOD PubIfDecisionPLAN_MDL_CM_single_m "Q = V" IDENTICAL "%8.6" "m" /end COMPU_METHOD
/begin COMPU_METHOD PubIfDecisionPLAN_MDL_CM_single_m_s "Q = V" IDENTICAL "%8.6" "m/s" /end COMPU_METHOD
/begin COMPU_METHOD PubIfDecisionPLAN_MDL_CM_single_m_s_2 "Q = V" IDENTICAL "%8.6" "m/s^2" /end COMPU_METHOD
/begin COMPU_METHOD PubIfDecisionPLAN_MDL_CM_single_m_s_3 "Q = V" IDENTICAL "%8.6" "m/s^3" /end COMPU_METHOD
/begin COMPU_METHOD PubIfDecisionPLAN_MDL_CM_single_s "Q = V" IDENTICAL "%8.6" "s" /end COMPU_METHOD
/begin COMPU_METHOD PubIfDecisionPLAN_MDL_CM_uint16 "Q = V" IDENTICAL "%5.0" "" /end COMPU_METHOD
/begin COMPU_METHOD PubIfDecisionPLAN_MDL_CM_uint8 "Q = V" IDENTICAL "%3.0" "" /end COMPU_METHOD
/begin COMPU_METHOD PubIfStateVSM_MDL_CM_boolean "Q = V" IDENTICAL "%1.0" "" /end COMPU_METHOD
/begin COMPU_METHOD PubIfStateVSM_MDL_CM_double "Q = V" IDENTICAL "%15.10" "" /end COMPU_METHOD
/begin COMPU_METHOD PubIfStateVSM_MDL_CM_single "Q = V" IDENTICAL "%8.6" "" /end COMPU_METHOD
/begin COMPU_METHOD PubIfStateVSM_MDL_CM_single_m "Q = V" IDENTICAL "%8.6" "m" /end COMPU_METHOD
/begin COMPU_METHOD PubIfStateVSM_MDL_CM_uint16 "Q = V" IDENTICAL "%5.0" "" /end COMPU_METHOD
/begin COMPU_METHOD PubIfStateVSM_MDL_CM_uint32 "Q = V" IDENTICAL "%10.0" "" /end COMPU_METHOD
/begin COMPU_METHOD PubIfStateVSM_MDL_CM_uint8 "Q = V" IDENTICAL "%3.0" "" /end COMPU_METHOD
/begin CHARACTERISTIC C_LongCtrl_0_Single "" VALUE 0x3CB018 Scalar_FLOAT32_IEEE 0 PubIfDecisionPLAN_MDL_CM_single -3.4e+38 3.4e+38 /end CHARACTERISTIC
/begin MEASUREMENT HMI_Counter "" UBYTE PubIfChassisHMI_MDL_CM_uint8 0 0 0 255 ECU_ADDRESS 0x3F1008 /end MEASUREMENT
/begin MEASUREMENT LCS_CurrentSteerAngleOffset_deg "" FLOAT32_IEEE PubIfControlLATC_MDL_CM_single 0 0 -3.4e+38 3.4e+38 ECU_ADDRESS 0x3F1940 /end MEASUREMENT
/begin MEASUREMENT LSM_Edge_Offset "" FLOAT32_IEEE PubIfDecisionLSM_MDL_CM_single 0 0 -3.4e+38 3.4e+38 ECU_ADDRESS 0x3FE954 /end MEASUREMENT
/begin MEASUREMENT LSM_Line_source "" UBYTE Noa_Nofusion_CM_uint8 0 0 0 255 ECU_ADDRESS 0x3CAFC0 /end MEASUREMENT
/begin MEASUREMENT LSM_Line_state "" UBYTE PubIfDecisionLSM_MDL_CM_uint8 0 0 0 255 ECU_ADDRESS 0x3FE984 /end MEASUREMENT
/begin MEASUREMENT LSM_RFM_LineCenter_C0 "" FLOAT32_IEEE PubIfDecisionLSM_MDL_CM_single 0 0 -3.4e+38 3.4e+38 ECU_ADDRESS 0x3FE7A4 /end MEASUREMENT
/begin MEASUREMENT LSM_RFM_LineCenter_C1 "" FLOAT32_IEEE PubIfDecisionLSM_MDL_CM_single 0 0 -3.4e+38 3.4e+38 ECU_ADDRESS 0x3FE7CC /end MEASUREMENT
/begin MEASUREMENT LSM_RFM_LineCenter_C2 "" FLOAT32_IEEE PubIfDecisionLSM_MDL_CM_single 0 0 -3.4e+38 3.4e+38 ECU_ADDRESS 0x3FE7D4 /end MEASUREMENT
/begin MEASUREMENT LSM_RFM_LineCenter_C3 "" FLOAT32_IEEE PubIfDecisionLSM_MDL_CM_single 0 0 -3.4e+38 3.4e+38 ECU_ADDRESS 0x3FE7D8 /end MEASUREMENT
/begin MEASUREMENT LSM_RFM_LineCenter_Front "" FLOAT32_IEEE PubIfDecisionLSM_MDL_CM_single 0 0 -3.4e+38 3.4e+38 ECU_ADDRESS 0x3FE7E0 /end MEASUREMENT
/begin MEASUREMENT LSM_RFM_LineCenter_Start "" FLOAT32_IEEE PubIfDecisionLSM_MDL_CM_single 0 0 -3.4e+38 3.4e+38 ECU_ADDRESS 0x3FE7DC /end MEASUREMENT
/begin MEASUREMENT LSM_RFM_LineCenter_Valid "" UBYTE PubIfDecisionLSM_MDL_CM_uint8 0 0 0 255 ECU_ADDRESS 0x3FE959 /end MEASUREMENT
/begin MEASUREMENT LSM_RFM_LineL1_C0 "" FLOAT32_IEEE PubIfDecisionLSM_MDL_CM_single 0 0 -3.4e+38 3.4e+38 ECU_ADDRESS 0x3FE7E4 /end MEASUREMENT
/begin MEASUREMENT LSM_RFM_LineL1_C1 "" FLOAT32_IEEE PubIfDecisionLSM_MDL_CM_single 0 0 -3.4e+38 3.4e+38 ECU_ADDRESS 0x3FE7E8 /end MEASUREMENT
/begin MEASUREMENT LSM_RFM_LineL1_C2 "" FLOAT32_IEEE PubIfDecisionLSM_MDL_CM_single 0 0 -3.4e+38 3.4e+38 ECU_ADDRESS 0x3FE7A8 /end MEASUREMENT
/begin MEASUREMENT LSM_RFM_LineL1_C3 "" FLOAT32_IEEE PubIfDecisionLSM_MDL_CM_single 0 0 -3.4e+38 3.4e+38 ECU_ADDRESS 0x3FE7AC /end MEASUREMENT
/begin MEASUREMENT LSM_RFM_LineL1_Front "" FLOAT32_IEEE PubIfDecisionLSM_MDL_CM_single 0 0 -3.4e+38 3.4e+38 ECU_ADDRESS 0x3FE7B4 /end MEASUREMENT
/begin MEASUREMENT LSM_RFM_LineL1_Start "" FLOAT32_IEEE PubIfDecisionLSM_MDL_CM_single 0 0 -3.4e+38 3.4e+38 ECU_ADDRESS 0x3FE7B0 /end MEASUREMENT
/begin MEASUREMENT LSM_RFM_LineL1_Valid "" UBYTE PubIfDecisionLSM_MDL_CM_uint8 0 0 0 255 ECU_ADDRESS 0x3FE95B /end MEASUREMENT
/begin MEASUREMENT LSM_RFM_LineR1_C0 "" FLOAT32_IEEE PubIfDecisionLSM_MDL_CM_single 0 0 -3.4e+38 3.4e+38 ECU_ADDRESS 0x3FE7C8 /end MEASUREMENT
/begin MEASUREMENT LSM_RFM_LineR1_C1 "" FLOAT32_IEEE PubIfDecisionLSM_MDL_CM_single 0 0 -3.4e+38 3.4e+38 ECU_ADDRESS 0x3FE7D0 /end MEASUREMENT
/begin MEASUREMENT LSM_RFM_LineR1_C2 "" FLOAT32_IEEE PubIfDecisionLSM_MDL_CM_single 0 0 -3.4e+38 3.4e+38 ECU_ADDRESS 0x3FE7B8 /end MEASUREMENT
/begin MEASUREMENT LSM_RFM_LineR1_C3 "" FLOAT32_IEEE PubIfDecisionLSM_MDL_CM_single 0 0 -3.4e+38 3.4e+38 ECU_ADDRESS 0x3FE7BC /end MEASUREMENT
/begin MEASUREMENT LSM_RFM_LineR1_Front "" FLOAT32_IEEE PubIfDecisionLSM_MDL_CM_single 0 0 -3.4e+38 3.4e+38 ECU_ADDRESS 0x3FE7C4 /end MEASUREMENT
/begin MEASUREMENT LSM_RFM_LineR1_Start "" FLOAT32_IEEE PubIfDecisionLSM_MDL_CM_single 0 0 -3.4e+38 3.4e+38 ECU_ADDRESS 0x3FE7C0 /end MEASUREMENT
/begin MEASUREMENT LSM_RFM_LineR1_Valid "" UBYTE PubIfDecisionLSM_MDL_CM_uint8 0 0 0 255 ECU_ADDRESS 0x3FE95A /end MEASUREMENT
/begin MEASUREMENT LongCtrl_ALC_intention "" SBYTE PubIfDecisionPLAN_MDL_CM_int8 0 0 -128 127 ECU_ADDRESS 0x3F3568 /end MEASUREMENT
/begin MEASUREMENT LongCtrl_BrakePrefer "" UBYTE PubIfDecisionPLAN_MDL_CM_boolean 0 0 0 1 BIT_MASK 0x1 ECU_ADDRESS 0x3F35C2 /end MEASUREMENT
/begin MEASUREMENT LongCtrl_Counter "" UBYTE PubIfControlLONC_MDL_CM_uint8 0 0 0 255 ECU_ADDRESS 0x3F24A0 /end MEASUREMENT
/begin MEASUREMENT LongCtrl_DecleToStop "" UBYTE Noa_Nofusion_CM_boolean 0 0 0 1 BIT_MASK 0x1 ECU_ADDRESS 0x3CAFCF /end MEASUREMENT
/begin MEASUREMENT LongCtrl_DriveOffConditonFulfilled "" UBYTE Noa_Nofusion_CM_boolean 0 0 0 1 BIT_MASK 0x1 ECU_ADDRESS 0x3CAFD0 /end MEASUREMENT
/begin MEASUREMENT LongCtrl_Follow_Counter "" UBYTE PubIfDecisionPLAN_MDL_CM_uint8 0 0 0 255 ECU_ADDRESS 0x3F3562 /end MEASUREMENT
/begin MEASUREMENT LongCtrl_IC_EHRV2_Cur "" FLOAT32_IEEE PubIfDecisionPLAN_MDL_CM_single 0 0 -3.4e+38 3.4e+38 ECU_ADDRESS 0x3F2DA4 /end MEASUREMENT
/begin MEASUREMENT LongCtrl_IC_EHRV2_CurDisMatrix "" FLOAT32_IEEE PubIfDecisionPLAN_MDL_CM_single 0 0 -3.4e+38 3.4e+38 ECU_ADDRESS 0x3F2DD0 MATRIX_DIM 10 1 1 LAYOUT ROW_DIR /end MEASUREMENT
/begin MEASUREMENT LongCtrl_IC_EHRV2_CurFar "" FLOAT32_IEEE PubIfDecisionPLAN_MDL_CM_single 0 0 -3.4e+38 3.4e+38 ECU_ADDRESS 0x3F2DA0 /end MEASUREMENT
/begin MEASUREMENT LongCtrl_IC_EHRV2_CurFarDis "" UWORD PubIfDecisionPLAN_MDL_CM_uint16 0 0 0 65535 ECU_ADDRESS 0x3F3524 /end MEASUREMENT
/begin MEASUREMENT LongCtrl_IC_EHRV2_CurMatrix "" FLOAT32_IEEE PubIfDecisionPLAN_MDL_CM_single 0 0 -3.4e+38 3.4e+38 ECU_ADDRESS 0x3F2DA8 MATRIX_DIM 10 1 1 LAYOUT ROW_DIR /end MEASUREMENT
/begin MEASUREMENT LongCtrl_IC_EHRV2_CurMatrixSize "" UBYTE PubIfDecisionPLAN_MDL_CM_uint8 0 0 0 255 ECU_ADDRESS 0x3F355D /end MEASUREMENT
/begin MEASUREMENT LongCtrl_L1_Avail_dis "" FLOAT32_IEEE PubIfDecisionPLAN_MDL_CM_single 0 0 -3.4e+38 3.4e+38 ECU_ADDRESS 0x3F2E00 /end MEASUREMENT
/begin MEASUREMENT LongCtrl_L1_Avail_time "" FLOAT32_IEEE PubIfDecisionPLAN_MDL_CM_single 0 0 -3.4e+38 3.4e+38 ECU_ADDRESS 0x3F2DFC /end MEASUREMENT
/begin MEASUREMENT LongCtrl_L1_KeepLineSts "" UBYTE PubIfDecisionPLAN_MDL_CM_uint8 0 0 0 255 ECU_ADDRESS 0x3F355E /end MEASUREMENT
/begin MEASUREMENT LongCtrl_L1_Line_std "" FLOAT32_IEEE PubIfDecisionPLAN_MDL_CM_single 0 0 -3.4e+38 3.4e+38 ECU_ADDRESS 0x3F2E0C /end MEASUREMENT
/begin MEASUREMENT LongCtrl_LC_DisMin "" FLOAT32_IEEE PubIfDecisionPLAN_MDL_CM_single 0 0 -3.4e+38 3.4e+38 ECU_ADDRESS 0x3F2FD8 /end MEASUREMENT
/begin MEASUREMENT LongCtrl_LC_Enable_Assess "" UBYTE PubIfDecisionPLAN_MDL_CM_boolean 0 0 0 1 BIT_MASK 0x1 ECU_ADDRESS 0x3F35C9 /end MEASUREMENT
/begin MEASUREMENT LongCtrl_LC_IDP0 "" UBYTE PubIfDecisionPLAN_MDL_CM_uint8 0 0 0 255 ECU_ADDRESS 0x3F3563 /end MEASUREMENT
/begin MEASUREMENT LongCtrl_LC_Objstate "" UBYTE PubIfDecisionPLAN_MDL_CM_uint8 0 0 0 255 ECU_ADDRESS 0x3F3564 /end MEASUREMENT
/begin MEASUREMENT LongCtrl_LC_axAbsGroundP0 "" FLOAT32_IEEE PubIfDecisionPLAN_MDL_CM_single 0 0 -3.4e+38 3.4e+38 ECU_ADDRESS 0x3F2F74 /end MEASUREMENT
/begin MEASUREMENT LongCtrl_LC_condition "" UBYTE PubIfDecisionPLAN_MDL_CM_boolean 0 0 0 1 BIT_MASK 0x1 ECU_ADDRESS 0x3F35CA /end MEASUREMENT
/begin MEASUREMENT LongCtrl_LC_distDesCur "" FLOAT32_IEEE PubIfDecisionPLAN_MDL_CM_single 0 0 -3.4e+38 3.4e+38 ECU_ADDRESS 0x3F2F7C /end MEASUREMENT
/begin MEASUREMENT LongCtrl_LC_distDesPlanCorr "" FLOAT32_IEEE PubIfDecisionPLAN_MDL_CM_single 0 0 -3.4e+38 3.4e+38 ECU_ADDRESS 0x3F2F80 MATRIX_DIM 20 1 1 LAYOUT ROW_DIR /end MEASUREMENT
/begin MEASUREMENT LongCtrl_LC_locationDis "" FLOAT32_IEEE PubIfDecisionPLAN_MDL_CM_single 0 0 -3.4e+38 3.4e+38 ECU_ADDRESS 0x3F2FD0 /end MEASUREMENT
/begin MEASUREMENT LongCtrl_LC_rangeP0 "" FLOAT32_IEEE PubIfDecisionPLAN_MDL_CM_single 0 0 -3.4e+38 3.4e+38 ECU_ADDRESS 0x3F2F78 /end MEASUREMENT
/begin MEASUREMENT LongCtrl_LC_targetExistP0 "" UBYTE PubIfDecisionPLAN_MDL_CM_boolean 0 0 0 1 BIT_MASK 0x1 ECU_ADDRESS 0x3F35C8 /end MEASUREMENT
/begin MEASUREMENT LongCtrl_LC_vxRelP0 "" FLOAT32_IEEE PubIfDecisionPLAN_MDL_CM_single 0 0 -3.4e+38 3.4e+38 ECU_ADDRESS 0x3F2F70 /end MEASUREMENT
/begin MEASUREMENT LongCtrl_P0_DisMin "" FLOAT32_IEEE PubIfDecisionPLAN_MDL_CM_single 0 0 -3.4e+38 3.4e+38 ECU_ADDRESS 0x3F2FD4 /end MEASUREMENT
/begin MEASUREMENT LongCtrl_R1_Avail_dis "" FLOAT32_IEEE PubIfDecisionPLAN_MDL_CM_single 0 0 -3.4e+38 3.4e+38 ECU_ADDRESS 0x3F2E04 /end MEASUREMENT
/begin MEASUREMENT LongCtrl_R1_Avail_time "" FLOAT32_IEEE PubIfDecisionPLAN_MDL_CM_single 0 0 -3.4e+38 3.4e+38 ECU_ADDRESS 0x3F2E08 /end MEASUREMENT
/begin MEASUREMENT LongCtrl_R1_KeepLineSts "" UBYTE PubIfDecisionPLAN_MDL_CM_uint8 0 0 0 255 ECU_ADDRESS 0x3F355F /end MEASUREMENT
/begin MEASUREMENT LongCtrl_R1_Line_std "" FLOAT32_IEEE PubIfDecisionPLAN_MDL_CM_single 0 0 -3.4e+38 3.4e+38 ECU_ADDRESS 0x3F2E10 /end MEASUREMENT
/begin MEASUREMENT LongCtrl_SW_VERSION "" ULONG PubIfControlLONC_MDL_CM_uint32 0 0 0 4294967295 ECU_ADDRESS 0x3F2458 /end MEASUREMENT
/begin MEASUREMENT LongCtrl_TgtObjBarDisp "" UBYTE PubIfDecisionPLAN_MDL_CM_uint8 0 0 0 255 ECU_ADDRESS 0x3F3560 /end MEASUREMENT
/begin MEASUREMENT LongCtrl_VlcInternalAcc "" FLOAT32_IEEE Noa_Nofusion_CM_single 0 0 -3.4e+38 3.4e+38 ECU_ADDRESS 0x3CAF8C /end MEASUREMENT
/begin MEASUREMENT LongCtrl_accelCC "" FLOAT32_IEEE PubIfDecisionPLAN_MDL_CM_single 0 0 -3.4e+38 3.4e+38 ECU_ADDRESS 0x3F2D98 /end MEASUREMENT
/begin MEASUREMENT LongCtrl_accelCCCtrlAfterJerk "" FLOAT32_IEEE PubIfDecisionPLAN_MDL_CM_single 0 0 -3.4e+38 3.4e+38 ECU_ADDRESS 0x3F2D9C /end MEASUREMENT
/begin MEASUREMENT LongCtrl_accelCurvature "" FLOAT32_IEEE PubIfDecisionPLAN_MDL_CM_single 0 0 -3.4e+38 3.4e+38 ECU_ADDRESS 0x3F2E1C /end MEASUREMENT
/begin MEASUREMENT LongCtrl_accelIC "" FLOAT32_IEEE PubIfDecisionPLAN_MDL_CM_single 0 0 -3.4e+38 3.4e+38 ECU_ADDRESS 0x3F34C8 /end MEASUREMENT
/begin MEASUREMENT LongCtrl_accelKap "" FLOAT32_IEEE PubIfDecisionPLAN_MDL_CM_single 0 0 -3.4e+38 3.4e+38 ECU_ADDRESS 0x3F2E30 /end MEASUREMENT
/begin MEASUREMENT LongCtrl_accelKapRun "" FLOAT32_IEEE PubIfDecisionPLAN_MDL_CM_single 0 0 -3.4e+38 3.4e+38 ECU_ADDRESS 0x3F2E24 /end MEASUREMENT
/begin MEASUREMENT LongCtrl_accelKapStartup "" FLOAT32_IEEE PubIfDecisionPLAN_MDL_CM_single 0 0 -3.4e+38 3.4e+38 ECU_ADDRESS 0x3F2E2C /end MEASUREMENT
/begin MEASUREMENT LongCtrl_accelKapStartupRaw "" FLOAT32_IEEE PubIfDecisionPLAN_MDL_CM_single 0 0 -3.4e+38 3.4e+38 ECU_ADDRESS 0x3F2E28 /end MEASUREMENT
/begin MEASUREMENT LongCtrl_curvatureForCurveDecel "" FLOAT32_IEEE PubIfDecisionPLAN_MDL_CM_single 0 0 -3.4e+38 3.4e+38 ECU_ADDRESS 0x3F2E18 /end MEASUREMENT
/begin MEASUREMENT LongCtrl_distRelPlanTerminate "" FLOAT32_IEEE PubIfDecisionPLAN_MDL_CM_single_m 0 0 -3.4e+38 3.4e+38 ECU_ADDRESS 0x3F2EFC MATRIX_DIM 1 20 1 LAYOUT ROW_DIR /end MEASUREMENT
/begin MEASUREMENT LongCtrl_kapFilt "" FLOAT32_IEEE PubIfDecisionPLAN_MDL_CM_single 0 0 -3.4e+38 3.4e+38 ECU_ADDRESS 0x3F2E20 /end MEASUREMENT
/begin MEASUREMENT LongCtrl_lowerBandIC "" FLOAT32_IEEE PubIfDecisionPLAN_MDL_CM_single 0 0 -3.4e+38 3.4e+38 ECU_ADDRESS 0x3F2E38 /end MEASUREMENT
/begin MEASUREMENT LongCtrl_lowerJerkCC "" FLOAT32_IEEE PubIfDecisionPLAN_MDL_CM_single 0 0 -3.4e+38 3.4e+38 ECU_ADDRESS 0x3F2E84 /end MEASUREMENT
/begin MEASUREMENT LongCtrl_lowerJerkIC "" FLOAT32_IEEE PubIfDecisionPLAN_MDL_CM_single 0 0 -3.4e+38 3.4e+38 ECU_ADDRESS 0x3F2E40 /end MEASUREMENT
/begin MEASUREMENT LongCtrl_upperBandIC "" FLOAT32_IEEE PubIfDecisionPLAN_MDL_CM_single 0 0 -3.4e+38 3.4e+38 ECU_ADDRESS 0x3F2E34 /end MEASUREMENT
/begin MEASUREMENT LongCtrl_upperJerkCC "" FLOAT32_IEEE PubIfDecisionPLAN_MDL_CM_single 0 0 -3.4e+38 3.4e+38 ECU_ADDRESS 0x3F2E88 /end MEASUREMENT
/begin MEASUREMENT LongCtrl_upperJerkIC "" FLOAT32_IEEE PubIfDecisionPLAN_MDL_CM_single 0 0 -3.4e+38 3.4e+38 ECU_ADDRESS 0x3F2E3C /end MEASUREMENT
/begin MEASUREMENT LongCtrl_velSubjPlanArb "" FLOAT32_IEEE PubIfDecisionPLAN_MDL_CM_single 0 0 -3.4e+38 3.4e+38 ECU_ADDRESS 0x3F2E64 MATRIX_DIM 1 8 1 LAYOUT ROW_DIR /end MEASUREMENT
/begin MEASUREMENT LongCtrl_velSubjPlanCC "" FLOAT32_IEEE PubIfDecisionPLAN_MDL_CM_single 0 0 -3.4e+38 3.4e+38 ECU_ADDRESS 0x3F34CC MATRIX_DIM 1 8 1 LAYOUT ROW_DIR /end MEASUREMENT
/begin MEASUREMENT LongCtrl_velSubjPlanFollow "" FLOAT32_IEEE PubIfDecisionPLAN_MDL_CM_single 0 0 -3.4e+38 3.4e+38 ECU_ADDRESS 0x3F2E44 MATRIX_DIM 1 8 1 LAYOUT ROW_DIR /end MEASUREMENT
/begin MEASUREMENT Longctrl_VIE_AxRefDt "" FLOAT32_IEEE Noa_Nofusion_CM_single 0 0 -3.4e+38 3.4e+38 ECU_ADDRESS 0x3CAF78 /end MEASUREMENT
/begin MEASUREMENT Longctrl_VIE_alpSideSlipAngle "" FLOAT32_IEEE Noa_Nofusion_CM_single 0 0 -3.4e+38 3.4e+38 ECU_ADDRESS 0x3CAF74 /end MEASUREMENT
/begin MEASUREMENT Longctrl_VIE_axRefMs2 "" FLOAT32_IEEE Noa_Nofusion_CM_single 0 0 -3.4e+38 3.4e+38 ECU_ADDRESS 0x3CAF7C /end MEASUREMENT
/begin MEASUREMENT ObjDYP0 "" FLOAT32_IEEE Noa_Nofusion_CM_single 0 0 -3.4e+38 3.4e+38 ECU_ADDRESS 0x3CAF88 /end MEASUREMENT
/begin MEASUREMENT PLAN_SW_VERSION "" UBYTE PubIfDecisionPLAN_MDL_CM_uint8 0 0 0 255 ECU_ADDRESS 0x3F352A /end MEASUREMENT
/begin MEASUREMENT PLAN_UpdateCnt "" UBYTE PubIfDecisionPLAN_MDL_CM_uint8 0 0 0 255 ECU_ADDRESS 0x3F3529 /end MEASUREMENT
/begin CHARACTERISTIC P_BCM_TurnLmpType "" VALUE 0x3CB091 Scalar_UBYTE 0 Noa_Nofusion_CM_uint8 0 255 /end CHARACTERISTIC
/begin CHARACTERISTIC P_Global_EQ2RearAxisY_m "摄像头光心到后轴中心点的Y向位置" VALUE 0x3B4CDC Scalar_FLOAT32_IEEE 0 Noa_Nofusion_CM_single_m -3.4e+38 3.4e+38 /end CHARACTERISTIC
/begin CHARACTERISTIC P_Global_SteeringAngleRatio "方向盘与前轮转角传动比" VALUE 0x3B4CF0 Scalar_FLOAT32_IEEE 0 Noa_Nofusion_CM_single -3.4e+38 3.4e+38 /end CHARACTERISTIC
/begin CHARACTERISTIC P_Global_VehicleWidthMin_m "最小车宽" VALUE 0x3B4CF8 Scalar_FLOAT32_IEEE 0 PubIfStateVSM_MDL_CM_single_m -3.4e+38 3.4e+38 /end CHARACTERISTIC
/begin CHARACTERISTIC P_Global_Vehicle_Length_m "车长" VALUE 0x3B4CFC Scalar_FLOAT32_IEEE 0 PubIfStateVSM_MDL_CM_single_m -3.4e+38 3.4e+38 /end CHARACTERISTIC
/begin CHARACTERISTIC P_HWA_TOS_P0HeadingAngle "" VALUE 0x3CAFD8 Scalar_FLOAT64_IEEE 0 Noa_Nofusion_CM_double -1.7e+308 1.7e+308 /end CHARACTERISTIC
/begin CHARACTERISTIC P_LCS_Offset_FliterTime "" VALUE 0x3B6F84 Scalar_FLOAT32_IEEE 0 PubIfControlLATC_MDL_CM_single -3.4e+38 3.4e+38 /end CHARACTERISTIC
/begin CHARACTERISTIC P_LCS_StateActiv_AngleSlope "" MAP 0x3B6FAC Lookup2D_FLOAT32_IEEE 0 PubIfControlLATC_MDL_CM_single -3.4e+38 3.4e+38
 /begin AXIS_DESCR COM_AXIS LCS_AngleSlope_Flg PubIfControlLATC_MDL_CM_uint8 4 0 255 DEPOSIT ABSOLUTE AXIS_PTS_REF P_LCS_StateActiveFlg_BP /end AXIS_DESCR
 /begin AXIS_DESCR COM_AXIS LCS_HoldTime PubIfControlLATC_MDL_CM_double 15 -1.7e+308 1.7e+308 DEPOSIT ABSOLUTE AXIS_PTS_REF P_LCS_StateActive_HoldTime_BP /end AXIS_DESCR
/end CHARACTERISTIC
/begin AXIS_PTS P_LCS_StateActiveFlg_BP "" 0x3B9F5C LCS_AngleSlope_Flg Lookup2D_X_UBYTE 0 PubIfControlLATC_MDL_CM_uint8 4 0 255 DEPOSIT ABSOLUTE /end AXIS_PTS
/begin AXIS_PTS P_LCS_StateActive_HoldTime_BP "" 0x3B4AA0 LCS_HoldTime Lookup2D_X_FLOAT64_IEEE 0 PubIfControlLATC_MDL_CM_double 15 -1.7e+308 1.7e+308 DEPOSIT ABSOLUTE /end AXIS_PTS
/begin CHARACTERISTIC P_LSM_AwayEdge_offset "" VALUE 0x3B8DB0 Scalar_FLOAT32_IEEE 0 PubIfDecisionLSM_MDL_CM_single -3.4e+38 3.4e+38 /end CHARACTERISTIC
/begin CHARACTERISTIC P_LSM_Line2Edge_limit "" VALUE 0x3B8DB8 Scalar_FLOAT32_IEEE 0 PubIfDecisionLSM_MDL_CM_single -3.4e+38 3.4e+38 /end CHARACTERISTIC
/begin CHARACTERISTIC P_LSM_Line_Error "" VALUE 0x3B4B28 Scalar_FLOAT64_IEEE 0 PubIfDecisionLSM_MDL_CM_double -1.7e+308 1.7e+308 /end CHARACTERISTIC
/begin CHARACTERISTIC P_LongCtrl_CCaccelCCNeg2PosJerk "" VALUE 0x3B8F94 Scalar_FLOAT32_IEEE 0 PubIfDecisionPLAN_MDL_CM_single_m_s_3 0 5 /end CHARACTERISTIC
/begin CHARACTERISTIC P_LongCtrl_CCaccelCCPosJerk "" VALUE 0x3B8F98 Scalar_FLOAT32_IEEE 0 PubIfDecisionPLAN_MDL_CM_single_m_s_3 0 4 /end CHARACTERISTIC
/begin CHARACTERISTIC P_LongCtrl_CCaccelLowerIsLaneChange "" VALUE 0x3B8F9C Scalar_FLOAT32_IEEE 0 PubIfDecisionPLAN_MDL_CM_single_m_s_2 0 2 /end CHARACTERISTIC
/begin CHARACTERISTIC P_LongCtrl_CCaccelMinFastDecel "" VALUE 0x3B8FA0 Scalar_FLOAT32_IEEE 0 PubIfDecisionPLAN_MDL_CM_single_m_s_2 -5 -1 /end CHARACTERISTIC
/begin CHARACTERISTIC P_LongCtrl_CCaccelMinNoFastDecel "" VALUE 0x3B8FA4 Scalar_FLOAT32_IEEE 0 PubIfDecisionPLAN_MDL_CM_single_m_s_2 -2 0 /end CHARACTERISTIC
/begin CHARACTERISTIC P_LongCtrl_CCaccelUpperCC "" VALUE 0x3B8FA8 Scalar_FLOAT32_IEEE 0 PubIfDecisionPLAN_MDL_CM_single_m_s_2 1 3 /end CHARACTERISTIC
/begin CHARACTERISTIC P_LongCtrl_CCaccelUpperCCSafeStop "" VALUE 0x3B8FAC Scalar_FLOAT32_IEEE 0 PubIfDecisionPLAN_MDL_CM_single_m_s_2 -2 0 /end CHARACTERISTIC
/begin CHARACTERISTIC P_LongCtrl_CCdecelCCJerk "" VALUE 0x3B8FB0 Scalar_FLOAT32_IEEE 0 PubIfDecisionPLAN_MDL_CM_single_m_s_3 -4 0 /end CHARACTERISTIC
/begin CHARACTERISTIC P_LongCtrl_CCdecelCCJerkNegVLCInternalAcc "" VALUE 0x3B8FB4 Scalar_FLOAT32_IEEE 0 PubIfDecisionPLAN_MDL_CM_single_m_s_3 -4 0 /end CHARACTERISTIC
/begin CHARACTERISTIC P_LongCtrl_FollowDrvOffDistCorrDistFullFillOverride "" VALUE 0x3B9038 Scalar_FLOAT32_IEEE 0 PubIfDecisionPLAN_MDL_CM_single_m 0 10 /end CHARACTERISTIC
/begin CHARACTERISTIC P_LongCtrl_FollowDrvOffDistCorrVelFullFillOverride "" VALUE 0x3B903C Scalar_FLOAT32_IEEE 0 PubIfDecisionPLAN_MDL_CM_single_m 0 5 /end CHARACTERISTIC
/begin CHARACTERISTIC P_LongCtrl_FollowDrvOffDistExitNoOverride "" VALUE 0x3B9040 Scalar_FLOAT32_IEEE 0 PubIfDecisionPLAN_MDL_CM_single_m 0 5 /end CHARACTERISTIC
/begin CHARACTERISTIC P_LongCtrl_FollowDrvOffDistExitOverride "" VALUE 0x3B9044 Scalar_FLOAT32_IEEE 0 PubIfDecisionPLAN_MDL_CM_single_m 0 5 /end CHARACTERISTIC
/begin CHARACTERISTIC P_LongCtrl_FollowDrvOffDistOffsetdDesiredAutoDrvOff "" VALUE 0x3B9048 Scalar_FLOAT32_IEEE 0 PubIfDecisionPLAN_MDL_CM_single_m 0 4 /end CHARACTERISTIC
/begin CHARACTERISTIC P_LongCtrl_FollowDrvOffStandstillVelThres "" VALUE 0x3B904C Scalar_FLOAT32_IEEE 0 PubIfDecisionPLAN_MDL_CM_single_m_s 0 5 /end CHARACTERISTIC
/begin CHARACTERISTIC P_LongCtrl_FollowDrvOffVelCorrVelFullFillOverride "" VALUE 0x3B9050 Scalar_FLOAT32_IEEE 0 PubIfDecisionPLAN_MDL_CM_single_m_s 0 1 /end CHARACTERISTIC
/begin CHARACTERISTIC P_LongCtrl_FollowDrvOffVelExitDistCorrNoOverride "" VALUE 0x3B9054 Scalar_FLOAT32_IEEE 0 PubIfDecisionPLAN_MDL_CM_single_m 0 5 /end CHARACTERISTIC
/begin CHARACTERISTIC P_LongCtrl_FollowDrvOffVelExitDistCorrOverride "" VALUE 0x3B9058 Scalar_FLOAT32_IEEE 0 PubIfDecisionPLAN_MDL_CM_single_m 0 5 /end CHARACTERISTIC
/begin CHARACTERISTIC P_LongCtrl_FollowDrvOffVelExitVelCorrNoOverride "" VALUE 0x3B905C Scalar_FLOAT32_IEEE 0 PubIfDecisionPLAN_MDL_CM_single_m_s 0 2 /end CHARACTERISTIC
/begin CHARACTERISTIC P_LongCtrl_FollowDrvOffVelExitVelCorrOverride "" VALUE 0x3B9060 Scalar_FLOAT32_IEEE 0 PubIfDecisionPLAN_MDL_CM_single_m_s 0 2 /end CHARACTERISTIC
/begin CHARACTERISTIC P_LongCtrl_FollowDrvOffVelRelMinAutoDrvOff "" VALUE 0x3B9064 Scalar_FLOAT32_IEEE 0 PubIfDecisionPLAN_MDL_CM_single_m_s 0 2 /end CHARACTERISTIC
/begin CHARACTERISTIC P_LongCtrl_FollowDrvOffdistRelMinAutoDrvOff "" VALUE 0x3B9068 Scalar_FLOAT32_IEEE 0 PubIfDecisionPLAN_MDL_CM_single_m 2 6 /end CHARACTERISTIC
/begin CHARACTERISTIC P_LongCtrl_FollowDrvOffvSetMinDriveOffConditions "" VALUE 0x3B906C Scalar_FLOAT32_IEEE 0 PubIfDecisionPLAN_MDL_CM_single_m_s 0 10 /end CHARACTERISTIC
/begin AXIS_PTS P_LongCtrl_ICCurvatureLimitSpdXAxis "" 0x3B9270 LongCtrl_curvatureForCurveDecel Lookup1D_X_FLOAT32_IEEE 0 PubIfDecisionPLAN_MDL_CM_single 10 0 1 DEPOSIT ABSOLUTE /end AXIS_PTS
/begin CHARACTERISTIC P_LongCtrl_ICCurvatureLimitSpdYAxis "" CURVE 0x3B9298 Lookup1D_FLOAT32_IEEE 0 PubIfDecisionPLAN_MDL_CM_single_km_h 0 150
 /begin AXIS_DESCR COM_AXIS LongCtrl_curvatureForCurveDecel PubIfDecisionPLAN_MDL_CM_single 10 0 1 DEPOSIT ABSOLUTE AXIS_PTS_REF P_LongCtrl_ICCurvatureLimitSpdXAxis /end AXIS_DESCR
/end CHARACTERISTIC
/begin CHARACTERISTIC P_LongCtrl_ICCurveDecelEnable "" VALUE 0x3B9F46 Scalar_BOOLEAN 0 PubIfDecisionPLAN_MDL_CM_boolean 0 1 BIT_MASK 0x1 /end CHARACTERISTIC
/begin AXIS_PTS P_LongCtrl_ICKapLimitAccelXAxis "" 0x3B92C0 LongCtrl_kapFilt Lookup1D_X_FLOAT32_IEEE 0 PubIfDecisionPLAN_MDL_CM_single 10 0 1 DEPOSIT ABSOLUTE /end AXIS_PTS
/begin CHARACTERISTIC P_LongCtrl_ICKapLimitAccelYAxis "" CURVE 0x3B92E8 Lookup1D_FLOAT32_IEEE 0 PubIfDecisionPLAN_MDL_CM_single 0 16
 /begin AXIS_DESCR COM_AXIS LongCtrl_kapFilt PubIfDecisionPLAN_MDL_CM_single 10 0 1 DEPOSIT ABSOLUTE AXIS_PTS_REF P_LongCtrl_ICKapLimitAccelXAxis /end AXIS_DESCR
/end CHARACTERISTIC
/begin AXIS_PTS P_LongCtrl_ICKapLimitSpdXAxis "" 0x3B9310 LongCtrl_kapFilt Lookup1D_X_FLOAT32_IEEE 0 PubIfDecisionPLAN_MDL_CM_single 10 0 1 DEPOSIT ABSOLUTE /end AXIS_PTS
/begin CHARACTERISTIC P_LongCtrl_ICKapLimitSpdYAxis "" CURVE 0x3B9338 Lookup1D_FLOAT32_IEEE 0 PubIfDecisionPLAN_MDL_CM_single 0 150
 /begin AXIS_DESCR COM_AXIS LongCtrl_kapFilt PubIfDecisionPLAN_MDL_CM_single 10 0 1 DEPOSIT ABSOLUTE AXIS_PTS_REF P_LongCtrl_ICKapLimitSpdXAxis /end AXIS_DESCR
/end CHARACTERISTIC
/begin CHARACTERISTIC P_LongCtrl_ICKapUpperJerkMin "" VALUE 0x3B9360 Scalar_FLOAT32_IEEE 0 PubIfDecisionPLAN_MDL_CM_single -3.4e+38 3.4e+38 /end CHARACTERISTIC
/begin CHARACTERISTIC P_LongCtrl_IC_EHRV2Enable "" VALUE 0x3CB07C Scalar_BOOLEAN 0 PubIfDecisionPLAN_MDL_CM_boolean 0 1 BIT_MASK 0x1 /end CHARACTERISTIC
/begin CHARACTERISTIC P_LongCtrl_IC_EHRV2Pretime "" VALUE 0x3B9364 Scalar_FLOAT32_IEEE 0 PubIfDecisionPLAN_MDL_CM_single -3.4e+38 3.4e+38 /end CHARACTERISTIC
/begin AXIS_PTS P_LongCtrl_IC_PreDisLimitByCurXAxis "" 0x3B9368 NO_INPUT_QUANTITY Lookup1D_X_FLOAT32_IEEE 0 PubIfDecisionPLAN_MDL_CM_single 10 0 1 DEPOSIT ABSOLUTE /end AXIS_PTS
/begin CHARACTERISTIC P_LongCtrl_IC_PreDisLimitByCurYAxis "" CURVE 0x3B9390 Lookup1D_FLOAT32_IEEE 0 PubIfDecisionPLAN_MDL_CM_single 0 150
 /begin AXIS_DESCR COM_AXIS NO_INPUT_QUANTITY PubIfDecisionPLAN_MDL_CM_single 10 0 1 DEPOSIT ABSOLUTE AXIS_PTS_REF P_LongCtrl_IC_PreDisLimitByCurXAxis /end AXIS_DESCR
/end CHARACTERISTIC
/begin CHARACTERISTIC P_LongCtrl_ICaccelThresEnableLine "" VALUE 0x3B93B8 Scalar_FLOAT32_IEEE 0 PubIfDecisionPLAN_MDL_CM_single_m_s_2 -2 1 /end CHARACTERISTIC
/begin CHARACTERISTIC P_LongCtrl_ICdeltaAccelLowerBand "" VALUE 0x3B941C Scalar_FLOAT32_IEEE 0 PubIfDecisionPLAN_MDL_CM_single_m_s_2 0 0.5 /end CHARACTERISTIC
/begin CHARACTERISTIC P_LongCtrl_ICdeltaAccelUpperBand "" VALUE 0x3B9420 Scalar_FLOAT32_IEEE 0 PubIfDecisionPLAN_MDL_CM_single_m_s_2 0 0.5 /end CHARACTERISTIC
/begin AXIS_PTS P_LongCtrl_IClowerJerkICCharXAxis "" 0x3B9424 LongCtrl_accelIC Lookup1D_X_FLOAT32_IEEE 0 PubIfDecisionPLAN_MDL_CM_single_m_s_2 3 -5 2 DEPOSIT ABSOLUTE /end AXIS_PTS
/begin CHARACTERISTIC P_LongCtrl_IClowerJerkICCharYAxis "" CURVE 0x3B9430 Lookup1D_FLOAT32_IEEE 0 PubIfDecisionPLAN_MDL_CM_single_m_s_3 -5 0
 /begin AXIS_DESCR COM_AXIS LongCtrl_accelIC PubIfDecisionPLAN_MDL_CM_single_m_s_2 3 -5 2 DEPOSIT ABSOLUTE AXIS_PTS_REF P_LongCtrl_IClowerJerkICCharXAxis /end AXIS_DESCR
/end CHARACTERISTIC
/begin CHARACTERISTIC P_LongCtrl_IClowerJerkPosVLCInternalAccMax "" VALUE 0x3B943C Scalar_FLOAT32_IEEE 0 PubIfDecisionPLAN_MDL_CM_single_m_s_3 -5 0 /end CHARACTERISTIC
/begin CHARACTERISTIC P_LongCtrl_IClowerJerkPosVLCInternalAccMin "" VALUE 0x3B9440 Scalar_FLOAT32_IEEE 0 PubIfDecisionPLAN_MDL_CM_single_m_s_3 -5 0 /end CHARACTERISTIC
/begin CHARACTERISTIC P_LongCtrl_ICtDecel "" VALUE 0x3B9444 Scalar_FLOAT32_IEEE 0 PubIfDecisionPLAN_MDL_CM_single_s 2 10 /end CHARACTERISTIC
/begin AXIS_PTS P_LongCtrl_ICupperJerkICCharXAxis "" 0x3B9448 LongCtrl_accelIC Lookup1D_X_FLOAT32_IEEE 0 PubIfDecisionPLAN_MDL_CM_single_m_s_2 3 -2 2 DEPOSIT ABSOLUTE /end AXIS_PTS
/begin CHARACTERISTIC P_LongCtrl_ICupperJerkICCharYAxis "" CURVE 0x3B9454 Lookup1D_FLOAT32_IEEE 0 PubIfDecisionPLAN_MDL_CM_single_m_s_3 0 3
 /begin AXIS_DESCR COM_AXIS LongCtrl_accelIC PubIfDecisionPLAN_MDL_CM_single_m_s_2 3 -2 2 DEPOSIT ABSOLUTE AXIS_PTS_REF P_LongCtrl_ICupperJerkICCharXAxis /end AXIS_DESCR
/end CHARACTERISTIC
/begin CHARACTERISTIC P_LongCtrl_KeepLaneSurDis "" VALUE 0x3B9460 Scalar_FLOAT32_IEEE 0 PubIfDecisionPLAN_MDL_CM_single_m -3.4e+38 3.4e+38 /end CHARACTERISTIC
/begin CHARACTERISTIC P_LongCtrl_KeepLaneTime "" VALUE 0x3B9464 Scalar_FLOAT32_IEEE 0 PubIfDecisionPLAN_MDL_CM_single_s -3.4e+38 3.4e+38 /end CHARACTERISTIC
/begin CHARACTERISTIC P_LongCtrl_LC_LowerAccelLimit "" VALUE 0x3B9470 Scalar_FLOAT32_IEEE 0 PubIfDecisionPLAN_MDL_CM_single -3.4e+38 3.4e+38 /end CHARACTERISTIC
/begin CHARACTERISTIC P_LongCtrl_LC_LowerJerkLimit "" VALUE 0x3B9474 Scalar_FLOAT32_IEEE 0 PubIfDecisionPLAN_MDL_CM_single -3.4e+38 3.4e+38 /end CHARACTERISTIC
/begin CHARACTERISTIC P_LongCtrl_LC_UpperAccelLimit "" VALUE 0x3B9484 Scalar_FLOAT32_IEEE 0 PubIfDecisionPLAN_MDL_CM_single -3.4e+38 3.4e+38 /end CHARACTERISTIC
/begin CHARACTERISTIC P_LongCtrl_LC_UpperJerkLimit "" VALUE 0x3B9488 Scalar_FLOAT32_IEEE 0 PubIfDecisionPLAN_MDL_CM_single -3.4e+38 3.4e+38 /end CHARACTERISTIC
/begin CHARACTERISTIC P_LongCtrl_LaneAvailDis "" VALUE 0x3B948C Scalar_FLOAT32_IEEE 0 PubIfDecisionPLAN_MDL_CM_single 0 100 /end CHARACTERISTIC
/begin CHARACTERISTIC P_LongCtrl_LaneAvailStd "" VALUE 0x3B9490 Scalar_FLOAT32_IEEE 0 PubIfDecisionPLAN_MDL_CM_single 0 1 /end CHARACTERISTIC
/begin CHARACTERISTIC P_LongCtrl_LaneAvailStdAverage "" VALUE 0x3B9494 Scalar_FLOAT32_IEEE 0 PubIfDecisionPLAN_MDL_CM_single 0 1 /end CHARACTERISTIC
/begin CHARACTERISTIC P_LongCtrl_LaneAvailStdMax "" VALUE 0x3B9498 Scalar_FLOAT32_IEEE 0 PubIfDecisionPLAN_MDL_CM_single 0 1 /end CHARACTERISTIC
/begin CHARACTERISTIC P_LongCtrl_LaneAvailTime "" VALUE 0x3B949C Scalar_FLOAT32_IEEE 0 PubIfDecisionPLAN_MDL_CM_single 0 10 /end CHARACTERISTIC
/begin CHARACTERISTIC P_LongCtrl_ORDtAcceleTimeNeg "" VALUE 0x3B94A0 Scalar_FLOAT32_IEEE 0 PubIfDecisionPLAN_MDL_CM_single_s 5 30 /end CHARACTERISTIC
/begin CHARACTERISTIC P_LongCtrl_ORDtAcceleTimePos "" VALUE 0x3B94A4 Scalar_FLOAT32_IEEE 0 PubIfDecisionPLAN_MDL_CM_single_s 1 40 /end CHARACTERISTIC
/begin CHARACTERISTIC P_LongCtrl_SJVlcInternalAccThresEnableBrkPrefer "" VALUE 0x3B94AC Scalar_FLOAT32_IEEE 0 PubIfDecisionPLAN_MDL_CM_single_m_s_2 -1 2 /end CHARACTERISTIC
/begin CHARACTERISTIC P_LongCtrl_SJaccelFollowThresEnableBrkPrefer "" VALUE 0x3CB038 Scalar_FLOAT32_IEEE 0 PubIfDecisionPLAN_MDL_CM_single_m_s_2 -3 1 /end CHARACTERISTIC
/begin CHARACTERISTIC P_LongCtrl_SJaccelSubjPlanOptThresEnableBrkPrefer "" VALUE 0x3B94B0 Scalar_FLOAT32_IEEE 0 PubIfDecisionPLAN_MDL_CM_single_m_s_2 -5 0 /end CHARACTERISTIC
/begin CHARACTERISTIC P_LongCtrl_SJaccelSubjThresEnableBrkPrefer "" VALUE 0x3B94B4 Scalar_FLOAT32_IEEE 0 PubIfDecisionPLAN_MDL_CM_single_m_s_2 -2 1 /end CHARACTERISTIC
/begin CHARACTERISTIC P_LongCtrl_SJaxvRoadSlopeThresEnableBrkPrefer "" VALUE 0x3B94B8 Scalar_FLOAT32_IEEE 0 PubIfDecisionPLAN_MDL_CM_single_m_s_2 -3 4 /end CHARACTERISTIC
/begin CHARACTERISTIC P_LongCtrl_SJttcThresEnableBrkPrefer "" VALUE 0x3B94C0 Scalar_FLOAT32_IEEE 0 PubIfDecisionPLAN_MDL_CM_single_s 0 20 /end CHARACTERISTIC
/begin CHARACTERISTIC P_LongCtrl_SJvelSubjThresEnableBrkPrefer "" VALUE 0x3B94C4 Scalar_FLOAT32_IEEE 0 PubIfDecisionPLAN_MDL_CM_single_m_s 0 30 /end CHARACTERISTIC
/begin AXIS_PTS P_LongCtrl_distThreDecToStopXAxis "" 0x3B9674 NO_INPUT_QUANTITY Lookup1D_X_FLOAT32_IEEE 0 PubIfDecisionPLAN_MDL_CM_single_m_s_2 3 0 5 DEPOSIT ABSOLUTE /end AXIS_PTS
/begin CHARACTERISTIC P_LongCtrl_distThreDecToStopYAxis "" CURVE 0x3B9680 Lookup1D_FLOAT32_IEEE 0 PubIfDecisionPLAN_MDL_CM_single_m 0 30
 /begin AXIS_DESCR COM_AXIS NO_INPUT_QUANTITY PubIfDecisionPLAN_MDL_CM_single_m_s_2 3 0 5 DEPOSIT ABSOLUTE AXIS_PTS_REF P_LongCtrl_distThreDecToStopXAxis /end AXIS_DESCR
/end CHARACTERISTIC
/begin CHARACTERISTIC P_LongCtrl_velSubjThreDecToStop "" VALUE 0x3B9690 Scalar_FLOAT32_IEEE 0 PubIfDecisionPLAN_MDL_CM_single_m_s 0 10 /end CHARACTERISTIC
/begin CHARACTERISTIC P_LongCtrl_velTargetThreDecleToStop "" VALUE 0x3B9694 Scalar_FLOAT32_IEEE 0 PubIfDecisionPLAN_MDL_CM_single_m_s 0 10 /end CHARACTERISTIC
/begin CHARACTERISTIC P_RFM_RoadType "" VALUE 0x3B9F64 Scalar_UBYTE 0 Noa_Nofusion_CM_uint8 0 255 /end CHARACTERISTIC
/begin CHARACTERISTIC P_RFM_mapvalid "" VALUE 0x3B9F65 Scalar_UBYTE 0 Noa_Nofusion_CM_uint8 0 255 /end CHARACTERISTIC
/begin CHARACTERISTIC P_TOSS_DxOffset "" VALUE 0x3B9854 Scalar_FLOAT32_IEEE 0 Noa_Nofusion_CM_single -3.4e+38 3.4e+38 /end CHARACTERISTIC
/begin CHARACTERISTIC P_VSM_ALCSwtReq "" VALUE 0x3CB082 Scalar_BOOLEAN 0 PubIfStateVSM_MDL_CM_boolean 0 1 BIT_MASK 0x1 /end CHARACTERISTIC
/begin CHARACTERISTIC P_VSM_LCKIE_LatC_DisOffofLanWidth "" CURVE 0x3B9AD8 Lookup1D_FLOAT32_IEEE 0 PubIfStateVSM_MDL_CM_single -3.4e+38 3.4e+38
 /begin AXIS_DESCR COM_AXIS VSM_LCKIE_OS_RoadWidth PubIfStateVSM_MDL_CM_single 4 -3.4e+38 3.4e+38 DEPOSIT ABSOLUTE AXIS_PTS_REF P_VSM_LCKIE_LatC_LanWidth /end AXIS_DESCR
/end CHARACTERISTIC
/begin CHARACTERISTIC P_VSM_LCKIE_LatC_DisOffofSpd "" CURVE 0x3B9AE8 Lookup1D_FLOAT32_IEEE 0 PubIfStateVSM_MDL_CM_single -3.4e+38 3.4e+38
 /begin AXIS_DESCR COM_AXIS NO_INPUT_QUANTITY PubIfStateVSM_MDL_CM_single 6 -3.4e+38 3.4e+38 DEPOSIT ABSOLUTE AXIS_PTS_REF P_VSM_LCKIE_LatC_Spd /end AXIS_DESCR
/end CHARACTERISTIC
/begin AXIS_PTS P_VSM_LCKIE_LatC_LanWidth "" 0x3B9B00 VSM_LCKIE_OS_RoadWidth Lookup1D_X_FLOAT32_IEEE 0 PubIfStateVSM_MDL_CM_single 4 -3.4e+38 3.4e+38 DEPOSIT ABSOLUTE /end AXIS_PTS
/begin CHARACTERISTIC P_VSM_LCKIE_LatC_LimitDisEgoToObjSelt "" VALUE 0x3B9B10 Scalar_FLOAT32_IEEE 0 PubIfStateVSM_MDL_CM_single -3.4e+38 3.4e+38 /end CHARACTERISTIC
/begin CHARACTERISTIC P_VSM_LCKIE_LatC_LimitEgoToOppLane "" VALUE 0x3B9B14 Scalar_FLOAT32_IEEE 0 PubIfStateVSM_MDL_CM_single -3.4e+38 3.4e+38 /end CHARACTERISTIC
/begin CHARACTERISTIC P_VSM_LCKIE_LatC_MoveEnableDis "" VALUE 0x3CB06C Scalar_FLOAT32_IEEE 0 PubIfStateVSM_MDL_CM_single -3.4e+38 3.4e+38 /end CHARACTERISTIC
/begin CHARACTERISTIC P_VSM_LCKIE_LatC_RESafDis "" VALUE 0x3B9B18 Scalar_FLOAT32_IEEE 0 PubIfStateVSM_MDL_CM_single -3.4e+38 3.4e+38 /end CHARACTERISTIC
/begin CHARACTERISTIC P_VSM_LCKIE_LatC_SafeDisofLanWidth "" CURVE 0x3B9B1C Lookup1D_FLOAT32_IEEE 0 PubIfStateVSM_MDL_CM_single -3.4e+38 3.4e+38
 /begin AXIS_DESCR COM_AXIS VSM_LCKIE_OS_RoadWidth PubIfStateVSM_MDL_CM_single 4 -3.4e+38 3.4e+38 DEPOSIT ABSOLUTE AXIS_PTS_REF P_VSM_LCKIE_LatC_LanWidth /end AXIS_DESCR
/end CHARACTERISTIC
/begin AXIS_PTS P_VSM_LCKIE_LatC_Spd "" 0x3B9B2C NO_INPUT_QUANTITY Lookup1D_X_FLOAT32_IEEE 0 PubIfStateVSM_MDL_CM_single 6 -3.4e+38 3.4e+38 DEPOSIT ABSOLUTE /end AXIS_PTS
/begin CHARACTERISTIC P_VSM_LCKIE_LatC_maxLimitDisREToLane "" VALUE 0x3B9B44 Scalar_FLOAT32_IEEE 0 PubIfStateVSM_MDL_CM_single -3.4e+38 3.4e+38 /end CHARACTERISTIC
/begin CHARACTERISTIC P_VSM_LCKIE_LatC_minLimitDisREToLane "" VALUE 0x3B9B48 Scalar_FLOAT32_IEEE 0 PubIfStateVSM_MDL_CM_single -3.4e+38 3.4e+38 /end CHARACTERISTIC
/begin AXIS_PTS P_VSM_LCKIE_LongC_DetaSpd "" 0x3B9B4C VSM_LCKIE_OS_DetaSpdSelect Lookup1D_X_FLOAT32_IEEE 0 PubIfStateVSM_MDL_CM_single 3 -3.4e+38 3.4e+38 DEPOSIT ABSOLUTE /end AXIS_PTS
/begin CHARACTERISTIC P_VSM_LCKIE_LongC_DirecChangeDis "" VALUE 0x3B9B58 Scalar_FLOAT32_IEEE 0 PubIfStateVSM_MDL_CM_single -3.4e+38 3.4e+38 /end CHARACTERISTIC
/begin CHARACTERISTIC P_VSM_LCKIE_LongC_FleetOff "" VALUE 0x3B9B5C Scalar_FLOAT32_IEEE 0 PubIfStateVSM_MDL_CM_single -3.4e+38 3.4e+38 /end CHARACTERISTIC
/begin CHARACTERISTIC P_VSM_LCKIE_LongC_ShutDownLongDis "" VALUE 0x3B9B60 Scalar_FLOAT32_IEEE 0 PubIfStateVSM_MDL_CM_single -3.4e+38 3.4e+38 /end CHARACTERISTIC
/begin CHARACTERISTIC P_VSM_LCKIE_LongC_ShutDownTTC "" VALUE 0x3B9B64 Scalar_FLOAT32_IEEE 0 PubIfStateVSM_MDL_CM_single -3.4e+38 3.4e+38 /end CHARACTERISTIC
/begin AXIS_PTS P_VSM_LCKIE_LongC_Spd "" 0x3B9B68 NO_INPUT_QUANTITY Lookup1D_X_FLOAT32_IEEE 0 PubIfStateVSM_MDL_CM_single 6 -3.4e+38 3.4e+38 DEPOSIT ABSOLUTE /end AXIS_PTS
/begin CHARACTERISTIC P_VSM_LCKIE_LongC_d1 "" CURVE 0x3B9B80 Lookup1D_FLOAT32_IEEE 0 PubIfStateVSM_MDL_CM_single -3.4e+38 3.4e+38
 /begin AXIS_DESCR COM_AXIS NO_INPUT_QUANTITY PubIfStateVSM_MDL_CM_single 6 -3.4e+38 3.4e+38 DEPOSIT ABSOLUTE AXIS_PTS_REF P_VSM_LCKIE_LongC_Spd /end AXIS_DESCR
/end CHARACTERISTIC
/begin CHARACTERISTIC P_VSM_LCKIE_LongC_d2 "" CURVE 0x3B9B98 Lookup1D_FLOAT32_IEEE 0 PubIfStateVSM_MDL_CM_single -3.4e+38 3.4e+38
 /begin AXIS_DESCR COM_AXIS VSM_LCKIE_OS_DetaSpdSelect PubIfStateVSM_MDL_CM_single 3 -3.4e+38 3.4e+38 DEPOSIT ABSOLUTE AXIS_PTS_REF P_VSM_LCKIE_LongC_DetaSpd /end AXIS_DESCR
/end CHARACTERISTIC
/begin CHARACTERISTIC P_VSM_LCKIE_LongC_maxDis "" VALUE 0x3B9BA4 Scalar_FLOAT32_IEEE 0 PubIfStateVSM_MDL_CM_single -3.4e+38 3.4e+38 /end CHARACTERISTIC
/begin CHARACTERISTIC P_VSM_LCKIE_LongC_minDis "" VALUE 0x3B9BA8 Scalar_FLOAT32_IEEE 0 PubIfStateVSM_MDL_CM_single -3.4e+38 3.4e+38 /end CHARACTERISTIC
/begin CHARACTERISTIC P_VSM_LCKIE_LongC_toff "" VALUE 0x3B9BAC Scalar_FLOAT32_IEEE 0 PubIfStateVSM_MDL_CM_single -3.4e+38 3.4e+38 /end CHARACTERISTIC
/begin CHARACTERISTIC P_VSM_LCKIE_OFC_ActDis "" VALUE 0x3B9BB0 Scalar_FLOAT32_IEEE 0 PubIfStateVSM_MDL_CM_single -3.4e+38 3.4e+38 /end CHARACTERISTIC
/begin CHARACTERISTIC P_VSM_LCKIE_OFC_DownDis "" VALUE 0x3B9BB4 Scalar_FLOAT32_IEEE 0 PubIfStateVSM_MDL_CM_single -3.4e+38 3.4e+38 /end CHARACTERISTIC
/begin CHARACTERISTIC P_VSM_LCKIE_OFC_DownTTC "" VALUE 0x3B9BB8 Scalar_FLOAT32_IEEE 0 PubIfStateVSM_MDL_CM_single -3.4e+38 3.4e+38 /end CHARACTERISTIC
/begin CHARACTERISTIC P_VSM_LCKIE_OFC_SafDis "" VALUE 0x3B9BBC Scalar_FLOAT32_IEEE 0 PubIfStateVSM_MDL_CM_single -3.4e+38 3.4e+38 /end CHARACTERISTIC
/begin CHARACTERISTIC P_VSM_LCKIE_OFC_Toff "" VALUE 0x3B9BC0 Scalar_FLOAT32_IEEE 0 PubIfStateVSM_MDL_CM_single -3.4e+38 3.4e+38 /end CHARACTERISTIC
/begin CHARACTERISTIC P_VSM_LCKIE_ORC_LatDis "" VALUE 0x3B9BC4 Scalar_FLOAT32_IEEE 0 PubIfStateVSM_MDL_CM_single -3.4e+38 3.4e+38 /end CHARACTERISTIC
/begin CHARACTERISTIC P_VSM_LCKIE_ORC_LimitDis1 "" VALUE 0x3B9BC8 Scalar_FLOAT32_IEEE 0 PubIfStateVSM_MDL_CM_single -3.4e+38 3.4e+38 /end CHARACTERISTIC
/begin CHARACTERISTIC P_VSM_LCKIE_ORC_LimitDis2 "" VALUE 0x3B9BCC Scalar_FLOAT32_IEEE 0 PubIfStateVSM_MDL_CM_single -3.4e+38 3.4e+38 /end CHARACTERISTIC
/begin CHARACTERISTIC P_VSM_LCKIE_ORC_LimitTTC "" VALUE 0x3B9BD0 Scalar_FLOAT32_IEEE 0 PubIfStateVSM_MDL_CM_single -3.4e+38 3.4e+38 /end CHARACTERISTIC
/begin CHARACTERISTIC P_VSM_LCKIE_ORC_LowSpd "" VALUE 0x3B9BD4 Scalar_FLOAT32_IEEE 0 PubIfStateVSM_MDL_CM_single -3.4e+38 3.4e+38 /end CHARACTERISTIC
/begin CHARACTERISTIC P_VSM_LCKIE_POC_Delaytime "" VAL_BLK 0x3B9BD8 Scalar_FLOAT32_IEEE 0 PubIfStateVSM_MDL_CM_single -3.4e+38 3.4e+38 MATRIX_DIM 1 6 1 /end CHARACTERISTIC
/begin CHARACTERISTIC P_VSM_LCKIE_POC_LimitDis "" VALUE 0x3B9BF0 Scalar_FLOAT32_IEEE 0 PubIfStateVSM_MDL_CM_single -3.4e+38 3.4e+38 /end CHARACTERISTIC
/begin CHARACTERISTIC P_VSM_LCKIE_POC_LimitTTC "" VALUE 0x3B9BF4 Scalar_FLOAT32_IEEE 0 PubIfStateVSM_MDL_CM_single -3.4e+38 3.4e+38 /end CHARACTERISTIC
/begin CHARACTERISTIC P_VSM_LCKIE_POC_detaSpd "" VAL_BLK 0x3B9BF8 Scalar_FLOAT32_IEEE 0 PubIfStateVSM_MDL_CM_single -3.4e+38 3.4e+38 MATRIX_DIM 1 6 1 /end CHARACTERISTIC
/begin CHARACTERISTIC P_VSM_LCKIE_State_DriverInputTrqValue_enable "" VALUE 0x3B9C10 Scalar_FLOAT32_IEEE 0 PubIfStateVSM_MDL_CM_single -3.4e+38 3.4e+38 /end CHARACTERISTIC
/begin CHARACTERISTIC P_VSM_LCKIE_State_ELKObjClc "" VALUE 0x3B9C14 Scalar_FLOAT32_IEEE 0 PubIfStateVSM_MDL_CM_single -3.4e+38 3.4e+38 /end CHARACTERISTIC
/begin CHARACTERISTIC P_VSM_LCKIE_State_HWASts_disable "" VALUE 0x3B9C18 Scalar_FLOAT32_IEEE 0 PubIfStateVSM_MDL_CM_single -3.4e+38 3.4e+38 /end CHARACTERISTIC
/begin CHARACTERISTIC P_VSM_LCKIE_State_IEObjClc "" VALUE 0x3B9C1C Scalar_FLOAT32_IEEE 0 PubIfStateVSM_MDL_CM_single -3.4e+38 3.4e+38 /end CHARACTERISTIC
/begin CHARACTERISTIC P_VSM_LCKIE_State_IFVReady "" VALUE 0x3B9C20 Scalar_FLOAT32_IEEE 0 PubIfStateVSM_MDL_CM_single -3.4e+38 3.4e+38 /end CHARACTERISTIC
/begin CHARACTERISTIC P_VSM_LCKIE_State_LaneWidth_enable "" VALUE 0x3B9C24 Scalar_FLOAT32_IEEE 0 PubIfStateVSM_MDL_CM_single -3.4e+38 3.4e+38 /end CHARACTERISTIC
/begin CHARACTERISTIC P_VSM_LCKIE_State_Lanecurve_enable "" VALUE 0x3B9C28 Scalar_FLOAT32_IEEE 0 PubIfStateVSM_MDL_CM_single -3.4e+38 3.4e+38 /end CHARACTERISTIC
/begin CHARACTERISTIC P_VSM_LCKIE_State_Off2on "" VALUE 0x3B9C2C Scalar_FLOAT32_IEEE 0 PubIfStateVSM_MDL_CM_single -3.4e+38 3.4e+38 /end CHARACTERISTIC
/begin CHARACTERISTIC P_VSM_LCKIE_State_OppObjClc "" VALUE 0x3B9C30 Scalar_FLOAT32_IEEE 0 PubIfStateVSM_MDL_CM_single -3.4e+38 3.4e+38 /end CHARACTERISTIC
/begin CHARACTERISTIC P_VSM_LCKIE_State_Vehspeed_enable "" VALUE 0x3B9C34 Scalar_FLOAT32_IEEE 0 PubIfStateVSM_MDL_CM_single -3.4e+38 3.4e+38 /end CHARACTERISTIC
/begin CHARACTERISTIC P_VSM_LCKIE_State_detaspd "" VALUE 0x3B9C38 Scalar_FLOAT32_IEEE 0 PubIfStateVSM_MDL_CM_single -3.4e+38 3.4e+38 /end CHARACTERISTIC
/begin CHARACTERISTIC P_VSM_LCKIE_State_detaspd_enable "" VALUE 0x3B9C3C Scalar_FLOAT32_IEEE 0 PubIfStateVSM_MDL_CM_single -3.4e+38 3.4e+38 /end CHARACTERISTIC
/begin CHARACTERISTIC P_VSM_LCKIE_State_lamb_enable "" VALUE 0x3B9C40 Scalar_FLOAT32_IEEE 0 PubIfStateVSM_MDL_CM_single -3.4e+38 3.4e+38 /end CHARACTERISTIC
/begin CHARACTERISTIC P_VSM_LCKIE_State_wiper_enable "" VALUE 0x3B9C44 Scalar_FLOAT32_IEEE 0 PubIfStateVSM_MDL_CM_single -3.4e+38 3.4e+38 /end CHARACTERISTIC
/begin CHARACTERISTIC P_VSM_LCKIE_tcycle "" VALUE 0x3B9C48 Scalar_FLOAT32_IEEE 0 PubIfStateVSM_MDL_CM_single -3.4e+38 3.4e+38 /end CHARACTERISTIC
/begin CHARACTERISTIC P_VSM_LDW_AbsEspInTime "" VALUE 0x3B4BD0 Scalar_FLOAT64_IEEE 0 PubIfStateVSM_MDL_CM_double -1.7e+308 1.7e+308 /end CHARACTERISTIC
/begin CHARACTERISTIC P_VSM_LDW_AccPedalOut "" VALUE 0x3B9CF4 Scalar_FLOAT32_IEEE 0 PubIfStateVSM_MDL_CM_single -3.4e+38 3.4e+38 /end CHARACTERISTIC
/begin CHARACTERISTIC P_VSM_LDW_AccRateIn "" VALUE 0x3B9CF8 Scalar_FLOAT32_IEEE 0 PubIfStateVSM_MDL_CM_single -3.4e+38 3.4e+38 /end CHARACTERISTIC
/begin CHARACTERISTIC P_VSM_LDW_AccRateInTime "" VALUE 0x3B4BD8 Scalar_FLOAT64_IEEE 0 PubIfStateVSM_MDL_CM_double -1.7e+308 1.7e+308 /end CHARACTERISTIC
/begin CHARACTERISTIC P_VSM_LDW_AccRateOut "" VALUE 0x3B9CFC Scalar_FLOAT32_IEEE 0 PubIfStateVSM_MDL_CM_single -3.4e+38 3.4e+38 /end CHARACTERISTIC
/begin CHARACTERISTIC P_VSM_LDW_BrakePressIn "" VALUE 0x3B9D00 Scalar_FLOAT32_IEEE 0 PubIfStateVSM_MDL_CM_single -3.4e+38 3.4e+38 /end CHARACTERISTIC
/begin CHARACTERISTIC P_VSM_LDW_BrakePressInTime "" VALUE 0x3B4BE0 Scalar_FLOAT64_IEEE 0 PubIfStateVSM_MDL_CM_double -1.7e+308 1.7e+308 /end CHARACTERISTIC
/begin CHARACTERISTIC P_VSM_LDW_BrakePressOut "" VALUE 0x3B9D04 Scalar_FLOAT32_IEEE 0 PubIfStateVSM_MDL_CM_single -3.4e+38 3.4e+38 /end CHARACTERISTIC
/begin CHARACTERISTIC P_VSM_LDW_LaneCurveIn "" VALUE 0x3B9D08 Scalar_FLOAT32_IEEE 0 PubIfStateVSM_MDL_CM_single -3.4e+38 3.4e+38 /end CHARACTERISTIC
/begin CHARACTERISTIC P_VSM_LDW_LaneCurveOut "" VALUE 0x3B9D0C Scalar_FLOAT32_IEEE 0 PubIfStateVSM_MDL_CM_single -3.4e+38 3.4e+38 /end CHARACTERISTIC
/begin CHARACTERISTIC P_VSM_LDW_LateralAcceIn "" VALUE 0x3B9D10 Scalar_FLOAT32_IEEE 0 PubIfStateVSM_MDL_CM_single -3.4e+38 3.4e+38 /end CHARACTERISTIC
/begin CHARACTERISTIC P_VSM_LDW_LateralAcceInTime "" VALUE 0x3B4BE8 Scalar_FLOAT64_IEEE 0 PubIfStateVSM_MDL_CM_double -1.7e+308 1.7e+308 /end CHARACTERISTIC
/begin CHARACTERISTIC P_VSM_LDW_LateralAcceOut "" VALUE 0x3B9D14 Scalar_FLOAT32_IEEE 0 PubIfStateVSM_MDL_CM_single -3.4e+38 3.4e+38 /end CHARACTERISTIC
/begin CHARACTERISTIC P_VSM_LDW_LongitudeAccIn "" VALUE 0x3B9D18 Scalar_FLOAT32_IEEE 0 PubIfStateVSM_MDL_CM_single -3.4e+38 3.4e+38 /end CHARACTERISTIC
/begin CHARACTERISTIC P_VSM_LDW_LongitudeAccInTime "" VALUE 0x3B4BF0 Scalar_FLOAT64_IEEE 0 PubIfStateVSM_MDL_CM_double -1.7e+308 1.7e+308 /end CHARACTERISTIC
/begin CHARACTERISTIC P_VSM_LDW_LongitudeAccOut "" VALUE 0x3B9D1C Scalar_FLOAT32_IEEE 0 PubIfStateVSM_MDL_CM_single -3.4e+38 3.4e+38 /end CHARACTERISTIC
/begin CHARACTERISTIC P_VSM_LDW_State_Absesp_enable "" VALUE 0x3B9D20 Scalar_FLOAT32_IEEE 0 PubIfStateVSM_MDL_CM_single -3.4e+38 3.4e+38 /end CHARACTERISTIC
/begin CHARACTERISTIC P_VSM_LDW_State_Accpedalrate_enable "" VALUE 0x3B9D24 Scalar_FLOAT32_IEEE 0 PubIfStateVSM_MDL_CM_single -3.4e+38 3.4e+38 /end CHARACTERISTIC
/begin CHARACTERISTIC P_VSM_LDW_State_Breakpressure_enable "" VALUE 0x3B9D28 Scalar_FLOAT32_IEEE 0 PubIfStateVSM_MDL_CM_single -3.4e+38 3.4e+38 /end CHARACTERISTIC
/begin CHARACTERISTIC P_VSM_LDW_State_ESSSts_enable "" VALUE 0x3B4BF8 Scalar_FLOAT64_IEEE 0 PubIfStateVSM_MDL_CM_double -1.7e+308 1.7e+308 /end CHARACTERISTIC
/begin CHARACTERISTIC P_VSM_LDW_State_Failsafe_enable "" VALUE 0x3B9D2C Scalar_FLOAT32_IEEE 0 PubIfStateVSM_MDL_CM_single -3.4e+38 3.4e+38 /end CHARACTERISTIC
/begin CHARACTERISTIC P_VSM_LDW_State_GEAR_enable "" VALUE 0x3B9D30 Scalar_FLOAT32_IEEE 0 PubIfStateVSM_MDL_CM_single -3.4e+38 3.4e+38 /end CHARACTERISTIC
/begin CHARACTERISTIC P_VSM_LDW_State_Headingangle_enable "" VALUE 0x3B9D34 Scalar_FLOAT32_IEEE 0 PubIfStateVSM_MDL_CM_single -3.4e+38 3.4e+38 /end CHARACTERISTIC
/begin CHARACTERISTIC P_VSM_LDW_State_LaneChange_enable "" VALUE 0x3B9D38 Scalar_FLOAT32_IEEE 0 PubIfStateVSM_MDL_CM_single -3.4e+38 3.4e+38 /end CHARACTERISTIC
/begin CHARACTERISTIC P_VSM_LDW_State_Lane_enable "" VALUE 0x3B9D3C Scalar_FLOAT32_IEEE 0 PubIfStateVSM_MDL_CM_single -3.4e+38 3.4e+38 /end CHARACTERISTIC
/begin CHARACTERISTIC P_VSM_LDW_State_Lanecurve_enable "" VALUE 0x3B9D40 Scalar_FLOAT32_IEEE 0 PubIfStateVSM_MDL_CM_single -3.4e+38 3.4e+38 /end CHARACTERISTIC
/begin CHARACTERISTIC P_VSM_LDW_State_LateralAcce_enable "" VALUE 0x3B9D44 Scalar_FLOAT32_IEEE 0 PubIfStateVSM_MDL_CM_single -3.4e+38 3.4e+38 /end CHARACTERISTIC
/begin CHARACTERISTIC P_VSM_LDW_State_LongitudeAcc_enable "" VALUE 0x3B9D48 Scalar_FLOAT32_IEEE 0 PubIfStateVSM_MDL_CM_single -3.4e+38 3.4e+38 /end CHARACTERISTIC
/begin CHARACTERISTIC P_VSM_LDW_State_Param_LaneWidth_Offset "" VAL_BLK 0x3B9D8C Scalar_FLOAT32_IEEE 0 PubIfStateVSM_MDL_CM_single -3.4e+38 3.4e+38 MATRIX_DIM 1 7 1 /end CHARACTERISTIC
/begin CHARACTERISTIC P_VSM_LDW_State_Param_REWarningZoneIn "" VALUE 0x3B9DA8 Scalar_FLOAT32_IEEE 0 PubIfStateVSM_MDL_CM_single -3.4e+38 3.4e+38 /end CHARACTERISTIC
/begin CHARACTERISTIC P_VSM_LDW_State_Param_Sensitive_Offset "" VAL_BLK 0x3B9DAC Scalar_FLOAT32_IEEE 0 PubIfStateVSM_MDL_CM_single -3.4e+38 3.4e+38 MATRIX_DIM 1 3 1 /end CHARACTERISTIC
/begin CHARACTERISTIC P_VSM_LDW_State_Param_WarningZoneIn "" VALUE 0x3B9DF8 Scalar_FLOAT32_IEEE 0 PubIfStateVSM_MDL_CM_single -3.4e+38 3.4e+38 /end CHARACTERISTIC
/begin CHARACTERISTIC P_VSM_LDW_State_Param_WarningZoneOut "" VALUE 0x3B9DFC Scalar_FLOAT32_IEEE 0 PubIfStateVSM_MDL_CM_single -3.4e+38 3.4e+38 /end CHARACTERISTIC
/begin CHARACTERISTIC P_VSM_LDW_State_SteerWheelAngle_enable "" VALUE 0x3B9E00 Scalar_FLOAT32_IEEE 0 PubIfStateVSM_MDL_CM_single -3.4e+38 3.4e+38 /end CHARACTERISTIC
/begin CHARACTERISTIC P_VSM_LDW_State_SteerWheelSpd_enable "" VALUE 0x3B9E04 Scalar_FLOAT32_IEEE 0 PubIfStateVSM_MDL_CM_single -3.4e+38 3.4e+38 /end CHARACTERISTIC
/begin CHARACTERISTIC P_VSM_LDW_State_TurnLight_enable "" VALUE 0x3B9E08 Scalar_FLOAT32_IEEE 0 PubIfStateVSM_MDL_CM_single -3.4e+38 3.4e+38 /end CHARACTERISTIC
/begin CHARACTERISTIC P_VSM_LDW_State_Vehspeed_enable "" VALUE 0x3B9E0C Scalar_FLOAT32_IEEE 0 PubIfStateVSM_MDL_CM_single -3.4e+38 3.4e+38 /end CHARACTERISTIC
/begin CHARACTERISTIC P_VSM_LDW_State_Yawsup_enable "" VALUE 0x3B9E10 Scalar_FLOAT32_IEEE 0 PubIfStateVSM_MDL_CM_single -3.4e+38 3.4e+38 /end CHARACTERISTIC
/begin CHARACTERISTIC P_VSM_LDW_SteerWheelAngleIn "" VALUE 0x3B9E14 Scalar_FLOAT32_IEEE 0 PubIfStateVSM_MDL_CM_single -3.4e+38 3.4e+38 /end CHARACTERISTIC
/begin CHARACTERISTIC P_VSM_LDW_SteerWheelAngleInTime "" VALUE 0x3B4C00 Scalar_FLOAT64_IEEE 0 PubIfStateVSM_MDL_CM_double -1.7e+308 1.7e+308 /end CHARACTERISTIC
/begin CHARACTERISTIC P_VSM_LDW_SteerWheelAngleOut "" VALUE 0x3B9E18 Scalar_FLOAT32_IEEE 0 PubIfStateVSM_MDL_CM_single -3.4e+38 3.4e+38 /end CHARACTERISTIC
/begin CHARACTERISTIC P_VSM_LDW_SteerWheelSpdIn "" VALUE 0x3B9E1C Scalar_FLOAT32_IEEE 0 PubIfStateVSM_MDL_CM_single -3.4e+38 3.4e+38 /end CHARACTERISTIC
/begin CHARACTERISTIC P_VSM_LDW_SteerWheelSpdInTime "" VALUE 0x3B4C08 Scalar_FLOAT64_IEEE 0 PubIfStateVSM_MDL_CM_double -1.7e+308 1.7e+308 /end CHARACTERISTIC
/begin CHARACTERISTIC P_VSM_LDW_SteerWheelSpdOut "" VALUE 0x3B9E20 Scalar_FLOAT32_IEEE 0 PubIfStateVSM_MDL_CM_single -3.4e+38 3.4e+38 /end CHARACTERISTIC
/begin CHARACTERISTIC P_VSM_LDW_TurnLightInTime "" VALUE 0x3B4C10 Scalar_FLOAT64_IEEE 0 PubIfStateVSM_MDL_CM_double -1.7e+308 1.7e+308 /end CHARACTERISTIC
/begin CHARACTERISTIC P_VSM_LDW_WhelDy "" VALUE 0x3B9E24 Scalar_FLOAT32_IEEE 0 PubIfStateVSM_MDL_CM_single -3.4e+38 3.4e+38 /end CHARACTERISTIC
/begin CHARACTERISTIC P_VSM_LDW_YawRateIn "" VALUE 0x3B9E28 Scalar_FLOAT32_IEEE 0 PubIfStateVSM_MDL_CM_single -3.4e+38 3.4e+38 /end CHARACTERISTIC
/begin CHARACTERISTIC P_VSM_LDW_YawRateInTime "" VALUE 0x3B4C18 Scalar_FLOAT64_IEEE 0 PubIfStateVSM_MDL_CM_double -1.7e+308 1.7e+308 /end CHARACTERISTIC
/begin CHARACTERISTIC P_VSM_LDW_YawRateOut "" VALUE 0x3B9E2C Scalar_FLOAT32_IEEE 0 PubIfStateVSM_MDL_CM_single -3.4e+38 3.4e+38 /end CHARACTERISTIC
/begin CHARACTERISTIC P_VSM_LDW_absLongitudeAccIn "" VALUE 0x3B9E30 Scalar_FLOAT32_IEEE 0 PubIfStateVSM_MDL_CM_single -3.4e+38 3.4e+38 /end CHARACTERISTIC
/begin CHARACTERISTIC P_VSM_LDW_absLongitudeAccOut "" VALUE 0x3B9E34 Scalar_FLOAT32_IEEE 0 PubIfStateVSM_MDL_CM_single -3.4e+38 3.4e+38 /end CHARACTERISTIC
/begin CHARACTERISTIC P_VSM_LKA_AbsEspInTime "" VALUE 0x3B4C20 Scalar_FLOAT64_IEEE 0 PubIfStateVSM_MDL_CM_double -1.7e+308 1.7e+308 /end CHARACTERISTIC
/begin CHARACTERISTIC P_VSM_LKA_AccPedalPosnOut "" VALUE 0x3B9E38 Scalar_FLOAT32_IEEE 0 PubIfStateVSM_MDL_CM_single -3.4e+38 3.4e+38 /end CHARACTERISTIC
/begin CHARACTERISTIC P_VSM_LKA_AccPedalRateOutTime "" VALUE 0x3CB000 Scalar_FLOAT64_IEEE 0 PubIfStateVSM_MDL_CM_double -1.7e+308 1.7e+308 /end CHARACTERISTIC
/begin CHARACTERISTIC P_VSM_LKA_AccRateIn "" VALUE 0x3B9E3C Scalar_FLOAT32_IEEE 0 PubIfStateVSM_MDL_CM_single -3.4e+38 3.4e+38 /end CHARACTERISTIC
/begin CHARACTERISTIC P_VSM_LKA_AccRateInTime "" VALUE 0x3B4C28 Scalar_FLOAT64_IEEE 0 PubIfStateVSM_MDL_CM_double -1.7e+308 1.7e+308 /end CHARACTERISTIC
/begin CHARACTERISTIC P_VSM_LKA_AccRateOut "" VALUE 0x3B9E40 Scalar_FLOAT32_IEEE 0 PubIfStateVSM_MDL_CM_single -3.4e+38 3.4e+38 /end CHARACTERISTIC
/begin CHARACTERISTIC P_VSM_LKA_BrakePressIn "" VALUE 0x3B9E44 Scalar_FLOAT32_IEEE 0 PubIfStateVSM_MDL_CM_single -3.4e+38 3.4e+38 /end CHARACTERISTIC
/begin CHARACTERISTIC P_VSM_LKA_BrakePressInTime "" VALUE 0x3B4C30 Scalar_FLOAT64_IEEE 0 PubIfStateVSM_MDL_CM_double -1.7e+308 1.7e+308 /end CHARACTERISTIC
/begin CHARACTERISTIC P_VSM_LKA_BrakePressOut "" VALUE 0x3B9E48 Scalar_FLOAT32_IEEE 0 PubIfStateVSM_MDL_CM_single -3.4e+38 3.4e+38 /end CHARACTERISTIC
/begin CHARACTERISTIC P_VSM_LKA_DriverInputTrqValueIn "" VALUE 0x3B9E4C Scalar_FLOAT32_IEEE 0 PubIfStateVSM_MDL_CM_single -3.4e+38 3.4e+38 /end CHARACTERISTIC
/begin CHARACTERISTIC P_VSM_LKA_DriverInputTrqValueInTime "" VALUE 0x3B4C38 Scalar_FLOAT64_IEEE 0 PubIfStateVSM_MDL_CM_double -1.7e+308 1.7e+308 /end CHARACTERISTIC
/begin CHARACTERISTIC P_VSM_LKA_DriverInputTrqValueOut "" VALUE 0x3B9E50 Scalar_FLOAT32_IEEE 0 PubIfStateVSM_MDL_CM_single -3.4e+38 3.4e+38 /end CHARACTERISTIC
/begin CHARACTERISTIC P_VSM_LKA_LaneCurveIn "" VALUE 0x3B9E54 Scalar_FLOAT32_IEEE 0 PubIfStateVSM_MDL_CM_single -3.4e+38 3.4e+38 /end CHARACTERISTIC
/begin CHARACTERISTIC P_VSM_LKA_LaneCurveOut "" VALUE 0x3B9E58 Scalar_FLOAT32_IEEE 0 PubIfStateVSM_MDL_CM_single -3.4e+38 3.4e+38 /end CHARACTERISTIC
/begin CHARACTERISTIC P_VSM_LKA_LateralAcceIn "" VALUE 0x3B9E5C Scalar_FLOAT32_IEEE 0 PubIfStateVSM_MDL_CM_single -3.4e+38 3.4e+38 /end CHARACTERISTIC
/begin CHARACTERISTIC P_VSM_LKA_LateralAcceInTime "" VALUE 0x3B4C40 Scalar_FLOAT64_IEEE 0 PubIfStateVSM_MDL_CM_double -1.7e+308 1.7e+308 /end CHARACTERISTIC
/begin CHARACTERISTIC P_VSM_LKA_LateralAcceOut "" VALUE 0x3B9E60 Scalar_FLOAT32_IEEE 0 PubIfStateVSM_MDL_CM_single -3.4e+38 3.4e+38 /end CHARACTERISTIC
/begin CHARACTERISTIC P_VSM_LKA_LongitudeAcceIn "" VALUE 0x3B9E64 Scalar_FLOAT32_IEEE 0 PubIfStateVSM_MDL_CM_single -3.4e+38 3.4e+38 /end CHARACTERISTIC
/begin CHARACTERISTIC P_VSM_LKA_LongitudeAcceOut "" VALUE 0x3B9E68 Scalar_FLOAT32_IEEE 0 PubIfStateVSM_MDL_CM_single -3.4e+38 3.4e+38 /end CHARACTERISTIC
/begin CHARACTERISTIC P_VSM_LKA_OverrideInTime "" VALUE 0x3B4C48 Scalar_FLOAT64_IEEE 0 PubIfStateVSM_MDL_CM_double -1.7e+308 1.7e+308 /end CHARACTERISTIC
/begin CHARACTERISTIC P_VSM_LKA_OverrideTime "" VALUE 0x3B4C50 Scalar_FLOAT64_IEEE 0 PubIfStateVSM_MDL_CM_double -1.7e+308 1.7e+308 /end CHARACTERISTIC
/begin CHARACTERISTIC P_VSM_LKA_OverrideValue "" VALUE 0x3B9E6C Scalar_FLOAT32_IEEE 0 PubIfStateVSM_MDL_CM_single -3.4e+38 3.4e+38 /end CHARACTERISTIC
/begin CHARACTERISTIC P_VSM_LKA_State_Absesp_enable "" VALUE 0x3B9E70 Scalar_FLOAT32_IEEE 0 PubIfStateVSM_MDL_CM_single -3.4e+38 3.4e+38 /end CHARACTERISTIC
/begin CHARACTERISTIC P_VSM_LKA_State_Accpedalrate_enable "" VALUE 0x3B9E74 Scalar_FLOAT32_IEEE 0 PubIfStateVSM_MDL_CM_single -3.4e+38 3.4e+38 /end CHARACTERISTIC
/begin CHARACTERISTIC P_VSM_LKA_State_Breakpressure_enable "" VALUE 0x3B9E78 Scalar_FLOAT32_IEEE 0 PubIfStateVSM_MDL_CM_single -3.4e+38 3.4e+38 /end CHARACTERISTIC
/begin CHARACTERISTIC P_VSM_LKA_State_DriverInputTrqValue_enable "" VALUE 0x3B9E7C Scalar_FLOAT32_IEEE 0 PubIfStateVSM_MDL_CM_single -3.4e+38 3.4e+38 /end CHARACTERISTIC
/begin CHARACTERISTIC P_VSM_LKA_State_ESSSts_enable "" VALUE 0x3B4C58 Scalar_FLOAT64_IEEE 0 PubIfStateVSM_MDL_CM_double -1.7e+308 1.7e+308 /end CHARACTERISTIC
/begin CHARACTERISTIC P_VSM_LKA_State_Eps_enable "" VALUE 0x3B9E80 Scalar_FLOAT32_IEEE 0 PubIfStateVSM_MDL_CM_single -3.4e+38 3.4e+38 /end CHARACTERISTIC
/begin CHARACTERISTIC P_VSM_LKA_State_Failsafe_enable "" VALUE 0x3B9E84 Scalar_FLOAT32_IEEE 0 PubIfStateVSM_MDL_CM_single -3.4e+38 3.4e+38 /end CHARACTERISTIC
/begin CHARACTERISTIC P_VSM_LKA_State_GEAR_enable "" VALUE 0x3B9E88 Scalar_FLOAT32_IEEE 0 PubIfStateVSM_MDL_CM_single -3.4e+38 3.4e+38 /end CHARACTERISTIC
/begin CHARACTERISTIC P_VSM_LKA_State_Headingangle_enable "" VALUE 0x3B9E8C Scalar_FLOAT32_IEEE 0 PubIfStateVSM_MDL_CM_single -3.4e+38 3.4e+38 /end CHARACTERISTIC
/begin CHARACTERISTIC P_VSM_LKA_State_LaneChange_enable "" VALUE 0x3B9E90 Scalar_FLOAT32_IEEE 0 PubIfStateVSM_MDL_CM_single -3.4e+38 3.4e+38 /end CHARACTERISTIC
/begin CHARACTERISTIC P_VSM_LKA_State_Lane_enable "" VALUE 0x3B9E94 Scalar_FLOAT32_IEEE 0 PubIfStateVSM_MDL_CM_single -3.4e+38 3.4e+38 /end CHARACTERISTIC
/begin CHARACTERISTIC P_VSM_LKA_State_Lanecurve_enable "" VALUE 0x3B9E98 Scalar_FLOAT32_IEEE 0 PubIfStateVSM_MDL_CM_single -3.4e+38 3.4e+38 /end CHARACTERISTIC
/begin CHARACTERISTIC P_VSM_LKA_State_LateralAcce_enable "" VALUE 0x3B9E9C Scalar_FLOAT32_IEEE 0 PubIfStateVSM_MDL_CM_single -3.4e+38 3.4e+38 /end CHARACTERISTIC
/begin CHARACTERISTIC P_VSM_LKA_State_LongitudeAcc_enable "" VALUE 0x3B9EA0 Scalar_FLOAT32_IEEE 0 PubIfStateVSM_MDL_CM_single -3.4e+38 3.4e+38 /end CHARACTERISTIC
/begin CHARACTERISTIC P_VSM_LKA_State_Overide_enable "" VALUE 0x3B9EA4 Scalar_FLOAT32_IEEE 0 PubIfStateVSM_MDL_CM_single -3.4e+38 3.4e+38 /end CHARACTERISTIC
/begin CHARACTERISTIC P_VSM_LKA_State_Param_AngleOffset "" VALUE 0x3B9EA8 Scalar_FLOAT32_IEEE 0 PubIfStateVSM_MDL_CM_single -3.4e+38 3.4e+38 /end CHARACTERISTIC
/begin CHARACTERISTIC P_VSM_LKA_State_Param_InterventionZoneIn "" VALUE 0x3B9EAC Scalar_FLOAT32_IEEE 0 PubIfStateVSM_MDL_CM_single -3.4e+38 3.4e+38 /end CHARACTERISTIC
/begin CHARACTERISTIC P_VSM_LKA_State_Param_InterventionZoneOut "" VALUE 0x3B9EB0 Scalar_FLOAT32_IEEE 0 PubIfStateVSM_MDL_CM_single -3.4e+38 3.4e+38 /end CHARACTERISTIC
/begin CHARACTERISTIC P_VSM_LKA_State_Param_LaneCurve "" VAL_BLK 0x3B4C60 Scalar_FLOAT64_IEEE 0 PubIfStateVSM_MDL_CM_double -1.7e+308 1.7e+308 MATRIX_DIM 1 4 1 /end CHARACTERISTIC
/begin CHARACTERISTIC P_VSM_LKA_State_Param_LaneCurve_Offset "" VAL_BLK 0x3B4C80 Scalar_FLOAT64_IEEE 0 PubIfStateVSM_MDL_CM_double -1.7e+308 1.7e+308 MATRIX_DIM 1 4 1 /end CHARACTERISTIC
/begin CHARACTERISTIC P_VSM_LKA_State_Param_LaneWidth_Offset "" VAL_BLK 0x3B9EB4 Scalar_FLOAT32_IEEE 0 PubIfStateVSM_MDL_CM_single -3.4e+38 3.4e+38 MATRIX_DIM 1 7 1 /end CHARACTERISTIC
/begin CHARACTERISTIC P_VSM_LKA_State_Param_Offset "" VALUE 0x3B9ED0 Scalar_FLOAT32_IEEE 0 PubIfStateVSM_MDL_CM_single -3.4e+38 3.4e+38 /end CHARACTERISTIC
/begin CHARACTERISTIC P_VSM_LKA_State_Param_OutOffset "" VALUE 0x3B9ED4 Scalar_FLOAT32_IEEE 0 PubIfStateVSM_MDL_CM_single -3.4e+38 3.4e+38 /end CHARACTERISTIC
/begin CHARACTERISTIC P_VSM_LKA_State_Param_REInterventionZoneIn "" VALUE 0x3B9ED8 Scalar_FLOAT32_IEEE 0 PubIfStateVSM_MDL_CM_single -3.4e+38 3.4e+38 /end CHARACTERISTIC
/begin CHARACTERISTIC P_VSM_LKA_State_Param_Sensitive_Offset "" VAL_BLK 0x3B9EDC Scalar_FLOAT32_IEEE 0 PubIfStateVSM_MDL_CM_single -3.4e+38 3.4e+38 MATRIX_DIM 1 3 1 /end CHARACTERISTIC
/begin CHARACTERISTIC P_VSM_LKA_State_SteerWheelAngle_enable "" VALUE 0x3B9EE8 Scalar_FLOAT32_IEEE 0 PubIfStateVSM_MDL_CM_single -3.4e+38 3.4e+38 /end CHARACTERISTIC
/begin CHARACTERISTIC P_VSM_LKA_State_SteerWheelSpd_enable "" VALUE 0x3B9EEC Scalar_FLOAT32_IEEE 0 PubIfStateVSM_MDL_CM_single -3.4e+38 3.4e+38 /end CHARACTERISTIC
/begin CHARACTERISTIC P_VSM_LKA_State_TJASts_enable "" VALUE 0x3B9EF0 Scalar_FLOAT32_IEEE 0 PubIfStateVSM_MDL_CM_single -3.4e+38 3.4e+38 /end CHARACTERISTIC
/begin CHARACTERISTIC P_VSM_LKA_State_TurnLight_enable "" VALUE 0x3B9EF4 Scalar_FLOAT32_IEEE 0 PubIfStateVSM_MDL_CM_single -3.4e+38 3.4e+38 /end CHARACTERISTIC
/begin CHARACTERISTIC P_VSM_LKA_State_Vehspeed_enable "" VALUE 0x3B9EF8 Scalar_FLOAT32_IEEE 0 PubIfStateVSM_MDL_CM_single -3.4e+38 3.4e+38 /end CHARACTERISTIC
/begin CHARACTERISTIC P_VSM_LKA_State_Yawsup_enable "" VALUE 0x3B9EFC Scalar_FLOAT32_IEEE 0 PubIfStateVSM_MDL_CM_single -3.4e+38 3.4e+38 /end CHARACTERISTIC
/begin CHARACTERISTIC P_VSM_LKA_SteerWheelAngleIn "" VALUE 0x3B9F00 Scalar_FLOAT32_IEEE 0 PubIfStateVSM_MDL_CM_single -3.4e+38 3.4e+38 /end CHARACTERISTIC
/begin CHARACTERISTIC P_VSM_LKA_SteerWheelAngleInTime "" VALUE 0x3B4CA0 Scalar_FLOAT64_IEEE 0 PubIfStateVSM_MDL_CM_double -1.7e+308 1.7e+308 /end CHARACTERISTIC
/begin CHARACTERISTIC P_VSM_LKA_SteerWheelAngleOut "" VALUE 0x3B9F04 Scalar_FLOAT32_IEEE 0 PubIfStateVSM_MDL_CM_single -3.4e+38 3.4e+38 /end CHARACTERISTIC
/begin CHARACTERISTIC P_VSM_LKA_SteerWheelSpdIn "" VALUE 0x3B9F08 Scalar_FLOAT32_IEEE 0 PubIfStateVSM_MDL_CM_single -3.4e+38 3.4e+38 /end CHARACTERISTIC
/begin CHARACTERISTIC P_VSM_LKA_SteerWheelSpdInTime "" VALUE 0x3B4CA8 Scalar_FLOAT64_IEEE 0 PubIfStateVSM_MDL_CM_double -1.7e+308 1.7e+308 /end CHARACTERISTIC
/begin CHARACTERISTIC P_VSM_LKA_SteerWheelSpdOut "" VALUE 0x3B9F0C Scalar_FLOAT32_IEEE 0 PubIfStateVSM_MDL_CM_single -3.4e+38 3.4e+38 /end CHARACTERISTIC
/begin CHARACTERISTIC P_VSM_LKA_TurnLightInTime "" VALUE 0x3B4CB0 Scalar_FLOAT64_IEEE 0 PubIfStateVSM_MDL_CM_double -1.7e+308 1.7e+308 /end CHARACTERISTIC
/begin CHARACTERISTIC P_VSM_LKA_WarnInTime "" VALUE 0x3B4CB8 Scalar_FLOAT64_IEEE 0 PubIfStateVSM_MDL_CM_double -1.7e+308 1.7e+308 /end CHARACTERISTIC
/begin CHARACTERISTIC P_VSM_LKA_Warnarea1 "" VALUE 0x3B9F10 Scalar_FLOAT32_IEEE 0 PubIfStateVSM_MDL_CM_single -3.4e+38 3.4e+38 /end CHARACTERISTIC
/begin CHARACTERISTIC P_VSM_LKA_Warnarea2 "" VALUE 0x3B9F14 Scalar_FLOAT32_IEEE 0 PubIfStateVSM_MDL_CM_single -3.4e+38 3.4e+38 /end CHARACTERISTIC
/begin CHARACTERISTIC P_VSM_LKA_WhelDy "" VALUE 0x3B9F18 Scalar_FLOAT32_IEEE 0 PubIfStateVSM_MDL_CM_single -3.4e+38 3.4e+38 /end CHARACTERISTIC
/begin CHARACTERISTIC P_VSM_LKA_YawRateIn "" VALUE 0x3B9F1C Scalar_FLOAT32_IEEE 0 PubIfStateVSM_MDL_CM_single -3.4e+38 3.4e+38 /end CHARACTERISTIC
/begin CHARACTERISTIC P_VSM_LKA_YawRateInTime "" VALUE 0x3B4CC0 Scalar_FLOAT64_IEEE 0 PubIfStateVSM_MDL_CM_double -1.7e+308 1.7e+308 /end CHARACTERISTIC
/begin CHARACTERISTIC P_VSM_LKA_YawRateOut "" VALUE 0x3B9F20 Scalar_FLOAT32_IEEE 0 PubIfStateVSM_MDL_CM_single -3.4e+38 3.4e+38 /end CHARACTERISTIC
/begin CHARACTERISTIC P_VSM_LKA_absLongitudeAcceIn "" VALUE 0x3B9F24 Scalar_FLOAT32_IEEE 0 PubIfStateVSM_MDL_CM_single -3.4e+38 3.4e+38 /end CHARACTERISTIC
/begin CHARACTERISTIC P_VSM_LKA_absLongitudeAcceInTime "" VALUE 0x3B4CC8 Scalar_FLOAT64_IEEE 0 PubIfStateVSM_MDL_CM_double -1.7e+308 1.7e+308 /end CHARACTERISTIC
/begin CHARACTERISTIC P_VSM_LKA_absLongitudeAcceOut "" VALUE 0x3B9F28 Scalar_FLOAT32_IEEE 0 PubIfStateVSM_MDL_CM_single -3.4e+38 3.4e+38 /end CHARACTERISTIC
/begin CHARACTERISTIC P_VSM_LSMC_SampleTime "" VALUE 0x3B9F2C Scalar_FLOAT32_IEEE 0 PubIfStateVSM_MDL_CM_single -3.4e+38 3.4e+38 /end CHARACTERISTIC
/begin MEASUREMENT RFM_L1_bIsLineExist "" UBYTE Noa_Nofusion_CM_uint8 0 0 0 255 ECU_ADDRESS 0x3CAFBF /end MEASUREMENT
/begin MEASUREMENT RFM_L1_dC0V "" FLOAT32_IEEE Noa_Nofusion_CM_single 0 0 -30 30 ECU_ADDRESS 0x3CAF70 /end MEASUREMENT
/begin MEASUREMENT RFM_L1_dC1V "" FLOAT32_IEEE Noa_Nofusion_CM_single 0 0 -2 2 ECU_ADDRESS 0x3CAF6C /end MEASUREMENT
/begin MEASUREMENT RFM_L1_dC3V "" FLOAT32_IEEE Noa_Nofusion_CM_single 0 0 -0.004 0.004 ECU_ADDRESS 0x3CAF68 /end MEASUREMENT
/begin MEASUREMENT RFM_L1_dDisFront "" FLOAT32_IEEE Noa_Nofusion_CM_single 0 0 0 200 ECU_ADDRESS 0x3CAF60 /end MEASUREMENT
/begin MEASUREMENT RFM_L1_dDisStart "" FLOAT32_IEEE Noa_Nofusion_CM_single 0 0 0 200 ECU_ADDRESS 0x3CAF64 /end MEASUREMENT
/begin MEASUREMENT RFM_L1_eLineType "" UBYTE Noa_Nofusion_CM_uint8 0 0 0 255 ECU_ADDRESS 0x3CAFBE /end MEASUREMENT
/begin MEASUREMENT RFM_R1_bIsLineExist "" UBYTE Noa_Nofusion_CM_uint8 0 0 0 255 ECU_ADDRESS 0x3CAFBD /end MEASUREMENT
/begin MEASUREMENT RFM_R1_dC0V "" FLOAT32_IEEE Noa_Nofusion_CM_single 0 0 -30 30 ECU_ADDRESS 0x3CAF5C /end MEASUREMENT
/begin MEASUREMENT RFM_R1_dC1V "" FLOAT32_IEEE Noa_Nofusion_CM_single 0 0 -2 2 ECU_ADDRESS 0x3CAF58 /end MEASUREMENT
/begin MEASUREMENT RFM_R1_dC2V "" FLOAT32_IEEE Noa_Nofusion_CM_single 0 0 -0.125 0.125 ECU_ADDRESS 0x3CAF54 /end MEASUREMENT
/begin MEASUREMENT RFM_R1_dC3V "" FLOAT32_IEEE Noa_Nofusion_CM_single 0 0 -0.004 0.004 ECU_ADDRESS 0x3CAF50 /end MEASUREMENT
/begin MEASUREMENT RFM_R1_dDisFront "" FLOAT32_IEEE Noa_Nofusion_CM_single 0 0 0 200 ECU_ADDRESS 0x3CAF48 /end MEASUREMENT
/begin MEASUREMENT RFM_R1_dDisStart "" FLOAT32_IEEE Noa_Nofusion_CM_single 0 0 0 200 ECU_ADDRESS 0x3CAF4C /end MEASUREMENT
/begin MEASUREMENT RFM_R1_eLineType "" UBYTE Noa_Nofusion_CM_uint8 0 0 0 255 ECU_ADDRESS 0x3CAFBC /end MEASUREMENT
/begin MEASUREMENT Source_CRObjDy "" FLOAT32_IEEE Noa_Nofusion_CM_single 0 0 -3.4e+38 3.4e+38 ECU_ADDRESS 0x3CAF90 MATRIX_DIM 11 1 1 LAYOUT ROW_DIR /end MEASUREMENT
/begin MEASUREMENT Source_CRObjID "" UBYTE Noa_Nofusion_CM_uint8 0 0 0 255 ECU_ADDRESS 0x3CAFC4 MATRIX_DIM 11 1 1 LAYOUT ROW_DIR /end MEASUREMENT
/begin MEASUREMENT VIE_SW_VERSION "" ULONG PubIfCommonVIE_MDL_CM_uint32 0 0 0 4294967295 ECU_ADDRESS 0x3F12F0 /end MEASUREMENT
/begin MEASUREMENT VSM_ACC_SWCruise "" UBYTE PubIfStateVSM_MDL_CM_boolean 0 0 0 1 BIT_MASK 0x1 ECU_ADDRESS 0x3FF726 /end MEASUREMENT
/begin MEASUREMENT VSM_ACC_SWEngState "" UBYTE PubIfStateVSM_MDL_CM_uint8 0 0 0 255 ECU_ADDRESS 0x3FF6C7 /end MEASUREMENT
/begin MEASUREMENT VSM_ACC_SWRes "" UBYTE PubIfStateVSM_MDL_CM_boolean 0 0 0 1 BIT_MASK 0x1 ECU_ADDRESS 0x3FF792 /end MEASUREMENT
/begin MEASUREMENT VSM_ACC_SWSet "" UBYTE PubIfStateVSM_MDL_CM_boolean 0 0 0 1 BIT_MASK 0x1 ECU_ADDRESS 0x3FF791 /end MEASUREMENT
/begin MEASUREMENT VSM_ERROR_LEFT "" FLOAT32_IEEE PubIfStateVSM_MDL_CM_single 0 0 -3.4e+38 3.4e+38 ECU_ADDRESS 0x3FF5A4 /end MEASUREMENT
/begin MEASUREMENT VSM_ERROR_RIGHT "" FLOAT32_IEEE PubIfStateVSM_MDL_CM_single 0 0 -3.4e+38 3.4e+38 ECU_ADDRESS 0x3FF5A0 /end MEASUREMENT
/begin MEASUREMENT VSM_ISL_SLWSPLvalue "" UBYTE PubIfStateVSM_MDL_CM_uint8 0 0 0 255 ECU_ADDRESS 0x3FF6E1 /end MEASUREMENT
/begin MEASUREMENT VSM_LCKIE_DelayReady "" UBYTE PubIfStateVSM_MDL_CM_uint8 0 0 0 255 ECU_ADDRESS 0x3FF70E /end MEASUREMENT
/begin MEASUREMENT VSM_LCKIE_Laneoffset "" FLOAT32_IEEE PubIfStateVSM_MDL_CM_single 0 0 -3.4e+38 3.4e+38 ECU_ADDRESS 0x3FF688 /end MEASUREMENT
/begin MEASUREMENT VSM_LCKIE_LatC_Counter "" UBYTE PubIfStateVSM_MDL_CM_uint8 0 0 0 255 ECU_ADDRESS 0x3FF708 /end MEASUREMENT
/begin MEASUREMENT VSM_LCKIE_LatC_Counter1 "" UBYTE PubIfStateVSM_MDL_CM_uint8 0 0 0 255 ECU_ADDRESS 0x3FF709 /end MEASUREMENT
/begin MEASUREMENT VSM_LCKIE_LatC_Counter2 "" UBYTE PubIfStateVSM_MDL_CM_uint8 0 0 0 255 ECU_ADDRESS 0x3FF70A /end MEASUREMENT
/begin MEASUREMENT VSM_LCKIE_LatC_Counter3 "" UBYTE PubIfStateVSM_MDL_CM_uint8 0 0 0 255 ECU_ADDRESS 0x3FF70B /end MEASUREMENT
/begin MEASUREMENT VSM_LCKIE_LatC_Counter4 "" UBYTE PubIfStateVSM_MDL_CM_uint8 0 0 0 255 ECU_ADDRESS 0x3FF70C /end MEASUREMENT
/begin MEASUREMENT VSM_LCKIE_LatC_Counter5 "" UBYTE PubIfStateVSM_MDL_CM_uint8 0 0 0 255 ECU_ADDRESS 0x3FF70D /end MEASUREMENT
/begin MEASUREMENT VSM_LCKIE_LatC_DirectChange "" UBYTE PubIfStateVSM_MDL_CM_uint8 0 0 0 255 ECU_ADDRESS 0x3FF704 /end MEASUREMENT
/begin MEASUREMENT VSM_LCKIE_LatC_DisEgo2ObjOff "" FLOAT32_IEEE PubIfStateVSM_MDL_CM_single 0 0 -3.4e+38 3.4e+38 ECU_ADDRESS 0x3FF584 /end MEASUREMENT
/begin MEASUREMENT VSM_LCKIE_LatC_DisREToLane "" FLOAT32_IEEE PubIfStateVSM_MDL_CM_single 0 0 -3.4e+38 3.4e+38 ECU_ADDRESS 0x3FF67C /end MEASUREMENT
/begin MEASUREMENT VSM_LCKIE_LatC_LatFLg "" UBYTE PubIfStateVSM_MDL_CM_uint8 0 0 0 255 ECU_ADDRESS 0x3FF707 /end MEASUREMENT
/begin MEASUREMENT VSM_LCKIE_LatC_LatMovDis "" FLOAT32_IEEE PubIfStateVSM_MDL_CM_single 0 0 -3.4e+38 3.4e+38 ECU_ADDRESS 0x3FF684 /end MEASUREMENT
/begin MEASUREMENT VSM_LCKIE_LatC_LatWarning "" UBYTE PubIfStateVSM_MDL_CM_uint8 0 0 0 255 ECU_ADDRESS 0x3FF703 /end MEASUREMENT
/begin MEASUREMENT VSM_LCKIE_LatC_MovDirct "" UBYTE PubIfStateVSM_MDL_CM_uint8 0 0 0 255 ECU_ADDRESS 0x3FF706 /end MEASUREMENT
/begin MEASUREMENT VSM_LCKIE_LatC_MovDirct1 "" UBYTE PubIfStateVSM_MDL_CM_uint8 0 0 0 255 ECU_ADDRESS 0x3FF702 /end MEASUREMENT
/begin MEASUREMENT VSM_LCKIE_LatC_MoveDis "" FLOAT32_IEEE PubIfStateVSM_MDL_CM_single 0 0 -3.4e+38 3.4e+38 ECU_ADDRESS 0x3FF678 /end MEASUREMENT
/begin MEASUREMENT VSM_LCKIE_LatC_ObjLatFailFlg "" UBYTE PubIfStateVSM_MDL_CM_uint8 0 0 0 255 ECU_ADDRESS 0x3FF705 /end MEASUREMENT
/begin MEASUREMENT VSM_LCKIE_LatC_SafDis "" FLOAT32_IEEE PubIfStateVSM_MDL_CM_single 0 0 -3.4e+38 3.4e+38 ECU_ADDRESS 0x3FF680 /end MEASUREMENT
/begin MEASUREMENT VSM_LCKIE_LatC_SafeDisToLaneEdge "" FLOAT32_IEEE PubIfStateVSM_MDL_CM_single 0 0 -3.4e+38 3.4e+38 ECU_ADDRESS 0x3FF580 /end MEASUREMENT
/begin MEASUREMENT VSM_LCKIE_LongC_Couter1 "" UWORD PubIfStateVSM_MDL_CM_uint16 0 0 0 65535 ECU_ADDRESS 0x3FF6C0 /end MEASUREMENT
/begin MEASUREMENT VSM_LCKIE_LongC_Couter2 "" UWORD PubIfStateVSM_MDL_CM_uint16 0 0 0 65535 ECU_ADDRESS 0x3FF6C2 /end MEASUREMENT
/begin MEASUREMENT VSM_LCKIE_LongC_Couter3 "" UWORD PubIfStateVSM_MDL_CM_uint16 0 0 0 65535 ECU_ADDRESS 0x3FF6C4 /end MEASUREMENT
/begin MEASUREMENT VSM_LCKIE_LongC_CouterOff "" UWORD PubIfStateVSM_MDL_CM_uint16 0 0 0 65535 ECU_ADDRESS 0x3FF6BE /end MEASUREMENT
/begin MEASUREMENT VSM_LCKIE_LongC_IEReady "" UBYTE PubIfStateVSM_MDL_CM_uint8 0 0 0 255 ECU_ADDRESS 0x3FF700 /end MEASUREMENT
/begin MEASUREMENT VSM_LCKIE_LongC_LongDis "" FLOAT32_IEEE PubIfStateVSM_MDL_CM_single 0 0 -3.4e+38 3.4e+38 ECU_ADDRESS 0x3FF594 /end MEASUREMENT
/begin MEASUREMENT VSM_LCKIE_LongC_LongDisfinal "" FLOAT32_IEEE PubIfStateVSM_MDL_CM_single 0 0 -3.4e+38 3.4e+38 ECU_ADDRESS 0x3FF670 /end MEASUREMENT
/begin MEASUREMENT VSM_LCKIE_LongC_LongFlg "" UBYTE PubIfStateVSM_MDL_CM_uint8 0 0 0 255 ECU_ADDRESS 0x3FF701 /end MEASUREMENT
/begin MEASUREMENT VSM_LCKIE_LongC_ObjLong "" FLOAT32_IEEE PubIfStateVSM_MDL_CM_single 0 0 -3.4e+38 3.4e+38 ECU_ADDRESS 0x3FF674 /end MEASUREMENT
/begin MEASUREMENT VSM_LCKIE_LongC_PocFlg "" UBYTE PubIfStateVSM_MDL_CM_uint8 0 0 0 255 ECU_ADDRESS 0x3FF6FF /end MEASUREMENT
/begin MEASUREMENT VSM_LCKIE_LongC_d1 "" FLOAT32_IEEE PubIfStateVSM_MDL_CM_single 0 0 -3.4e+38 3.4e+38 ECU_ADDRESS 0x3FF590 /end MEASUREMENT
/begin MEASUREMENT VSM_LCKIE_LongC_d2 "" FLOAT32_IEEE PubIfStateVSM_MDL_CM_single 0 0 -3.4e+38 3.4e+38 ECU_ADDRESS 0x3FF58C /end MEASUREMENT
/begin MEASUREMENT VSM_LCKIE_OFC_Counter "" UBYTE PubIfStateVSM_MDL_CM_uint8 0 0 0 255 ECU_ADDRESS 0x3FF6FD /end MEASUREMENT
/begin MEASUREMENT VSM_LCKIE_OFC_Counter1 "" UBYTE PubIfStateVSM_MDL_CM_uint8 0 0 0 255 ECU_ADDRESS 0x3FF6FE /end MEASUREMENT
/begin MEASUREMENT VSM_LCKIE_OFC_Long "" FLOAT32_IEEE PubIfStateVSM_MDL_CM_single 0 0 -3.4e+38 3.4e+38 ECU_ADDRESS 0x3FF660 /end MEASUREMENT
/begin MEASUREMENT VSM_LCKIE_OFC_ObjTTC "" FLOAT32_IEEE PubIfStateVSM_MDL_CM_single 0 0 -3.4e+38 3.4e+38 ECU_ADDRESS 0x3FF668 /end MEASUREMENT
/begin MEASUREMENT VSM_LCKIE_OFC_OppObjDetaSpd "" FLOAT32_IEEE PubIfStateVSM_MDL_CM_single 0 0 -3.4e+38 3.4e+38 ECU_ADDRESS 0x3FF664 /end MEASUREMENT
/begin MEASUREMENT VSM_LCKIE_OFC_OppObjFail "" UBYTE PubIfStateVSM_MDL_CM_uint8 0 0 0 255 ECU_ADDRESS 0x3FF6FC /end MEASUREMENT
/begin MEASUREMENT VSM_LCKIE_OFC_OppObjReady "" UBYTE PubIfStateVSM_MDL_CM_uint8 0 0 0 255 ECU_ADDRESS 0x3FF6FB /end MEASUREMENT
/begin MEASUREMENT VSM_LCKIE_OFC_Tset "" FLOAT32_IEEE PubIfStateVSM_MDL_CM_single 0 0 -3.4e+38 3.4e+38 ECU_ADDRESS 0x3FF66C /end MEASUREMENT
/begin MEASUREMENT VSM_LCKIE_ORC_Counter "" UBYTE PubIfStateVSM_MDL_CM_uint8 0 0 0 255 ECU_ADDRESS 0x3FF6FA /end MEASUREMENT
/begin MEASUREMENT VSM_LCKIE_ORC_ObjDetaSpd "" FLOAT32_IEEE PubIfStateVSM_MDL_CM_single 0 0 -3.4e+38 3.4e+38 ECU_ADDRESS 0x3FF65C /end MEASUREMENT
/begin MEASUREMENT VSM_LCKIE_ORC_ObjLatPos "" FLOAT32_IEEE PubIfStateVSM_MDL_CM_single 0 0 -3.4e+38 3.4e+38 ECU_ADDRESS 0x3FF658 /end MEASUREMENT
/begin MEASUREMENT VSM_LCKIE_ORC_ObjLong "" FLOAT32_IEEE PubIfStateVSM_MDL_CM_single 0 0 -3.4e+38 3.4e+38 ECU_ADDRESS 0x3FF654 /end MEASUREMENT
/begin MEASUREMENT VSM_LCKIE_ORC_ObjTTC "" FLOAT32_IEEE PubIfStateVSM_MDL_CM_single 0 0 -3.4e+38 3.4e+38 ECU_ADDRESS 0x3FF650 /end MEASUREMENT
/begin MEASUREMENT VSM_LCKIE_ORC_OppREARObjReady "" UBYTE PubIfStateVSM_MDL_CM_uint8 0 0 0 255 ECU_ADDRESS 0x3FF6F9 /end MEASUREMENT
/begin MEASUREMENT VSM_LCKIE_OS_Couter "" UBYTE PubIfStateVSM_MDL_CM_uint8 0 0 0 255 ECU_ADDRESS 0x3FF6F7 /end MEASUREMENT
/begin MEASUREMENT VSM_LCKIE_OS_Couter1 "" UBYTE PubIfStateVSM_MDL_CM_uint8 0 0 0 255 ECU_ADDRESS 0x3FF6F8 /end MEASUREMENT
/begin MEASUREMENT VSM_LCKIE_OS_DetaSpd "" FLOAT32_IEEE PubIfStateVSM_MDL_CM_single 0 0 -3.4e+38 3.4e+38 ECU_ADDRESS 0x3FF608 MATRIX_DIM 9 1 1 LAYOUT ROW_DIR /end MEASUREMENT
/begin MEASUREMENT VSM_LCKIE_OS_DetaSpdSelect "" FLOAT32_IEEE PubIfStateVSM_MDL_CM_single 0 0 -3.4e+38 3.4e+38 ECU_ADDRESS 0x3FF600 /end MEASUREMENT
/begin MEASUREMENT VSM_LCKIE_OS_DisEgo2Obj "" FLOAT32_IEEE PubIfStateVSM_MDL_CM_single 0 0 -3.4e+38 3.4e+38 ECU_ADDRESS 0x3FF5DC MATRIX_DIM 9 1 1 LAYOUT ROW_DIR /end MEASUREMENT
/begin MEASUREMENT VSM_LCKIE_OS_DisEgo2ObjSelect "" FLOAT32_IEEE PubIfStateVSM_MDL_CM_single 0 0 -3.4e+38 3.4e+38 ECU_ADDRESS 0x3FF5D8 /end MEASUREMENT
/begin MEASUREMENT VSM_LCKIE_OS_DisEgo2OppLane "" FLOAT32_IEEE PubIfStateVSM_MDL_CM_single 0 0 -3.4e+38 3.4e+38 ECU_ADDRESS 0x3FF604 /end MEASUREMENT
/begin MEASUREMENT VSM_LCKIE_OS_ObjIDSelect "" UBYTE PubIfStateVSM_MDL_CM_uint8 0 0 0 255 ECU_ADDRESS 0x3FF6F6 /end MEASUREMENT
/begin MEASUREMENT VSM_LCKIE_OS_ObjLane "" UBYTE PubIfStateVSM_MDL_CM_uint8 0 0 0 255 ECU_ADDRESS 0x3FF6EC MATRIX_DIM 9 1 1 LAYOUT ROW_DIR /end MEASUREMENT
/begin MEASUREMENT VSM_LCKIE_OS_ObjSelectID "" UBYTE PubIfStateVSM_MDL_CM_uint8 0 0 0 255 ECU_ADDRESS 0x3FF6F5 /end MEASUREMENT
/begin MEASUREMENT VSM_LCKIE_OS_OppFObjID "" UBYTE PubIfStateVSM_MDL_CM_uint8 0 0 0 255 ECU_ADDRESS 0x3FF6E8 /end MEASUREMENT
/begin MEASUREMENT VSM_LCKIE_OS_OppRObjID "" UBYTE PubIfStateVSM_MDL_CM_uint8 0 0 0 255 ECU_ADDRESS 0x3FF6E9 /end MEASUREMENT
/begin MEASUREMENT VSM_LCKIE_OS_POSRObjID "" UBYTE PubIfStateVSM_MDL_CM_uint8 0 0 0 255 ECU_ADDRESS 0x3FF6EA /end MEASUREMENT
/begin MEASUREMENT VSM_LCKIE_OS_RoadWidth "" FLOAT32_IEEE PubIfStateVSM_MDL_CM_single 0 0 -3.4e+38 3.4e+38 ECU_ADDRESS 0x3FF5D4 /end MEASUREMENT
/begin MEASUREMENT VSM_LCKIE_OS_TTC "" FLOAT32_IEEE PubIfStateVSM_MDL_CM_single 0 0 -3.4e+38 3.4e+38 ECU_ADDRESS 0x3FF62C MATRIX_DIM 9 1 1 LAYOUT ROW_DIR /end MEASUREMENT
/begin MEASUREMENT VSM_LCKIE_POC_Counter "" UBYTE PubIfStateVSM_MDL_CM_uint8 0 0 0 255 ECU_ADDRESS 0x3FF6E6 /end MEASUREMENT
/begin MEASUREMENT VSM_LCKIE_POC_Couter1 "" UWORD PubIfStateVSM_MDL_CM_uint16 0 0 0 65535 ECU_ADDRESS 0x3FF6BC /end MEASUREMENT
/begin MEASUREMENT VSM_LCKIE_POC_Couter2 "" UBYTE PubIfStateVSM_MDL_CM_uint8 0 0 0 255 ECU_ADDRESS 0x3FF6E7 /end MEASUREMENT
/begin MEASUREMENT VSM_LCKIE_POC_LongDown "" UBYTE PubIfStateVSM_MDL_CM_uint8 0 0 0 255 ECU_ADDRESS 0x3FF6E3 /end MEASUREMENT
/begin MEASUREMENT VSM_LCKIE_POC_OvertakeFlg "" UBYTE PubIfStateVSM_MDL_CM_uint8 0 0 0 255 ECU_ADDRESS 0x3FF6E2 /end MEASUREMENT
/begin MEASUREMENT VSM_LCKIE_POC_OvertakeSpd "" FLOAT32_IEEE PubIfStateVSM_MDL_CM_single 0 0 -3.4e+38 3.4e+38 ECU_ADDRESS 0x3FF5C8 /end MEASUREMENT
/begin MEASUREMENT VSM_LCKIE_POC_POCObjLong "" FLOAT32_IEEE PubIfStateVSM_MDL_CM_single 0 0 -3.4e+38 3.4e+38 ECU_ADDRESS 0x3FF5CC /end MEASUREMENT
/begin MEASUREMENT VSM_LCKIE_POC_POCObjTTC "" FLOAT32_IEEE PubIfStateVSM_MDL_CM_single 0 0 -3.4e+38 3.4e+38 ECU_ADDRESS 0x3FF5D0 /end MEASUREMENT
/begin MEASUREMENT VSM_LCKIE_POC_POSID "" UBYTE PubIfStateVSM_MDL_CM_uint8 0 0 0 255 ECU_ADDRESS 0x3FF6E4 /end MEASUREMENT
/begin MEASUREMENT VSM_LCKIE_POC_POSObjID "" UBYTE PubIfStateVSM_MDL_CM_uint8 0 0 0 255 ECU_ADDRESS 0x3FF6E5 /end MEASUREMENT
/begin MEASUREMENT VSM_LCKIE_POC_delay_time "" FLOAT32_IEEE PubIfStateVSM_MDL_CM_single 0 0 -3.4e+38 3.4e+38 ECU_ADDRESS 0x3FF588 /end MEASUREMENT
/begin MEASUREMENT VSM_LCKIE_State_Active2Ready "" UBYTE PubIfStateVSM_MDL_CM_boolean 0 0 0 1 BIT_MASK 0x1 ECU_ADDRESS 0x3FF836 /end MEASUREMENT
/begin MEASUREMENT VSM_LCKIE_State_DrvInputTrqValue_Active2Ready "" UBYTE PubIfStateVSM_MDL_CM_boolean 0 0 0 1 BIT_MASK 0x1 ECU_ADDRESS 0x3FF832 /end MEASUREMENT
/begin MEASUREMENT VSM_LCKIE_State_DrvInputTrqValue_Ready2Active "" UBYTE PubIfStateVSM_MDL_CM_boolean 0 0 0 1 BIT_MASK 0x1 ECU_ADDRESS 0x3FF826 /end MEASUREMENT
/begin MEASUREMENT VSM_LCKIE_State_ELKObj_Active2Ready "" UBYTE PubIfStateVSM_MDL_CM_boolean 0 0 0 1 BIT_MASK 0x1 ECU_ADDRESS 0x3FF833 /end MEASUREMENT
/begin MEASUREMENT VSM_LCKIE_State_ELKObj_Ready2Active "" UBYTE PubIfStateVSM_MDL_CM_boolean 0 0 0 1 BIT_MASK 0x1 ECU_ADDRESS 0x3FF827 /end MEASUREMENT
/begin MEASUREMENT VSM_LCKIE_State_HWASts_Ready2Active "" UBYTE PubIfStateVSM_MDL_CM_boolean 0 0 0 1 BIT_MASK 0x1 ECU_ADDRESS 0x3FF837 /end MEASUREMENT
/begin MEASUREMENT VSM_LCKIE_State_IEObj_Active2Ready "" UBYTE PubIfStateVSM_MDL_CM_boolean 0 0 0 1 BIT_MASK 0x1 ECU_ADDRESS 0x3FF835 /end MEASUREMENT
/begin MEASUREMENT VSM_LCKIE_State_IEObj_Ready2Active "" UBYTE PubIfStateVSM_MDL_CM_boolean 0 0 0 1 BIT_MASK 0x1 ECU_ADDRESS 0x3FF829 /end MEASUREMENT
/begin MEASUREMENT VSM_LCKIE_State_IFVFail "" UBYTE PubIfStateVSM_MDL_CM_boolean 0 0 0 1 BIT_MASK 0x1 ECU_ADDRESS 0x3FF839 /end MEASUREMENT
/begin MEASUREMENT VSM_LCKIE_State_IFVReady "" UBYTE PubIfStateVSM_MDL_CM_boolean 0 0 0 1 BIT_MASK 0x1 ECU_ADDRESS 0x3FF838 /end MEASUREMENT
/begin MEASUREMENT VSM_LCKIE_State_Idel2Ready "" UBYTE PubIfStateVSM_MDL_CM_boolean 0 0 0 1 BIT_MASK 0x1 ECU_ADDRESS 0x3FF825 /end MEASUREMENT
/begin MEASUREMENT VSM_LCKIE_State_LaneWidth_Idel2Ready "" UBYTE PubIfStateVSM_MDL_CM_boolean 0 0 0 1 BIT_MASK 0x1 ECU_ADDRESS 0x3FF821 /end MEASUREMENT
/begin MEASUREMENT VSM_LCKIE_State_LaneWidth_Ready2Idel "" UBYTE PubIfStateVSM_MDL_CM_boolean 0 0 0 1 BIT_MASK 0x1 ECU_ADDRESS 0x3FF82D /end MEASUREMENT
/begin MEASUREMENT VSM_LCKIE_State_Lanecurve_Idel2Ready "" UBYTE PubIfStateVSM_MDL_CM_boolean 0 0 0 1 BIT_MASK 0x1 ECU_ADDRESS 0x3FF820 /end MEASUREMENT
/begin MEASUREMENT VSM_LCKIE_State_Lanecurve_Ready2Idel "" UBYTE PubIfStateVSM_MDL_CM_boolean 0 0 0 1 BIT_MASK 0x1 ECU_ADDRESS 0x3FF82C /end MEASUREMENT
/begin MEASUREMENT VSM_LCKIE_State_OppFrontObj_Active2Ready "" UBYTE PubIfStateVSM_MDL_CM_boolean 0 0 0 1 BIT_MASK 0x1 ECU_ADDRESS 0x3FF834 /end MEASUREMENT
/begin MEASUREMENT VSM_LCKIE_State_OppFrontObj_Ready2Active "" UBYTE PubIfStateVSM_MDL_CM_boolean 0 0 0 1 BIT_MASK 0x1 ECU_ADDRESS 0x3FF828 /end MEASUREMENT
/begin MEASUREMENT VSM_LCKIE_State_Ready2Active "" UBYTE PubIfStateVSM_MDL_CM_boolean 0 0 0 1 BIT_MASK 0x1 ECU_ADDRESS 0x3FF82A /end MEASUREMENT
/begin MEASUREMENT VSM_LCKIE_State_Ready2Idel "" UBYTE PubIfStateVSM_MDL_CM_boolean 0 0 0 1 BIT_MASK 0x1 ECU_ADDRESS 0x3FF831 /end MEASUREMENT
/begin MEASUREMENT VSM_LCKIE_State_Vehspeed_Idel2Ready "" UBYTE PubIfStateVSM_MDL_CM_boolean 0 0 0 1 BIT_MASK 0x1 ECU_ADDRESS 0x3FF81F /end MEASUREMENT
/begin MEASUREMENT VSM_LCKIE_State_Vehspeed_Ready2Idel "" UBYTE PubIfStateVSM_MDL_CM_boolean 0 0 0 1 BIT_MASK 0x1 ECU_ADDRESS 0x3FF82B /end MEASUREMENT
/begin MEASUREMENT VSM_LCKIE_State_detaspd_Idel2Ready "" UBYTE PubIfStateVSM_MDL_CM_boolean 0 0 0 1 BIT_MASK 0x1 ECU_ADDRESS 0x3FF824 /end MEASUREMENT
/begin MEASUREMENT VSM_LCKIE_State_detaspd_Ready2Idel "" UBYTE PubIfStateVSM_MDL_CM_boolean 0 0 0 1 BIT_MASK 0x1 ECU_ADDRESS 0x3FF830 /end MEASUREMENT
/begin MEASUREMENT VSM_LCKIE_State_lamb_Idel2Ready "" UBYTE PubIfStateVSM_MDL_CM_boolean 0 0 0 1 BIT_MASK 0x1 ECU_ADDRESS 0x3FF823 /end MEASUREMENT
/begin MEASUREMENT VSM_LCKIE_State_lamb_Ready2Idel "" UBYTE PubIfStateVSM_MDL_CM_boolean 0 0 0 1 BIT_MASK 0x1 ECU_ADDRESS 0x3FF82F /end MEASUREMENT
/begin MEASUREMENT VSM_LCKIE_State_wiper_Idel2Ready "" UBYTE PubIfStateVSM_MDL_CM_boolean 0 0 0 1 BIT_MASK 0x1 ECU_ADDRESS 0x3FF822 /end MEASUREMENT
/begin MEASUREMENT VSM_LCKIE_State_wiper_Ready2Idel "" UBYTE PubIfStateVSM_MDL_CM_boolean 0 0 0 1 BIT_MASK 0x1 ECU_ADDRESS 0x3FF82E /end MEASUREMENT
/begin MEASUREMENT VSM_LDWSts "" UBYTE PubIfStateVSM_MDL_CM_uint8 0 0 0 255 ECU_ADDRESS 0x3FF6DC /end MEASUREMENT
/begin MEASUREMENT VSM_LDW_Active2Ready "" UBYTE PubIfStateVSM_MDL_CM_boolean 0 0 0 1 BIT_MASK 0x1 ECU_ADDRESS 0x3FF85B /end MEASUREMENT
/begin MEASUREMENT VSM_LDW_Con_AbsEsp_Idle2Ready "" UBYTE PubIfStateVSM_MDL_CM_boolean 0 0 0 1 BIT_MASK 0x1 ECU_ADDRESS 0x3FF83B /end MEASUREMENT
/begin MEASUREMENT VSM_LDW_Con_AbsEsp_Ready2Idle "" UBYTE PubIfStateVSM_MDL_CM_boolean 0 0 0 1 BIT_MASK 0x1 ECU_ADDRESS 0x3FF844 /end MEASUREMENT
/begin MEASUREMENT VSM_LDW_Con_AccPedalRate_Active2Ready "" UBYTE PubIfStateVSM_MDL_CM_boolean 0 0 0 1 BIT_MASK 0x1 ECU_ADDRESS 0x3FF781 /end MEASUREMENT
/begin MEASUREMENT VSM_LDW_Con_AccPedalRate_Ready2Active "" UBYTE PubIfStateVSM_MDL_CM_boolean 0 0 0 1 BIT_MASK 0x1 ECU_ADDRESS 0x3FF851 /end MEASUREMENT
/begin MEASUREMENT VSM_LDW_Con_BrakePressure_Active2Ready "" UBYTE PubIfStateVSM_MDL_CM_boolean 0 0 0 1 BIT_MASK 0x1 ECU_ADDRESS 0x3FF782 /end MEASUREMENT
/begin MEASUREMENT VSM_LDW_Con_BrakePressure_Ready2Active "" UBYTE PubIfStateVSM_MDL_CM_boolean 0 0 0 1 BIT_MASK 0x1 ECU_ADDRESS 0x3FF850 /end MEASUREMENT
/begin MEASUREMENT VSM_LDW_Con_CURRENT_GEAR_Active2Ready "" UBYTE PubIfStateVSM_MDL_CM_boolean 0 0 0 1 BIT_MASK 0x1 ECU_ADDRESS 0x3FF856 /end MEASUREMENT
/begin MEASUREMENT VSM_LDW_Con_CURRENT_GEAR_Ready2Active "" UBYTE PubIfStateVSM_MDL_CM_boolean 0 0 0 1 BIT_MASK 0x1 ECU_ADDRESS 0x3FF852 /end MEASUREMENT
/begin MEASUREMENT VSM_LDW_Con_ESSSts_Idle2Ready "" UBYTE PubIfStateVSM_MDL_CM_boolean 0 0 0 1 BIT_MASK 0x1 ECU_ADDRESS 0x3FF841 /end MEASUREMENT
/begin MEASUREMENT VSM_LDW_Con_ESSSts_Ready2Idle "" UBYTE PubIfStateVSM_MDL_CM_boolean 0 0 0 1 BIT_MASK 0x1 ECU_ADDRESS 0x3FF84A /end MEASUREMENT
/begin MEASUREMENT VSM_LDW_Con_Failsafe_Idle2Ready "" UBYTE PubIfStateVSM_MDL_CM_boolean 0 0 0 1 BIT_MASK 0x1 ECU_ADDRESS 0x3FF83D /end MEASUREMENT
/begin MEASUREMENT VSM_LDW_Con_Failsafe_Ready2Idle "" UBYTE PubIfStateVSM_MDL_CM_boolean 0 0 0 1 BIT_MASK 0x1 ECU_ADDRESS 0x3FF845 /end MEASUREMENT
/begin MEASUREMENT VSM_LDW_Con_Headingangle_Idle2Ready "" UBYTE PubIfStateVSM_MDL_CM_boolean 0 0 0 1 BIT_MASK 0x1 ECU_ADDRESS 0x3FF83C /end MEASUREMENT
/begin MEASUREMENT VSM_LDW_Con_Headingangle_Ready2Idle "" UBYTE PubIfStateVSM_MDL_CM_boolean 0 0 0 1 BIT_MASK 0x1 ECU_ADDRESS 0x3FF847 /end MEASUREMENT
/begin MEASUREMENT VSM_LDW_Con_LaneChange_Active2Ready "" UBYTE PubIfStateVSM_MDL_CM_boolean 0 0 0 1 BIT_MASK 0x1 ECU_ADDRESS 0x3FF859 /end MEASUREMENT
/begin MEASUREMENT VSM_LDW_Con_LaneChange_Ready2Active "" UBYTE PubIfStateVSM_MDL_CM_boolean 0 0 0 1 BIT_MASK 0x1 ECU_ADDRESS 0x3FF854 /end MEASUREMENT
/begin MEASUREMENT VSM_LDW_Con_LaneCurve_Idle2Ready "" UBYTE PubIfStateVSM_MDL_CM_boolean 0 0 0 1 BIT_MASK 0x1 ECU_ADDRESS 0x3FF83E /end MEASUREMENT
/begin MEASUREMENT VSM_LDW_Con_LaneCurve_Ready2Idle "" UBYTE PubIfStateVSM_MDL_CM_boolean 0 0 0 1 BIT_MASK 0x1 ECU_ADDRESS 0x3FF846 /end MEASUREMENT
/begin MEASUREMENT VSM_LDW_Con_Lane_Idle2Ready "" UBYTE PubIfStateVSM_MDL_CM_boolean 0 0 0 1 BIT_MASK 0x1 ECU_ADDRESS 0x3FF83F /end MEASUREMENT
/begin MEASUREMENT VSM_LDW_Con_Lane_Ready2Idle "" UBYTE PubIfStateVSM_MDL_CM_boolean 0 0 0 1 BIT_MASK 0x1 ECU_ADDRESS 0x3FF849 /end MEASUREMENT
/begin MEASUREMENT VSM_LDW_Con_LateralAcc_Active2Ready "" UBYTE PubIfStateVSM_MDL_CM_boolean 0 0 0 1 BIT_MASK 0x1 ECU_ADDRESS 0x3FF857 /end MEASUREMENT
/begin MEASUREMENT VSM_LDW_Con_LateralAcc_Ready2Active "" UBYTE PubIfStateVSM_MDL_CM_boolean 0 0 0 1 BIT_MASK 0x1 ECU_ADDRESS 0x3FF84E /end MEASUREMENT
/begin MEASUREMENT VSM_LDW_Con_LongitudeAcc_Active2Ready "" UBYTE PubIfStateVSM_MDL_CM_boolean 0 0 0 1 BIT_MASK 0x1 ECU_ADDRESS 0x3FF858 /end MEASUREMENT
/begin MEASUREMENT VSM_LDW_Con_LongitudeAcc_Ready2Active "" UBYTE PubIfStateVSM_MDL_CM_boolean 0 0 0 1 BIT_MASK 0x1 ECU_ADDRESS 0x3FF84F /end MEASUREMENT
/begin MEASUREMENT VSM_LDW_Con_SteerWheelAngle_Active2Ready "" UBYTE PubIfStateVSM_MDL_CM_boolean 0 0 0 1 BIT_MASK 0x1 ECU_ADDRESS 0x3FF783 /end MEASUREMENT
/begin MEASUREMENT VSM_LDW_Con_SteerWheelAngle_Ready2Active "" UBYTE PubIfStateVSM_MDL_CM_boolean 0 0 0 1 BIT_MASK 0x1 ECU_ADDRESS 0x3FF84C /end MEASUREMENT
/begin MEASUREMENT VSM_LDW_Con_SteerWheelSpd_Active2Ready "" UBYTE PubIfStateVSM_MDL_CM_boolean 0 0 0 1 BIT_MASK 0x1 ECU_ADDRESS 0x3FF784 /end MEASUREMENT
/begin MEASUREMENT VSM_LDW_Con_SteerWheelSpd_Ready2Active "" UBYTE PubIfStateVSM_MDL_CM_boolean 0 0 0 1 BIT_MASK 0x1 ECU_ADDRESS 0x3FF84D /end MEASUREMENT
/begin MEASUREMENT VSM_LDW_Con_TurnLight_Active2Ready "" UBYTE PubIfStateVSM_MDL_CM_boolean 0 0 0 1 BIT_MASK 0x1 ECU_ADDRESS 0x3FF85A /end MEASUREMENT
/begin MEASUREMENT VSM_LDW_Con_TurnLight_Ready2Active "" UBYTE PubIfStateVSM_MDL_CM_boolean 0 0 0 1 BIT_MASK 0x1 ECU_ADDRESS 0x3FF853 /end MEASUREMENT
/begin MEASUREMENT VSM_LDW_Con_VehicleSpeed_Idle2Ready "" UBYTE PubIfStateVSM_MDL_CM_boolean 0 0 0 1 BIT_MASK 0x1 ECU_ADDRESS 0x3FF840 /end MEASUREMENT
/begin MEASUREMENT VSM_LDW_Con_VehicleSpeed_Ready2Idle "" UBYTE PubIfStateVSM_MDL_CM_boolean 0 0 0 1 BIT_MASK 0x1 ECU_ADDRESS 0x3FF848 /end MEASUREMENT
/begin MEASUREMENT VSM_LDW_Con_YawRate_Idle2Ready "" UBYTE PubIfStateVSM_MDL_CM_boolean 0 0 0 1 BIT_MASK 0x1 ECU_ADDRESS 0x3FF83A /end MEASUREMENT
/begin MEASUREMENT VSM_LDW_Con_YawRate_Ready2Idle "" UBYTE PubIfStateVSM_MDL_CM_boolean 0 0 0 1 BIT_MASK 0x1 ECU_ADDRESS 0x3FF843 /end MEASUREMENT
/begin MEASUREMENT VSM_LDW_Count "" FLOAT32_IEEE PubIfStateVSM_MDL_CM_single 0 0 -3.4e+38 3.4e+38 ECU_ADDRESS 0x3FF598 /end MEASUREMENT
/begin MEASUREMENT VSM_LDW_Counter "" UBYTE PubIfStateVSM_MDL_CM_uint8 0 0 0 255 ECU_ADDRESS 0x3FF6DD /end MEASUREMENT
/begin MEASUREMENT VSM_LDW_Idle2Ready "" UBYTE PubIfStateVSM_MDL_CM_boolean 0 0 0 1 BIT_MASK 0x1 ECU_ADDRESS 0x3FF842 /end MEASUREMENT
/begin MEASUREMENT VSM_LDW_Leftwarnflag "" FLOAT32_IEEE PubIfStateVSM_MDL_CM_single 0 0 -3.4e+38 3.4e+38 ECU_ADDRESS 0x3FF5C0 /end MEASUREMENT
/begin MEASUREMENT VSM_LDW_Other2Idle "" UBYTE PubIfStateVSM_MDL_CM_boolean 0 0 0 1 BIT_MASK 0x1 ECU_ADDRESS 0x3FF84B /end MEASUREMENT
/begin MEASUREMENT VSM_LDW_Ready2Active "" UBYTE PubIfStateVSM_MDL_CM_boolean 0 0 0 1 BIT_MASK 0x1 ECU_ADDRESS 0x3FF855 /end MEASUREMENT
/begin MEASUREMENT VSM_LDW_Rightwarnflag "" FLOAT32_IEEE PubIfStateVSM_MDL_CM_single 0 0 -3.4e+38 3.4e+38 ECU_ADDRESS 0x3FF5C4 /end MEASUREMENT
/begin MEASUREMENT VSM_LDW_VERSION "" ULONG PubIfStateVSM_MDL_CM_uint32 0 0 0 4294967295 ECU_ADDRESS 0x3FF56C /end MEASUREMENT
/begin MEASUREMENT VSM_LDW_wCount "" FLOAT32_IEEE PubIfStateVSM_MDL_CM_single 0 0 -3.4e+38 3.4e+38 ECU_ADDRESS 0x3FF59C /end MEASUREMENT
/begin MEASUREMENT VSM_LKAState "" UBYTE PubIfStateVSM_MDL_CM_uint8 0 0 0 255 ECU_ADDRESS 0x3FF6CC /end MEASUREMENT
/begin MEASUREMENT VSM_LKAWarnflag "" UBYTE PubIfStateVSM_MDL_CM_boolean 0 0 0 1 BIT_MASK 0x1 ECU_ADDRESS 0x3FF7E1 /end MEASUREMENT
/begin MEASUREMENT VSM_LKA_Active2Ready "" UBYTE PubIfStateVSM_MDL_CM_boolean 0 0 0 1 BIT_MASK 0x1 ECU_ADDRESS 0x3FF7EA /end MEASUREMENT
/begin MEASUREMENT VSM_LKA_Con_AbsEsp_Idle2Ready "" UBYTE PubIfStateVSM_MDL_CM_boolean 0 0 0 1 BIT_MASK 0x1 ECU_ADDRESS 0x3FF7C2 /end MEASUREMENT
/begin MEASUREMENT VSM_LKA_Con_AbsEsp_Ready2Idle "" UBYTE PubIfStateVSM_MDL_CM_boolean 0 0 0 1 BIT_MASK 0x1 ECU_ADDRESS 0x3FF7CB /end MEASUREMENT
/begin MEASUREMENT VSM_LKA_Con_AccPedalRate_Active2Ready "" UBYTE PubIfStateVSM_MDL_CM_boolean 0 0 0 1 BIT_MASK 0x1 ECU_ADDRESS 0x3FF785 /end MEASUREMENT
/begin MEASUREMENT VSM_LKA_Con_AccPedalRate_Ready2Active "" UBYTE PubIfStateVSM_MDL_CM_boolean 0 0 0 1 BIT_MASK 0x1 ECU_ADDRESS 0x3FF7D9 /end MEASUREMENT
/begin MEASUREMENT VSM_LKA_Con_BrakePressure_Active2Ready "" UBYTE PubIfStateVSM_MDL_CM_boolean 0 0 0 1 BIT_MASK 0x1 ECU_ADDRESS 0x3FF786 /end MEASUREMENT
/begin MEASUREMENT VSM_LKA_Con_BrakePressure_Ready2Active "" UBYTE PubIfStateVSM_MDL_CM_boolean 0 0 0 1 BIT_MASK 0x1 ECU_ADDRESS 0x3FF7D8 /end MEASUREMENT
/begin MEASUREMENT VSM_LKA_Con_CURRENT_GEAR_Active2Ready "" UBYTE PubIfStateVSM_MDL_CM_boolean 0 0 0 1 BIT_MASK 0x1 ECU_ADDRESS 0x3FF7E5 /end MEASUREMENT
/begin MEASUREMENT VSM_LKA_Con_CURRENT_GEAR_Ready2Active "" UBYTE PubIfStateVSM_MDL_CM_boolean 0 0 0 1 BIT_MASK 0x1 ECU_ADDRESS 0x3FF7DB /end MEASUREMENT
/begin MEASUREMENT VSM_LKA_Con_DriverInput_Active2Ready "" UBYTE PubIfStateVSM_MDL_CM_boolean 0 0 0 1 BIT_MASK 0x1 ECU_ADDRESS 0x3FF788 /end MEASUREMENT
/begin MEASUREMENT VSM_LKA_Con_DriverInput_Ready2Active "" UBYTE PubIfStateVSM_MDL_CM_boolean 0 0 0 1 BIT_MASK 0x1 ECU_ADDRESS 0x3FF7D4 /end MEASUREMENT
/begin MEASUREMENT VSM_LKA_Con_ESSSts_Active2Ready "" UBYTE PubIfStateVSM_MDL_CM_boolean 0 0 0 1 BIT_MASK 0x1 ECU_ADDRESS 0x3FF7E8 /end MEASUREMENT
/begin MEASUREMENT VSM_LKA_Con_ESSSts_Idle2Ready "" UBYTE PubIfStateVSM_MDL_CM_boolean 0 0 0 1 BIT_MASK 0x1 ECU_ADDRESS 0x3FF7C5 /end MEASUREMENT
/begin MEASUREMENT VSM_LKA_Con_ESSSts_Ready2Idle "" UBYTE PubIfStateVSM_MDL_CM_boolean 0 0 0 1 BIT_MASK 0x1 ECU_ADDRESS 0x3FF7CF /end MEASUREMENT
/begin MEASUREMENT VSM_LKA_Con_EpsSta_Active2Ready "" UBYTE PubIfStateVSM_MDL_CM_boolean 0 0 0 1 BIT_MASK 0x1 ECU_ADDRESS 0x3FF7E4 /end MEASUREMENT
/begin MEASUREMENT VSM_LKA_Con_EpsSta_Ready2Active "" UBYTE PubIfStateVSM_MDL_CM_boolean 0 0 0 1 BIT_MASK 0x1 ECU_ADDRESS 0x3FF7DA /end MEASUREMENT
/begin MEASUREMENT VSM_LKA_Con_Failsafe_Idle2Ready "" UBYTE PubIfStateVSM_MDL_CM_boolean 0 0 0 1 BIT_MASK 0x1 ECU_ADDRESS 0x3FF7C4 /end MEASUREMENT
/begin MEASUREMENT VSM_LKA_Con_Failsafe_Ready2Idle "" UBYTE PubIfStateVSM_MDL_CM_boolean 0 0 0 1 BIT_MASK 0x1 ECU_ADDRESS 0x3FF7CC /end MEASUREMENT
/begin MEASUREMENT VSM_LKA_Con_Headingangle_Idle2Ready "" UBYTE PubIfStateVSM_MDL_CM_boolean 0 0 0 1 BIT_MASK 0x1 ECU_ADDRESS 0x3FF7C3 /end MEASUREMENT
/begin MEASUREMENT VSM_LKA_Con_Headingangle_Ready2Idle "" UBYTE PubIfStateVSM_MDL_CM_boolean 0 0 0 1 BIT_MASK 0x1 ECU_ADDRESS 0x3FF7CE /end MEASUREMENT
/begin MEASUREMENT VSM_LKA_Con_LaneChange_Active2Ready "" UBYTE PubIfStateVSM_MDL_CM_boolean 0 0 0 1 BIT_MASK 0x1 ECU_ADDRESS 0x3FF7E7 /end MEASUREMENT
/begin MEASUREMENT VSM_LKA_Con_LaneChange_Ready2Active "" UBYTE PubIfStateVSM_MDL_CM_boolean 0 0 0 1 BIT_MASK 0x1 ECU_ADDRESS 0x3FF7DE /end MEASUREMENT
/begin MEASUREMENT VSM_LKA_Con_LaneCurve_Idle2Ready "" UBYTE PubIfStateVSM_MDL_CM_boolean 0 0 0 1 BIT_MASK 0x1 ECU_ADDRESS 0x3FF7C6 /end MEASUREMENT
/begin MEASUREMENT VSM_LKA_Con_LaneCurve_Ready2Idle "" UBYTE PubIfStateVSM_MDL_CM_boolean 0 0 0 1 BIT_MASK 0x1 ECU_ADDRESS 0x3FF7CD /end MEASUREMENT
/begin MEASUREMENT VSM_LKA_Con_Lane_Idle2Ready "" UBYTE PubIfStateVSM_MDL_CM_boolean 0 0 0 1 BIT_MASK 0x1 ECU_ADDRESS 0x3FF7C7 /end MEASUREMENT
/begin MEASUREMENT VSM_LKA_Con_Lane_Ready2Idle "" UBYTE PubIfStateVSM_MDL_CM_boolean 0 0 0 1 BIT_MASK 0x1 ECU_ADDRESS 0x3FF7D0 /end MEASUREMENT
/begin MEASUREMENT VSM_LKA_Con_LateralAcc_Active2Ready "" UBYTE PubIfStateVSM_MDL_CM_boolean 0 0 0 1 BIT_MASK 0x1 ECU_ADDRESS 0x3FF7E2 /end MEASUREMENT
/begin MEASUREMENT VSM_LKA_Con_LateralAcc_Ready2Active "" UBYTE PubIfStateVSM_MDL_CM_boolean 0 0 0 1 BIT_MASK 0x1 ECU_ADDRESS 0x3FF7D6 /end MEASUREMENT
/begin MEASUREMENT VSM_LKA_Con_LongitudeAcc_Active2Ready "" UBYTE PubIfStateVSM_MDL_CM_boolean 0 0 0 1 BIT_MASK 0x1 ECU_ADDRESS 0x3FF7E3 /end MEASUREMENT
/begin MEASUREMENT VSM_LKA_Con_LongitudeAcc_Ready2Active "" UBYTE PubIfStateVSM_MDL_CM_boolean 0 0 0 1 BIT_MASK 0x1 ECU_ADDRESS 0x3FF7D7 /end MEASUREMENT
/begin MEASUREMENT VSM_LKA_Con_OverRide_Active2Ready "" UBYTE PubIfStateVSM_MDL_CM_boolean 0 0 0 1 BIT_MASK 0x1 ECU_ADDRESS 0x3FF78A /end MEASUREMENT
/begin MEASUREMENT VSM_LKA_Con_Override_Ready2Active "" UBYTE PubIfStateVSM_MDL_CM_boolean 0 0 0 1 BIT_MASK 0x1 ECU_ADDRESS 0x3FF7DD /end MEASUREMENT
/begin MEASUREMENT VSM_LKA_Con_SteerWheelAngle_Active2Ready "" UBYTE PubIfStateVSM_MDL_CM_boolean 0 0 0 1 BIT_MASK 0x1 ECU_ADDRESS 0x3FF787 /end MEASUREMENT
/begin MEASUREMENT VSM_LKA_Con_SteerWheelAngle_Ready2Active "" UBYTE PubIfStateVSM_MDL_CM_boolean 0 0 0 1 BIT_MASK 0x1 ECU_ADDRESS 0x3FF7D3 /end MEASUREMENT
/begin MEASUREMENT VSM_LKA_Con_SteerWheelSpd_Active2Ready "" UBYTE PubIfStateVSM_MDL_CM_boolean 0 0 0 1 BIT_MASK 0x1 ECU_ADDRESS 0x3FF789 /end MEASUREMENT
/begin MEASUREMENT VSM_LKA_Con_SteerWheelSpd_Ready2Active "" UBYTE PubIfStateVSM_MDL_CM_boolean 0 0 0 1 BIT_MASK 0x1 ECU_ADDRESS 0x3FF7D5 /end MEASUREMENT
/begin MEASUREMENT VSM_LKA_Con_TJASts_Active2Ready "" UBYTE PubIfStateVSM_MDL_CM_boolean 0 0 0 1 BIT_MASK 0x1 ECU_ADDRESS 0x3FF7E9 /end MEASUREMENT
/begin MEASUREMENT VSM_LKA_Con_TJASts_Ready2Active "" UBYTE PubIfStateVSM_MDL_CM_boolean 0 0 0 1 BIT_MASK 0x1 ECU_ADDRESS 0x3FF7DF /end MEASUREMENT
/begin MEASUREMENT VSM_LKA_Con_TurnLight_Active2Ready "" UBYTE PubIfStateVSM_MDL_CM_boolean 0 0 0 1 BIT_MASK 0x1 ECU_ADDRESS 0x3FF7E6 /end MEASUREMENT
/begin MEASUREMENT VSM_LKA_Con_TurnLight_Ready2Active "" UBYTE PubIfStateVSM_MDL_CM_boolean 0 0 0 1 BIT_MASK 0x1 ECU_ADDRESS 0x3FF7DC /end MEASUREMENT
/begin MEASUREMENT VSM_LKA_Con_VehicleSpeed_Idle2Ready "" UBYTE PubIfStateVSM_MDL_CM_boolean 0 0 0 1 BIT_MASK 0x1 ECU_ADDRESS 0x3FF7C8 /end MEASUREMENT
/begin MEASUREMENT VSM_LKA_Con_VehicleSpeed_Ready2Idle "" UBYTE PubIfStateVSM_MDL_CM_boolean 0 0 0 1 BIT_MASK 0x1 ECU_ADDRESS 0x3FF7D1 /end MEASUREMENT
/begin MEASUREMENT VSM_LKA_Con_YawRate_Idle2Ready "" UBYTE PubIfStateVSM_MDL_CM_boolean 0 0 0 1 BIT_MASK 0x1 ECU_ADDRESS 0x3FF7C1 /end MEASUREMENT
/begin MEASUREMENT VSM_LKA_Con_YawRate_Ready2Idle "" UBYTE PubIfStateVSM_MDL_CM_boolean 0 0 0 1 BIT_MASK 0x1 ECU_ADDRESS 0x3FF7CA /end MEASUREMENT
/begin MEASUREMENT VSM_LKA_Counter "" UBYTE PubIfStateVSM_MDL_CM_uint8 0 0 0 255 ECU_ADDRESS 0x3FF6DE /end MEASUREMENT
/begin MEASUREMENT VSM_LKA_End "" UBYTE PubIfStateVSM_MDL_CM_boolean 0 0 0 1 BIT_MASK 0x1 ECU_ADDRESS 0x3FF7EB /end MEASUREMENT
/begin MEASUREMENT VSM_LKA_Idle2Ready "" UBYTE PubIfStateVSM_MDL_CM_boolean 0 0 0 1 BIT_MASK 0x1 ECU_ADDRESS 0x3FF7C9 /end MEASUREMENT
/begin MEASUREMENT VSM_LKA_LKAactive "" FLOAT32_IEEE PubIfStateVSM_MDL_CM_single 0 0 -3.4e+38 3.4e+38 ECU_ADDRESS 0x3FF5B8 /end MEASUREMENT
/begin MEASUREMENT VSM_LKA_LKAout "" FLOAT32_IEEE PubIfStateVSM_MDL_CM_single 0 0 -3.4e+38 3.4e+38 ECU_ADDRESS 0x3FF5BC /end MEASUREMENT
/begin MEASUREMENT VSM_LKA_LeftWarning "" UBYTE PubIfStateVSM_MDL_CM_boolean 0 0 0 1 BIT_MASK 0x1 ECU_ADDRESS 0x3FF7EC /end MEASUREMENT
/begin MEASUREMENT VSM_LKA_Other2Idle "" UBYTE PubIfStateVSM_MDL_CM_boolean 0 0 0 1 BIT_MASK 0x1 ECU_ADDRESS 0x3FF7D2 /end MEASUREMENT
/begin MEASUREMENT VSM_LKA_Ready2Active "" UBYTE PubIfStateVSM_MDL_CM_boolean 0 0 0 1 BIT_MASK 0x1 ECU_ADDRESS 0x3FF7E0 /end MEASUREMENT
/begin MEASUREMENT VSM_LKA_RightWarning "" UBYTE PubIfStateVSM_MDL_CM_boolean 0 0 0 1 BIT_MASK 0x1 ECU_ADDRESS 0x3FF7ED /end MEASUREMENT
/begin MEASUREMENT VSM_LKA_VERSION "" ULONG PubIfStateVSM_MDL_CM_uint32 0 0 0 4294967295 ECU_ADDRESS 0x3FF570 /end MEASUREMENT
/begin MEASUREMENT VSM_LKA_Warning "" UBYTE PubIfStateVSM_MDL_CM_uint8 0 0 0 255 ECU_ADDRESS 0x3FF6D4 /end MEASUREMENT
/begin MEASUREMENT VSM_LeftChange_new "" UBYTE PubIfStateVSM_MDL_CM_boolean 0 0 0 1 BIT_MASK 0x1 ECU_ADDRESS 0x3FF7B4 /end MEASUREMENT
/begin MEASUREMENT VSM_LeftChange_old "" UBYTE PubIfStateVSM_MDL_CM_boolean 0 0 0 1 BIT_MASK 0x1 ECU_ADDRESS 0x3FF7B3 /end MEASUREMENT
/begin MEASUREMENT VSM_RightChange_new "" UBYTE PubIfStateVSM_MDL_CM_boolean 0 0 0 1 BIT_MASK 0x1 ECU_ADDRESS 0x3FF7B6 /end MEASUREMENT
/begin MEASUREMENT VSM_RightChange_old "" UBYTE PubIfStateVSM_MDL_CM_boolean 0 0 0 1 BIT_MASK 0x1 ECU_ADDRESS 0x3FF7B5 /end MEASUREMENT
/begin MEASUREMENT VSM_TJA_ACC_SelSts "" UBYTE PubIfStateVSM_MDL_CM_uint8 0 0 0 255 ECU_ADDRESS 0x3FF6E0 /end MEASUREMENT
/begin MEASUREMENT VSM_UOM_SubModel_Number "" UWORD PubIfStateVSM_MDL_CM_uint16 0 0 0 65535 ECU_ADDRESS 0x3FF6BA /end MEASUREMENT
/begin MEASUREMENT VSM_UOM_SubModel_VERSION "" ULONG PubIfStateVSM_MDL_CM_uint32 0 0 0 4294967295 ECU_ADDRESS 0x3FF574 /end MEASUREMENT
/begin MEASUREMENT dxP0 "" FLOAT32_IEEE Noa_Nofusion_CM_single 0 0 -3.4e+38 3.4e+38 ECU_ADDRESS 0x3CAF80 /end MEASUREMENT
/begin MEASUREMENT rangeP0 "" FLOAT32_IEEE Noa_Nofusion_CM_single 0 0 -3.4e+38 3.4e+38 ECU_ADDRESS 0x3CAF84 /end MEASUREMENT
/begin GROUP Noa_Nofusion "Noa_Nofusion" ROOT
 /begin SUB_GROUP Root_CR_RSDS_Input Root_Chassis1 Root_Common Root_Control1 Root_LPV Root_Subsystem1 Root_Subsystem4 Root_TOS /end SUB_GROUP
 /begin REF_CHARACTERISTIC P_BCM_TurnLmpType /end REF_CHARACTERISTIC
 /begin REF_MEASUREMENT Longctrl_VIE_AxRefDt Longctrl_VIE_alpSideSlipAngle Longctrl_VIE_axRefMs2 /end REF_MEASUREMENT
/end GROUP
/begin GROUP PubIfChassisHMI_MDL "PubIfChassisHMI_MDL" /begin SUB_GROUP Root_Subsystem /end SUB_GROUP /end GROUP
/begin GROUP PubIfCommonVIE_MDL "PubIfCommonVIE_MDL" /begin SUB_GROUP Root_VIE /end SUB_GROUP /begin REF_MEASUREMENT VIE_SW_VERSION /end REF_MEASUREMENT /end GROUP
/begin GROUP PubIfControlLATC_MDL "PubIfControlLATC_MDL" /begin SUB_GROUP Root_Subsystem_Reference /end SUB_GROUP /end GROUP
/begin GROUP PubIfControlLONC_MDL "PubIfControlLONC_MDL" /begin SUB_GROUP Root_Subsystem2 /end SUB_GROUP /end GROUP
/begin GROUP PubIfDecisionLSM_MDL "PubIfDecisionLSM_MDL" /begin SUB_GROUP Root_Subsystem11 /end SUB_GROUP /end GROUP
/begin GROUP PubIfDecisionPLAN_MDL "PubIfDecisionPLAN_MDL" /begin SUB_GROUP Root_PLAN /end SUB_GROUP /end GROUP
/begin GROUP PubIfStateVSM_MDL "PubIfStateVSM_MDL" /begin SUB_GROUP Root_Subsystem_Reference1 /end SUB_GROUP /end GROUP
/begin GROUP Root_Chassis1 "Noa_Nofusion/Chassis1" /begin SUB_GROUP S6_HMI /end SUB_GROUP /begin REF_CHARACTERISTIC P_BCM_TurnLmpType /end REF_CHARACTERISTIC /end GROUP
/begin GROUP Root_Common "Noa_Nofusion/Common" /begin SUB_GROUP PubIfCommonVIE_MDL /end SUB_GROUP /end GROUP
/begin GROUP Root_Control1 "Noa_Nofusion/Control1" /begin SUB_GROUP PubIfControlLATC_MDL PubIfControlLONC_MDL /end SUB_GROUP /begin REF_MEASUREMENT LongCtrl_VlcInternalAcc /end REF_MEASUREMENT /end GROUP
/begin GROUP Root_CR_RSDS_Input "Noa_Nofusion/CR_RSDS_Input" /begin REF_MEASUREMENT Source_CRObjDy Source_CRObjID /end REF_MEASUREMENT /end GROUP
/begin GROUP Root_LPV "Noa_Nofusion/LPV" /begin SUB_GROUP S17_Subsystem5 S17_VSM PubIfDecisionPLAN_MDL /end SUB_GROUP /begin REF_MEASUREMENT LongCtrl_DecleToStop LongCtrl_DriveOffConditonFulfilled /end REF_MEASUREMENT /end GROUP
/begin GROUP Root_PLAN "PubIfDecisionPLAN_MDL/PLAN" /begin SUB_GROUP S1_Subsystem_Reference S1_Subsystem_Reference1 /end SUB_GROUP /begin REF_MEASUREMENT PLAN_SW_VERSION PLAN_UpdateCnt /end REF_MEASUREMENT /end GROUP
/begin GROUP Root_Subsystem "PubIfChassisHMI_MDL/Subsystem" /begin SUB_GROUP S1_HMI2_12 /end SUB_GROUP /begin REF_MEASUREMENT HMI_Counter /end REF_MEASUREMENT /end GROUP
/begin GROUP Root_Subsystem1 "Noa_Nofusion/Subsystem1" /begin REF_CHARACTERISTIC P_RFM_RoadType P_RFM_mapvalid /end REF_CHARACTERISTIC /end GROUP
/begin GROUP Root_Subsystem11 "PubIfDecisionLSM_MDL/Subsystem1" /begin SUB_GROUP S1_LSM_Signal S1_TargetLineCalc_20ms /end SUB_GROUP
 /begin REF_MEASUREMENT LSM_RFM_LineCenter_C0 LSM_RFM_LineCenter_C1 LSM_RFM_LineCenter_C2 LSM_RFM_LineCenter_C3 LSM_RFM_LineCenter_Front LSM_RFM_LineCenter_Start LSM_RFM_LineCenter_Valid LSM_RFM_LineL1_C0 LSM_RFM_LineL1_C1 LSM_RFM_LineL1_C2 LSM_RFM_LineL1_C3 LSM_RFM_LineL1_Front LSM_RFM_LineL1_Start LSM_RFM_LineL1_Valid LSM_RFM_LineR1_C0 LSM_RFM_LineR1_C1 LSM_RFM_LineR1_C2 LSM_RFM_LineR1_C3 LSM_RFM_LineR1_Front LSM_RFM_LineR1_Start LSM_RFM_LineR1_Valid /end REF_MEASUREMENT
/end GROUP
/begin GROUP Root_Subsystem2 "PubIfControlLONC_MDL/Subsystem" /begin SUB_GROUP S1_VLC /end SUB_GROUP /begin REF_MEASUREMENT LongCtrl_Counter LongCtrl_SW_VERSION /end REF_MEASUREMENT /end GROUP
/begin GROUP Root_Subsystem4 "Noa_Nofusion/Subsystem4" /begin SUB_GROUP S22_Simulink_Function /end SUB_GROUP /begin REF_CHARACTERISTIC P_Global_EQ2RearAxisY_m /end REF_CHARACTERISTIC
 /begin REF_MEASUREMENT RFM_L1_bIsLineExist RFM_L1_dC0V RFM_L1_dC1V RFM_L1_dC3V RFM_L1_dDisFront RFM_L1_dDisStart RFM_L1_eLineType RFM_R1_bIsLineExist RFM_R1_dC0V RFM_R1_dC1V RFM_R1_dC2V RFM_R1_dC3V RFM_R1_dDisFront RFM_R1_dDisStart RFM_R1_eLineType /end REF_MEASUREMENT
/end GROUP
/begin GROUP Root_Subsystem_Reference "PubIfControlLATC_MDL/Subsystem Reference" /begin SUB_GROUP S1_Subsystem /end SUB_GROUP /end GROUP
/begin GROUP Root_Subsystem_Reference1 "PubIfStateVSM_MDL/Subsystem Reference" /begin SUB_GROUP S1_Subsystem1 /end SUB_GROUP /end GROUP
/begin GROUP Root_TOS "Noa_Nofusion/TOS" /begin SUB_GROUP S23_Subsystem1 /end SUB_GROUP /end GROUP
/begin GROUP Root_VIE "PubIfCommonVIE_MDL/VIE" /begin SUB_GROUP S1_VIE /end SUB_GROUP /end GROUP
/begin GROUP S10_Enabled_Subsystem "PubIfControlLATC_MDL/Subsystem Reference/Subsystem/LateralControl/Understeer&Offset_Calc/Enabled Subsystem" /begin REF_CHARACTERISTIC P_Global_SteeringAngleRatio P_LCS_Offset_FliterTime /end REF_CHARACTERISTIC /begin REF_MEASUREMENT LCS_CurrentSteerAngleOffset_deg /end REF_MEASUREMENT /end GROUP
/begin GROUP S10_Subsystem "PubIfDecisionPLAN_MDL/PLAN/Subsystem Reference/AP/AP/Arbitrate/Subsystem" /begin REF_MEASUREMENT LongCtrl_velSubjPlanArb LongCtrl_velSubjPlanFollow /end REF_MEASUREMENT /end GROUP
/begin GROUP S1192_LCKIE_StateMachine "PubIfStateVSM_MDL/Subsystem Reference/Subsystem/StateManage/LSS/LCK_LKA_LDW_ELKStateMachine3/LCKIE/LCKIE/LCKIE_StateMachine" /begin SUB_GROUP S1193_Subsystem S1193_Subsystem1 /end SUB_GROUP /end GROUP
/begin GROUP S1192_Subsystem1 "PubIfStateVSM_MDL/Subsystem Reference/Subsystem/StateManage/LSS/LCK_LKA_LDW_ELKStateMachine3/LCKIE/LCKIE/Subsystem1" /begin SUB_GROUP S1194_IEStateClc S1194_LCKIE_SignalProcess1 /end SUB_GROUP /end GROUP
/begin GROUP S1193_Subsystem "PubIfStateVSM_MDL/Subsystem Reference/Subsystem/StateManage/LSS/LCK_LKA_LDW_ELKStateMachine3/LCKIE/LCKIE/LCKIE_StateMachine/Subsystem" /begin REF_CHARACTERISTIC P_VSM_LCKIE_State_Off2on P_VSM_LCKIE_tcycle /end REF_CHARACTERISTIC /begin REF_MEASUREMENT VSM_LCKIE_DelayReady /end REF_MEASUREMENT /end GROUP
/begin GROUP S1193_Subsystem1 "PubIfStateVSM_MDL/Subsystem Reference/Subsystem/StateManage/LSS/LCK_LKA_LDW_ELKStateMachine3/LCKIE/LCKIE/LCKIE_StateMachine/Subsystem1" /begin REF_MEASUREMENT VSM_LCKIE_Laneoffset /end REF_MEASUREMENT /end GROUP
/begin GROUP S1194_IEStateClc "PubIfStateVSM_MDL/Subsystem Reference/Subsystem/StateManage/LSS/LCK_LKA_LDW_ELKStateMachine3/LCKIE/LCKIE/Subsystem1/IEStateClc" /begin SUB_GROUP S1205_Subsystem1 S1205_Subsystem12 S1205_Subsystem4 /end SUB_GROUP
 /begin REF_CHARACTERISTIC P_VSM_LCKIE_State_DriverInputTrqValue_enable P_VSM_LCKIE_State_ELKObjClc P_VSM_LCKIE_State_HWASts_disable P_VSM_LCKIE_State_IEObjClc P_VSM_LCKIE_State_IFVReady P_VSM_LCKIE_State_LaneWidth_enable P_VSM_LCKIE_State_Lanecurve_enable P_VSM_LCKIE_State_OppObjClc P_VSM_LCKIE_State_Vehspeed_enable P_VSM_LCKIE_State_detaspd P_VSM_LCKIE_State_detaspd_enable P_VSM_LCKIE_State_lamb_enable P_VSM_LCKIE_State_wiper_enable /end REF_CHARACTERISTIC
 /begin REF_MEASUREMENT VSM_LCKIE_State_Active2Ready VSM_LCKIE_State_DrvInputTrqValue_Active2Ready VSM_LCKIE_State_DrvInputTrqValue_Ready2Active VSM_LCKIE_State_ELKObj_Active2Ready VSM_LCKIE_State_ELKObj_Ready2Active VSM_LCKIE_State_HWASts_Ready2Active VSM_LCKIE_State_IEObj_Active2Ready VSM_LCKIE_State_IEObj_Ready2Active VSM_LCKIE_State_IFVFail VSM_LCKIE_State_IFVReady VSM_LCKIE_State_Idel2Ready VSM_LCKIE_State_LaneWidth_Idel2Ready VSM_LCKIE_State_LaneWidth_Ready2Idel VSM_LCKIE_State_Lanecurve_Idel2Ready VSM_LCKIE_State_Lanecurve_Ready2Idel VSM_LCKIE_State_OppFrontObj_Active2Ready VSM_LCKIE_State_OppFrontObj_Ready2Active VSM_LCKIE_State_Ready2Active VSM_LCKIE_State_Ready2Idel VSM_LCKIE_State_Vehspeed_Idel2Ready VSM_LCKIE_State_Vehspeed_Ready2Idel VSM_LCKIE_State_detaspd_Idel2Ready VSM_LCKIE_State_detaspd_Ready2Idel VSM_LCKIE_State_lamb_Idel2Ready VSM_LCKIE_State_lamb_Ready2Idel VSM_LCKIE_State_wiper_Idel2Ready VSM_LCKIE_State_wiper_Ready2Idel /end REF_MEASUREMENT
/end GROUP
/begin GROUP S1194_LCKIE_SignalProcess1 "PubIfStateVSM_MDL/Subsystem Reference/Subsystem/StateManage/LSS/LCK_LKA_LDW_ELKStateMachine3/LCKIE/LCKIE/Subsystem1/LCKIE_SignalProcess1"
 /begin SUB_GROUP S1206_IE_LATC S1206_IE_Long S1206_IE_OFC S1206_IE_ORC S1206_IE_OS S1206_IE_POC /end SUB_GROUP
 /begin REF_CHARACTERISTIC P_Global_VehicleWidthMin_m /end REF_CHARACTERISTIC
/end GROUP
/begin GROUP S11_AccelCCCalc "PubIfDecisionPLAN_MDL/PLAN/Subsystem Reference/AP/AP/CCCtrl/AccelCCCalc" /begin SUB_GROUP S24_CCAcceleNeg S24_CCAccelePos S24_Mph2KphCalc /end SUB_GROUP /end GROUP
/begin GROUP S11_accelCCJerkSelect "PubIfDecisionPLAN_MDL/PLAN/Subsystem Reference/AP/AP/CCCtrl/accelCCJerkSelect"
 /begin REF_CHARACTERISTIC P_LongCtrl_CCaccelCCNeg2PosJerk P_LongCtrl_CCaccelCCPosJerk P_LongCtrl_CCdecelCCJerk P_LongCtrl_CCdecelCCJerkNegVLCInternalAcc /end REF_CHARACTERISTIC
/end GROUP
/begin GROUP S11_AccelCCLimit "PubIfDecisionPLAN_MDL/PLAN/Subsystem Reference/AP/AP/CCCtrl/AccelCCLimit"
 /begin REF_CHARACTERISTIC P_LongCtrl_CCaccelLowerIsLaneChange P_LongCtrl_CCaccelMinFastDecel P_LongCtrl_CCaccelMinNoFastDecel P_LongCtrl_CCaccelUpperCC P_LongCtrl_CCaccelUpperCCSafeStop /end REF_CHARACTERISTIC
 /begin REF_MEASUREMENT LongCtrl_accelCC /end REF_MEASUREMENT
/end GROUP
/begin GROUP S11_AcceleBandCC "PubIfDecisionPLAN_MDL/PLAN/Subsystem Reference/AP/AP/CCCtrl/AcceleBandCC" /begin SUB_GROUP S26_CCNegAcceleBandCalc S26_CCPosAcceleBandCalc /end SUB_GROUP /end GROUP
/begin GROUP S11_accelJerkCalc "PubIfDecisionPLAN_MDL/PLAN/Subsystem Reference/AP/AP/CCCtrl/accelJerkCalc"
 /begin REF_MEASUREMENT LongCtrl_accelCCCtrlAfterJerk LongCtrl_lowerJerkCC LongCtrl_upperJerkCC /end REF_MEASUREMENT
/end GROUP
/begin GROUP S11_velPlanCC "PubIfDecisionPLAN_MDL/PLAN/Subsystem Reference/AP/AP/CCCtrl/velPlanCC"
 /begin REF_CHARACTERISTIC P_LongCtrl_CCaccelCCNeg2PosJerk P_LongCtrl_CCaccelCCPosJerk P_LongCtrl_CCaccelMinFastDecel P_LongCtrl_CCaccelMinNoFastDecel P_LongCtrl_CCdecelCCJerk P_LongCtrl_CCdecelCCJerkNegVLCInternalAcc /end REF_CHARACTERISTIC
 /begin REF_MEASUREMENT LongCtrl_velSubjPlanCC /end REF_MEASUREMENT
/end GROUP
/begin GROUP S1205_Subsystem1 "PubIfStateVSM_MDL/Subsystem Reference/Subsystem/StateManage/LSS/LCK_LKA_LDW_ELKStateMachine3/LCKIE/LCKIE/Subsystem1/IEStateClc/Subsystem1" /begin REF_CHARACTERISTIC P_VSM_LSMC_SampleTime /end REF_CHARACTERISTIC /end GROUP
/begin GROUP S1205_Subsystem12 "PubIfStateVSM_MDL/Subsystem Reference/Subsystem/StateManage/LSS/LCK_LKA_LDW_ELKStateMachine3/LCKIE/LCKIE/Subsystem1/IEStateClc/Subsystem12" /begin REF_CHARACTERISTIC P_VSM_LSMC_SampleTime /end REF_CHARACTERISTIC /end GROUP
/begin GROUP S1205_Subsystem4 "PubIfStateVSM_MDL/Subsystem Reference/Subsystem/StateManage/LSS/LCK_LKA_LDW_ELKStateMachine3/LCKIE/LCKIE/Subsystem1/IEStateClc/Subsystem4" /begin REF_CHARACTERISTIC P_VSM_LSMC_SampleTime /end REF_CHARACTERISTIC /end GROUP
/begin GROUP S1206_IE_LATC "PubIfStateVSM_MDL/Subsystem Reference/Subsystem/StateManage/LSS/LCK_LKA_LDW_ELKStateMachine3/LCKIE/LCKIE/Subsystem1/LCKIE_SignalProcess1/IE_LATC"
 /begin REF_CHARACTERISTIC P_VSM_LCKIE_LatC_DisOffofLanWidth P_VSM_LCKIE_LatC_DisOffofSpd P_VSM_LCKIE_LatC_LanWidth P_VSM_LCKIE_LatC_LimitDisEgoToObjSelt P_VSM_LCKIE_LatC_LimitEgoToOppLane P_VSM_LCKIE_LatC_MoveEnableDis P_VSM_LCKIE_LatC_RESafDis P_VSM_LCKIE_LatC_SafeDisofLanWidth P_VSM_LCKIE_LatC_Spd P_VSM_LCKIE_LatC_maxLimitDisREToLane P_VSM_LCKIE_LatC_minLimitDisREToLane /end REF_CHARACTERISTIC
 /begin REF_MEASUREMENT VSM_LCKIE_LatC_Counter VSM_LCKIE_LatC_Counter1 VSM_LCKIE_LatC_Counter2 VSM_LCKIE_LatC_Counter3 VSM_LCKIE_LatC_Counter4 VSM_LCKIE_LatC_Counter5 VSM_LCKIE_LatC_DirectChange VSM_LCKIE_LatC_DisEgo2ObjOff VSM_LCKIE_LatC_DisREToLane VSM_LCKIE_LatC_LatFLg VSM_LCKIE_LatC_LatMovDis VSM_LCKIE_LatC_LatWarning VSM_LCKIE_LatC_MovDirct VSM_LCKIE_LatC_MovDirct1 VSM_LCKIE_LatC_MoveDis VSM_LCKIE_LatC_ObjLatFailFlg VSM_LCKIE_LatC_SafDis VSM_LCKIE_LatC_SafeDisToLaneEdge /end REF_MEASUREMENT
/end GROUP
/begin GROUP S1206_IE_Long "PubIfStateVSM_MDL/Subsystem Reference/Subsystem/StateManage/LSS/LCK_LKA_LDW_ELKStateMachine3/LCKIE/LCKIE/Subsystem1/LCKIE_SignalProcess1/IE_Long"
 /begin REF_CHARACTERISTIC P_VSM_LCKIE_LongC_DetaSpd P_VSM_LCKIE_LongC_DirecChangeDis P_VSM_LCKIE_LongC_FleetOff P_VSM_LCKIE_LongC_ShutDownLongDis P_VSM_LCKIE_LongC_ShutDownTTC P_VSM_LCKIE_LongC_Spd P_VSM_LCKIE_LongC_d1 P_VSM_LCKIE_LongC_d2 P_VSM_LCKIE_LongC_maxDis P_VSM_LCKIE_LongC_minDis P_VSM_LCKIE_LongC_toff P_VSM_LCKIE_tcycle /end REF_CHARACTERISTIC
 /begin REF_MEASUREMENT VSM_LCKIE_LongC_Couter1 VSM_LCKIE_LongC_Couter2 VSM_LCKIE_LongC_Couter3 VSM_LCKIE_LongC_CouterOff VSM_LCKIE_LongC_IEReady VSM_LCKIE_LongC_LongDis VSM_LCKIE_LongC_LongDisfinal VSM_LCKIE_LongC_LongFlg VSM_LCKIE_LongC_ObjLong VSM_LCKIE_LongC_PocFlg VSM_LCKIE_LongC_d1 VSM_LCKIE_LongC_d2 /end REF_MEASUREMENT
/end GROUP
/begin GROUP S1206_IE_OFC "PubIfStateVSM_MDL/Subsystem Reference/Subsystem/StateManage/LSS/LCK_LKA_LDW_ELKStateMachine3/LCKIE/LCKIE/Subsystem1/LCKIE_SignalProcess1/IE_OFC"
 /begin REF_CHARACTERISTIC P_Global_Vehicle_Length_m P_VSM_LCKIE_OFC_ActDis P_VSM_LCKIE_OFC_DownDis P_VSM_LCKIE_OFC_DownTTC P_VSM_LCKIE_OFC_SafDis P_VSM_LCKIE_OFC_Toff /end REF_CHARACTERISTIC
 /begin REF_MEASUREMENT VSM_LCKIE_OFC_Counter VSM_LCKIE_OFC_Counter1 VSM_LCKIE_OFC_Long VSM_LCKIE_OFC_ObjTTC VSM_LCKIE_OFC_OppObjDetaSpd VSM_LCKIE_OFC_OppObjFail VSM_LCKIE_OFC_OppObjReady VSM_LCKIE_OFC_Tset /end REF_MEASUREMENT
/end GROUP
/begin GROUP S1206_IE_ORC "PubIfStateVSM_MDL/Subsystem Reference/Subsystem/StateManage/LSS/LCK_LKA_LDW_ELKStateMachine3/LCKIE/LCKIE/Subsystem1/LCKIE_SignalProcess1/IE_ORC"
 /begin REF_CHARACTERISTIC P_VSM_LCKIE_ORC_LatDis P_VSM_LCKIE_ORC_LimitDis1 P_VSM_LCKIE_ORC_LimitDis2 P_VSM_LCKIE_ORC_LimitTTC P_VSM_LCKIE_ORC_LowSpd /end REF_CHARACTERISTIC
 /begin REF_MEASUREMENT VSM_LCKIE_ORC_Counter VSM_LCKIE_ORC_ObjDetaSpd VSM_LCKIE_ORC_ObjLatPos VSM_LCKIE_ORC_ObjLong VSM_LCKIE_ORC_ObjTTC VSM_LCKIE_ORC_OppREARObjReady /end REF_MEASUREMENT
/end GROUP
/begin GROUP S1206_IE_OS "PubIfStateVSM_MDL/Subsystem Reference/Subsystem/StateManage/LSS/LCK_LKA_LDW_ELKStateMachine3/LCKIE/LCKIE/Subsystem1/LCKIE_SignalProcess1/IE_OS"
 /begin REF_MEASUREMENT VSM_LCKIE_OS_Couter VSM_LCKIE_OS_Couter1 VSM_LCKIE_OS_DetaSpd VSM_LCKIE_OS_DetaSpdSelect VSM_LCKIE_OS_DisEgo2Obj VSM_LCKIE_OS_DisEgo2ObjSelect VSM_LCKIE_OS_DisEgo2OppLane VSM_LCKIE_OS_ObjIDSelect VSM_LCKIE_OS_ObjLane VSM_LCKIE_OS_ObjSelectID VSM_LCKIE_OS_OppFObjID VSM_LCKIE_OS_OppRObjID VSM_LCKIE_OS_POSRObjID VSM_LCKIE_OS_RoadWidth VSM_LCKIE_OS_TTC /end REF_MEASUREMENT
/end GROUP
/begin GROUP S1206_IE_POC "PubIfStateVSM_MDL/Subsystem Reference/Subsystem/StateManage/LSS/LCK_LKA_LDW_ELKStateMachine3/LCKIE/LCKIE/Subsystem1/LCKIE_SignalProcess1/IE_POC"
 /begin REF_CHARACTERISTIC P_VSM_LCKIE_POC_Delaytime P_VSM_LCKIE_POC_LimitDis P_VSM_LCKIE_POC_LimitTTC P_VSM_LCKIE_POC_detaSpd P_VSM_LCKIE_tcycle /end REF_CHARACTERISTIC
 /begin REF_MEASUREMENT VSM_LCKIE_POC_Counter VSM_LCKIE_POC_Couter1 VSM_LCKIE_POC_Couter2 VSM_LCKIE_POC_LongDown VSM_LCKIE_POC_OvertakeFlg VSM_LCKIE_POC_OvertakeSpd VSM_LCKIE_POC_POCObjLong VSM_LCKIE_POC_POCObjTTC VSM_LCKIE_POC_POSID VSM_LCKIE_POC_POSObjID VSM_LCKIE_POC_delay_time /end REF_MEASUREMENT
/end GROUP
/begin GROUP S1284_LDW2 "PubIfStateVSM_MDL/Subsystem Reference/Subsystem/StateManage/LSS/LCK_LKA_LDW_ELKStateMachine3/LDW/LDW/LDW2"
 /begin SUB_GROUP S1285_LDWSignal_calculate S1285_LDW_Condition S1285_LDW_StateMachine /end SUB_GROUP
 /begin REF_CHARACTERISTIC P_VSM_LDW_State_Param_LaneWidth_Offset P_VSM_LDW_State_Param_Sensitive_Offset /end REF_CHARACTERISTIC
 /begin REF_MEASUREMENT VSM_LDWSts VSM_LDW_Counter VSM_LDW_VERSION /end REF_MEASUREMENT
/end GROUP
/begin GROUP S1285_LDW_Condition "PubIfStateVSM_MDL/Subsystem Reference/Subsystem/StateManage/LSS/LCK_LKA_LDW_ELKStateMachine3/LDW/LDW/LDW2/LDW_Condition"
 /begin SUB_GROUP S1288_Subsystem S1288_Subsystem1 S1288_Subsystem10 S1288_Subsystem17 S1288_Subsystem2 S1288_Subsystem3 S1288_Subsystem4 S1288_Subsystem5 S1288_Subsystem6 S1288_Subsystem7 S1288_Subsystem8 /end SUB_GROUP
 /begin REF_CHARACTERISTIC P_VSM_LDW_AbsEspInTime P_VSM_LDW_AccPedalOut P_VSM_LDW_AccRateIn P_VSM_LDW_AccRateInTime P_VSM_LDW_AccRateOut P_VSM_LDW_BrakePressIn P_VSM_LDW_BrakePressInTime P_VSM_LDW_BrakePressOut P_VSM_LDW_LaneCurveIn P_VSM_LDW_LaneCurveOut P_VSM_LDW_LateralAcceIn P_VSM_LDW_LateralAcceInTime P_VSM_LDW_LateralAcceOut P_VSM_LDW_LongitudeAccIn P_VSM_LDW_LongitudeAccInTime P_VSM_LDW_LongitudeAccOut P_VSM_LDW_State_Absesp_enable P_VSM_LDW_State_Accpedalrate_enable P_VSM_LDW_State_Breakpressure_enable P_VSM_LDW_State_ESSSts_enable P_VSM_LDW_State_Failsafe_enable P_VSM_LDW_State_GEAR_enable P_VSM_LDW_State_Headingangle_enable P_VSM_LDW_State_LaneChange_enable P_VSM_LDW_State_Lane_enable P_VSM_LDW_State_Lanecurve_enable P_VSM_LDW_State_LateralAcce_enable P_VSM_LDW_State_LongitudeAcc_enable P_VSM_LDW_State_Param_REWarningZoneIn P_VSM_LDW_State_Param_WarningZoneIn P_VSM_LDW_State_SteerWheelAngle_enable P_VSM_LDW_State_SteerWheelSpd_enable P_VSM_LDW_State_TurnLight_enable P_VSM_LDW_State_Vehspeed_enable P_VSM_LDW_State_Yawsup_enable P_VSM_LDW_SteerWheelAngleIn P_VSM_LDW_SteerWheelAngleInTime P_VSM_LDW_SteerWheelAngleOut P_VSM_LDW_SteerWheelSpdIn P_VSM_LDW_SteerWheelSpdInTime P_VSM_LDW_SteerWheelSpdOut P_VSM_LDW_TurnLightInTime P_VSM_LDW_WhelDy P_VSM_LDW_YawRateIn P_VSM_LDW_YawRateInTime P_VSM_LDW_YawRateOut P_VSM_LDW_absLongitudeAccIn P_VSM_LDW_absLongitudeAccOut /end REF_CHARACTERISTIC
 /begin REF_MEASUREMENT VSM_LDW_Active2Ready VSM_LDW_Con_AbsEsp_Idle2Ready VSM_LDW_Con_AbsEsp_Ready2Idle VSM_LDW_Con_AccPedalRate_Active2Ready VSM_LDW_Con_AccPedalRate_Ready2Active VSM_LDW_Con_BrakePressure_Active2Ready VSM_LDW_Con_BrakePressure_Ready2Active VSM_LDW_Con_CURRENT_GEAR_Active2Ready VSM_LDW_Con_CURRENT_GEAR_Ready2Active VSM_LDW_Con_ESSSts_Idle2Ready VSM_LDW_Con_ESSSts_Ready2Idle VSM_LDW_Con_Failsafe_Idle2Ready VSM_LDW_Con_Failsafe_Ready2Idle VSM_LDW_Con_Headingangle_Idle2Ready VSM_LDW_Con_Headingangle_Ready2Idle VSM_LDW_Con_LaneChange_Active2Ready VSM_LDW_Con_LaneChange_Ready2Active VSM_LDW_Con_LaneCurve_Idle2Ready VSM_LDW_Con_LaneCurve_Ready2Idle VSM_LDW_Con_Lane_Idle2Ready VSM_LDW_Con_Lane_Ready2Idle VSM_LDW_Con_LateralAcc_Active2Ready VSM_LDW_Con_LateralAcc_Ready2Active VSM_LDW_Con_LongitudeAcc_Active2Ready VSM_LDW_Con_LongitudeAcc_Ready2Active VSM_LDW_Con_SteerWheelAngle_Active2Ready VSM_LDW_Con_SteerWheelAngle_Ready2Active VSM_LDW_Con_SteerWheelSpd_Active2Ready VSM_LDW_Con_SteerWheelSpd_Ready2Active VSM_LDW_Con_TurnLight_Active2Ready VSM_LDW_Con_TurnLight_Ready2Active VSM_LDW_Con_VehicleSpeed_Idle2Ready VSM_LDW_Con_VehicleSpeed_Ready2Idle VSM_LDW_Con_YawRate_Idle2Ready VSM_LDW_Con_YawRate_Ready2Idle VSM_LDW_Idle2Ready VSM_LDW_Other2Idle VSM_LDW_Ready2Active /end REF_MEASUREMENT
/end GROUP
/begin GROUP S1285_LDW_StateMachine "PubIfStateVSM_MDL/Subsystem Reference/Subsystem/StateManage/LSS/LCK_LKA_LDW_ELKStateMachine3/LDW/LDW/LDW2/LDW_StateMachine" /begin REF_MEASUREMENT VSM_LDW_Count VSM_LDW_wCount /end REF_MEASUREMENT /end GROUP
/begin GROUP S1285_LDWSignal_calculate "PubIfStateVSM_MDL/Subsystem Reference/Subsystem/StateManage/LSS/LCK_LKA_LDW_ELKStateMachine3/LDW/LDW/LDW2/LDWSignal_calculate" /begin SUB_GROUP S1287_Subsystem1 S1287_Subsystem4 S1287_Subsystem7 /end SUB_GROUP
 /begin REF_CHARACTERISTIC P_VSM_LDW_State_Param_REWarningZoneIn P_VSM_LDW_State_Param_WarningZoneIn P_VSM_LDW_State_Param_WarningZoneOut /end REF_CHARACTERISTIC
 /begin REF_MEASUREMENT VSM_LDW_Leftwarnflag VSM_LDW_Rightwarnflag /end REF_MEASUREMENT
/end GROUP
/begin GROUP S1287_Subsystem1 "PubIfStateVSM_MDL/Subsystem Reference/Subsystem/StateManage/LSS/LCK_LKA_LDW_ELKStateMachine3/LDW/LDW/LDW2/LDWSignal_calculate/Subsystem1" /begin REF_CHARACTERISTIC P_VSM_LSMC_SampleTime /end REF_CHARACTERISTIC /end GROUP
/begin GROUP S1287_Subsystem4 "PubIfStateVSM_MDL/Subsystem Reference/Subsystem/StateManage/LSS/LCK_LKA_LDW_ELKStateMachine3/LDW/LDW/LDW2/LDWSignal_calculate/Subsystem4" /begin REF_CHARACTERISTIC P_VSM_LSMC_SampleTime /end REF_CHARACTERISTIC /end GROUP
/begin GROUP S1287_Subsystem7 "PubIfStateVSM_MDL/Subsystem Reference/Subsystem/StateManage/LSS/LCK_LKA_LDW_ELKStateMachine3/LDW/LDW/LDW2/LDWSignal_calculate/Subsystem7" /begin REF_CHARACTERISTIC P_VSM_LSMC_SampleTime /end REF_CHARACTERISTIC /end GROUP
/begin GROUP S1288_Subsystem "PubIfStateVSM_MDL/Subsystem Reference/Subsystem/StateManage/LSS/LCK_LKA_LDW_ELKStateMachine3/LDW/LDW/LDW2/LDW_Condition/Subsystem" /begin REF_CHARACTERISTIC P_VSM_LSMC_SampleTime /end REF_CHARACTERISTIC /end GROUP
/begin GROUP S1288_Subsystem1 "PubIfStateVSM_MDL/Subsystem Reference/Subsystem/StateManage/LSS/LCK_LKA_LDW_ELKStateMachine3/LDW/LDW/LDW2/LDW_Condition/Subsystem1" /begin REF_CHARACTERISTIC P_VSM_LSMC_SampleTime /end REF_CHARACTERISTIC /end GROUP
/begin GROUP S1288_Subsystem10 "PubIfStateVSM_MDL/Subsystem Reference/Subsystem/StateManage/LSS/LCK_LKA_LDW_ELKStateMachine3/LDW/LDW/LDW2/LDW_Condition/Subsystem10" /begin REF_CHARACTERISTIC P_VSM_LSMC_SampleTime /end REF_CHARACTERISTIC /end GROUP
/begin GROUP S1288_Subsystem17 "PubIfStateVSM_MDL/Subsystem Reference/Subsystem/StateManage/LSS/LCK_LKA_LDW_ELKStateMachine3/LDW/LDW/LDW2/LDW_Condition/Subsystem17" /begin REF_CHARACTERISTIC P_VSM_LSMC_SampleTime /end REF_CHARACTERISTIC /end GROUP
/begin GROUP S1288_Subsystem2 "PubIfStateVSM_MDL/Subsystem Reference/Subsystem/StateManage/LSS/LCK_LKA_LDW_ELKStateMachine3/LDW/LDW/LDW2/LDW_Condition/Subsystem2" /begin REF_CHARACTERISTIC P_VSM_LSMC_SampleTime /end REF_CHARACTERISTIC /end GROUP
/begin GROUP S1288_Subsystem3 "PubIfStateVSM_MDL/Subsystem Reference/Subsystem/StateManage/LSS/LCK_LKA_LDW_ELKStateMachine3/LDW/LDW/LDW2/LDW_Condition/Subsystem3" /begin REF_CHARACTERISTIC P_VSM_LSMC_SampleTime /end REF_CHARACTERISTIC /end GROUP
/begin GROUP S1288_Subsystem4 "PubIfStateVSM_MDL/Subsystem Reference/Subsystem/StateManage/LSS/LCK_LKA_LDW_ELKStateMachine3/LDW/LDW/LDW2/LDW_Condition/Subsystem4" /begin REF_CHARACTERISTIC P_VSM_LSMC_SampleTime /end REF_CHARACTERISTIC /end GROUP
/begin GROUP S1288_Subsystem5 "PubIfStateVSM_MDL/Subsystem Reference/Subsystem/StateManage/LSS/LCK_LKA_LDW_ELKStateMachine3/LDW/LDW/LDW2/LDW_Condition/Subsystem5" /begin REF_CHARACTERISTIC P_VSM_LSMC_SampleTime /end REF_CHARACTERISTIC /end GROUP
/begin GROUP S1288_Subsystem6 "PubIfStateVSM_MDL/Subsystem Reference/Subsystem/StateManage/LSS/LCK_LKA_LDW_ELKStateMachine3/LDW/LDW/LDW2/LDW_Condition/Subsystem6" /begin REF_CHARACTERISTIC P_VSM_LSMC_SampleTime /end REF_CHARACTERISTIC /end GROUP
/begin GROUP S1288_Subsystem7 "PubIfStateVSM_MDL/Subsystem Reference/Subsystem/StateManage/LSS/LCK_LKA_LDW_ELKStateMachine3/LDW/LDW/LDW2/LDW_Condition/Subsystem7" /begin REF_CHARACTERISTIC P_VSM_LSMC_SampleTime /end REF_CHARACTERISTIC /end GROUP
/begin GROUP S1288_Subsystem8 "PubIfStateVSM_MDL/Subsystem Reference/Subsystem/StateManage/LSS/LCK_LKA_LDW_ELKStateMachine3/LDW/LDW/LDW2/LDW_Condition/Subsystem8" /begin REF_CHARACTERISTIC P_VSM_LSMC_SampleTime /end REF_CHARACTERISTIC /end GROUP
/begin GROUP S13_Switch_Case_Action_Subsystem "PubIfControlLATC_MDL/Subsystem Reference/Subsystem/LateralControl/LCS_Angle/AngSlopeCalc/Switch Case Action Subsystem"
 /begin REF_CHARACTERISTIC P_LCS_StateActiv_AngleSlope P_LCS_StateActiveFlg_BP P_LCS_StateActive_HoldTime_BP /end REF_CHARACTERISTIC
/end GROUP
/begin GROUP S140_Subsystem "PubIfDecisionPLAN_MDL/PLAN/Subsystem Reference/AP/AP/LCObjChoose+FollowCtrl/LaneChangeObjectChoose/Virtual target and desired distance/Subsystem"
 /begin REF_MEASUREMENT LongCtrl_LC_DisMin LongCtrl_LC_Enable_Assess LongCtrl_LC_IDP0 LongCtrl_LC_Objstate LongCtrl_LC_axAbsGroundP0 LongCtrl_LC_condition LongCtrl_LC_distDesCur LongCtrl_LC_distDesPlanCorr LongCtrl_LC_locationDis LongCtrl_LC_rangeP0 LongCtrl_LC_targetExistP0 LongCtrl_LC_vxRelP0 LongCtrl_P0_DisMin /end REF_MEASUREMENT
/end GROUP
/begin GROUP S1413_LKA2 "PubIfStateVSM_MDL/Subsystem Reference/Subsystem/StateManage/LSS/LCK_LKA_LDW_ELKStateMachine3/LKA/LKA/LKA2" /begin SUB_GROUP S1414_LKA S1414_LKA_Condition S1414_LKA_StateMachine /end SUB_GROUP
 /begin REF_CHARACTERISTIC P_VSM_LKA_State_Param_LaneCurve P_VSM_LKA_State_Param_LaneCurve_Offset P_VSM_LKA_State_Param_LaneWidth_Offset P_VSM_LKA_State_Param_Sensitive_Offset /end REF_CHARACTERISTIC
 /begin REF_MEASUREMENT VSM_LKAState VSM_LKA_Counter VSM_LKA_VERSION /end REF_MEASUREMENT
/end GROUP
/begin GROUP S1414_LKA "PubIfStateVSM_MDL/Subsystem Reference/Subsystem/StateManage/LSS/LCK_LKA_LDW_ELKStateMachine3/LKA/LKA/LKA2/LKA"
 /begin SUB_GROUP S1416_Subsystem1 S1416_Subsystem10 S1416_Subsystem2 S1416_Subsystem3 S1416_Subsystem4 S1416_Subsystem7 /end SUB_GROUP
 /begin REF_CHARACTERISTIC P_VSM_LKA_State_Param_AngleOffset P_VSM_LKA_State_Param_InterventionZoneIn P_VSM_LKA_State_Param_InterventionZoneOut P_VSM_LKA_State_Param_OutOffset P_VSM_LKA_State_Param_REInterventionZoneIn P_VSM_LKA_WarnInTime P_VSM_LKA_Warnarea1 P_VSM_LKA_Warnarea2 /end REF_CHARACTERISTIC
 /begin REF_MEASUREMENT VSM_LKAWarnflag VSM_LKA_End VSM_LKA_LKAactive VSM_LKA_LKAout VSM_LKA_LeftWarning VSM_LKA_RightWarning /end REF_MEASUREMENT
/end GROUP
/begin GROUP S1414_LKA_Condition "PubIfStateVSM_MDL/Subsystem Reference/Subsystem/StateManage/LSS/LCK_LKA_LDW_ELKStateMachine3/LKA/LKA/LKA2/LKA_Condition"
 /begin SUB_GROUP S1417_Subsystem1 S1417_Subsystem10 S1417_Subsystem12 S1417_Subsystem13 S1417_Subsystem15 S1417_Subsystem18 S1417_Subsystem2 S1417_Subsystem3 S1417_Subsystem4 S1417_Subsystem5 S1417_Subsystem6 S1417_Subsystem7 S1417_Subsystem8 S1417_Subsystem9 /end SUB_GROUP
 /begin REF_CHARACTERISTIC P_VSM_LKA_AbsEspInTime P_VSM_LKA_AccPedalPosnOut P_VSM_LKA_AccPedalRateOutTime P_VSM_LKA_AccRateIn P_VSM_LKA_AccRateInTime P_VSM_LKA_AccRateOut P_VSM_LKA_BrakePressIn P_VSM_LKA_BrakePressInTime P_VSM_LKA_BrakePressOut P_VSM_LKA_DriverInputTrqValueIn P_VSM_LKA_DriverInputTrqValueInTime P_VSM_LKA_DriverInputTrqValueOut P_VSM_LKA_LaneCurveIn P_VSM_LKA_LaneCurveOut P_VSM_LKA_LateralAcceIn P_VSM_LKA_LateralAcceInTime P_VSM_LKA_LateralAcceOut P_VSM_LKA_LongitudeAcceIn P_VSM_LKA_LongitudeAcceOut P_VSM_LKA_OverrideInTime P_VSM_LKA_OverrideTime P_VSM_LKA_OverrideValue P_VSM_LKA_State_Absesp_enable P_VSM_LKA_State_Accpedalrate_enable P_VSM_LKA_State_Breakpressure_enable P_VSM_LKA_State_DriverInputTrqValue_enable P_VSM_LKA_State_ESSSts_enable P_VSM_LKA_State_Eps_enable P_VSM_LKA_State_Failsafe_enable P_VSM_LKA_State_GEAR_enable P_VSM_LKA_State_Headingangle_enable P_VSM_LKA_State_LaneChange_enable P_VSM_LKA_State_Lane_enable P_VSM_LKA_State_Lanecurve_enable P_VSM_LKA_State_LateralAcce_enable P_VSM_LKA_State_LongitudeAcc_enable P_VSM_LKA_State_Overide_enable P_VSM_LKA_State_Param_InterventionZoneIn P_VSM_LKA_State_Param_REInterventionZoneIn P_VSM_LKA_State_SteerWheelAngle_enable P_VSM_LKA_State_SteerWheelSpd_enable P_VSM_LKA_State_TJASts_enable P_VSM_LKA_State_TurnLight_enable P_VSM_LKA_State_Vehspeed_enable P_VSM_LKA_State_Yawsup_enable P_VSM_LKA_SteerWheelAngleIn P_VSM_LKA_SteerWheelAngleInTime P_VSM_LKA_SteerWheelAngleOut P_VSM_LKA_SteerWheelSpdIn P_VSM_LKA_SteerWheelSpdInTime P_VSM_LKA_SteerWheelSpdOut P_VSM_LKA_TurnLightInTime P_VSM_LKA_WhelDy P_VSM_LKA_YawRateIn P_VSM_LKA_YawRateInTime P_VSM_LKA_YawRateOut P_VSM_LKA_absLongitudeAcceIn P_VSM_LKA_absLongitudeAcceInTime P_VSM_LKA_absLongitudeAcceOut /end REF_CHARACTERISTIC
 /begin REF_MEASUREMENT VSM_LKA_Active2Ready VSM_LKA_Con_AbsEsp_Idle2Ready VSM_LKA_Con_AbsEsp_Ready2Idle VSM_LKA_Con_AccPedalRate_Active2Ready VSM_LKA_Con_AccPedalRate_Ready2Active VSM_LKA_Con_BrakePressure_Active2Ready VSM_LKA_Con_BrakePressure_Ready2Active VSM_LKA_Con_CURRENT_GEAR_Active2Ready VSM_LKA_Con_CURRENT_GEAR_Ready2Active VSM_LKA_Con_DriverInput_Active2Ready VSM_LKA_Con_DriverInput_Ready2Active VSM_LKA_Con_ESSSts_Active2Ready VSM_LKA_Con_ESSSts_Idle2Ready VSM_LKA_Con_ESSSts_Ready2Idle VSM_LKA_Con_EpsSta_Active2Ready VSM_LKA_Con_EpsSta_Ready2Active VSM_LKA_Con_Failsafe_Idle2Ready VSM_LKA_Con_Failsafe_Ready2Idle VSM_LKA_Con_Headingangle_Idle2Ready VSM_LKA_Con_Headingangle_Ready2Idle VSM_LKA_Con_LaneChange_Active2Ready VSM_LKA_Con_LaneChange_Ready2Active VSM_LKA_Con_LaneCurve_Idle2Ready VSM_LKA_Con_LaneCurve_Ready2Idle VSM_LKA_Con_Lane_Idle2Ready VSM_LKA_Con_Lane_Ready2Idle VSM_LKA_Con_LateralAcc_Active2Ready VSM_LKA_Con_LateralAcc_Ready2Active VSM_LKA_Con_LongitudeAcc_Active2Ready VSM_LKA_Con_LongitudeAcc_Ready2Active VSM_LKA_Con_OverRide_Active2Ready VSM_LKA_Con_Override_Ready2Active VSM_LKA_Con_SteerWheelAngle_Active2Ready VSM_LKA_Con_SteerWheelAngle_Ready2Active VSM_LKA_Con_SteerWheelSpd_Active2Ready VSM_LKA_Con_SteerWheelSpd_Ready2Active VSM_LKA_Con_TJASts_Active2Ready VSM_LKA_Con_TJASts_Ready2Active VSM_LKA_Con_TurnLight_Active2Ready VSM_LKA_Con_TurnLight_Ready2Active VSM_LKA_Con_VehicleSpeed_Idle2Ready VSM_LKA_Con_VehicleSpeed_Ready2Idle VSM_LKA_Con_YawRate_Idle2Ready VSM_LKA_Con_YawRate_Ready2Idle VSM_LKA_Idle2Ready VSM_LKA_Other2Idle VSM_LKA_Ready2Active /end REF_MEASUREMENT
/end GROUP
/begin GROUP S1414_LKA_StateMachine "PubIfStateVSM_MDL/Subsystem Reference/Subsystem/StateManage/LSS/LCK_LKA_LDW_ELKStateMachine3/LKA/LKA/LKA2/LKA_StateMachine" /begin REF_MEASUREMENT VSM_LKA_Warning /end REF_MEASUREMENT /end GROUP
/begin GROUP S1416_Subsystem1 "PubIfStateVSM_MDL/Subsystem Reference/Subsystem/StateManage/LSS/LCK_LKA_LDW_ELKStateMachine3/LKA/LKA/LKA2/LKA/Subsystem1" /begin REF_CHARACTERISTIC P_VSM_LSMC_SampleTime /end REF_CHARACTERISTIC /end GROUP
/begin GROUP S1416_Subsystem10 "PubIfStateVSM_MDL/Subsystem Reference/Subsystem/StateManage/LSS/LCK_LKA_LDW_ELKStateMachine3/LKA/LKA/LKA2/LKA/Subsystem10" /begin REF_CHARACTERISTIC P_VSM_LSMC_SampleTime /end REF_CHARACTERISTIC /end GROUP
/begin GROUP S1416_Subsystem2 "PubIfStateVSM_MDL/Subsystem Reference/Subsystem/StateManage/LSS/LCK_LKA_LDW_ELKStateMachine3/LKA/LKA/LKA2/LKA/Subsystem2" /begin REF_CHARACTERISTIC P_VSM_LSMC_SampleTime /end REF_CHARACTERISTIC /end GROUP
/begin GROUP S1416_Subsystem3 "PubIfStateVSM_MDL/Subsystem Reference/Subsystem/StateManage/LSS/LCK_LKA_LDW_ELKStateMachine3/LKA/LKA/LKA2/LKA/Subsystem3" /begin REF_CHARACTERISTIC P_VSM_LSMC_SampleTime /end REF_CHARACTERISTIC /end GROUP
/begin GROUP S1416_Subsystem4 "PubIfStateVSM_MDL/Subsystem Reference/Subsystem/StateManage/LSS/LCK_LKA_LDW_ELKStateMachine3/LKA/LKA/LKA2/LKA/Subsystem4" /begin REF_CHARACTERISTIC P_VSM_LSMC_SampleTime /end REF_CHARACTERISTIC /end GROUP
/begin GROUP S1416_Subsystem7 "PubIfStateVSM_MDL/Subsystem Reference/Subsystem/StateManage/LSS/LCK_LKA_LDW_ELKStateMachine3/LKA/LKA/LKA2/LKA/Subsystem7" /begin REF_CHARACTERISTIC P_VSM_LSMC_SampleTime /end REF_CHARACTERISTIC /end GROUP
/begin GROUP S1417_Subsystem1 "PubIfStateVSM_MDL/Subsystem Reference/Subsystem/StateManage/LSS/LCK_LKA_LDW_ELKStateMachine3/LKA/LKA/LKA2/LKA_Condition/Subsystem1" /begin REF_CHARACTERISTIC P_VSM_LSMC_SampleTime /end REF_CHARACTERISTIC /end GROUP
/begin GROUP S1417_Subsystem10 "PubIfStateVSM_MDL/Subsystem Reference/Subsystem/StateManage/LSS/LCK_LKA_LDW_ELKStateMachine3/LKA/LKA/LKA2/LKA_Condition/Subsystem10" /begin REF_CHARACTERISTIC P_VSM_LSMC_SampleTime /end REF_CHARACTERISTIC /end GROUP
/begin GROUP S1417_Subsystem12 "PubIfStateVSM_MDL/Subsystem Reference/Subsystem/StateManage/LSS/LCK_LKA_LDW_ELKStateMachine3/LKA/LKA/LKA2/LKA_Condition/Subsystem12" /begin REF_CHARACTERISTIC P_VSM_LSMC_SampleTime /end REF_CHARACTERISTIC /end GROUP
/begin GROUP S1417_Subsystem13 "PubIfStateVSM_MDL/Subsystem Reference/Subsystem/StateManage/LSS/LCK_LKA_LDW_ELKStateMachine3/LKA/LKA/LKA2/LKA_Condition/Subsystem13" /begin REF_CHARACTERISTIC P_VSM_LSMC_SampleTime /end REF_CHARACTERISTIC /end GROUP
/begin GROUP S1417_Subsystem15 "PubIfStateVSM_MDL/Subsystem Reference/Subsystem/StateManage/LSS/LCK_LKA_LDW_ELKStateMachine3/LKA/LKA/LKA2/LKA_Condition/Subsystem15" /begin REF_CHARACTERISTIC P_VSM_LSMC_SampleTime /end REF_CHARACTERISTIC /end GROUP
/begin GROUP S1417_Subsystem18 "PubIfStateVSM_MDL/Subsystem Reference/Subsystem/StateManage/LSS/LCK_LKA_LDW_ELKStateMachine3/LKA/LKA/LKA2/LKA_Condition/Subsystem18" /begin REF_CHARACTERISTIC P_VSM_LSMC_SampleTime /end REF_CHARACTERISTIC /end GROUP
/begin GROUP S1417_Subsystem2 "PubIfStateVSM_MDL/Subsystem Reference/Subsystem/StateManage/LSS/LCK_LKA_LDW_ELKStateMachine3/LKA/LKA/LKA2/LKA_Condition/Subsystem2" /begin REF_CHARACTERISTIC P_VSM_LSMC_SampleTime /end REF_CHARACTERISTIC /end GROUP
/begin GROUP S1417_Subsystem3 "PubIfStateVSM_MDL/Subsystem Reference/Subsystem/StateManage/LSS/LCK_LKA_LDW_ELKStateMachine3/LKA/LKA/LKA2/LKA_Condition/Subsystem3" /begin REF_CHARACTERISTIC P_VSM_LSMC_SampleTime /end REF_CHARACTERISTIC /end GROUP
/begin GROUP S1417_Subsystem4 "PubIfStateVSM_MDL/Subsystem Reference/Subsystem/StateManage/LSS/LCK_LKA_LDW_ELKStateMachine3/LKA/LKA/LKA2/LKA_Condition/Subsystem4" /begin REF_CHARACTERISTIC P_VSM_LSMC_SampleTime /end REF_CHARACTERISTIC /end GROUP
/begin GROUP S1417_Subsystem5 "PubIfStateVSM_MDL/Subsystem Reference/Subsystem/StateManage/LSS/LCK_LKA_LDW_ELKStateMachine3/LKA/LKA/LKA2/LKA_Condition/Subsystem5" /begin REF_CHARACTERISTIC P_VSM_LSMC_SampleTime /end REF_CHARACTERISTIC /end GROUP
/begin GROUP S1417_Subsystem6 "PubIfStateVSM_MDL/Subsystem Reference/Subsystem/StateManage/LSS/LCK_LKA_LDW_ELKStateMachine3/LKA/LKA/LKA2/LKA_Condition/Subsystem6" /begin REF_CHARACTERISTIC P_VSM_LSMC_SampleTime /end REF_CHARACTERISTIC /end GROUP
/begin GROUP S1417_Subsystem7 "PubIfStateVSM_MDL/Subsystem Reference/Subsystem/StateManage/LSS/LCK_LKA_LDW_ELKStateMachine3/LKA/LKA/LKA2/LKA_Condition/Subsystem7" /begin REF_CHARACTERISTIC P_VSM_LSMC_SampleTime /end REF_CHARACTERISTIC /end GROUP
/begin GROUP S1417_Subsystem8 "PubIfStateVSM_MDL/Subsystem Reference/Subsystem/StateManage/LSS/LCK_LKA_LDW_ELKStateMachine3/LKA/LKA/LKA2/LKA_Condition/Subsystem8" /begin REF_CHARACTERISTIC P_VSM_LSMC_SampleTime /end REF_CHARACTERISTIC /end GROUP
/begin GROUP S1417_Subsystem9 "PubIfStateVSM_MDL/Subsystem Reference/Subsystem/StateManage/LSS/LCK_LKA_LDW_ELKStateMachine3/LKA/LKA/LKA2/LKA_Condition/Subsystem9" /begin REF_CHARACTERISTIC P_VSM_LSMC_SampleTime /end REF_CHARACTERISTIC /end GROUP
/begin GROUP S14_AccelArbIC "PubIfDecisionPLAN_MDL/PLAN/Subsystem Reference/AP/AP/IC/AccelArbIC" /begin REF_MEASUREMENT LongCtrl_accelIC /end REF_MEASUREMENT /end GROUP
/begin GROUP S14_AccelBandIC "PubIfDecisionPLAN_MDL/PLAN/Subsystem Reference/AP/AP/IC/AccelBandIC"
 /begin REF_CHARACTERISTIC P_LongCtrl_ICdeltaAccelLowerBand P_LongCtrl_ICdeltaAccelUpperBand /end REF_CHARACTERISTIC
 /begin REF_MEASUREMENT LongCtrl_lowerBandIC LongCtrl_upperBandIC /end REF_MEASUREMENT
/end GROUP
/begin GROUP S14_AccelCurvature "PubIfDecisionPLAN_MDL/PLAN/Subsystem Reference/AP/AP/IC/AccelCurvature"
 /begin REF_CHARACTERISTIC P_LongCtrl_ICCurvatureLimitSpdXAxis P_LongCtrl_ICCurvatureLimitSpdYAxis P_LongCtrl_ICtDecel /end REF_CHARACTERISTIC
 /begin REF_MEASUREMENT LongCtrl_accelCurvature LongCtrl_curvatureForCurveDecel /end REF_MEASUREMENT
/end GROUP
/begin GROUP S14_AccelKap "PubIfDecisionPLAN_MDL/PLAN/Subsystem Reference/AP/AP/IC/AccelKap"
 /begin REF_CHARACTERISTIC P_LongCtrl_ICKapLimitAccelXAxis P_LongCtrl_ICKapLimitAccelYAxis P_LongCtrl_ICKapLimitSpdXAxis P_LongCtrl_ICKapLimitSpdYAxis P_LongCtrl_ICtDecel /end REF_CHARACTERISTIC
 /begin REF_MEASUREMENT LongCtrl_accelKap LongCtrl_accelKapRun LongCtrl_accelKapStartup LongCtrl_accelKapStartupRaw LongCtrl_kapFilt /end REF_MEASUREMENT
/end GROUP
/begin GROUP S14_CurvatureOfMapCalc "PubIfDecisionPLAN_MDL/PLAN/Subsystem Reference/AP/AP/IC/CurvatureOfMapCalc" /begin SUB_GROUP S49_Subsystem /end SUB_GROUP
 /begin REF_CHARACTERISTIC P_LongCtrl_IC_EHRV2Enable P_LongCtrl_IC_EHRV2Pretime P_LongCtrl_IC_PreDisLimitByCurXAxis P_LongCtrl_IC_PreDisLimitByCurYAxis /end REF_CHARACTERISTIC
 /begin REF_MEASUREMENT LongCtrl_IC_EHRV2_Cur LongCtrl_IC_EHRV2_CurDisMatrix LongCtrl_IC_EHRV2_CurFar LongCtrl_IC_EHRV2_CurFarDis LongCtrl_IC_EHRV2_CurMatrix LongCtrl_IC_EHRV2_CurMatrixSize /end REF_MEASUREMENT
/end GROUP
/begin GROUP S14_CurvatureOfRoadCalc "PubIfDecisionPLAN_MDL/PLAN/Subsystem Reference/AP/AP/IC/CurvatureOfRoadCalc" /begin SUB_GROUP S50_If_Action_Subsystem S50_LP2 /end SUB_GROUP
 /begin REF_CHARACTERISTIC P_LongCtrl_ICCurveDecelEnable P_LongCtrl_ICaccelThresEnableLine /end REF_CHARACTERISTIC
/end GROUP
/begin GROUP S14_JerkIC "PubIfDecisionPLAN_MDL/PLAN/Subsystem Reference/AP/AP/IC/JerkIC"
 /begin REF_CHARACTERISTIC P_LongCtrl_ICKapUpperJerkMin P_LongCtrl_IClowerJerkICCharXAxis P_LongCtrl_IClowerJerkICCharYAxis P_LongCtrl_IClowerJerkPosVLCInternalAccMax P_LongCtrl_IClowerJerkPosVLCInternalAccMin P_LongCtrl_ICupperJerkICCharXAxis P_LongCtrl_ICupperJerkICCharYAxis /end REF_CHARACTERISTIC
 /begin REF_MEASUREMENT LongCtrl_lowerJerkIC LongCtrl_upperJerkIC /end REF_MEASUREMENT
/end GROUP
/begin GROUP S14_Subsystem1 "PubIfDecisionPLAN_MDL/PLAN/Subsystem Reference/AP/AP/IC/Subsystem1"
 /begin REF_CHARACTERISTIC P_LongCtrl_KeepLaneSurDis P_LongCtrl_KeepLaneTime P_LongCtrl_LaneAvailDis P_LongCtrl_LaneAvailStd P_LongCtrl_LaneAvailStdAverage P_LongCtrl_LaneAvailStdMax P_LongCtrl_LaneAvailTime /end REF_CHARACTERISTIC
 /begin REF_MEASUREMENT LongCtrl_L1_Avail_dis LongCtrl_L1_Avail_time LongCtrl_L1_KeepLineSts LongCtrl_L1_Line_std LongCtrl_R1_Avail_dis LongCtrl_R1_Avail_time LongCtrl_R1_KeepLineSts LongCtrl_R1_Line_std /end REF_MEASUREMENT
/end GROUP
/begin GROUP S15_CenLineCal1 "PubIfDecisionLSM_MDL/Subsystem1/TargetLineCalc_20ms/TargetLineCalc/CenLineCal1"
 /begin REF_CHARACTERISTIC P_LSM_AwayEdge_offset P_LSM_Line2Edge_limit P_LSM_Line_Error /end REF_CHARACTERISTIC
 /begin REF_MEASUREMENT LSM_Edge_Offset LSM_Line_state /end REF_MEASUREMENT
/end GROUP
/begin GROUP S15_FollowCtrl "PubIfDecisionPLAN_MDL/PLAN/Subsystem Reference/AP/AP/LCObjChoose+FollowCtrl/FollowCtrl"
 /begin SUB_GROUP S79_AccelSupression S79_AccelTargAbsEnableJudge S79_DecelToStopCtrl S79_DistDesCalc S79_FollowBandJerkCalc S79_LaneChangeAccelLimit S79_PlausibilityCheck S79_SlopeStartupAssist S79_VelPlan S79_VelTargPlanTerminateCalc /end SUB_GROUP
 /begin REF_MEASUREMENT LongCtrl_Follow_Counter LongCtrl_distRelPlanTerminate /end REF_MEASUREMENT
/end GROUP
/begin GROUP S15_LaneChangeObjectChoose "PubIfDecisionPLAN_MDL/PLAN/Subsystem Reference/AP/AP/LCObjChoose+FollowCtrl/LaneChangeObjectChoose"
 /begin SUB_GROUP S80_OptimalSpace S80_Subsystem S80_Virtual_target_and_desired_distance /end SUB_GROUP
 /begin REF_CHARACTERISTIC P_LongCtrl_LC_LowerAccelLimit P_LongCtrl_LC_LowerJerkLimit P_LongCtrl_LC_UpperAccelLimit P_LongCtrl_LC_UpperJerkLimit /end REF_CHARACTERISTIC
 /begin REF_MEASUREMENT LongCtrl_ALC_intention /end REF_MEASUREMENT
/end GROUP
/begin GROUP S15_Subsystem "PubIfDecisionLSM_MDL/Subsystem1/TargetLineCalc_20ms/TargetLineCalc/Subsystem" /begin SUB_GROUP S38_Subsystem2 /end SUB_GROUP /end GROUP
/begin GROUP S1602_InCondition1 "PubIfStateVSM_MDL/Subsystem Reference/Subsystem/StateManage/LSS/LCK_LKA_LDW_ELKStateMachine3/Signal_calculate/LaneAndRe_SignalProcess/InCondition1" /begin REF_CHARACTERISTIC P_VSM_LSMC_SampleTime /end REF_CHARACTERISTIC /end GROUP
/begin GROUP S1602_LaneRage_Handle "PubIfStateVSM_MDL/Subsystem Reference/Subsystem/StateManage/LSS/LCK_LKA_LDW_ELKStateMachine3/Signal_calculate/LaneAndRe_SignalProcess/LaneRage_Handle" /begin SUB_GROUP S1606_Subsystem4 S1606_Subsystem6 /end SUB_GROUP /begin REF_CHARACTERISTIC P_VSM_LKA_State_Param_Offset /end REF_CHARACTERISTIC
 /begin REF_MEASUREMENT VSM_ERROR_LEFT VSM_ERROR_RIGHT VSM_LeftChange_new VSM_LeftChange_old VSM_RightChange_new VSM_RightChange_old /end REF_MEASUREMENT
/end GROUP
/begin GROUP S1606_Subsystem4 "PubIfStateVSM_MDL/Subsystem Reference/Subsystem/StateManage/LSS/LCK_LKA_LDW_ELKStateMachine3/Signal_calculate/LaneAndRe_SignalProcess/LaneRage_Handle/Subsystem4" /begin REF_CHARACTERISTIC P_VSM_LSMC_SampleTime /end REF_CHARACTERISTIC /end GROUP
/begin GROUP S1606_Subsystem6 "PubIfStateVSM_MDL/Subsystem Reference/Subsystem/StateManage/LSS/LCK_LKA_LDW_ELKStateMachine3/Signal_calculate/LaneAndRe_SignalProcess/LaneRage_Handle/Subsystem6" /begin REF_CHARACTERISTIC P_VSM_LSMC_SampleTime /end REF_CHARACTERISTIC /end GROUP
/begin GROUP S161_accelOffRampNegCalc "PubIfDecisionPLAN_MDL/PLAN/Subsystem Reference/AP/AP/ORD/ORD/accelOffRampNegCalc" /begin REF_CHARACTERISTIC P_LongCtrl_ORDtAcceleTimeNeg /end REF_CHARACTERISTIC /end GROUP
/begin GROUP S161_accelOffRampPosCalc "PubIfDecisionPLAN_MDL/PLAN/Subsystem Reference/AP/AP/ORD/ORD/accelOffRampPosCalc" /begin REF_CHARACTERISTIC P_LongCtrl_ORDtAcceleTimePos /end REF_CHARACTERISTIC /end GROUP
/begin GROUP S167_ACCOSM "Noa_Nofusion/TOS/Subsystem1/ACCOSM"
 /begin REF_CHARACTERISTIC P_Global_SteeringAngleRatio P_HWA_TOS_P0HeadingAngle P_TOSS_DxOffset /end REF_CHARACTERISTIC
 /begin REF_MEASUREMENT ObjDYP0 dxP0 rangeP0 /end REF_MEASUREMENT
/end GROUP
/begin GROUP S1689_TSRv3_6 "PubIfStateVSM_MDL/Subsystem Reference/Subsystem/StateManage/Subsystem/TSR/TSRv3_6" /begin SUB_GROUP S1690_ISAnoSupp /end SUB_GROUP /end GROUP
/begin GROUP S168_DeceleToStop "PubIfDecisionPLAN_MDL/PLAN/Subsystem Reference/AP/AP/SJ/DeceleToStop/DeceleToStop" /begin SUB_GROUP S181_DresCalc /end SUB_GROUP /end GROUP
/begin GROUP S1690_ISAnoSupp "PubIfStateVSM_MDL/Subsystem Reference/Subsystem/StateManage/Subsystem/TSR/TSRv3_6/ISAnoSupp" /begin REF_MEASUREMENT VSM_ISL_SLWSPLvalue /end REF_MEASUREMENT /end GROUP
/begin GROUP S16_ORD "PubIfDecisionPLAN_MDL/PLAN/Subsystem Reference/AP/AP/ORD/ORD" /begin SUB_GROUP S161_accelOffRampNegCalc S161_accelOffRampPosCalc /end SUB_GROUP /end GROUP
/begin GROUP S1726_UOM "PubIfStateVSM_MDL/Subsystem Reference/Subsystem/StateManage/UOM/GW_V71/UOM" /begin SUB_GROUP S1727_Subsystem /end SUB_GROUP /begin REF_CHARACTERISTIC P_VSM_ALCSwtReq /end REF_CHARACTERISTIC /begin REF_MEASUREMENT VSM_UOM_SubModel_Number VSM_UOM_SubModel_VERSION /end REF_MEASUREMENT /end GROUP
/begin GROUP S1727_Subsystem "PubIfStateVSM_MDL/Subsystem Reference/Subsystem/StateManage/UOM/GW_V71/UOM/Subsystem"
 /begin REF_MEASUREMENT VSM_ACC_SWCruise VSM_ACC_SWEngState VSM_ACC_SWRes VSM_ACC_SWSet VSM_TJA_ACC_SelSts /end REF_MEASUREMENT
/end GROUP
/begin GROUP S17_BrakePreferJudge "PubIfDecisionPLAN_MDL/PLAN/Subsystem Reference/AP/AP/SJ/BrakePreferJudge"
 /begin REF_CHARACTERISTIC P_LongCtrl_SJVlcInternalAccThresEnableBrkPrefer P_LongCtrl_SJaccelFollowThresEnableBrkPrefer P_LongCtrl_SJaccelSubjPlanOptThresEnableBrkPrefer P_LongCtrl_SJaccelSubjThresEnableBrkPrefer P_LongCtrl_SJaxvRoadSlopeThresEnableBrkPrefer P_LongCtrl_SJttcThresEnableBrkPrefer P_LongCtrl_SJvelSubjThresEnableBrkPrefer /end REF_CHARACTERISTIC
 /begin REF_MEASUREMENT LongCtrl_BrakePrefer /end REF_MEASUREMENT
/end GROUP
/begin GROUP S17_DeceleToStop "PubIfDecisionPLAN_MDL/PLAN/Subsystem Reference/AP/AP/SJ/DeceleToStop" /begin SUB_GROUP S168_DeceleToStop /end SUB_GROUP
 /begin REF_CHARACTERISTIC C_LongCtrl_0_Single P_LongCtrl_distThreDecToStopXAxis P_LongCtrl_distThreDecToStopYAxis P_LongCtrl_velSubjThreDecToStop P_LongCtrl_velTargetThreDecleToStop /end REF_CHARACTERISTIC
/end GROUP
/begin GROUP S17_DisBar "PubIfDecisionPLAN_MDL/PLAN/Subsystem Reference/AP/AP/SJ/DisBar" /begin REF_MEASUREMENT LongCtrl_TgtObjBarDisp /end REF_MEASUREMENT /end GROUP
/begin GROUP S17_DriverOffConditionFulfilled "PubIfDecisionPLAN_MDL/PLAN/Subsystem Reference/AP/AP/SJ/DriverOffConditionFulfilled"
 /begin REF_CHARACTERISTIC P_LongCtrl_FollowDrvOffDistCorrDistFullFillOverride P_LongCtrl_FollowDrvOffDistCorrVelFullFillOverride P_LongCtrl_FollowDrvOffDistExitNoOverride P_LongCtrl_FollowDrvOffDistExitOverride P_LongCtrl_FollowDrvOffDistOffsetdDesiredAutoDrvOff P_LongCtrl_FollowDrvOffStandstillVelThres P_LongCtrl_FollowDrvOffVelCorrVelFullFillOverride P_LongCtrl_FollowDrvOffVelExitDistCorrNoOverride P_LongCtrl_FollowDrvOffVelExitDistCorrOverride P_LongCtrl_FollowDrvOffVelExitVelCorrNoOverride P_LongCtrl_FollowDrvOffVelExitVelCorrOverride P_LongCtrl_FollowDrvOffVelRelMinAutoDrvOff P_LongCtrl_FollowDrvOffdistRelMinAutoDrvOff P_LongCtrl_FollowDrvOffvSetMinDriveOffConditions /end REF_CHARACTERISTIC
/end GROUP
/begin GROUP S17_Subsystem5 "Noa_Nofusion/LPV/Subsystem5" /begin SUB_GROUP PubIfDecisionLSM_MDL /end SUB_GROUP /begin REF_MEASUREMENT LSM_Line_source /end REF_MEASUREMENT /end GROUP
/begin GROUP S18_Enabled_Subsystem "PubIfCommonVIE_MDL/VIE/VIE/VxvRef_Calc/VxvRef_Calc/Enabled Subsystem" /begin REF_CHARACTERISTIC P_Global_SteeringAngleRatio /end REF_CHARACTERISTIC /end GROUP
/begin GROUP S22_Simulink_Function "Noa_Nofusion/Subsystem4/Simulink Function" /begin REF_CHARACTERISTIC P_Global_EQ2RearAxisY_m /end REF_CHARACTERISTIC /end GROUP
/begin GROUP S4_LCS_Angle "PubIfControlLATC_MDL/Subsystem Reference/Subsystem/LateralControl/LCS_Angle" /begin REF_CHARACTERISTIC P_Global_SteeringAngleRatio /end REF_CHARACTERISTIC /end GROUP
/begin GROUP S4_Understeer_Offset_Calc "PubIfControlLATC_MDL/Subsystem Reference/Subsystem/LateralControl/Understeer&Offset_Calc" /begin REF_CHARACTERISTIC P_Global_SteeringAngleRatio /end REF_CHARACTERISTIC /end GROUP
/begin GROUP S731_LKA_LDW_SignalProcess "PubIfStateVSM_MDL/Subsystem Reference/Subsystem/StateManage/LSS/LCK_LKA_LDW_ELKStateMachine3/Signal_calculate/LKA_LDW_SignalProcess" /begin REF_CHARACTERISTIC P_Global_VehicleWidthMin_m /end REF_CHARACTERISTIC /end GROUP
/begin GROUP S734_Subsystem "PubIfStateVSM_MDL/Subsystem Reference/Subsystem/StateManage/LSS/LCK_LKA_LDW_ELKStateMachine3/ELKState_Machine/ELK/ELK_Condition/Subsystem" /begin REF_CHARACTERISTIC P_VSM_LSMC_SampleTime /end REF_CHARACTERISTIC /end GROUP
/begin GROUP S734_Subsystem1 "PubIfStateVSM_MDL/Subsystem Reference/Subsystem/StateManage/LSS/LCK_LKA_LDW_ELKStateMachine3/ELKState_Machine/ELK/ELK_Condition/Subsystem1" /begin REF_CHARACTERISTIC P_VSM_LSMC_SampleTime /end REF_CHARACTERISTIC /end GROUP
/begin GROUP S734_Subsystem10 "PubIfStateVSM_MDL/Subsystem Reference/Subsystem/StateManage/LSS/LCK_LKA_LDW_ELKStateMachine3/ELKState_Machine/ELK/ELK_Condition/Subsystem10" /begin REF_CHARACTERISTIC P_VSM_LSMC_SampleTime /end REF_CHARACTERISTIC /end GROUP
/begin GROUP S734_Subsystem11 "PubIfStateVSM_MDL/Subsystem Reference/Subsystem/StateManage/LSS/LCK_LKA_LDW_ELKStateMachine3/ELKState_Machine/ELK/ELK_Condition/Subsystem11" /begin REF_CHARACTERISTIC P_VSM_LSMC_SampleTime /end REF_CHARACTERISTIC /end GROUP
/begin GROUP S734_Subsystem12 "PubIfStateVSM_MDL/Subsystem Reference/Subsystem/StateManage/LSS/LCK_LKA_LDW_ELKStateMachine3/ELKState_Machine/ELK/ELK_Condition/Subsystem12" /begin REF_CHARACTERISTIC P_VSM_LSMC_SampleTime /end REF_CHARACTERISTIC /end GROUP
/begin GROUP S734_Subsystem15 "PubIfStateVSM_MDL/Subsystem Reference/Subsystem/StateManage/LSS/LCK_LKA_LDW_ELKStateMachine3/ELKState_Machine/ELK/ELK_Condition/Subsystem15" /begin REF_CHARACTERISTIC P_VSM_LSMC_SampleTime /end REF_CHARACTERISTIC /end GROUP
/begin GROUP S734_Subsystem17 "PubIfStateVSM_MDL/Subsystem Reference/Subsystem/StateManage/LSS/LCK_LKA_LDW_ELKStateMachine3/ELKState_Machine/ELK/ELK_Condition/Subsystem17" /begin REF_CHARACTERISTIC P_VSM_LSMC_SampleTime /end REF_CHARACTERISTIC /end GROUP
/begin GROUP S734_Subsystem4 "PubIfStateVSM_MDL/Subsystem Reference/Subsystem/StateManage/LSS/LCK_LKA_LDW_ELKStateMachine3/ELKState_Machine/ELK/ELK_Condition/Subsystem4" /begin REF_CHARACTERISTIC P_VSM_LSMC_SampleTime /end REF_CHARACTERISTIC /end GROUP
/begin GROUP S734_Subsystem5 "PubIfStateVSM_MDL/Subsystem Reference/Subsystem/StateManage/LSS/LCK_LKA_LDW_ELKStateMachine3/ELKState_Machine/ELK/ELK_Condition/Subsystem5" /begin REF_CHARACTERISTIC P_VSM_LSMC_SampleTime /end REF_CHARACTERISTIC /end GROUP
/begin GROUP S734_Subsystem6 "PubIfStateVSM_MDL/Subsystem Reference/Subsystem/StateManage/LSS/LCK_LKA_LDW_ELKStateMachine3/ELKState_Machine/ELK/ELK_Condition/Subsystem6" /begin REF_CHARACTERISTIC P_VSM_LSMC_SampleTime /end REF_CHARACTERISTIC /end GROUP
/begin GROUP S734_Subsystem7 "PubIfStateVSM_MDL/Subsystem Reference/Subsystem/StateManage/LSS/LCK_LKA_LDW_ELKStateMachine3/ELKState_Machine/ELK/ELK_Condition/Subsystem7" /begin REF_CHARACTERISTIC P_VSM_LSMC_SampleTime /end REF_CHARACTERISTIC /end GROUP
/begin GROUP S734_Subsystem8 "PubIfStateVSM_MDL/Subsystem Reference/Subsystem/StateManage/LSS/LCK_LKA_LDW_ELKStateMachine3/ELKState_Machine/ELK/ELK_Condition/Subsystem8" /begin REF_CHARACTERISTIC P_VSM_LSMC_SampleTime /end REF_CHARACTERISTIC /end GROUP
/begin GROUP S734_Subsystem9 "PubIfStateVSM_MDL/Subsystem Reference/Subsystem/StateManage/LSS/LCK_LKA_LDW_ELKStateMachine3/ELKState_Machine/ELK/ELK_Condition/Subsystem9" /begin REF_CHARACTERISTIC P_VSM_LSMC_SampleTime /end REF_CHARACTERISTIC /end GROUP
/begin GROUP S735_OnComing "PubIfStateVSM_MDL/Subsystem Reference/Subsystem/StateManage/LSS/LCK_LKA_LDW_ELKStateMachine3/ELKState_Machine/ELK/ELK_OnComing_OverTaking/OnComing" /begin REF_CHARACTERISTIC P_Global_VehicleWidthMin_m /end REF_CHARACTERISTIC /end GROUP
/begin GROUP S735_OverTaking "PubIfStateVSM_MDL/Subsystem Reference/Subsystem/StateManage/LSS/LCK_LKA_LDW_ELKStateMachine3/ELKState_Machine/ELK/ELK_OnComing_OverTaking/OverTaking" /begin REF_CHARACTERISTIC P_Global_VehicleWidthMin_m P_Global_Vehicle_Length_m /end REF_CHARACTERISTIC /end GROUP
/begin GROUP S735_Subsystem "PubIfStateVSM_MDL/Subsystem Reference/Subsystem/StateManage/LSS/LCK_LKA_LDW_ELKStateMachine3/ELKState_Machine/ELK/ELK_OnComing_OverTaking/Subsystem" /begin REF_CHARACTERISTIC P_Global_VehicleWidthMin_m /end REF_CHARACTERISTIC /end GROUP
/begin GROUP S735_Subsystem2 "PubIfStateVSM_MDL/Subsystem Reference/Subsystem/StateManage/LSS/LCK_LKA_LDW_ELKStateMachine3/ELKState_Machine/ELK/ELK_OnComing_OverTaking/Subsystem2" /begin REF_CHARACTERISTIC P_VSM_LSMC_SampleTime /end REF_CHARACTERISTIC /end GROUP
/begin GROUP S735_Subsystem3 "PubIfStateVSM_MDL/Subsystem Reference/Subsystem/StateManage/LSS/LCK_LKA_LDW_ELKStateMachine3/ELKState_Machine/ELK/ELK_OnComing_OverTaking/Subsystem3" /begin REF_CHARACTERISTIC P_VSM_LSMC_SampleTime /end REF_CHARACTERISTIC /end GROUP
/begin GROUP S7_VxvRef_Calc "PubIfCommonVIE_MDL/VIE/VIE/VxvRef_Calc/VxvRef_Calc" /begin REF_CHARACTERISTIC P_Global_SteeringAngleRatio /end REF_CHARACTERISTIC /end GROUP
/begin GROUP S80_Virtual_target_and_desired_distance "PubIfDecisionPLAN_MDL/PLAN/Subsystem Reference/AP/AP/LCObjChoose+FollowCtrl/LaneChangeObjectChoose/Virtual target and desired distance"
 /begin REF_CHARACTERISTIC P_LongCtrl_LC_LowerAccelLimit P_LongCtrl_LC_UpperAccelLimit /end REF_CHARACTERISTIC
/end GROUP
/begin GROUP S865_Subsystem1 "PubIfStateVSM_MDL/Subsystem Reference/Subsystem/StateManage/LSS/LCK_LKA_LDW_ELKStateMachine3/ELKState_Machine/ELK/ELK_OnComing_OverTaking/Subsystem/Subsystem1" /begin REF_CHARACTERISTIC P_VSM_LSMC_SampleTime /end REF_CHARACTERISTIC /end GROUP
/begin GROUP S865_Subsystem4 "PubIfStateVSM_MDL/Subsystem Reference/Subsystem/StateManage/LSS/LCK_LKA_LDW_ELKStateMachine3/ELKState_Machine/ELK/ELK_OnComing_OverTaking/Subsystem/Subsystem4" /begin REF_CHARACTERISTIC P_VSM_LSMC_SampleTime /end REF_CHARACTERISTIC /end GROUP
/begin GROUP S865_Subsystem7 "PubIfStateVSM_MDL/Subsystem Reference/Subsystem/StateManage/LSS/LCK_LKA_LDW_ELKStateMachine3/ELKState_Machine/ELK/ELK_OnComing_OverTaking/Subsystem/Subsystem7" /begin REF_CHARACTERISTIC P_VSM_LSMC_SampleTime /end REF_CHARACTERISTIC /end GROUP
/begin GROUP S8_Arbitrate "PubIfDecisionPLAN_MDL/PLAN/Subsystem Reference/AP/AP/Arbitrate" /begin REF_CHARACTERISTIC C_LongCtrl_0_Single /end REF_CHARACTERISTIC /end GROUP
/begin GROUP S8_CCCtrl "PubIfDecisionPLAN_MDL/PLAN/Subsystem Reference/AP/AP/CCCtrl" /begin REF_CHARACTERISTIC C_LongCtrl_0_Single /end REF_CHARACTERISTIC /end GROUP
/begin GROUP S930_Subsystem2 "PubIfStateVSM_MDL/Subsystem Reference/Subsystem/StateManage/LSS/LCK_LKA_LDW_ELKStateMachine3/LCK/LCK/LCK2/LCK/Subsystem2" /begin REF_CHARACTERISTIC P_VSM_LSMC_SampleTime /end REF_CHARACTERISTIC /end GROUP
/begin GROUP S930_Subsystem3 "PubIfStateVSM_MDL/Subsystem Reference/Subsystem/StateManage/LSS/LCK_LKA_LDW_ELKStateMachine3/LCK/LCK/LCK2/LCK/Subsystem3" /begin REF_CHARACTERISTIC P_VSM_LSMC_SampleTime /end REF_CHARACTERISTIC /end GROUP
/begin GROUP S931_Subsystem1 "PubIfStateVSM_MDL/Subsystem Reference/Subsystem/StateManage/LSS/LCK_LKA_LDW_ELKStateMachine3/LCK/LCK/LCK2/LCK_Condition1/Subsystem1" /begin REF_CHARACTERISTIC P_VSM_LSMC_SampleTime /end REF_CHARACTERISTIC /end GROUP
/begin GROUP S931_Subsystem10 "PubIfStateVSM_MDL/Subsystem Reference/Subsystem/StateManage/LSS/LCK_LKA_LDW_ELKStateMachine3/LCK/LCK/LCK2/LCK_Condition1/Subsystem10" /begin REF_CHARACTERISTIC P_VSM_LSMC_SampleTime /end REF_CHARACTERISTIC /end GROUP
/begin GROUP S931_Subsystem11 "PubIfStateVSM_MDL/Subsystem Reference/Subsystem/StateManage/LSS/LCK_LKA_LDW_ELKStateMachine3/LCK/LCK/LCK2/LCK_Condition1/Subsystem11" /begin REF_CHARACTERISTIC P_VSM_LSMC_SampleTime /end REF_CHARACTERISTIC /end GROUP
/begin GROUP S931_Subsystem12 "PubIfStateVSM_MDL/Subsystem Reference/Subsystem/StateManage/LSS/LCK_LKA_LDW_ELKStateMachine3/LCK/LCK/LCK2/LCK_Condition1/Subsystem12" /begin REF_CHARACTERISTIC P_VSM_LSMC_SampleTime /end REF_CHARACTERISTIC /end GROUP
/begin GROUP S931_Subsystem13 "PubIfStateVSM_MDL/Subsystem Reference/Subsystem/StateManage/LSS/LCK_LKA_LDW_ELKStateMachine3/LCK/LCK/LCK2/LCK_Condition1/Subsystem13" /begin REF_CHARACTERISTIC P_VSM_LSMC_SampleTime /end REF_CHARACTERISTIC /end GROUP
/begin GROUP S931_Subsystem14 "PubIfStateVSM_MDL/Subsystem Reference/Subsystem/StateManage/LSS/LCK_LKA_LDW_ELKStateMachine3/LCK/LCK/LCK2/LCK_Condition1/Subsystem14" /begin REF_CHARACTERISTIC P_VSM_LSMC_SampleTime /end REF_CHARACTERISTIC /end GROUP
/begin GROUP S931_Subsystem15 "PubIfStateVSM_MDL/Subsystem Reference/Subsystem/StateManage/LSS/LCK_LKA_LDW_ELKStateMachine3/LCK/LCK/LCK2/LCK_Condition1/Subsystem15" /begin REF_CHARACTERISTIC P_VSM_LSMC_SampleTime /end REF_CHARACTERISTIC /end GROUP
/begin GROUP S931_Subsystem16 "PubIfStateVSM_MDL/Subsystem Reference/Subsystem/StateManage/LSS/LCK_LKA_LDW_ELKStateMachine3/LCK/LCK/LCK2/LCK_Condition1/Subsystem16" /begin REF_CHARACTERISTIC P_VSM_LSMC_SampleTime /end REF_CHARACTERISTIC /end GROUP
/begin GROUP S931_Subsystem17 "PubIfStateVSM_MDL/Subsystem Reference/Subsystem/StateManage/LSS/LCK_LKA_LDW_ELKStateMachine3/LCK/LCK/LCK2/LCK_Condition1/Subsystem17" /begin REF_CHARACTERISTIC P_VSM_LSMC_SampleTime /end REF_CHARACTERISTIC /end GROUP
/begin GROUP S931_Subsystem18 "PubIfStateVSM_MDL/Subsystem Reference/Subsystem/StateManage/LSS/LCK_LKA_LDW_ELKStateMachine3/LCK/LCK/LCK2/LCK_Condition1/Subsystem18" /begin REF_CHARACTERISTIC P_VSM_LSMC_SampleTime /end REF_CHARACTERISTIC /end GROUP
/begin GROUP S931_Subsystem19 "PubIfStateVSM_MDL/Subsystem Reference/Subsystem/StateManage/LSS/LCK_LKA_LDW_ELKStateMachine3/LCK/LCK/LCK2/LCK_Condition1/Subsystem19" /begin REF_CHARACTERISTIC P_VSM_LSMC_SampleTime /end REF_CHARACTERISTIC /end GROUP
/begin GROUP S931_Subsystem2 "PubIfStateVSM_MDL/Subsystem Reference/Subsystem/StateManage/LSS/LCK_LKA_LDW_ELKStateMachine3/LCK/LCK/LCK2/LCK_Condition1/Subsystem2" /begin REF_CHARACTERISTIC P_VSM_LSMC_SampleTime /end REF_CHARACTERISTIC /end GROUP
/begin GROUP S931_Subsystem20 "PubIfStateVSM_MDL/Subsystem Reference/Subsystem/StateManage/LSS/LCK_LKA_LDW_ELKStateMachine3/LCK/LCK/LCK2/LCK_Condition1/Subsystem20" /begin REF_CHARACTERISTIC P_VSM_LSMC_SampleTime /end REF_CHARACTERISTIC /end GROUP
/begin GROUP S931_Subsystem21 "PubIfStateVSM_MDL/Subsystem Reference/Subsystem/StateManage/LSS/LCK_LKA_LDW_ELKStateMachine3/LCK/LCK/LCK2/LCK_Condition1/Subsystem21" /begin REF_CHARACTERISTIC P_VSM_LSMC_SampleTime /end REF_CHARACTERISTIC /end GROUP
/begin GROUP S931_Subsystem3 "PubIfStateVSM_MDL/Subsystem Reference/Subsystem/StateManage/LSS/LCK_LKA_LDW_ELKStateMachine3/LCK/LCK/LCK2/LCK_Condition1/Subsystem3" /begin REF_CHARACTERISTIC P_VSM_LSMC_SampleTime /end REF_CHARACTERISTIC /end GROUP
/begin GROUP S931_Subsystem4 "PubIfStateVSM_MDL/Subsystem Reference/Subsystem/StateManage/LSS/LCK_LKA_LDW_ELKStateMachine3/LCK/LCK/LCK2/LCK_Condition1/Subsystem4" /begin REF_CHARACTERISTIC P_VSM_LSMC_SampleTime /end REF_CHARACTERISTIC /end GROUP
/begin GROUP S931_Subsystem5 "PubIfStateVSM_MDL/Subsystem Reference/Subsystem/StateManage/LSS/LCK_LKA_LDW_ELKStateMachine3/LCK/LCK/LCK2/LCK_Condition1/Subsystem5" /begin REF_CHARACTERISTIC P_VSM_LSMC_SampleTime /end REF_CHARACTERISTIC /end GROUP
/begin GROUP S931_Subsystem7 "PubIfStateVSM_MDL/Subsystem Reference/Subsystem/StateManage/LSS/LCK_LKA_LDW_ELKStateMachine3/LCK/LCK/LCK2/LCK_Condition1/Subsystem7" /begin REF_CHARACTERISTIC P_VSM_LSMC_SampleTime /end REF_CHARACTERISTIC /end GROUP
/begin GROUP S931_Subsystem8 "PubIfStateVSM_MDL/Subsystem Reference/Subsystem/StateManage/LSS/LCK_LKA_LDW_ELKStateMachine3/LCK/LCK/LCK2/LCK_Condition1/Subsystem8" /begin REF_CHARACTERISTIC P_VSM_LSMC_SampleTime /end REF_CHARACTERISTIC /end GROUP
/begin GROUP S931_Subsystem9 "PubIfStateVSM_MDL/Subsystem Reference/Subsystem/StateManage/LSS/LCK_LKA_LDW_ELKStateMachine3/LCK/LCK/LCK2/LCK_Condition1/Subsystem9" /begin REF_CHARACTERISTIC P_VSM_LSMC_SampleTime /end REF_CHARACTERISTIC /end GROUP
/begin RECORD_LAYOUT Lookup1D_BOOLEAN FNC_VALUES 1 UBYTE ROW_DIR DIRECT /end RECORD_LAYOUT
/begin RECORD_LAYOUT Lookup1D_BYTE FNC_VALUES 1 SBYTE ROW_DIR DIRECT /end RECORD_LAYOUT
/begin RECORD_LAYOUT Lookup1D_FLOAT32_IEEE FNC_VALUES 1 FLOAT32_IEEE ROW_DIR DIRECT /end RECORD_LAYOUT
/begin RECORD_LAYOUT Lookup1D_FLOAT64_IEEE FNC_VALUES 1 FLOAT64_IEEE ROW_DIR DIRECT /end RECORD_LAYOUT
/begin RECORD_LAYOUT Lookup1D_LONG FNC_VALUES 1 SLONG ROW_DIR DIRECT /end RECORD_LAYOUT
/begin RECORD_LAYOUT Lookup1D_UBYTE FNC_VALUES 1 UBYTE ROW_DIR DIRECT /end RECORD_LAYOUT
/begin RECORD_LAYOUT Lookup1D_ULONG FNC_VALUES 1 ULONG ROW_DIR DIRECT /end RECORD_LAYOUT
/begin RECORD_LAYOUT Lookup1D_UWORD FNC_VALUES 1 UWORD ROW_DIR DIRECT /end RECORD_LAYOUT
/begin RECORD_LAYOUT Lookup1D_WORD FNC_VALUES 1 SWORD ROW_DIR DIRECT /end RECORD_LAYOUT
/begin RECORD_LAYOUT Lookup1D_X_BOOLEAN AXIS_PTS_X 1 UBYTE INDEX_INCR DIRECT /end RECORD_LAYOUT
/begin RECORD_LAYOUT Lookup1D_X_BYTE AXIS_PTS_X 1 SBYTE INDEX_INCR DIRECT /end RECORD_LAYOUT
/begin RECORD_LAYOUT Lookup1D_X_FLOAT32_IEEE AXIS_PTS_X 1 FLOAT32_IEEE INDEX_INCR DIRECT /end RECORD_LAYOUT
/begin RECORD_LAYOUT Lookup1D_X_FLOAT64_IEEE AXIS_PTS_X 1 FLOAT64_IEEE INDEX_INCR DIRECT /end RECORD_LAYOUT
/begin RECORD_LAYOUT Lookup1D_X_LONG AXIS_PTS_X 1 SLONG INDEX_INCR DIRECT /end RECORD_LAYOUT
/begin RECORD_LAYOUT Lookup1D_X_UBYTE AXIS_PTS_X 1 UBYTE INDEX_INCR DIRECT /end RECORD_LAYOUT
/begin RECORD_LAYOUT Lookup1D_X_ULONG AXIS_PTS_X 1 ULONG INDEX_INCR DIRECT /end RECORD_LAYOUT
/begin RECORD_LAYOUT Lookup1D_X_UWORD AXIS_PTS_X 1 UWORD INDEX_INCR DIRECT /end RECORD_LAYOUT
/begin RECORD_LAYOUT Lookup1D_X_WORD AXIS_PTS_X 1 SWORD INDEX_INCR DIRECT /end RECORD_LAYOUT
/begin RECORD_LAYOUT Lookup2D_BOOLEAN FNC_VALUES 1 UBYTE ROW_DIR DIRECT /end RECORD_LAYOUT
/begin RECORD_LAYOUT Lookup2D_FLOAT32_IEEE FNC_VALUES 1 FLOAT32_IEEE ROW_DIR DIRECT /end RECORD_LAYOUT
/begin RECORD_LAYOUT Lookup2D_X_FLOAT64_IEEE AXIS_PTS_X 1 FLOAT64_IEEE INDEX_INCR DIRECT /end RECORD_LAYOUT
/begin RECORD_LAYOUT Lookup2D_X_UBYTE AXIS_PTS_X 1 UBYTE INDEX_INCR DIRECT /end RECORD_LAYOUT
/begin RECORD_LAYOUT Scalar_BOOLEAN FNC_VALUES 1 UBYTE ROW_DIR DIRECT /end RECORD_LAYOUT
/begin RECORD_LAYOUT Scalar_FLOAT32_IEEE FNC_VALUES 1 FLOAT32_IEEE ROW_DIR DIRECT /end RECORD_LAYOUT
/begin RECORD_LAYOUT Scalar_FLOAT64_IEEE FNC_VALUES 1 FLOAT64_IEEE ROW_DIR DIRECT /end RECORD_LAYOUT
/begin RECORD_LAYOUT Scalar_UBYTE FNC_VALUES 1 UBYTE ROW_DIR DIRECT /end RECORD_LAYOUT
/end MODULE
/end PROJECT
