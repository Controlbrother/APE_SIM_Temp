ASAP2_VERSION 1 61
/begin PROJECT Noa_Nofusion ""
/begin MODULE Noa_Nofusion ""
/begin MOD_COMMON "" DEPOSIT ABSOLUTE BYTE_ORDER MSB_LAST ALIGNMENT_BYTE 1 ALIGNMENT_WORD 2 ALIGNMENT_LONG 4 ALIGNMENT_INT64 1 ALIGNMENT_FLOAT32_IEEE 4 ALIGNMENT_FLOAT64_IEEE 8 /end MOD_COMMON
/begin COMPU_VTAB VTAB_FOR_PubIfStateVSM_MDL_CM_LCK_STATE "Enumerated data type: LCK_STATE" TAB_VERB 5 0 "LCK_STATE_LCK_Off" 1 "LCK_STATE_LCK_Idle" 2 "LCK_STATE_LCK_Ready" 3 "LCK_STATE_LCK_Active" 7 "LCK_STATE_LCK_Error" DEFAULT_VALUE "" /end COMPU_VTAB
/begin COMPU_METHOD PubIfChassisHMI_MDL_CM_single "Q = V" IDENTICAL "%8.6" "" /end COMPU_METHOD
/begin COMPU_METHOD PubIfControlLATC_MDL_CM_boolean "Q = V" IDENTICAL "%1.0" "" /end COMPU_METHOD
/begin COMPU_METHOD PubIfControlLATC_MDL_CM_double "Q = V" IDENTICAL "%15.10" "" /end COMPU_METHOD
/begin COMPU_METHOD PubIfControlLATC_MDL_CM_single "Q = V" IDENTICAL "%8.6" "" /end COMPU_METHOD
/begin COMPU_METHOD PubIfControlLATC_MDL_CM_uint16 "Q = V" IDENTICAL "%5.0" "" /end COMPU_METHOD
/begin COMPU_METHOD PubIfControlLATC_MDL_CM_uint8 "Q = V" IDENTICAL "%3.0" "" /end COMPU_METHOD
/begin COMPU_METHOD PubIfControlLONC_MDL_CM_boolean "Q = V" IDENTICAL "%1.0" "" /end COMPU_METHOD
/begin COMPU_METHOD PubIfControlLONC_MDL_CM_single "Q = V" IDENTICAL "%8.6" "" /end COMPU_METHOD
/begin COMPU_METHOD PubIfControlLONC_MDL_CM_single__ "Q = V" IDENTICAL "%8.6" "%" /end COMPU_METHOD
/begin COMPU_METHOD PubIfControlLONC_MDL_CM_single_km_h "Q = V" IDENTICAL "%8.6" "km/h" /end COMPU_METHOD
/begin COMPU_METHOD PubIfControlLONC_MDL_CM_single_m_s "Q = V" IDENTICAL "%8.6" "m/s" /end COMPU_METHOD
/begin COMPU_METHOD PubIfControlLONC_MDL_CM_single_m_s_2 "Q = V" IDENTICAL "%8.6" "m/s^2" /end COMPU_METHOD
/begin COMPU_METHOD PubIfControlLONC_MDL_CM_single_m_s_3 "Q = V" IDENTICAL "%8.6" "m/s^3" /end COMPU_METHOD
/begin COMPU_METHOD PubIfControlLONC_MDL_CM_single_N "Q = V" IDENTICAL "%8.6" "N" /end COMPU_METHOD
/begin COMPU_METHOD PubIfDecisionPLAN_MDL_CM_boolean "Q = V" IDENTICAL "%1.0" "" /end COMPU_METHOD
/begin COMPU_METHOD PubIfDecisionPLAN_MDL_CM_double "Q = V" IDENTICAL "%15.10" "" /end COMPU_METHOD
/begin COMPU_METHOD PubIfDecisionPLAN_MDL_CM_int16_s "Q = V" IDENTICAL "%5.0" "s" /end COMPU_METHOD
/begin COMPU_METHOD PubIfDecisionPLAN_MDL_CM_single "Q = V" IDENTICAL "%8.6" "" /end COMPU_METHOD
/begin COMPU_METHOD PubIfDecisionPLAN_MDL_CM_single_1_m "Q = V" IDENTICAL "%8.6" "1/m" /end COMPU_METHOD
/begin COMPU_METHOD PubIfDecisionPLAN_MDL_CM_single_km_h "Q = V" IDENTICAL "%8.6" "km/h" /end COMPU_METHOD
/begin COMPU_METHOD PubIfDecisionPLAN_MDL_CM_single_m "Q = V" IDENTICAL "%8.6" "m" /end COMPU_METHOD
/begin COMPU_METHOD PubIfDecisionPLAN_MDL_CM_single_m_s "Q = V" IDENTICAL "%8.6" "m/s" /end COMPU_METHOD
/begin COMPU_METHOD PubIfDecisionPLAN_MDL_CM_single_m_s_2 "Q = V" IDENTICAL "%8.6" "m/s^2" /end COMPU_METHOD
/begin COMPU_METHOD PubIfDecisionPLAN_MDL_CM_single_m_s_3 "Q = V" IDENTICAL "%8.6" "m/s^3" /end COMPU_METHOD
/begin COMPU_METHOD PubIfDecisionPLAN_MDL_CM_single_s "Q = V" IDENTICAL "%8.6" "s" /end COMPU_METHOD
/begin COMPU_METHOD PubIfDecisionPLAN_MDL_CM_uint16 "Q = V" IDENTICAL "%5.0" "" /end COMPU_METHOD
/begin COMPU_METHOD PubIfDecisionPLAN_MDL_CM_uint32 "Q = V" IDENTICAL "%10.0" "" /end COMPU_METHOD
/begin COMPU_METHOD PubIfDecisionPLAN_MDL_CM_uint8 "Q = V" IDENTICAL "%3.0" "" /end COMPU_METHOD
/begin COMPU_METHOD PubIfStateVSM_MDL_CM_boolean "Q = V" IDENTICAL "%1.0" "" /end COMPU_METHOD
/begin COMPU_METHOD PubIfStateVSM_MDL_CM_double "Q = V" IDENTICAL "%15.10" "" /end COMPU_METHOD
/begin COMPU_METHOD PubIfStateVSM_MDL_CM_LCK_STATE "Enumerated data type: LCK_STATE" TAB_VERB "%10.6" "" COMPU_TAB_REF VTAB_FOR_PubIfStateVSM_MDL_CM_LCK_STATE /end COMPU_METHOD
/begin COMPU_METHOD PubIfStateVSM_MDL_CM_single "Q = V" IDENTICAL "%8.6" "" /end COMPU_METHOD
/begin COMPU_METHOD PubIfStateVSM_MDL_CM_single_m "Q = V" IDENTICAL "%8.6" "m" /end COMPU_METHOD
/begin COMPU_METHOD PubIfStateVSM_MDL_CM_uint16 "Q = V" IDENTICAL "%5.0" "" /end COMPU_METHOD
/begin COMPU_METHOD PubIfStateVSM_MDL_CM_uint32 "Q = V" IDENTICAL "%10.0" "" /end COMPU_METHOD
/begin COMPU_METHOD PubIfStateVSM_MDL_CM_uint8 "Q = V" IDENTICAL "%3.0" "" /end COMPU_METHOD
/begin CHARACTERISTIC C_LongCtrl_0_Uint8 "" VALUE 0x3CB090 Scalar_UBYTE 0 PubIfDecisionPLAN_MDL_CM_uint8 0 255 /end CHARACTERISTIC
/begin MEASUREMENT LCS_AngleErrorReversTorq "" FLOAT32_IEEE PubIfControlLATC_MDL_CM_single 0 0 -3.4e+38 3.4e+38 ECU_ADDRESS 0x3F1910 /end MEASUREMENT
/begin MEASUREMENT LCS_AngleSlope_Cnt "" UWORD PubIfControlLATC_MDL_CM_uint16 0 0 0 65535 ECU_ADDRESS 0x3F1950 /end MEASUREMENT
/begin MEASUREMENT LCS_AngleSlope_Flg "" UBYTE PubIfControlLATC_MDL_CM_uint8 0 0 0 255 ECU_ADDRESS 0x3F1958 /end MEASUREMENT
/begin MEASUREMENT LCS_AngleSlope_LCcancel "" UBYTE PubIfControlLATC_MDL_CM_uint8 0 0 0 255 ECU_ADDRESS 0x3F1959 /end MEASUREMENT
/begin MEASUREMENT LCS_EpsTrqReqValue "" FLOAT32_IEEE PubIfControlLATC_MDL_CM_single 0 0 -3.4e+38 3.4e+38 ECU_ADDRESS 0x3F1934 /end MEASUREMENT
/begin MEASUREMENT LCS_EpsTrqReqValueVld "" UBYTE PubIfControlLATC_MDL_CM_uint8 0 0 0 255 ECU_ADDRESS 0x3F1954 /end MEASUREMENT
/begin MEASUREMENT LCS_HoldTime "" FLOAT64_IEEE PubIfControlLATC_MDL_CM_double 0 0 -1.7e+308 1.7e+308 ECU_ADDRESS 0x3F1840 /end MEASUREMENT
/begin MEASUREMENT LCS_IsOverRide "" UBYTE PubIfControlLATC_MDL_CM_boolean 0 0 0 1 BIT_MASK 0x1 ECU_ADDRESS 0x3F195E /end MEASUREMENT
/begin MEASUREMENT LCS_Q "" FLOAT32_IEEE PubIfControlLATC_MDL_CM_single 0 0 -3.4e+38 3.4e+38 ECU_ADDRESS 0x3F18DC /end MEASUREMENT
/begin MEASUREMENT LCS_StateActive_AngleSlope "" FLOAT32_IEEE PubIfControlLATC_MDL_CM_single 0 0 -3.4e+38 3.4e+38 ECU_ADDRESS 0x3F18E0 /end MEASUREMENT
/begin MEASUREMENT LCS_State_AngleSlope "" FLOAT32_IEEE PubIfControlLATC_MDL_CM_single 0 0 -3.4e+38 3.4e+38 ECU_ADDRESS 0x3F18E4 /end MEASUREMENT
/begin MEASUREMENT LCS_SteerAngleFilter_deg "" FLOAT32_IEEE PubIfControlLATC_MDL_CM_single 0 0 -3.4e+38 3.4e+38 ECU_ADDRESS 0x3F18FC /end MEASUREMENT
/begin MEASUREMENT LCS_SteerAngleSpdFilter_degs "" FLOAT32_IEEE PubIfControlLATC_MDL_CM_single 0 0 -3.4e+38 3.4e+38 ECU_ADDRESS 0x3F191C /end MEASUREMENT
/begin MEASUREMENT LCS_TarDangerLevelProc "" UBYTE PubIfControlLATC_MDL_CM_uint8 0 0 0 255 ECU_ADDRESS 0x3F1957 /end MEASUREMENT
/begin MEASUREMENT LCS_TarSteerAngle "" FLOAT32_IEEE PubIfControlLATC_MDL_CM_single 0 0 -3.4e+38 3.4e+38 ECU_ADDRESS 0x3F1944 /end MEASUREMENT
/begin MEASUREMENT LCS_TarSteerAngleCalc_Num "" FLOAT32_IEEE PubIfControlLATC_MDL_CM_single 0 0 -3.4e+38 3.4e+38 ECU_ADDRESS 0x3F194C /end MEASUREMENT
/begin MEASUREMENT LCS_TarSteerAngleEnd "" FLOAT32_IEEE PubIfControlLATC_MDL_CM_single 0 0 -3.4e+38 3.4e+38 ECU_ADDRESS 0x3F1948 /end MEASUREMENT
/begin MEASUREMENT LCS_TarSteerAngleSlope "" FLOAT32_IEEE PubIfControlLATC_MDL_CM_single 0 0 -3.4e+38 3.4e+38 ECU_ADDRESS 0x3F18E8 /end MEASUREMENT
/begin MEASUREMENT LCS_TorqFFPID_OUT "" FLOAT64_IEEE PubIfControlLATC_MDL_CM_double 0 0 -1.7e+308 1.7e+308 ECU_ADDRESS 0x3F1850 /end MEASUREMENT
/begin MEASUREMENT LCS_Torq_D "" FLOAT32_IEEE PubIfControlLATC_MDL_CM_single 0 0 -3.4e+38 3.4e+38 ECU_ADDRESS 0x3F1924 /end MEASUREMENT
/begin MEASUREMENT LCS_Torq_FF "" FLOAT32_IEEE PubIfControlLATC_MDL_CM_single 0 0 -3.4e+38 3.4e+38 ECU_ADDRESS 0x3F190C /end MEASUREMENT
/begin MEASUREMENT LCS_Torq_I "" FLOAT32_IEEE PubIfControlLATC_MDL_CM_single 0 0 -3.4e+38 3.4e+38 ECU_ADDRESS 0x3F1928 /end MEASUREMENT
/begin MEASUREMENT LCS_Torq_P "" FLOAT32_IEEE PubIfControlLATC_MDL_CM_single 0 0 -3.4e+38 3.4e+38 ECU_ADDRESS 0x3F1920 /end MEASUREMENT
/begin MEASUREMENT LongCtrl_ACC_Decel_ReqValue "" FLOAT32_IEEE PubIfControlLONC_MDL_CM_single 0 0 -3.4e+38 3.4e+38 ECU_ADDRESS 0x3F249C /end MEASUREMENT
/begin MEASUREMENT LongCtrl_ACC_EngTrqReq "" FLOAT32_IEEE PubIfControlLONC_MDL_CM_single 0 0 -3.4e+38 3.4e+38 ECU_ADDRESS 0x3F2488 /end MEASUREMENT
/begin MEASUREMENT LongCtrl_ArbFlag "" FLOAT64_IEEE PubIfDecisionPLAN_MDL_CM_double 0 0 -1.7e+308 1.7e+308 ECU_ADDRESS 0x3F28C8 /end MEASUREMENT
/begin MEASUREMENT LongCtrl_FF_NetEngTorqInc "" FLOAT32_IEEE PubIfControlLONC_MDL_CM_single 0 0 -3.4e+38 3.4e+38 ECU_ADDRESS 0x3F2484 /end MEASUREMENT
/begin MEASUREMENT LongCtrl_FF_NetEngTorqMax "" FLOAT32_IEEE PubIfControlLONC_MDL_CM_single__ 0 0 -3.4e+38 3.4e+38 ECU_ADDRESS 0x3F2480 /end MEASUREMENT
/begin MEASUREMENT LongCtrl_FollowAcceleStandstillOverride "" FLOAT32_IEEE PubIfDecisionPLAN_MDL_CM_single 0 0 -3.4e+38 3.4e+38 ECU_ADDRESS 0x3F2F4C /end MEASUREMENT
/begin MEASUREMENT LongCtrl_ForceStop "" UBYTE PubIfDecisionPLAN_MDL_CM_boolean 0 0 0 1 BIT_MASK 0x1 ECU_ADDRESS 0x3F35CD /end MEASUREMENT
/begin MEASUREMENT LongCtrl_Fz "" FLOAT32_IEEE PubIfControlLONC_MDL_CM_single 0 0 -3.4e+38 3.4e+38 ECU_ADDRESS 0x3F247C /end MEASUREMENT
/begin MEASUREMENT LongCtrl_IN_ACCModeSts "" UBYTE PubIfDecisionPLAN_MDL_CM_uint8 0 0 0 255 ECU_ADDRESS 0x3F3533 /end MEASUREMENT
/begin MEASUREMENT LongCtrl_IN_ACC_SpdSetValue "" FLOAT32_IEEE PubIfDecisionPLAN_MDL_CM_single 0 0 -3.4e+38 3.4e+38 ECU_ADDRESS 0x3F2ACC /end MEASUREMENT
/begin MEASUREMENT LongCtrl_IN_ALC_intention "" FLOAT64_IEEE PubIfDecisionPLAN_MDL_CM_double 0 0 -1.7e+308 1.7e+308 ECU_ADDRESS 0x3F28C0 /end MEASUREMENT
/begin MEASUREMENT LongCtrl_IN_DrivingMode "" UBYTE PubIfDecisionPLAN_MDL_CM_uint8 0 0 0 255 ECU_ADDRESS 0x3F354F /end MEASUREMENT
/begin MEASUREMENT LongCtrl_IN_HWAIsLaneChange "" UBYTE PubIfDecisionPLAN_MDL_CM_boolean 0 0 0 1 BIT_MASK 0x1 ECU_ADDRESS 0x3F35BD /end MEASUREMENT
/begin MEASUREMENT LongCtrl_IN_IDP0 "" UBYTE PubIfDecisionPLAN_MDL_CM_uint8 0 0 0 255 ECU_ADDRESS 0x3F3530 /end MEASUREMENT
/begin MEASUREMENT LongCtrl_IN_IDP2 "" UBYTE PubIfDecisionPLAN_MDL_CM_uint8 0 0 0 255 ECU_ADDRESS 0x3F3531 /end MEASUREMENT
/begin MEASUREMENT LongCtrl_IN_IDP3 "" UBYTE PubIfDecisionPLAN_MDL_CM_uint8 0 0 0 255 ECU_ADDRESS 0x3F3532 /end MEASUREMENT
/begin MEASUREMENT LongCtrl_IN_IP_VehSpdUnit "" UBYTE PubIfDecisionPLAN_MDL_CM_uint8 0 0 0 255 ECU_ADDRESS 0x3F3561 /end MEASUREMENT
/begin MEASUREMENT LongCtrl_IN_L1bIsLineExist "" UBYTE PubIfDecisionPLAN_MDL_CM_uint8 0 0 0 255 ECU_ADDRESS 0x3F355B /end MEASUREMENT
/begin MEASUREMENT LongCtrl_IN_L1dC0V "" FLOAT32_IEEE PubIfDecisionPLAN_MDL_CM_single 0 0 -3.4e+38 3.4e+38 ECU_ADDRESS 0x3F2B04 /end MEASUREMENT
/begin MEASUREMENT LongCtrl_IN_L1dC1V "" FLOAT32_IEEE PubIfDecisionPLAN_MDL_CM_single 0 0 -3.4e+38 3.4e+38 ECU_ADDRESS 0x3F2ADC /end MEASUREMENT
/begin MEASUREMENT LongCtrl_IN_L1dC2V "" FLOAT32_IEEE PubIfDecisionPLAN_MDL_CM_single 0 0 -3.4e+38 3.4e+38 ECU_ADDRESS 0x3F2AE0 /end MEASUREMENT
/begin MEASUREMENT LongCtrl_IN_L1dC3V "" FLOAT32_IEEE PubIfDecisionPLAN_MDL_CM_single 0 0 -3.4e+38 3.4e+38 ECU_ADDRESS 0x3F2AE4 /end MEASUREMENT
/begin MEASUREMENT LongCtrl_IN_L1dDisFront "" FLOAT32_IEEE PubIfDecisionPLAN_MDL_CM_single 0 0 -3.4e+38 3.4e+38 ECU_ADDRESS 0x3F2B0C /end MEASUREMENT
/begin MEASUREMENT LongCtrl_IN_Object_AX "" FLOAT32_IEEE PubIfDecisionPLAN_MDL_CM_single 0 0 -3.4e+38 3.4e+38 ECU_ADDRESS 0x3F2D60 MATRIX_DIM 11 1 1 LAYOUT ROW_DIR /end MEASUREMENT
/begin MEASUREMENT LongCtrl_IN_Object_Age "" FLOAT32_IEEE PubIfDecisionPLAN_MDL_CM_single 0 0 -3.4e+38 3.4e+38 ECU_ADDRESS 0x3F2C1C MATRIX_DIM 11 1 1 LAYOUT ROW_DIR /end MEASUREMENT
/begin MEASUREMENT LongCtrl_IN_Object_DX "" FLOAT32_IEEE PubIfDecisionPLAN_MDL_CM_single 0 0 -3.4e+38 3.4e+38 ECU_ADDRESS 0x3F2CCC MATRIX_DIM 11 1 1 LAYOUT ROW_DIR /end MEASUREMENT
/begin MEASUREMENT LongCtrl_IN_Object_DY "" FLOAT32_IEEE PubIfDecisionPLAN_MDL_CM_single 0 0 -3.4e+38 3.4e+38 ECU_ADDRESS 0x3F2CF8 MATRIX_DIM 11 1 1 LAYOUT ROW_DIR /end MEASUREMENT
/begin MEASUREMENT LongCtrl_IN_Object_ExistProb "" FLOAT32_IEEE PubIfDecisionPLAN_MDL_CM_single 0 0 -3.4e+38 3.4e+38 ECU_ADDRESS 0x3F2BC4 MATRIX_DIM 11 1 1 LAYOUT ROW_DIR /end MEASUREMENT
/begin MEASUREMENT LongCtrl_IN_Object_Fus_Type "" UBYTE PubIfDecisionPLAN_MDL_CM_uint8 0 0 0 255 ECU_ADDRESS 0x3F3538 MATRIX_DIM 11 1 1 LAYOUT ROW_DIR /end MEASUREMENT
/begin MEASUREMENT LongCtrl_IN_Object_HeadingAngle "" FLOAT32_IEEE PubIfDecisionPLAN_MDL_CM_single 0 0 -3.4e+38 3.4e+38 ECU_ADDRESS 0x3F2B94 MATRIX_DIM 11 1 1 LAYOUT ROW_DIR /end MEASUREMENT
/begin MEASUREMENT LongCtrl_IN_Object_Hight "" FLOAT32_IEEE PubIfDecisionPLAN_MDL_CM_single 0 0 -3.4e+38 3.4e+38 ECU_ADDRESS 0x3F2CA0 MATRIX_DIM 11 1 1 LAYOUT ROW_DIR /end MEASUREMENT
/begin MEASUREMENT LongCtrl_IN_Object_ID "" UBYTE PubIfDecisionPLAN_MDL_CM_uint8 0 0 0 255 ECU_ADDRESS 0x3F3544 MATRIX_DIM 11 1 1 LAYOUT ROW_DIR /end MEASUREMENT
/begin MEASUREMENT LongCtrl_IN_Object_Length "" FLOAT32_IEEE PubIfDecisionPLAN_MDL_CM_single 0 0 -3.4e+38 3.4e+38 ECU_ADDRESS 0x3F2C48 MATRIX_DIM 11 1 1 LAYOUT ROW_DIR /end MEASUREMENT
/begin MEASUREMENT LongCtrl_IN_Object_ObstacleProb "" FLOAT32_IEEE PubIfDecisionPLAN_MDL_CM_single 0 0 -3.4e+38 3.4e+38 ECU_ADDRESS 0x3F2BF0 MATRIX_DIM 11 1 1 LAYOUT ROW_DIR /end MEASUREMENT
/begin MEASUREMENT LongCtrl_IN_Object_Type "" UBYTE PubIfDecisionPLAN_MDL_CM_uint8 0 0 0 255 ECU_ADDRESS 0x3F3550 MATRIX_DIM 11 1 1 LAYOUT ROW_DIR /end MEASUREMENT
/begin MEASUREMENT LongCtrl_IN_Object_VX "" FLOAT32_IEEE PubIfDecisionPLAN_MDL_CM_single 0 0 -3.4e+38 3.4e+38 ECU_ADDRESS 0x3F2D24 MATRIX_DIM 11 1 1 LAYOUT ROW_DIR /end MEASUREMENT
/begin MEASUREMENT LongCtrl_IN_Object_VY "" FLOAT32_IEEE PubIfDecisionPLAN_MDL_CM_single 0 0 -3.4e+38 3.4e+38 ECU_ADDRESS 0x3F2B68 MATRIX_DIM 11 1 1 LAYOUT ROW_DIR /end MEASUREMENT
/begin MEASUREMENT LongCtrl_IN_Object_Width "" FLOAT32_IEEE PubIfDecisionPLAN_MDL_CM_single 0 0 -3.4e+38 3.4e+38 ECU_ADDRESS 0x3F2C74 MATRIX_DIM 11 1 1 LAYOUT ROW_DIR /end MEASUREMENT
/begin MEASUREMENT LongCtrl_IN_P2_Exist "" UBYTE PubIfDecisionPLAN_MDL_CM_boolean 0 0 0 1 BIT_MASK 0x1 ECU_ADDRESS 0x3F35C0 /end MEASUREMENT
/begin MEASUREMENT LongCtrl_IN_P3_Exist "" UBYTE PubIfDecisionPLAN_MDL_CM_boolean 0 0 0 1 BIT_MASK 0x1 ECU_ADDRESS 0x3F35C1 /end MEASUREMENT
/begin MEASUREMENT LongCtrl_IN_R1bIsLineExis "" UBYTE PubIfDecisionPLAN_MDL_CM_uint8 0 0 0 255 ECU_ADDRESS 0x3F355C /end MEASUREMENT
/begin MEASUREMENT LongCtrl_IN_R1dC0V "" FLOAT32_IEEE PubIfDecisionPLAN_MDL_CM_single 0 0 -3.4e+38 3.4e+38 ECU_ADDRESS 0x3F2AE8 /end MEASUREMENT
/begin MEASUREMENT LongCtrl_IN_R1dC1V "" FLOAT32_IEEE PubIfDecisionPLAN_MDL_CM_single 0 0 -3.4e+38 3.4e+38 ECU_ADDRESS 0x3F2AEC /end MEASUREMENT
/begin MEASUREMENT LongCtrl_IN_R1dC2V "" FLOAT32_IEEE PubIfDecisionPLAN_MDL_CM_single 0 0 -3.4e+38 3.4e+38 ECU_ADDRESS 0x3F2AF0 /end MEASUREMENT
/begin MEASUREMENT LongCtrl_IN_R1dC3V "" FLOAT32_IEEE PubIfDecisionPLAN_MDL_CM_single 0 0 -3.4e+38 3.4e+38 ECU_ADDRESS 0x3F2B08 /end MEASUREMENT
/begin MEASUREMENT LongCtrl_IN_R1dDisFront "" FLOAT32_IEEE PubIfDecisionPLAN_MDL_CM_single 0 0 -3.4e+38 3.4e+38 ECU_ADDRESS 0x3F2BC0 /end MEASUREMENT
/begin MEASUREMENT LongCtrl_IN_RFM_UpdateCnt "" ULONG PubIfDecisionPLAN_MDL_CM_uint32 0 0 0 4294967295 ECU_ADDRESS 0x3F28DC /end MEASUREMENT
/begin MEASUREMENT LongCtrl_IN_SafeStopActive "" UBYTE PubIfDecisionPLAN_MDL_CM_boolean 0 0 0 1 BIT_MASK 0x1 ECU_ADDRESS 0x3F35BE /end MEASUREMENT
/begin MEASUREMENT LongCtrl_IN_TOS_UpdateCnt "" ULONG PubIfDecisionPLAN_MDL_CM_uint32 0 0 0 4294967295 ECU_ADDRESS 0x3F28D8 /end MEASUREMENT
/begin MEASUREMENT LongCtrl_IN_VlcInternalAccK1 "" FLOAT32_IEEE PubIfDecisionPLAN_MDL_CM_single 0 0 -3.4e+38 3.4e+38 ECU_ADDRESS 0x3F2D54 /end MEASUREMENT
/begin MEASUREMENT LongCtrl_IN_accelSubj "" FLOAT32_IEEE PubIfDecisionPLAN_MDL_CM_single 0 0 -3.4e+38 3.4e+38 ECU_ADDRESS 0x3F2D90 /end MEASUREMENT
/begin MEASUREMENT LongCtrl_IN_accelTargAbsP0 "" FLOAT32_IEEE PubIfDecisionPLAN_MDL_CM_single 0 0 -3.4e+38 3.4e+38 ECU_ADDRESS 0x3F2AD4 /end MEASUREMENT
/begin MEASUREMENT LongCtrl_IN_accelTargAbsP2 "" FLOAT32_IEEE PubIfDecisionPLAN_MDL_CM_single 0 0 -3.4e+38 3.4e+38 ECU_ADDRESS 0x3F2AD8 /end MEASUREMENT
/begin MEASUREMENT LongCtrl_IN_accelTargAbsP3 "" FLOAT32_IEEE PubIfDecisionPLAN_MDL_CM_single 0 0 -3.4e+38 3.4e+38 ECU_ADDRESS 0x3F2AF4 /end MEASUREMENT
/begin MEASUREMENT LongCtrl_IN_axvRoadSlopeMs2 "" FLOAT32_IEEE PubIfDecisionPLAN_MDL_CM_single 0 0 -3.4e+38 3.4e+38 ECU_ADDRESS 0x3F2D50 /end MEASUREMENT
/begin MEASUREMENT LongCtrl_IN_dangerLevel "" FLOAT32_IEEE PubIfDecisionPLAN_MDL_CM_single 0 0 -3.4e+38 3.4e+38 ECU_ADDRESS 0x3F2AF8 /end MEASUREMENT
/begin MEASUREMENT LongCtrl_IN_distRamp2Cur "" UWORD PubIfDecisionPLAN_MDL_CM_uint16 0 0 0 65535 ECU_ADDRESS 0x3F3520 /end MEASUREMENT
/begin MEASUREMENT LongCtrl_IN_distTargRel "" FLOAT32_IEEE PubIfDecisionPLAN_MDL_CM_single 0 0 -3.4e+38 3.4e+38 ECU_ADDRESS 0x3F2D94 /end MEASUREMENT
/begin MEASUREMENT LongCtrl_IN_distTargRelP2 "" FLOAT32_IEEE PubIfDecisionPLAN_MDL_CM_single 0 0 -3.4e+38 3.4e+38 ECU_ADDRESS 0x3F2D58 /end MEASUREMENT
/begin MEASUREMENT LongCtrl_IN_distTargRelP3 "" FLOAT32_IEEE PubIfDecisionPLAN_MDL_CM_single 0 0 -3.4e+38 3.4e+38 ECU_ADDRESS 0x3F2D5C /end MEASUREMENT
/begin MEASUREMENT LongCtrl_IN_i_road_curvature "" FLOAT32_IEEE PubIfDecisionPLAN_MDL_CM_single 0 0 -3.4e+38 3.4e+38 ECU_ADDRESS 0x3F2B10 /end MEASUREMENT
/begin MEASUREMENT LongCtrl_IN_i_road_curvature_distance_matrix "" FLOAT32_IEEE PubIfDecisionPLAN_MDL_CM_single 0 0 -3.4e+38 3.4e+38 ECU_ADDRESS 0x3F2B40 MATRIX_DIM 10 1 1 LAYOUT ROW_DIR /end MEASUREMENT
/begin MEASUREMENT LongCtrl_IN_i_road_curvature_far "" FLOAT32_IEEE PubIfDecisionPLAN_MDL_CM_single 0 0 -3.4e+38 3.4e+38 ECU_ADDRESS 0x3F2B14 /end MEASUREMENT
/begin MEASUREMENT LongCtrl_IN_i_road_curvature_far_distance "" UWORD PubIfDecisionPLAN_MDL_CM_uint16 0 0 0 65535 ECU_ADDRESS 0x3F3522 /end MEASUREMENT
/begin MEASUREMENT LongCtrl_IN_i_road_curvature_matrix_size "" UBYTE PubIfDecisionPLAN_MDL_CM_uint8 0 0 0 255 ECU_ADDRESS 0x3F3535 /end MEASUREMENT
/begin MEASUREMENT LongCtrl_IN_i_road_curvature_value_matrix "" FLOAT32_IEEE PubIfDecisionPLAN_MDL_CM_single 0 0 -3.4e+38 3.4e+38 ECU_ADDRESS 0x3F2B18 MATRIX_DIM 10 1 1 LAYOUT ROW_DIR /end MEASUREMENT
/begin MEASUREMENT LongCtrl_IN_kap "" FLOAT32_IEEE PubIfDecisionPLAN_MDL_CM_single 0 0 -3.4e+38 3.4e+38 ECU_ADDRESS 0x3F2B00 /end MEASUREMENT
/begin MEASUREMENT LongCtrl_IN_laneChangeEnable "" UBYTE PubIfDecisionPLAN_MDL_CM_boolean 0 0 0 1 BIT_MASK 0x1 ECU_ADDRESS 0x3F35BF /end MEASUREMENT
/begin MEASUREMENT LongCtrl_IN_targetExistP0 "" UBYTE PubIfDecisionPLAN_MDL_CM_boolean 0 0 0 1 BIT_MASK 0x1 ECU_ADDRESS 0x3F35BB /end MEASUREMENT
/begin MEASUREMENT LongCtrl_IN_timeGap "" UBYTE PubIfDecisionPLAN_MDL_CM_uint8 0 0 0 255 ECU_ADDRESS 0x3F352F /end MEASUREMENT
/begin MEASUREMENT LongCtrl_IN_vSetBelowMin "" UBYTE PubIfDecisionPLAN_MDL_CM_boolean 0 0 0 1 BIT_MASK 0x1 ECU_ADDRESS 0x3F35BC /end MEASUREMENT
/begin MEASUREMENT LongCtrl_IN_vehicleSpd "" FLOAT32_IEEE PubIfDecisionPLAN_MDL_CM_single 0 0 -3.4e+38 3.4e+38 ECU_ADDRESS 0x3F2AFC /end MEASUREMENT
/begin MEASUREMENT LongCtrl_IN_velOffRampLimit "" UBYTE PubIfDecisionPLAN_MDL_CM_uint8 0 0 0 255 ECU_ADDRESS 0x3F3534 /end MEASUREMENT
/begin MEASUREMENT LongCtrl_IN_velSubj "" FLOAT32_IEEE PubIfDecisionPLAN_MDL_CM_single 0 0 -3.4e+38 3.4e+38 ECU_ADDRESS 0x3F2D8C /end MEASUREMENT
/begin MEASUREMENT LongCtrl_IN_velTargRel "" FLOAT32_IEEE PubIfDecisionPLAN_MDL_CM_single 0 0 -3.4e+38 3.4e+38 ECU_ADDRESS 0x3F2AD0 /end MEASUREMENT
/begin MEASUREMENT LongCtrl_J "" FLOAT32_IEEE PubIfDecisionPLAN_MDL_CM_single 0 0 -3.4e+38 3.4e+38 ECU_ADDRESS 0x3F32F4 MATRIX_DIM 20 1 1 LAYOUT ROW_DIR /end MEASUREMENT
/begin MEASUREMENT LongCtrl_JadtA "" FLOAT32_IEEE PubIfDecisionPLAN_MDL_CM_single 0 0 -3.4e+38 3.4e+38 ECU_ADDRESS 0x3F3344 MATRIX_DIM 20 1 1 LAYOUT ROW_DIR /end MEASUREMENT
/begin MEASUREMENT LongCtrl_JadtADist "" FLOAT32_IEEE PubIfDecisionPLAN_MDL_CM_single 0 0 -3.4e+38 3.4e+38 ECU_ADDRESS 0x3F3394 MATRIX_DIM 20 1 1 LAYOUT ROW_DIR /end MEASUREMENT
/begin MEASUREMENT LongCtrl_LC_F_Alive "" FLOAT32_IEEE PubIfDecisionPLAN_MDL_CM_single 0 0 -3.4e+38 3.4e+38 ECU_ADDRESS 0x3F2FE4 /end MEASUREMENT
/begin MEASUREMENT LongCtrl_LC_F_Ax_AbsFilter "" FLOAT32_IEEE PubIfDecisionPLAN_MDL_CM_single 0 0 -3.4e+38 3.4e+38 ECU_ADDRESS 0x3F2E94 /end MEASUREMENT
/begin MEASUREMENT LongCtrl_LC_F_ID "" UBYTE PubIfDecisionPLAN_MDL_CM_uint8 0 0 0 255 ECU_ADDRESS 0x3F3565 /end MEASUREMENT
/begin MEASUREMENT LongCtrl_LC_F_Range "" FLOAT32_IEEE PubIfDecisionPLAN_MDL_CM_single 0 0 -3.4e+38 3.4e+38 ECU_ADDRESS 0x3F2FDC /end MEASUREMENT
/begin MEASUREMENT LongCtrl_LC_F_Vx "" FLOAT32_IEEE PubIfDecisionPLAN_MDL_CM_single 0 0 -3.4e+38 3.4e+38 ECU_ADDRESS 0x3F2FE0 /end MEASUREMENT
/begin MEASUREMENT LongCtrl_LC_LimitEnable "" UBYTE PubIfDecisionPLAN_MDL_CM_boolean 0 0 0 1 BIT_MASK 0x1 ECU_ADDRESS 0x3F35C7 /end MEASUREMENT
/begin MEASUREMENT LongCtrl_LC_OptimalSpaceSts "" UBYTE PubIfDecisionPLAN_MDL_CM_uint8 0 0 0 255 ECU_ADDRESS 0x3F3567 /end MEASUREMENT
/begin MEASUREMENT LongCtrl_LC_OptimalSpace_jb "" FLOAT32_IEEE PubIfDecisionPLAN_MDL_CM_single 0 0 -3.4e+38 3.4e+38 ECU_ADDRESS 0x3F3014 MATRIX_DIM 1 4 1 LAYOUT ROW_DIR /end MEASUREMENT
/begin MEASUREMENT LongCtrl_LC_OptimalSpace_jf "" FLOAT32_IEEE PubIfDecisionPLAN_MDL_CM_single 0 0 -3.4e+38 3.4e+38 ECU_ADDRESS 0x3F2FF4 MATRIX_DIM 1 4 1 LAYOUT ROW_DIR /end MEASUREMENT
/begin MEASUREMENT LongCtrl_LC_OptimalSpace_jz "" FLOAT32_IEEE PubIfDecisionPLAN_MDL_CM_single 0 0 -3.4e+38 3.4e+38 ECU_ADDRESS 0x3F3004 MATRIX_DIM 1 4 1 LAYOUT ROW_DIR /end MEASUREMENT
/begin MEASUREMENT LongCtrl_LC_R_Alive "" FLOAT32_IEEE PubIfDecisionPLAN_MDL_CM_single 0 0 -3.4e+38 3.4e+38 ECU_ADDRESS 0x3F2FF0 /end MEASUREMENT
/begin MEASUREMENT LongCtrl_LC_R_Ax_AbsFilter "" FLOAT32_IEEE PubIfDecisionPLAN_MDL_CM_single 0 0 -3.4e+38 3.4e+38 ECU_ADDRESS 0x3F2E98 /end MEASUREMENT
/begin MEASUREMENT LongCtrl_LC_R_ID "" UBYTE PubIfDecisionPLAN_MDL_CM_uint8 0 0 0 255 ECU_ADDRESS 0x3F3566 /end MEASUREMENT
/begin MEASUREMENT LongCtrl_LC_R_Range "" FLOAT32_IEEE PubIfDecisionPLAN_MDL_CM_single 0 0 -3.4e+38 3.4e+38 ECU_ADDRESS 0x3F2FE8 /end MEASUREMENT
/begin MEASUREMENT LongCtrl_LC_R_Vx "" FLOAT32_IEEE PubIfDecisionPLAN_MDL_CM_single 0 0 -3.4e+38 3.4e+38 ECU_ADDRESS 0x3F2FEC /end MEASUREMENT
/begin MEASUREMENT LongCtrl_LC_SafeDisEnable "" UBYTE PubIfDecisionPLAN_MDL_CM_boolean 0 0 0 1 BIT_MASK 0x1 ECU_ADDRESS 0x3F35CC /end MEASUREMENT
/begin MEASUREMENT LongCtrl_LC_SafeDisMin "" FLOAT32_IEEE PubIfDecisionPLAN_MDL_CM_single 0 0 -3.4e+38 3.4e+38 ECU_ADDRESS 0x3F349C /end MEASUREMENT
/begin MEASUREMENT LongCtrl_LC_ShiftInProgress "" UBYTE PubIfDecisionPLAN_MDL_CM_boolean 0 0 0 1 BIT_MASK 0x1 ECU_ADDRESS 0x3F35C6 /end MEASUREMENT
/begin MEASUREMENT LongCtrl_PI_NetEngTorqInc "" FLOAT32_IEEE PubIfControlLONC_MDL_CM_single 0 0 -3.4e+38 3.4e+38 ECU_ADDRESS 0x3F2468 /end MEASUREMENT
/begin MEASUREMENT LongCtrl_Sw2DC1 "" UBYTE PubIfControlLONC_MDL_CM_boolean 0 0 0 1 BIT_MASK 0x1 ECU_ADDRESS 0x3F24A5 /end MEASUREMENT
/begin MEASUREMENT LongCtrl_Sw2DC2 "" UBYTE PubIfControlLONC_MDL_CM_boolean 0 0 0 1 BIT_MASK 0x1 ECU_ADDRESS 0x3F24A9 /end MEASUREMENT
/begin MEASUREMENT LongCtrl_Sw2DC3 "" UBYTE PubIfControlLONC_MDL_CM_boolean 0 0 0 1 BIT_MASK 0x1 ECU_ADDRESS 0x3F24A6 /end MEASUREMENT
/begin MEASUREMENT LongCtrl_Sw2DC4 "" UBYTE PubIfControlLONC_MDL_CM_boolean 0 0 0 1 BIT_MASK 0x1 ECU_ADDRESS 0x3F24AA /end MEASUREMENT
/begin MEASUREMENT LongCtrl_Sw2DC5 "" UBYTE PubIfControlLONC_MDL_CM_boolean 0 0 0 1 BIT_MASK 0x1 ECU_ADDRESS 0x3F24A7 /end MEASUREMENT
/begin MEASUREMENT LongCtrl_Sw2DC6 "" UBYTE PubIfControlLONC_MDL_CM_boolean 0 0 0 1 BIT_MASK 0x1 ECU_ADDRESS 0x3F24A4 /end MEASUREMENT
/begin MEASUREMENT LongCtrl_Sw2DC7 "" UBYTE PubIfControlLONC_MDL_CM_boolean 0 0 0 1 BIT_MASK 0x1 ECU_ADDRESS 0x3F24A8 /end MEASUREMENT
/begin MEASUREMENT LongCtrl_Sw2EC1 "" UBYTE PubIfControlLONC_MDL_CM_boolean 0 0 0 1 BIT_MASK 0x1 ECU_ADDRESS 0x3F24AB /end MEASUREMENT
/begin MEASUREMENT LongCtrl_Sw2EC2 "" UBYTE PubIfControlLONC_MDL_CM_boolean 0 0 0 1 BIT_MASK 0x1 ECU_ADDRESS 0x3F24AD /end MEASUREMENT
/begin MEASUREMENT LongCtrl_Sw2EC3 "" UBYTE PubIfControlLONC_MDL_CM_boolean 0 0 0 1 BIT_MASK 0x1 ECU_ADDRESS 0x3F24AC /end MEASUREMENT
/begin MEASUREMENT LongCtrl_Sw2EC4 "" UBYTE PubIfControlLONC_MDL_CM_boolean 0 0 0 1 BIT_MASK 0x1 ECU_ADDRESS 0x3F24AF /end MEASUREMENT
/begin MEASUREMENT LongCtrl_Sw2EC5 "" UBYTE PubIfControlLONC_MDL_CM_boolean 0 0 0 1 BIT_MASK 0x1 ECU_ADDRESS 0x3F24AE /end MEASUREMENT
/begin MEASUREMENT LongCtrl_UpdateEnable_axvModeldiff "" UBYTE PubIfControlLONC_MDL_CM_boolean 0 0 0 1 BIT_MASK 0x1 ECU_ADDRESS 0x3F24A3 /end MEASUREMENT
/begin MEASUREMENT LongCtrl_VlcInternalAccK20 "" FLOAT32_IEEE PubIfDecisionPLAN_MDL_CM_single 0 0 -3.4e+38 3.4e+38 ECU_ADDRESS 0x3F2E8C /end MEASUREMENT
/begin MEASUREMENT LongCtrl_accelAL "" FLOAT32_IEEE PubIfDecisionPLAN_MDL_CM_single 0 0 -3.4e+38 3.4e+38 ECU_ADDRESS 0x3F3508 /end MEASUREMENT
/begin MEASUREMENT LongCtrl_accelArb "" FLOAT32_IEEE PubIfDecisionPLAN_MDL_CM_single 0 0 -3.4e+38 3.4e+38 ECU_ADDRESS 0x3F34F4 /end MEASUREMENT
/begin MEASUREMENT LongCtrl_accelFollow "" FLOAT32_IEEE PubIfDecisionPLAN_MDL_CM_single 0 0 -3.4e+38 3.4e+38 ECU_ADDRESS 0x3F2F54 /end MEASUREMENT
/begin MEASUREMENT LongCtrl_accelFollowAfterDecelToStop "" FLOAT32_IEEE PubIfDecisionPLAN_MDL_CM_single 0 0 -3.4e+38 3.4e+38 ECU_ADDRESS 0x3F34A0 /end MEASUREMENT
/begin MEASUREMENT LongCtrl_accelFollowAfterJerk "" FLOAT32_IEEE PubIfDecisionPLAN_MDL_CM_single 0 0 -3.4e+38 3.4e+38 ECU_ADDRESS 0x3F2F64 /end MEASUREMENT
/begin MEASUREMENT LongCtrl_accelFollowAfterLaneChangeSupress "" FLOAT32_IEEE PubIfDecisionPLAN_MDL_CM_single 0 0 -3.4e+38 3.4e+38 ECU_ADDRESS 0x3F2F50 /end MEASUREMENT
/begin MEASUREMENT LongCtrl_accelFollowFilt "" FLOAT32_IEEE PubIfDecisionPLAN_MDL_CM_single 0 0 -3.4e+38 3.4e+38 ECU_ADDRESS 0x3F2F58 /end MEASUREMENT
/begin MEASUREMENT LongCtrl_accelFollowSlopeAssist "" FLOAT32_IEEE PubIfDecisionPLAN_MDL_CM_single 0 0 -3.4e+38 3.4e+38 ECU_ADDRESS 0x3F3490 /end MEASUREMENT
/begin MEASUREMENT LongCtrl_accelORD "" FLOAT32_IEEE PubIfDecisionPLAN_MDL_CM_single 0 0 -3.4e+38 3.4e+38 ECU_ADDRESS 0x3F2E90 /end MEASUREMENT
/begin MEASUREMENT LongCtrl_accelSubjDesCorr "" FLOAT32_IEEE PubIfDecisionPLAN_MDL_CM_single 0 0 -3.4e+38 3.4e+38 ECU_ADDRESS 0x3F2EF8 /end MEASUREMENT
/begin MEASUREMENT LongCtrl_accelSubjDesRaw "" FLOAT32_IEEE PubIfDecisionPLAN_MDL_CM_single 0 0 -3.4e+38 3.4e+38 ECU_ADDRESS 0x3F2EF4 /end MEASUREMENT
/begin MEASUREMENT LongCtrl_accelSubjPlanOpt "" FLOAT32_IEEE PubIfDecisionPLAN_MDL_CM_single 0 0 -3.4e+38 3.4e+38 ECU_ADDRESS 0x3F3254 MATRIX_DIM 1 40 1 LAYOUT ROW_DIR /end MEASUREMENT
/begin MEASUREMENT LongCtrl_accelSupressionEnable "" UBYTE PubIfDecisionPLAN_MDL_CM_boolean 0 0 0 1 BIT_MASK 0x1 ECU_ADDRESS 0x3F35CE /end MEASUREMENT
/begin MEASUREMENT LongCtrl_accelTargAbsEnable "" FLOAT32_IEEE PubIfDecisionPLAN_MDL_CM_single 0 0 -3.4e+38 3.4e+38 ECU_ADDRESS 0x3F34A4 /end MEASUREMENT
/begin MEASUREMENT LongCtrl_accelTargAbsFilt_P0 "" FLOAT32_IEEE PubIfDecisionPLAN_MDL_CM_single 0 0 -3.4e+38 3.4e+38 ECU_ADDRESS 0x3F2E9C /end MEASUREMENT
/begin MEASUREMENT LongCtrl_asum "" FLOAT32_IEEE PubIfDecisionPLAN_MDL_CM_single 0 0 -3.4e+38 3.4e+38 ECU_ADDRESS 0x3F33E4 MATRIX_DIM 20 1 1 LAYOUT ROW_DIR /end MEASUREMENT
/begin MEASUREMENT LongCtrl_axvClosedLoopControl "" FLOAT32_IEEE PubIfControlLONC_MDL_CM_single 0 0 -3.4e+38 3.4e+38 ECU_ADDRESS 0x3F2478 /end MEASUREMENT
/begin MEASUREMENT LongCtrl_axvDiff "" FLOAT32_IEEE PubIfControlLONC_MDL_CM_single 0 0 -3.4e+38 3.4e+38 ECU_ADDRESS 0x3F2464 /end MEASUREMENT
/begin MEASUREMENT LongCtrl_axvModelDiff "" FLOAT32_IEEE PubIfControlLONC_MDL_CM_single 0 0 -3.4e+38 3.4e+38 ECU_ADDRESS 0x3F2470 /end MEASUREMENT
/begin MEASUREMENT LongCtrl_axvModelRef "" FLOAT32_IEEE PubIfControlLONC_MDL_CM_single 0 0 -3.4e+38 3.4e+38 ECU_ADDRESS 0x3F2498 /end MEASUREMENT
/begin MEASUREMENT LongCtrl_axvModelResidual "" FLOAT32_IEEE PubIfControlLONC_MDL_CM_single 0 0 -3.4e+38 3.4e+38 ECU_ADDRESS 0x3F2474 /end MEASUREMENT
/begin MEASUREMENT LongCtrl_axvTracActMean "" FLOAT32_IEEE PubIfControlLONC_MDL_CM_single 0 0 -3.4e+38 3.4e+38 ECU_ADDRESS 0x3F246C /end MEASUREMENT
/begin MEASUREMENT LongCtrl_axvTracMin "" FLOAT32_IEEE PubIfControlLONC_MDL_CM_single 0 0 -3.4e+38 3.4e+38 ECU_ADDRESS 0x3F2494 /end MEASUREMENT
/begin MEASUREMENT LongCtrl_coefCurvatureNoC3 "" FLOAT32_IEEE PubIfDecisionPLAN_MDL_CM_single 0 0 -3.4e+38 3.4e+38 ECU_ADDRESS 0x3F34BC /end MEASUREMENT
/begin MEASUREMENT LongCtrl_coefCurvatureWithC3 "" FLOAT32_IEEE PubIfDecisionPLAN_MDL_CM_single 0 0 -3.4e+38 3.4e+38 ECU_ADDRESS 0x3F34C0 /end MEASUREMENT
/begin MEASUREMENT LongCtrl_coefJEnlarge "" FLOAT32_IEEE PubIfDecisionPLAN_MDL_CM_single 0 0 -3.4e+38 3.4e+38 ECU_ADDRESS 0x3F3434 MATRIX_DIM 20 1 1 LAYOUT ROW_DIR /end MEASUREMENT
/begin MEASUREMENT LongCtrl_coefStandstillOverride "" FLOAT32_IEEE PubIfDecisionPLAN_MDL_CM_single 0 0 -3.4e+38 3.4e+38 ECU_ADDRESS 0x3F3494 /end MEASUREMENT
/begin MEASUREMENT LongCtrl_curvatureForCurveDecelRaw "" FLOAT32_IEEE PubIfDecisionPLAN_MDL_CM_single 0 0 -3.4e+38 3.4e+38 ECU_ADDRESS 0x3F34C4 /end MEASUREMENT
/begin MEASUREMENT LongCtrl_curvatureNoC3 "" FLOAT32_IEEE PubIfDecisionPLAN_MDL_CM_single 0 0 -3.4e+38 3.4e+38 ECU_ADDRESS 0x3F34B4 /end MEASUREMENT
/begin MEASUREMENT LongCtrl_curvatureWithC3 "" FLOAT32_IEEE PubIfDecisionPLAN_MDL_CM_single 0 0 -3.4e+38 3.4e+38 ECU_ADDRESS 0x3F34B8 /end MEASUREMENT
/begin MEASUREMENT LongCtrl_distAccelSupressionEnter "" FLOAT32_IEEE PubIfDecisionPLAN_MDL_CM_single 0 0 -3.4e+38 3.4e+38 ECU_ADDRESS 0x3F34AC /end MEASUREMENT
/begin MEASUREMENT LongCtrl_distAccelSupressionExit "" FLOAT32_IEEE PubIfDecisionPLAN_MDL_CM_single 0 0 -3.4e+38 3.4e+38 ECU_ADDRESS 0x3F34B0 /end MEASUREMENT
/begin MEASUREMENT LongCtrl_distDesCur "" FLOAT32_IEEE PubIfDecisionPLAN_MDL_CM_single 0 0 -3.4e+38 3.4e+38 ECU_ADDRESS 0x3F2EF0 /end MEASUREMENT
/begin MEASUREMENT LongCtrl_distDesPlanCorr "" FLOAT32_IEEE PubIfDecisionPLAN_MDL_CM_single 0 0 -3.4e+38 3.4e+38 ECU_ADDRESS 0x3F2EA0 MATRIX_DIM 20 1 1 LAYOUT ROW_DIR /end MEASUREMENT
/begin MEASUREMENT LongCtrl_distRelDesDistRelPlanNumMin "" FLOAT32_IEEE PubIfDecisionPLAN_MDL_CM_single 0 0 -3.4e+38 3.4e+38 ECU_ADDRESS 0x3F3488 /end MEASUREMENT
/begin MEASUREMENT LongCtrl_distRelPlanMin "" FLOAT32_IEEE PubIfDecisionPLAN_MDL_CM_single 0 0 -3.4e+38 3.4e+38 ECU_ADDRESS 0x3F3484 /end MEASUREMENT
/begin MEASUREMENT LongCtrl_distRelPlanOpt "" FLOAT32_IEEE PubIfDecisionPLAN_MDL_CM_single 0 0 -3.4e+38 3.4e+38 ECU_ADDRESS 0x3F3074 MATRIX_DIM 1 40 1 LAYOUT ROW_DIR /end MEASUREMENT
/begin MEASUREMENT LongCtrl_followAccel_Plau "" FLOAT32_IEEE PubIfDecisionPLAN_MDL_CM_single_m_s_2 0 0 -3.4e+38 3.4e+38 ECU_ADDRESS 0x3F3498 /end MEASUREMENT
/begin MEASUREMENT LongCtrl_lowerBandAL "" FLOAT32_IEEE PubIfDecisionPLAN_MDL_CM_single 0 0 -3.4e+38 3.4e+38 ECU_ADDRESS 0x3F3510 /end MEASUREMENT
/begin MEASUREMENT LongCtrl_lowerBandArb "" FLOAT32_IEEE PubIfDecisionPLAN_MDL_CM_single 0 0 -3.4e+38 3.4e+38 ECU_ADDRESS 0x3F34F8 /end MEASUREMENT
/begin MEASUREMENT LongCtrl_lowerBandCC "" FLOAT32_IEEE PubIfDecisionPLAN_MDL_CM_single 0 0 -3.4e+38 3.4e+38 ECU_ADDRESS 0x3F34EC /end MEASUREMENT
/begin MEASUREMENT LongCtrl_lowerBandFollow "" FLOAT32_IEEE PubIfDecisionPLAN_MDL_CM_single 0 0 -3.4e+38 3.4e+38 ECU_ADDRESS 0x3F2F6C /end MEASUREMENT
/begin MEASUREMENT LongCtrl_lowerJerkAL "" FLOAT32_IEEE PubIfDecisionPLAN_MDL_CM_single 0 0 -3.4e+38 3.4e+38 ECU_ADDRESS 0x3F3518 /end MEASUREMENT
/begin MEASUREMENT LongCtrl_lowerJerkArb "" FLOAT32_IEEE PubIfDecisionPLAN_MDL_CM_single 0 0 -3.4e+38 3.4e+38 ECU_ADDRESS 0x3F34FC /end MEASUREMENT
/begin MEASUREMENT LongCtrl_lowerJerkFollow "" FLOAT32_IEEE PubIfDecisionPLAN_MDL_CM_single 0 0 -3.4e+38 3.4e+38 ECU_ADDRESS 0x3F2F60 /end MEASUREMENT
/begin MEASUREMENT LongCtrl_num "" FLOAT32_IEEE PubIfDecisionPLAN_MDL_CM_single 0 0 -3.4e+38 3.4e+38 ECU_ADDRESS 0x3F348C /end MEASUREMENT
/begin MEASUREMENT LongCtrl_quickDecel "" UBYTE PubIfDecisionPLAN_MDL_CM_boolean 0 0 0 1 BIT_MASK 0x1 ECU_ADDRESS 0x3F35C4 /end MEASUREMENT
/begin MEASUREMENT LongCtrl_slopeStartupAssist "" UBYTE PubIfDecisionPLAN_MDL_CM_boolean 0 0 0 1 BIT_MASK 0x1 ECU_ADDRESS 0x3F35C5 /end MEASUREMENT
/begin MEASUREMENT LongCtrl_standstillOverrideCondition "" UBYTE PubIfDecisionPLAN_MDL_CM_boolean 0 0 0 1 BIT_MASK 0x1 ECU_ADDRESS 0x3F35CB /end MEASUREMENT
/begin MEASUREMENT LongCtrl_tStartDecel "" FLOAT32_IEEE PubIfDecisionPLAN_MDL_CM_single 0 0 -3.4e+38 3.4e+38 ECU_ADDRESS 0x3F34A8 /end MEASUREMENT
/begin MEASUREMENT LongCtrl_upperBandAL "" FLOAT32_IEEE PubIfDecisionPLAN_MDL_CM_single 0 0 -3.4e+38 3.4e+38 ECU_ADDRESS 0x3F350C /end MEASUREMENT
/begin MEASUREMENT LongCtrl_upperBandArb "" FLOAT32_IEEE PubIfDecisionPLAN_MDL_CM_single 0 0 -3.4e+38 3.4e+38 ECU_ADDRESS 0x3F3500 /end MEASUREMENT
/begin MEASUREMENT LongCtrl_upperBandCC "" FLOAT32_IEEE PubIfDecisionPLAN_MDL_CM_single 0 0 -3.4e+38 3.4e+38 ECU_ADDRESS 0x3F34F0 /end MEASUREMENT
/begin MEASUREMENT LongCtrl_upperBandFollow "" FLOAT32_IEEE PubIfDecisionPLAN_MDL_CM_single 0 0 -3.4e+38 3.4e+38 ECU_ADDRESS 0x3F2F68 /end MEASUREMENT
/begin MEASUREMENT LongCtrl_upperJerkAL "" FLOAT32_IEEE PubIfDecisionPLAN_MDL_CM_single 0 0 -3.4e+38 3.4e+38 ECU_ADDRESS 0x3F3514 /end MEASUREMENT
/begin MEASUREMENT LongCtrl_upperJerkArb "" FLOAT32_IEEE PubIfDecisionPLAN_MDL_CM_single 0 0 -3.4e+38 3.4e+38 ECU_ADDRESS 0x3F3504 /end MEASUREMENT
/begin MEASUREMENT LongCtrl_upperJerkFollow "" FLOAT32_IEEE PubIfDecisionPLAN_MDL_CM_single 0 0 -3.4e+38 3.4e+38 ECU_ADDRESS 0x3F2F5C /end MEASUREMENT
/begin MEASUREMENT LongCtrl_velPlanRelOpt "" FLOAT32_IEEE PubIfDecisionPLAN_MDL_CM_single 0 0 -3.4e+38 3.4e+38 ECU_ADDRESS 0x3F3114 MATRIX_DIM 1 40 1 LAYOUT ROW_DIR /end MEASUREMENT
/begin MEASUREMENT LongCtrl_velSubjPlanOpt "" FLOAT32_IEEE PubIfDecisionPLAN_MDL_CM_single 0 0 -3.4e+38 3.4e+38 ECU_ADDRESS 0x3F31B4 MATRIX_DIM 1 40 1 LAYOUT ROW_DIR /end MEASUREMENT
/begin MEASUREMENT LongCtrl_velTargAbsPlanTerminate "" FLOAT32_IEEE PubIfDecisionPLAN_MDL_CM_single 0 0 -3.4e+38 3.4e+38 ECU_ADDRESS 0x3F3024 MATRIX_DIM 20 1 1 LAYOUT ROW_DIR /end MEASUREMENT
/begin CHARACTERISTIC P_Global_IEnvironment_RefPX_Front_Bumper "摄像头到前保险杠的X向距离偏移量" VALUE 0x3B4CE4 Scalar_FLOAT32_IEEE 0 PubIfStateVSM_MDL_CM_single_m -3.4e+38 3.4e+38 /end CHARACTERISTIC
/begin CHARACTERISTIC P_Global_Weight_N "车重" VALUE 0x3B4D00 Scalar_FLOAT32_IEEE 0 PubIfControlLONC_MDL_CM_single_N -3.4e+38 3.4e+38 /end CHARACTERISTIC
/begin CHARACTERISTIC P_HMI_ObjectTypeFilter "" VALUE 0x3B4D10 Scalar_FLOAT32_IEEE 0 PubIfChassisHMI_MDL_CM_single -3.4e+38 3.4e+38 /end CHARACTERISTIC
/begin AXIS_PTS P_LCS_A0_Dis_BP "" 0x3B4D14 LCS_EqA0 Lookup2D_X_FLOAT32_IEEE 0 PubIfControlLATC_MDL_CM_single 19 -3.4e+38 3.4e+38 DEPOSIT ABSOLUTE /end AXIS_PTS
/begin AXIS_PTS P_LCS_AngleErrorReversTorq_LC_TarAngleBp "" 0x3B4D74 NO_INPUT_QUANTITY Lookup1D_X_FLOAT32_IEEE 0 PubIfControlLATC_MDL_CM_single 8 -3.4e+38 3.4e+38 DEPOSIT ABSOLUTE /end AXIS_PTS
/begin CHARACTERISTIC P_LCS_AngleErrorReversTorq_LC_TarAngleFac "" CURVE 0x3B4D94 Lookup1D_FLOAT32_IEEE 0 PubIfControlLATC_MDL_CM_single -3.4e+38 3.4e+38
 /begin AXIS_DESCR COM_AXIS NO_INPUT_QUANTITY PubIfControlLATC_MDL_CM_single 8 -3.4e+38 3.4e+38 DEPOSIT ABSOLUTE AXIS_PTS_REF P_LCS_AngleErrorReversTorq_LC_TarAngleBp /end AXIS_DESCR
/end CHARACTERISTIC
/begin AXIS_PTS P_LCS_AngleErrorReversTorq_LC_VehSpdBp "" 0x3B4DB4 LCS_DisplaySpd_kph Lookup1D_X_FLOAT32_IEEE 0 PubIfControlLATC_MDL_CM_single 16 -3.4e+38 3.4e+38 DEPOSIT ABSOLUTE /end AXIS_PTS
/begin CHARACTERISTIC P_LCS_AngleErrorReversTorq_LC_VehSpdVal "" CURVE 0x3B4DF4 Lookup1D_FLOAT32_IEEE 0 PubIfControlLATC_MDL_CM_single -3.4e+38 3.4e+38
 /begin AXIS_DESCR COM_AXIS LCS_DisplaySpd_kph PubIfControlLATC_MDL_CM_single 16 -3.4e+38 3.4e+38 DEPOSIT ABSOLUTE AXIS_PTS_REF P_LCS_AngleErrorReversTorq_LC_VehSpdBp /end AXIS_DESCR
/end CHARACTERISTIC
/begin CHARACTERISTIC P_LCS_AngleFilterTime "" VALUE 0x3B4E34 Scalar_FLOAT32_IEEE 0 PubIfControlLATC_MDL_CM_single -3.4e+38 3.4e+38 /end CHARACTERISTIC
/begin CHARACTERISTIC P_LCS_AngleSlope_ELK "" MAP 0x3B4E38 Lookup2D_FLOAT32_IEEE 0 PubIfControlLATC_MDL_CM_single -3.4e+38 3.4e+38
 /begin AXIS_DESCR COM_AXIS LCS_EqA0 PubIfControlLATC_MDL_CM_single 19 -3.4e+38 3.4e+38 DEPOSIT ABSOLUTE AXIS_PTS_REF P_LCS_A0_Dis_BP /end AXIS_DESCR
 /begin AXIS_DESCR COM_AXIS LCS_DisplaySpd_kph PubIfControlLATC_MDL_CM_single 12 -3.4e+38 3.4e+38 DEPOSIT ABSOLUTE AXIS_PTS_REF P_LCS_AngleSlope_Spd_BP /end AXIS_DESCR
/end CHARACTERISTIC
/begin CHARACTERISTIC P_LCS_AngleSlope_ESS "" MAP 0x3B51C8 Lookup2D_FLOAT32_IEEE 0 PubIfControlLATC_MDL_CM_single -3.4e+38 3.4e+38
 /begin AXIS_DESCR COM_AXIS LCS_EqA0 PubIfControlLATC_MDL_CM_single 19 -3.4e+38 3.4e+38 DEPOSIT ABSOLUTE AXIS_PTS_REF P_LCS_A0_Dis_BP /end AXIS_DESCR
 /begin AXIS_DESCR COM_AXIS LCS_DisplaySpd_kph PubIfControlLATC_MDL_CM_single 12 -3.4e+38 3.4e+38 DEPOSIT ABSOLUTE AXIS_PTS_REF P_LCS_AngleSlope_Spd_BP /end AXIS_DESCR
/end CHARACTERISTIC
/begin CHARACTERISTIC P_LCS_AngleSlope_LCK "" MAP 0x3B5558 Lookup2D_FLOAT32_IEEE 0 PubIfControlLATC_MDL_CM_single -3.4e+38 3.4e+38
 /begin AXIS_DESCR COM_AXIS LCS_EqA0 PubIfControlLATC_MDL_CM_single 19 -3.4e+38 3.4e+38 DEPOSIT ABSOLUTE AXIS_PTS_REF P_LCS_A0_Dis_BP /end AXIS_DESCR
 /begin AXIS_DESCR COM_AXIS LCS_DisplaySpd_kph PubIfControlLATC_MDL_CM_single 12 -3.4e+38 3.4e+38 DEPOSIT ABSOLUTE AXIS_PTS_REF P_LCS_AngleSlope_Spd_BP /end AXIS_DESCR
/end CHARACTERISTIC
/begin CHARACTERISTIC P_LCS_AngleSlope_LCKIE "" MAP 0x3B58E8 Lookup2D_FLOAT32_IEEE 0 PubIfControlLATC_MDL_CM_single -3.4e+38 3.4e+38
 /begin AXIS_DESCR COM_AXIS LCS_EqA0 PubIfControlLATC_MDL_CM_single 19 -3.4e+38 3.4e+38 DEPOSIT ABSOLUTE AXIS_PTS_REF P_LCS_A0_Dis_BP /end AXIS_DESCR
 /begin AXIS_DESCR COM_AXIS LCS_DisplaySpd_kph PubIfControlLATC_MDL_CM_single 12 -3.4e+38 3.4e+38 DEPOSIT ABSOLUTE AXIS_PTS_REF P_LCS_AngleSlope_Spd_BP /end AXIS_DESCR
/end CHARACTERISTIC
/begin CHARACTERISTIC P_LCS_AngleSlope_LC_Cancel "" MAP 0x3B5C78 Lookup2D_FLOAT32_IEEE 0 PubIfControlLATC_MDL_CM_single -3.4e+38 3.4e+38
 /begin AXIS_DESCR COM_AXIS LCS_EqA0 PubIfControlLATC_MDL_CM_single 19 -3.4e+38 3.4e+38 DEPOSIT ABSOLUTE AXIS_PTS_REF P_LCS_A0_Dis_BP /end AXIS_DESCR
 /begin AXIS_DESCR COM_AXIS LCS_DisplaySpd_kph PubIfControlLATC_MDL_CM_single 12 -3.4e+38 3.4e+38 DEPOSIT ABSOLUTE AXIS_PTS_REF P_LCS_AngleSlope_Spd_BP /end AXIS_DESCR
/end CHARACTERISTIC
/begin CHARACTERISTIC P_LCS_AngleSlope_LC_Eco "" MAP 0x3B6008 Lookup2D_FLOAT32_IEEE 0 PubIfControlLATC_MDL_CM_single -3.4e+38 3.4e+38
 /begin AXIS_DESCR COM_AXIS LCS_EqA0 PubIfControlLATC_MDL_CM_single 19 -3.4e+38 3.4e+38 DEPOSIT ABSOLUTE AXIS_PTS_REF P_LCS_A0_Dis_BP /end AXIS_DESCR
 /begin AXIS_DESCR COM_AXIS LCS_DisplaySpd_kph PubIfControlLATC_MDL_CM_single 12 -3.4e+38 3.4e+38 DEPOSIT ABSOLUTE AXIS_PTS_REF P_LCS_AngleSlope_Spd_BP /end AXIS_DESCR
/end CHARACTERISTIC
/begin CHARACTERISTIC P_LCS_AngleSlope_LC_Nomal "" MAP 0x3B6398 Lookup2D_FLOAT32_IEEE 0 PubIfControlLATC_MDL_CM_single -3.4e+38 3.4e+38
 /begin AXIS_DESCR COM_AXIS LCS_EqA0 PubIfControlLATC_MDL_CM_single 19 -3.4e+38 3.4e+38 DEPOSIT ABSOLUTE AXIS_PTS_REF P_LCS_A0_Dis_BP /end AXIS_DESCR
 /begin AXIS_DESCR COM_AXIS LCS_DisplaySpd_kph PubIfControlLATC_MDL_CM_single 12 -3.4e+38 3.4e+38 DEPOSIT ABSOLUTE AXIS_PTS_REF P_LCS_AngleSlope_Spd_BP /end AXIS_DESCR
/end CHARACTERISTIC
/begin CHARACTERISTIC P_LCS_AngleSlope_LC_Sport "" MAP 0x3B6728 Lookup2D_FLOAT32_IEEE 0 PubIfControlLATC_MDL_CM_single -3.4e+38 3.4e+38
 /begin AXIS_DESCR COM_AXIS LCS_EqA0 PubIfControlLATC_MDL_CM_single 19 -3.4e+38 3.4e+38 DEPOSIT ABSOLUTE AXIS_PTS_REF P_LCS_A0_Dis_BP /end AXIS_DESCR
 /begin AXIS_DESCR COM_AXIS LCS_DisplaySpd_kph PubIfControlLATC_MDL_CM_single 12 -3.4e+38 3.4e+38 DEPOSIT ABSOLUTE AXIS_PTS_REF P_LCS_AngleSlope_Spd_BP /end AXIS_DESCR
/end CHARACTERISTIC
/begin CHARACTERISTIC P_LCS_AngleSlope_LKA "" MAP 0x3B6AB8 Lookup2D_FLOAT32_IEEE 0 PubIfControlLATC_MDL_CM_single -3.4e+38 3.4e+38
 /begin AXIS_DESCR COM_AXIS LCS_EqA0 PubIfControlLATC_MDL_CM_single 19 -3.4e+38 3.4e+38 DEPOSIT ABSOLUTE AXIS_PTS_REF P_LCS_A0_Dis_BP /end AXIS_DESCR
 /begin AXIS_DESCR COM_AXIS LCS_DisplaySpd_kph PubIfControlLATC_MDL_CM_single 12 -3.4e+38 3.4e+38 DEPOSIT ABSOLUTE AXIS_PTS_REF P_LCS_AngleSlope_Spd_BP /end AXIS_DESCR
/end CHARACTERISTIC
/begin AXIS_PTS P_LCS_AngleSlope_Spd_BP "" 0x3B6E48 LCS_DisplaySpd_kph Lookup2D_X_FLOAT32_IEEE 0 PubIfControlLATC_MDL_CM_single 12 -3.4e+38 3.4e+38 DEPOSIT ABSOLUTE /end AXIS_PTS
/begin AXIS_PTS P_LCS_DeltaEps_SpdBp "" 0x3B6E7C LCS_DisplaySpd_kph Lookup1D_X_FLOAT32_IEEE 0 PubIfControlLATC_MDL_CM_single 16 -3.4e+38 3.4e+38 DEPOSIT ABSOLUTE /end AXIS_PTS
/begin CHARACTERISTIC P_LCS_DeltaEps_TimeVal "" CURVE 0x3B6EBC Lookup1D_FLOAT32_IEEE 0 PubIfControlLATC_MDL_CM_single -3.4e+38 3.4e+38
 /begin AXIS_DESCR COM_AXIS LCS_DisplaySpd_kph PubIfControlLATC_MDL_CM_single 16 -3.4e+38 3.4e+38 DEPOSIT ABSOLUTE AXIS_PTS_REF P_LCS_DeltaEps_SpdBp /end AXIS_DESCR
/end CHARACTERISTIC
/begin CHARACTERISTIC P_LCS_FF_EnableSpd "" VALUE 0x3B6F3C Scalar_FLOAT32_IEEE 0 PubIfControlLATC_MDL_CM_single -3.4e+38 3.4e+38 /end CHARACTERISTIC
/begin CHARACTERISTIC P_LCS_LCcancel_detaA0 "" VALUE 0x3B6F80 Scalar_FLOAT32_IEEE 0 PubIfControlLATC_MDL_CM_single -3.4e+38 3.4e+38 /end CHARACTERISTIC
/begin CHARACTERISTIC P_LCS_StateHold_time "" VALUE 0x3B9F32 Scalar_UWORD 0 PubIfControlLATC_MDL_CM_uint16 0 65535 /end CHARACTERISTIC
/begin AXIS_PTS P_LongCtrl_ALCAccLimitByDangerXAxis "" 0x3B8DCC LongCtrl_ALC_dangerLevel Lookup1D_X_FLOAT32_IEEE 0 PubIfDecisionPLAN_MDL_CM_single 5 0 1 DEPOSIT ABSOLUTE /end AXIS_PTS
/begin CHARACTERISTIC P_LongCtrl_ALCAccLimitByDangerYAxis "" CURVE 0x3B8DE0 Lookup1D_FLOAT32_IEEE 0 PubIfDecisionPLAN_MDL_CM_single_m_s_2 -10 10
 /begin AXIS_DESCR COM_AXIS LongCtrl_ALC_dangerLevel PubIfDecisionPLAN_MDL_CM_single 5 0 1 DEPOSIT ABSOLUTE AXIS_PTS_REF P_LongCtrl_ALCAccLimitByDangerXAxis /end AXIS_DESCR
/end CHARACTERISTIC
/begin CHARACTERISTIC P_LongCtrl_ALaLowerChar "" VAL_BLK 0x3B8DF4 Scalar_FLOAT32_IEEE 0 PubIfDecisionPLAN_MDL_CM_single_m_s_2 -3.4e+38 3.4e+38 MATRIX_DIM 1 4 1 /end CHARACTERISTIC
/begin CHARACTERISTIC P_LongCtrl_ALaUpperCharEco "" VAL_BLK 0x3B8E04 Scalar_FLOAT32_IEEE 0 PubIfDecisionPLAN_MDL_CM_single_m_s_2 0 3 MATRIX_DIM 1 15 1 /end CHARACTERISTIC
/begin CHARACTERISTIC P_LongCtrl_ALaUpperCharNormal "" VAL_BLK 0x3B8E40 Scalar_FLOAT32_IEEE 0 PubIfDecisionPLAN_MDL_CM_single_m_s_2 0 3 MATRIX_DIM 1 15 1 /end CHARACTERISTIC
/begin CHARACTERISTIC P_LongCtrl_ALaUpperCharSport "" VAL_BLK 0x3B8E7C Scalar_FLOAT32_IEEE 0 PubIfDecisionPLAN_MDL_CM_single_m_s_2 0 3 MATRIX_DIM 1 15 1 /end CHARACTERISTIC
/begin CHARACTERISTIC P_LongCtrl_ALvAcceleLowerChar "" VAL_BLK 0x3B8EB8 Scalar_FLOAT32_IEEE 0 PubIfDecisionPLAN_MDL_CM_single_m_s 0 70 MATRIX_DIM 1 4 1 /end CHARACTERISTIC
/begin CHARACTERISTIC P_LongCtrl_ALvAcceleUpperCharEco "" VAL_BLK 0x3B8EC8 Scalar_FLOAT32_IEEE 0 PubIfDecisionPLAN_MDL_CM_single_m_s 0 70 MATRIX_DIM 1 15 1 /end CHARACTERISTIC
/begin CHARACTERISTIC P_LongCtrl_ALvAcceleUpperCharNormal "" VAL_BLK 0x3B8F04 Scalar_FLOAT32_IEEE 0 PubIfDecisionPLAN_MDL_CM_single_m_s 0 70 MATRIX_DIM 1 15 1 /end CHARACTERISTIC
/begin CHARACTERISTIC P_LongCtrl_ALvAcceleUpperCharSport "" VAL_BLK 0x3B8F40 Scalar_FLOAT32_IEEE 0 PubIfDecisionPLAN_MDL_CM_single_m_s 0 70 MATRIX_DIM 1 15 1 /end CHARACTERISTIC
/begin CHARACTERISTIC P_LongCtrl_CCLCIncSetSpdAdd "" VALUE 0x3B8F7C Scalar_FLOAT32_IEEE 0 PubIfDecisionPLAN_MDL_CM_single_km_h -3.4e+38 3.4e+38 /end CHARACTERISTIC
/begin CHARACTERISTIC P_LongCtrl_CCLCIncSetSpdAddCntStartValue "" VALUE 0x3B8F80 Scalar_FLOAT32_IEEE 0 PubIfDecisionPLAN_MDL_CM_single 0 1000 /end CHARACTERISTIC
/begin AXIS_PTS P_LongCtrl_FollowAccelAddSlopeAssistXAxis "" 0x3B8FF0 NO_INPUT_QUANTITY Lookup1D_X_FLOAT32_IEEE 0 PubIfDecisionPLAN_MDL_CM_single_m_s_2 2 0 4 DEPOSIT ABSOLUTE /end AXIS_PTS
/begin CHARACTERISTIC P_LongCtrl_FollowAccelAddSlopeAssistYAxis "" CURVE 0x3B8FF8 Lookup1D_FLOAT32_IEEE 0 PubIfDecisionPLAN_MDL_CM_single_m_s_2 0 1
 /begin AXIS_DESCR COM_AXIS NO_INPUT_QUANTITY PubIfDecisionPLAN_MDL_CM_single_m_s_2 2 0 4 DEPOSIT ABSOLUTE AXIS_PTS_REF P_LongCtrl_FollowAccelAddSlopeAssistXAxis /end AXIS_DESCR
/end CHARACTERISTIC
/begin CHARACTERISTIC P_LongCtrl_FollowAccelSlopeAssistStep "" VALUE 0x3B9000 Scalar_FLOAT32_IEEE 0 PubIfDecisionPLAN_MDL_CM_single_m_s_2 0 1 /end CHARACTERISTIC
/begin CHARACTERISTIC P_LongCtrl_FollowDecelJerkDiffTTC2GapCorrEnableTTCThres "" VALUE 0x3B9004 Scalar_FLOAT32_IEEE 0 PubIfDecisionPLAN_MDL_CM_single_s 2 15 /end CHARACTERISTIC
/begin CHARACTERISTIC P_LongCtrl_FollowDecelJerkDiffTTC2GapCorrEnableVelSubjThres "" VALUE 0x3B9008 Scalar_FLOAT32_IEEE 0 PubIfDecisionPLAN_MDL_CM_single_m_s 1 20 /end CHARACTERISTIC
/begin AXIS_PTS P_LongCtrl_FollowDecelJerkDiffTTC2GapCorrXAxis "" 0x3B900C NO_INPUT_QUANTITY Lookup1D_X_FLOAT32_IEEE 0 PubIfDecisionPLAN_MDL_CM_single_s 2 2 25 DEPOSIT ABSOLUTE /end AXIS_PTS
/begin CHARACTERISTIC P_LongCtrl_FollowDecelJerkDiffTTC2GapCorrYAxis "" CURVE 0x3B9014 Lookup1D_FLOAT32_IEEE 0 PubIfDecisionPLAN_MDL_CM_single 0.01 1
 /begin AXIS_DESCR COM_AXIS NO_INPUT_QUANTITY PubIfDecisionPLAN_MDL_CM_single_s 2 2 25 DEPOSIT ABSOLUTE AXIS_PTS_REF P_LongCtrl_FollowDecelJerkDiffTTC2GapCorrXAxis /end AXIS_DESCR
/end CHARACTERISTIC
/begin AXIS_PTS P_LongCtrl_FollowDecelJerkForceSlopeXAxis "" 0x3B901C NO_INPUT_QUANTITY Lookup1D_X_FLOAT32_IEEE 0 PubIfDecisionPLAN_MDL_CM_single_m_s_2 2 0 4 DEPOSIT ABSOLUTE /end AXIS_PTS
/begin CHARACTERISTIC P_LongCtrl_FollowDecelJerkForceSlopeYAxis "" CURVE 0x3B9024 Lookup1D_FLOAT32_IEEE 0 PubIfDecisionPLAN_MDL_CM_single_m_s_3 -50 0
 /begin AXIS_DESCR COM_AXIS NO_INPUT_QUANTITY PubIfDecisionPLAN_MDL_CM_single_m_s_2 2 0 4 DEPOSIT ABSOLUTE AXIS_PTS_REF P_LongCtrl_FollowDecelJerkForceSlopeXAxis /end AXIS_DESCR
/end CHARACTERISTIC
/begin CHARACTERISTIC P_LongCtrl_FollowDistDesCompensionVelRelThresMax "" VALUE 0x3B902C Scalar_FLOAT32_IEEE 0 PubIfDecisionPLAN_MDL_CM_single_km_h 0 20 /end CHARACTERISTIC
/begin CHARACTERISTIC P_LongCtrl_FollowDistDesCompensionVelRelThresMin "" VALUE 0x3CB034 Scalar_FLOAT32_IEEE 0 PubIfDecisionPLAN_MDL_CM_single_km_h -5 2 /end CHARACTERISTIC
/begin CHARACTERISTIC P_LongCtrl_FollowDistDiff2VelSubjThresEnableStop "" VAL_BLK 0x3B9030 Scalar_FLOAT32_IEEE 0 PubIfDecisionPLAN_MDL_CM_single_m -5 5 MATRIX_DIM 1 2 1 /end CHARACTERISTIC
/begin CHARACTERISTIC P_LongCtrl_FollowQuickAccelTargAbsEnableThres "" VALUE 0x3B9070 Scalar_FLOAT32_IEEE 0 PubIfDecisionPLAN_MDL_CM_single_m_s_2 -3 0 /end CHARACTERISTIC
/begin CHARACTERISTIC P_LongCtrl_FollowQuickDecelAccelDesMax "" VALUE 0x3B9074 Scalar_FLOAT32_IEEE 0 PubIfDecisionPLAN_MDL_CM_single_m_s_2 -3 0 /end CHARACTERISTIC
/begin CHARACTERISTIC P_LongCtrl_FollowQuickDecelDiffDistRel2DesThres "" VALUE 0x3B9078 Scalar_FLOAT32_IEEE 0 PubIfDecisionPLAN_MDL_CM_single_m -20 5 /end CHARACTERISTIC
/begin CHARACTERISTIC P_LongCtrl_FollowQuickDecelVelSubjThres "" VALUE 0x3B907C Scalar_FLOAT32_IEEE 0 PubIfDecisionPLAN_MDL_CM_single_m_s 0 100 /end CHARACTERISTIC
/begin CHARACTERISTIC P_LongCtrl_FollowQuickDecelVelTargRelThres "" VALUE 0x3B9080 Scalar_FLOAT32_IEEE 0 PubIfDecisionPLAN_MDL_CM_single_m_s -10 0 /end CHARACTERISTIC
/begin CHARACTERISTIC P_LongCtrl_FollowRateJConditionStep "" VALUE 0x3B9084 Scalar_FLOAT32_IEEE 0 PubIfDecisionPLAN_MDL_CM_single 0 1 /end CHARACTERISTIC
/begin CHARACTERISTIC P_LongCtrl_FollowRateJDirStep "" VALUE 0x3B9088 Scalar_FLOAT32_IEEE 0 PubIfDecisionPLAN_MDL_CM_single 0 1 /end CHARACTERISTIC
/begin AXIS_PTS P_LongCtrl_FollowVelSubjNegToleranceAddX1Axis "" 0x3B908C LongCtrl_LC_rangeP0 Lookup2D_X_FLOAT32_IEEE 0 PubIfDecisionPLAN_MDL_CM_single_m 2 0 20 DEPOSIT ABSOLUTE /end AXIS_PTS
/begin AXIS_PTS P_LongCtrl_FollowVelSubjNegToleranceAddX2Axis "" 0x3B9094 LongCtrl_LC_vxRelP0 Lookup2D_X_FLOAT32_IEEE 0 PubIfDecisionPLAN_MDL_CM_single_m_s 2 -10 0 DEPOSIT ABSOLUTE /end AXIS_PTS
/begin CHARACTERISTIC P_LongCtrl_FollowVelSubjNegToleranceAddYAxis "" MAP 0x3B909C Lookup2D_FLOAT32_IEEE 0 PubIfDecisionPLAN_MDL_CM_single_m_s -10 0
 /begin AXIS_DESCR COM_AXIS LongCtrl_LC_rangeP0 PubIfDecisionPLAN_MDL_CM_single_m 2 0 20 DEPOSIT ABSOLUTE AXIS_PTS_REF P_LongCtrl_FollowVelSubjNegToleranceAddX1Axis /end AXIS_DESCR
 /begin AXIS_DESCR COM_AXIS LongCtrl_LC_vxRelP0 PubIfDecisionPLAN_MDL_CM_single_m_s 2 -10 0 DEPOSIT ABSOLUTE AXIS_PTS_REF P_LongCtrl_FollowVelSubjNegToleranceAddX2Axis /end AXIS_DESCR
/end CHARACTERISTIC
/begin AXIS_PTS P_LongCtrl_FollowVelSubjThresForceStopXAxis "" 0x3B90AC NO_INPUT_QUANTITY Lookup1D_X_FLOAT32_IEEE 0 PubIfDecisionPLAN_MDL_CM_single_m_s_2 2 0 4 DEPOSIT ABSOLUTE /end AXIS_PTS
/begin CHARACTERISTIC P_LongCtrl_FollowVelSubjThresForceStopYAxis "" CURVE 0x3B90B4 Lookup1D_FLOAT32_IEEE 0 PubIfDecisionPLAN_MDL_CM_single_m_s 0 3
 /begin AXIS_DESCR COM_AXIS NO_INPUT_QUANTITY PubIfDecisionPLAN_MDL_CM_single_m_s_2 2 0 4 DEPOSIT ABSOLUTE AXIS_PTS_REF P_LongCtrl_FollowVelSubjThresForceStopXAxis /end AXIS_DESCR
/end CHARACTERISTIC
/begin CHARACTERISTIC P_LongCtrl_FollowVelTargetAbsSmoothNum "" VALUE 0x3B90BC Scalar_FLOAT32_IEEE 0 PubIfDecisionPLAN_MDL_CM_single_m_s 0 60 /end CHARACTERISTIC
/begin AXIS_PTS P_LongCtrl_FollowWdCoefXAxis "" 0x3B90C0 NO_INPUT_QUANTITY Lookup1D_X_FLOAT32_IEEE 0 PubIfDecisionPLAN_MDL_CM_single 3 0 20 DEPOSIT ABSOLUTE /end AXIS_PTS
/begin CHARACTERISTIC P_LongCtrl_FollowWdCoefYAxis "" CURVE 0x3B90CC Lookup1D_FLOAT32_IEEE 0 PubIfDecisionPLAN_MDL_CM_single 0 5
 /begin AXIS_DESCR COM_AXIS NO_INPUT_QUANTITY PubIfDecisionPLAN_MDL_CM_single 3 0 20 DEPOSIT ABSOLUTE AXIS_PTS_REF P_LongCtrl_FollowWdCoefXAxis /end AXIS_DESCR
/end CHARACTERISTIC
/begin AXIS_PTS P_LongCtrl_FollowWvCoefXAxis "" 0x3B90D8 LongCtrl_LC_vxRelP0 Lookup1D_X_FLOAT32_IEEE 0 PubIfDecisionPLAN_MDL_CM_single 4 -20 20 DEPOSIT ABSOLUTE /end AXIS_PTS
/begin CHARACTERISTIC P_LongCtrl_FollowWvCoefYAxis "" CURVE 0x3B90E8 Lookup1D_FLOAT32_IEEE 0 PubIfDecisionPLAN_MDL_CM_single 0 20
 /begin AXIS_DESCR COM_AXIS LongCtrl_LC_vxRelP0 PubIfDecisionPLAN_MDL_CM_single 4 -20 20 DEPOSIT ABSOLUTE AXIS_PTS_REF P_LongCtrl_FollowWvCoefXAxis /end AXIS_DESCR
/end CHARACTERISTIC
/begin AXIS_PTS P_LongCtrl_FollowaccelFollowDesThresEnableStopXAxis "" 0x3B90F8 LongCtrl_LC_rangeP0 Lookup1D_X_FLOAT32_IEEE 0 PubIfDecisionPLAN_MDL_CM_single_m 2 0 5.5 DEPOSIT ABSOLUTE /end AXIS_PTS
/begin CHARACTERISTIC P_LongCtrl_FollowaccelFollowDesThresEnableStopYAxis "" CURVE 0x3B9100 Lookup1D_FLOAT32_IEEE 0 PubIfDecisionPLAN_MDL_CM_single_m_s_2 0 1
 /begin AXIS_DESCR COM_AXIS LongCtrl_LC_rangeP0 PubIfDecisionPLAN_MDL_CM_single_m 2 0 5.5 DEPOSIT ABSOLUTE AXIS_PTS_REF P_LongCtrl_FollowaccelFollowDesThresEnableStopXAxis /end AXIS_DESCR
/end CHARACTERISTIC
/begin AXIS_PTS P_LongCtrl_FollowaccelForceStopMinCharXAxis "" 0x3B9108 NO_INPUT_QUANTITY Lookup1D_X_FLOAT32_IEEE 0 PubIfDecisionPLAN_MDL_CM_single_m_s_2 2 0 5 DEPOSIT ABSOLUTE /end AXIS_PTS
/begin CHARACTERISTIC P_LongCtrl_FollowaccelForceStopMinCharYAxis "" CURVE 0x3B9110 Lookup1D_FLOAT32_IEEE 0 PubIfDecisionPLAN_MDL_CM_single_m_s_2 -6 -2
 /begin AXIS_DESCR COM_AXIS NO_INPUT_QUANTITY PubIfDecisionPLAN_MDL_CM_single_m_s_2 2 0 5 DEPOSIT ABSOLUTE AXIS_PTS_REF P_LongCtrl_FollowaccelForceStopMinCharXAxis /end AXIS_DESCR
/end CHARACTERISTIC
/begin CHARACTERISTIC P_LongCtrl_FollowaccelMinAccelSupressionEnter "" VALUE 0x3B9118 Scalar_FLOAT32_IEEE 0 PubIfDecisionPLAN_MDL_CM_single -3.4e+38 3.4e+38 /end CHARACTERISTIC
/begin CHARACTERISTIC P_LongCtrl_FollowaccelMinAccelSupressionExit "" VALUE 0x3B911C Scalar_FLOAT32_IEEE 0 PubIfDecisionPLAN_MDL_CM_single_m_s_2 -3.5 0 /end CHARACTERISTIC
/begin CHARACTERISTIC P_LongCtrl_FollowaccelStopMax "" VALUE 0x3B9120 Scalar_FLOAT32_IEEE 0 PubIfDecisionPLAN_MDL_CM_single_m_s_2 -1 0 /end CHARACTERISTIC
/begin CHARACTERISTIC P_LongCtrl_FollowaccelSupressionAccelThres "" VALUE 0x3B9124 Scalar_FLOAT32_IEEE 0 PubIfDecisionPLAN_MDL_CM_single_m_s_2 -0.5 0.5 /end CHARACTERISTIC
/begin CHARACTERISTIC P_LongCtrl_FollowaccelTargAbsEnableNegJerk "" VALUE 0x3B9128 Scalar_FLOAT32_IEEE 0 PubIfDecisionPLAN_MDL_CM_single_m_s_3 -10 0 /end CHARACTERISTIC
/begin CHARACTERISTIC P_LongCtrl_FollowaccelTargAbsEnableNegMax "" VALUE 0x3B912C Scalar_FLOAT32_IEEE 0 PubIfDecisionPLAN_MDL_CM_single_m_s_2 -1 3 /end CHARACTERISTIC
/begin CHARACTERISTIC P_LongCtrl_FollowaccelTargAbsEnablePosJerk "" VALUE 0x3B9130 Scalar_FLOAT32_IEEE 0 PubIfDecisionPLAN_MDL_CM_single_m_s_3 0 10 /end CHARACTERISTIC
/begin CHARACTERISTIC P_LongCtrl_FollowaccelTargAbsEnableRangeMax "" VALUE 0x3B9134 Scalar_FLOAT32_IEEE 0 PubIfDecisionPLAN_MDL_CM_single_m_s_2 -2 2 /end CHARACTERISTIC
/begin CHARACTERISTIC P_LongCtrl_FollowaccelTargAbsExitNegMin "" VALUE 0x3B9138 Scalar_FLOAT32_IEEE 0 PubIfDecisionPLAN_MDL_CM_single_m_s_2 -3 0 /end CHARACTERISTIC
/begin CHARACTERISTIC P_LongCtrl_FollowaccelTargThresEnableStop "" VALUE 0x3B913C Scalar_FLOAT32_IEEE 0 PubIfDecisionPLAN_MDL_CM_single_m_s_2 0 2 /end CHARACTERISTIC
/begin CHARACTERISTIC P_LongCtrl_FollowaccelTargThresForceStop "" VALUE 0x3B9140 Scalar_FLOAT32_IEEE 0 PubIfDecisionPLAN_MDL_CM_single_m_s_2 0 1 /end CHARACTERISTIC
/begin CHARACTERISTIC P_LongCtrl_FollowcoefDistEnlargeDecToStop "" VALUE 0x3B9148 Scalar_FLOAT32_IEEE 0 PubIfDecisionPLAN_MDL_CM_single 1 20 /end CHARACTERISTIC
/begin CHARACTERISTIC P_LongCtrl_FollowcoefVelEnlargeDecToStop "" VALUE 0x3B9150 Scalar_FLOAT32_IEEE 0 PubIfDecisionPLAN_MDL_CM_single 1 20 /end CHARACTERISTIC
/begin AXIS_PTS P_LongCtrl_FollowdecelJerkCharXAxis "" 0x3B9154 NO_INPUT_QUANTITY Lookup1D_X_FLOAT32_IEEE 0 PubIfDecisionPLAN_MDL_CM_single_s 6 0 20 DEPOSIT ABSOLUTE /end AXIS_PTS
/begin CHARACTERISTIC P_LongCtrl_FollowdecelJerkCharYAxis "" CURVE 0x3B916C Lookup1D_FLOAT32_IEEE 0 PubIfDecisionPLAN_MDL_CM_single_m_s_3 -10 0
 /begin AXIS_DESCR COM_AXIS NO_INPUT_QUANTITY PubIfDecisionPLAN_MDL_CM_single_s 6 0 20 DEPOSIT ABSOLUTE AXIS_PTS_REF P_LongCtrl_FollowdecelJerkCharXAxis /end AXIS_DESCR
/end CHARACTERISTIC
/begin AXIS_PTS P_LongCtrl_FollowdistDesCompensionXAxis "" 0x3B9184 NO_INPUT_QUANTITY Lookup1D_X_FLOAT32_IEEE 0 PubIfDecisionPLAN_MDL_CM_single_m_s 2 0 70 DEPOSIT ABSOLUTE /end AXIS_PTS
/begin CHARACTERISTIC P_LongCtrl_FollowdistDesCompensionYAxis "" CURVE 0x3B918C Lookup1D_FLOAT32_IEEE 0 PubIfDecisionPLAN_MDL_CM_single_m 0 50
 /begin AXIS_DESCR COM_AXIS NO_INPUT_QUANTITY PubIfDecisionPLAN_MDL_CM_single_m_s 2 0 70 DEPOSIT ABSOLUTE AXIS_PTS_REF P_LongCtrl_FollowdistDesCompensionXAxis /end AXIS_DESCR
/end CHARACTERISTIC
/begin CHARACTERISTIC P_LongCtrl_FollowdistDesStopMin "" VALUE 0x3B9194 Scalar_FLOAT32_IEEE 0 PubIfDecisionPLAN_MDL_CM_single_m 1.5 5.5 /end CHARACTERISTIC
/begin CHARACTERISTIC P_LongCtrl_FollowdistDesX2Axis "" VAL_BLK 0x3B9198 Scalar_FLOAT32_IEEE 0 PubIfDecisionPLAN_MDL_CM_single_m_s 0 70 MATRIX_DIM 1 6 1 /end CHARACTERISTIC
/begin CHARACTERISTIC P_LongCtrl_FollowdistTargRelEnableAccelTargAbsThres "" VALUE 0x3B9210 Scalar_FLOAT32_IEEE 0 PubIfDecisionPLAN_MDL_CM_single_m 0 50 /end CHARACTERISTIC
/begin CHARACTERISTIC P_LongCtrl_FollowdistThresEnableStop "" VALUE 0x3B9214 Scalar_FLOAT32_IEEE 0 PubIfDecisionPLAN_MDL_CM_single_m 1 10 /end CHARACTERISTIC
/begin AXIS_PTS P_LongCtrl_FollowjerkForceStopCharXAxis "" 0x3B921C NO_INPUT_QUANTITY Lookup1D_X_FLOAT32_IEEE 0 PubIfDecisionPLAN_MDL_CM_single_m_s_2 3 0 4 DEPOSIT ABSOLUTE /end AXIS_PTS
/begin CHARACTERISTIC P_LongCtrl_FollowjerkForceStopCharYAxis "" CURVE 0x3B9228 Lookup1D_FLOAT32_IEEE 0 PubIfDecisionPLAN_MDL_CM_single_m_s_3 -5 0
 /begin AXIS_DESCR COM_AXIS NO_INPUT_QUANTITY PubIfDecisionPLAN_MDL_CM_single_m_s_2 3 0 4 DEPOSIT ABSOLUTE AXIS_PTS_REF P_LongCtrl_FollowjerkForceStopCharXAxis /end AXIS_DESCR
/end CHARACTERISTIC
/begin AXIS_PTS P_LongCtrl_FollowttcCorrDecelJerkXAxis "" 0x3B9234 NO_INPUT_QUANTITY Lookup1D_X_FLOAT32_IEEE 0 PubIfDecisionPLAN_MDL_CM_single_s 4 0 200 DEPOSIT ABSOLUTE /end AXIS_PTS
/begin CHARACTERISTIC P_LongCtrl_FollowttcCorrDecelJerkYAxis "" CURVE 0x3B9244 Lookup1D_FLOAT32_IEEE 0 PubIfDecisionPLAN_MDL_CM_single 0 1
 /begin AXIS_DESCR COM_AXIS NO_INPUT_QUANTITY PubIfDecisionPLAN_MDL_CM_single_s 4 0 200 DEPOSIT ABSOLUTE AXIS_PTS_REF P_LongCtrl_FollowttcCorrDecelJerkXAxis /end AXIS_DESCR
/end CHARACTERISTIC
/begin CHARACTERISTIC P_LongCtrl_FollowvelSubjThresEnableStop "" VALUE 0x3B9254 Scalar_FLOAT32_IEEE 0 PubIfDecisionPLAN_MDL_CM_single_m_s 0.2 2 /end CHARACTERISTIC
/begin AXIS_PTS P_LongCtrl_FollowvelSubjThresEnableStopAddXAxis "" 0x3B9258 NO_INPUT_QUANTITY Lookup1D_X_FLOAT32_IEEE 0 PubIfDecisionPLAN_MDL_CM_single_m 2 0 3.5 DEPOSIT ABSOLUTE /end AXIS_PTS
/begin CHARACTERISTIC P_LongCtrl_FollowvelSubjThresEnableStopAddYAxis "" CURVE 0x3B9260 Lookup1D_FLOAT32_IEEE 0 PubIfDecisionPLAN_MDL_CM_single_m_s 0 3
 /begin AXIS_DESCR COM_AXIS NO_INPUT_QUANTITY PubIfDecisionPLAN_MDL_CM_single_m 2 0 3.5 DEPOSIT ABSOLUTE AXIS_PTS_REF P_LongCtrl_FollowvelSubjThresEnableStopAddXAxis /end AXIS_DESCR
/end CHARACTERISTIC
/begin CHARACTERISTIC P_LongCtrl_FollowvelTarAbsThresForceStop "" VALUE 0x3B9268 Scalar_FLOAT32_IEEE 0 PubIfDecisionPLAN_MDL_CM_single_m_s 0.1 1 /end CHARACTERISTIC
/begin AXIS_PTS P_LongCtrl_ICcoefCurvatureCharX1 "" 0x3B93BC LongCtrl_curvatureNoC3 Lookup2D_X_FLOAT32_IEEE 0 PubIfDecisionPLAN_MDL_CM_single_1_m 4 0 1 DEPOSIT ABSOLUTE /end AXIS_PTS
/begin AXIS_PTS P_LongCtrl_ICcoefCurvatureCharX2 "" 0x3B93CC LongCtrl_curvatureWithC3 Lookup2D_X_FLOAT32_IEEE 0 PubIfDecisionPLAN_MDL_CM_single_1_m 4 0 1 DEPOSIT ABSOLUTE /end AXIS_PTS
/begin CHARACTERISTIC P_LongCtrl_ICcoefCurvatureCharY "" MAP 0x3B93DC Lookup2D_FLOAT32_IEEE 0 PubIfDecisionPLAN_MDL_CM_single 0 1
 /begin AXIS_DESCR COM_AXIS LongCtrl_curvatureNoC3 PubIfDecisionPLAN_MDL_CM_single_1_m 4 0 1 DEPOSIT ABSOLUTE AXIS_PTS_REF P_LongCtrl_ICcoefCurvatureCharX1 /end AXIS_DESCR
 /begin AXIS_DESCR COM_AXIS LongCtrl_curvatureWithC3 PubIfDecisionPLAN_MDL_CM_single_1_m 4 0 1 DEPOSIT ABSOLUTE AXIS_PTS_REF P_LongCtrl_ICcoefCurvatureCharX2 /end AXIS_DESCR
/end CHARACTERISTIC
/begin CHARACTERISTIC P_LongCtrl_LC_AccelMinSafeDis "" VALUE 0x3B9468 Scalar_FLOAT32_IEEE 0 PubIfDecisionPLAN_MDL_CM_single -3.4e+38 3.4e+38 /end CHARACTERISTIC
/begin CHARACTERISTIC P_LongCtrl_LC_DisAwayLocation "" VALUE 0x3B946C Scalar_FLOAT32_IEEE 0 PubIfDecisionPLAN_MDL_CM_single -3.4e+38 3.4e+38 /end CHARACTERISTIC
/begin CHARACTERISTIC P_LongCtrl_LC_OptimalSpaceEnable "" VALUE 0x3CB07D Scalar_BOOLEAN 0 PubIfDecisionPLAN_MDL_CM_boolean 0 1 BIT_MASK 0x1 /end CHARACTERISTIC
/begin CHARACTERISTIC P_LongCtrl_LC_OptimalSpaceIntervalTime "" VALUE 0x3B9478 Scalar_FLOAT32_IEEE 0 PubIfDecisionPLAN_MDL_CM_single_s -3.4e+38 3.4e+38 /end CHARACTERISTIC
/begin CHARACTERISTIC P_LongCtrl_LC_OptimalSpaceStartTime "" VALUE 0x3B947C Scalar_FLOAT32_IEEE 0 PubIfDecisionPLAN_MDL_CM_single_s -3.4e+38 3.4e+38 /end CHARACTERISTIC
/begin CHARACTERISTIC P_LongCtrl_LC_OptimalSpaceStopTime "" VALUE 0x3B9480 Scalar_FLOAT32_IEEE 0 PubIfDecisionPLAN_MDL_CM_single_s -3.4e+38 3.4e+38 /end CHARACTERISTIC
/begin CHARACTERISTIC P_LongCtrl_LC_TimeKeepLimit "" VALUE 0x3B9F30 Scalar_SWORD 0 PubIfDecisionPLAN_MDL_CM_int16_s -32768 32767 /end CHARACTERISTIC
/begin CHARACTERISTIC P_LongCtrl_ORDdecelEnable "" VALUE 0x3CB07E Scalar_BOOLEAN 0 PubIfDecisionPLAN_MDL_CM_boolean 0 1 BIT_MASK 0x1 /end CHARACTERISTIC
/begin CHARACTERISTIC P_LongCtrl_ORDvelDeltaEnableThres "" VALUE 0x3B94A8 Scalar_FLOAT32_IEEE 0 PubIfDecisionPLAN_MDL_CM_single_m_s 0 3 /end CHARACTERISTIC
/begin CHARACTERISTIC P_LongCtrl_VLCAxTarDtThreEnableI "" VALUE 0x3B94C8 Scalar_FLOAT32_IEEE 0 PubIfControlLONC_MDL_CM_single_m_s_3 0 5 /end CHARACTERISTIC
/begin AXIS_PTS P_LongCtrl_VLCAxvTracMinDC1FullFillXAxis "" 0x3B94CC NO_INPUT_QUANTITY Lookup1D_X_FLOAT32_IEEE 0 PubIfControlLONC_MDL_CM_single_m_s 4 0 60 DEPOSIT ABSOLUTE /end AXIS_PTS
/begin CHARACTERISTIC P_LongCtrl_VLCAxvTracMinDC1FullFillYAxis "" CURVE 0x3CB03C Lookup1D_FLOAT32_IEEE 0 PubIfControlLONC_MDL_CM_single_m_s_2 -1 1
 /begin AXIS_DESCR COM_AXIS NO_INPUT_QUANTITY PubIfControlLONC_MDL_CM_single_m_s 4 0 60 DEPOSIT ABSOLUTE AXIS_PTS_REF P_LongCtrl_VLCAxvTracMinDC1FullFillXAxis /end AXIS_DESCR
/end CHARACTERISTIC
/begin CHARACTERISTIC P_LongCtrl_VLCCounterAxvTracMinTimeout "" VALUE 0x3B94DC Scalar_FLOAT32_IEEE 0 PubIfControlLONC_MDL_CM_single 0 100 /end CHARACTERISTIC
/begin CHARACTERISTIC P_LongCtrl_VLCCounterDC2ECTorqDelay "" VALUE 0x3B94E0 Scalar_FLOAT32_IEEE 0 PubIfControlLONC_MDL_CM_single 0 100 /end CHARACTERISTIC
/begin CHARACTERISTIC P_LongCtrl_VLCCounterDrvOff2EC "" VALUE 0x3B94E4 Scalar_FLOAT32_IEEE 0 PubIfControlLONC_MDL_CM_single 0 100 /end CHARACTERISTIC
/begin CHARACTERISTIC P_LongCtrl_VLCDtAxvRef2UpperBandDC5 "" VALUE 0x3B94E8 Scalar_FLOAT32_IEEE 0 PubIfControlLONC_MDL_CM_single -1 1 /end CHARACTERISTIC
/begin CHARACTERISTIC P_LongCtrl_VLCIACompensionNeg "" VALUE 0x3B94EC Scalar_FLOAT32_IEEE 0 PubIfControlLONC_MDL_CM_single_m_s_2 -3 0 /end CHARACTERISTIC
/begin CHARACTERISTIC P_LongCtrl_VLCIACompensionPos "" VALUE 0x3B94F0 Scalar_FLOAT32_IEEE 0 PubIfControlLONC_MDL_CM_single_m_s_2 0 3 /end CHARACTERISTIC
/begin CHARACTERISTIC P_LongCtrl_VLCTorqDiffThreAxvTracMinTimeout "" VALUE 0x3B94F4 Scalar_FLOAT32_IEEE 0 PubIfControlLONC_MDL_CM_single 0 20 /end CHARACTERISTIC
/begin CHARACTERISTIC P_LongCtrl_VLCVlcAccThresAxvTracMinTimeout "" VALUE 0x3CB04C Scalar_FLOAT32_IEEE 0 PubIfControlLONC_MDL_CM_single_m_s_2 -5 2 /end CHARACTERISTIC
/begin AXIS_PTS P_LongCtrl_VLCaccelMinHoldXAxis "" 0x3B9548 NO_INPUT_QUANTITY Lookup1D_X_FLOAT32_IEEE 0 PubIfControlLONC_MDL_CM_single_m_s_2 2 0 5 DEPOSIT ABSOLUTE /end AXIS_PTS
/begin CHARACTERISTIC P_LongCtrl_VLCaccelMinHoldYAxis "" CURVE 0x3B9550 Lookup1D_FLOAT32_IEEE 0 PubIfControlLONC_MDL_CM_single_m_s_2 -6 0
 /begin AXIS_DESCR COM_AXIS NO_INPUT_QUANTITY PubIfControlLONC_MDL_CM_single_m_s_2 2 0 5 DEPOSIT ABSOLUTE AXIS_PTS_REF P_LongCtrl_VLCaccelMinHoldXAxis /end AXIS_DESCR
/end CHARACTERISTIC
/begin CHARACTERISTIC P_LongCtrl_VLCaxvRoadSlopeDC4CharXAxis "" VAL_BLK 0x3B959C Scalar_FLOAT32_IEEE 0 PubIfControlLONC_MDL_CM_single_m_s_2 -4 1 MATRIX_DIM 1 5 1 /end CHARACTERISTIC
/begin CHARACTERISTIC P_LongCtrl_VLCaxvRoadSlopeDC4CharYAxis "" VAL_BLK 0x3B95B0 Scalar_FLOAT32_IEEE 0 PubIfControlLONC_MDL_CM_single 0 1 MATRIX_DIM 1 5 1 /end CHARACTERISTIC
/begin AXIS_PTS P_LongCtrl_VLCcoefFXAxis "" 0x3B95C4 NO_INPUT_QUANTITY Lookup1D_X_FLOAT32_IEEE 0 PubIfControlLONC_MDL_CM_single_km_h 10 0 250 DEPOSIT ABSOLUTE /end AXIS_PTS
/begin CHARACTERISTIC P_LongCtrl_VLCcoefFYAxis "" CURVE 0x3B95EC Lookup1D_FLOAT32_IEEE 0 PubIfControlLONC_MDL_CM_single 0 1
 /begin AXIS_DESCR COM_AXIS NO_INPUT_QUANTITY PubIfControlLONC_MDL_CM_single_km_h 10 0 250 DEPOSIT ABSOLUTE AXIS_PTS_REF P_LongCtrl_VLCcoefFXAxis /end AXIS_DESCR
/end CHARACTERISTIC
/begin CHARACTERISTIC P_LongCtrl_VLCcoefIFadeOut1Calc "" VALUE 0x3B9614 Scalar_FLOAT32_IEEE 0 PubIfControlLONC_MDL_CM_single 1 10 /end CHARACTERISTIC
/begin CHARACTERISTIC P_LongCtrl_VLCcoefIFadeOut1Condition "" VALUE 0x3B9618 Scalar_FLOAT32_IEEE 0 PubIfControlLONC_MDL_CM_single 0 1 /end CHARACTERISTIC
/begin CHARACTERISTIC P_LongCtrl_VLCcoefIFadeOut2Calc "" VALUE 0x3B961C Scalar_FLOAT32_IEEE 0 PubIfControlLONC_MDL_CM_single 1 10 /end CHARACTERISTIC
/begin CHARACTERISTIC P_LongCtrl_VLCcoefIFadeOut2Condition "" VALUE 0x3B9620 Scalar_FLOAT32_IEEE 0 PubIfControlLONC_MDL_CM_single 0 1 /end CHARACTERISTIC
/begin CHARACTERISTIC P_LongCtrl_VLCcoefIFadeOut3Calc "" VALUE 0x3B9624 Scalar_FLOAT32_IEEE 0 PubIfControlLONC_MDL_CM_single 1 10 /end CHARACTERISTIC
/begin CHARACTERISTIC P_LongCtrl_VLCcoefIFadeOut3Condition "" VALUE 0x3B9628 Scalar_FLOAT32_IEEE 0 PubIfControlLONC_MDL_CM_single 0 1 /end CHARACTERISTIC
/begin AXIS_PTS P_LongCtrl_VLCjerkHoldXAxis "" 0x3B9658 NO_INPUT_QUANTITY Lookup1D_X_FLOAT32_IEEE 0 PubIfControlLONC_MDL_CM_single_m_s_2 2 0 4 DEPOSIT ABSOLUTE /end AXIS_PTS
/begin CHARACTERISTIC P_LongCtrl_VLCjerkHoldYAxis "" CURVE 0x3B9660 Lookup1D_FLOAT32_IEEE 0 PubIfControlLONC_MDL_CM_single_m_s_3 -50 0
 /begin AXIS_DESCR COM_AXIS NO_INPUT_QUANTITY PubIfControlLONC_MDL_CM_single_m_s_2 2 0 4 DEPOSIT ABSOLUTE AXIS_PTS_REF P_LongCtrl_VLCjerkHoldXAxis /end AXIS_DESCR
/end CHARACTERISTIC
/begin CHARACTERISTIC P_LongCtrl_tCycle "" VALUE 0x3B968C Scalar_FLOAT32_IEEE 0 PubIfDecisionPLAN_MDL_CM_single_s 0.02 0.02 /end CHARACTERISTIC
/begin CHARACTERISTIC P_VSM_CruiseFunUserInputMappingWays "" VALUE 0x3CB09A Scalar_UBYTE 0 PubIfStateVSM_MDL_CM_uint8 0 255 /end CHARACTERISTIC
/begin CHARACTERISTIC P_VSM_ELK_Lane_Width_Table "" VAL_BLK 0x3B9868 Scalar_FLOAT32_IEEE 0 PubIfStateVSM_MDL_CM_single -3.4e+38 3.4e+38 MATRIX_DIM 1 7 1 /end CHARACTERISTIC
/begin CHARACTERISTIC P_VSM_ELK_Lane_Width_Table_Calibration "" VAL_BLK 0x3CB050 Scalar_FLOAT32_IEEE 0 PubIfStateVSM_MDL_CM_single -3.4e+38 3.4e+38 MATRIX_DIM 1 7 1 /end CHARACTERISTIC
/begin CHARACTERISTIC P_VSM_ELK_OnComing_Lateral "" VALUE 0x3B9884 Scalar_FLOAT32_IEEE 0 PubIfStateVSM_MDL_CM_single -3.4e+38 3.4e+38 /end CHARACTERISTIC
/begin CHARACTERISTIC P_VSM_ELK_OnComing_TTC "" VALUE 0x3B9888 Scalar_FLOAT32_IEEE 0 PubIfStateVSM_MDL_CM_single -3.4e+38 3.4e+38 /end CHARACTERISTIC
/begin CHARACTERISTIC P_VSM_ELK_OverTaking_Lateral "" VALUE 0x3B988C Scalar_FLOAT32_IEEE 0 PubIfStateVSM_MDL_CM_single -3.4e+38 3.4e+38 /end CHARACTERISTIC
/begin CHARACTERISTIC P_VSM_ELK_OverTaking_TTC "" VALUE 0x3B9890 Scalar_FLOAT32_IEEE 0 PubIfStateVSM_MDL_CM_single -3.4e+38 3.4e+38 /end CHARACTERISTIC
/begin CHARACTERISTIC P_VSM_ELK_Sensitive_Table "" VAL_BLK 0x3B9894 Scalar_FLOAT32_IEEE 0 PubIfStateVSM_MDL_CM_single -3.4e+38 3.4e+38 MATRIX_DIM 1 3 1 /end CHARACTERISTIC
/begin CHARACTERISTIC P_VSM_ELK_Sensitive_Table_Calibration "" VAL_BLK 0x3B98A0 Scalar_FLOAT32_IEEE 0 PubIfStateVSM_MDL_CM_single -3.4e+38 3.4e+38 MATRIX_DIM 1 3 1 /end CHARACTERISTIC
/begin CHARACTERISTIC P_VSM_ELK_State_Absesp_enable "" VALUE 0x3B98AC Scalar_FLOAT32_IEEE 0 PubIfStateVSM_MDL_CM_single -3.4e+38 3.4e+38 /end CHARACTERISTIC
/begin CHARACTERISTIC P_VSM_ELK_State_Accpedalrate_enable "" VALUE 0x3B98B0 Scalar_FLOAT32_IEEE 0 PubIfStateVSM_MDL_CM_single -3.4e+38 3.4e+38 /end CHARACTERISTIC
/begin CHARACTERISTIC P_VSM_ELK_State_Breakpressure_enable "" VALUE 0x3B98B4 Scalar_FLOAT32_IEEE 0 PubIfStateVSM_MDL_CM_single -3.4e+38 3.4e+38 /end CHARACTERISTIC
/begin CHARACTERISTIC P_VSM_ELK_State_DriverInputTrqValue_enable "" VALUE 0x3B98B8 Scalar_FLOAT32_IEEE 0 PubIfStateVSM_MDL_CM_single -3.4e+38 3.4e+38 /end CHARACTERISTIC
/begin CHARACTERISTIC P_VSM_ELK_State_ESSSts_enable "" VALUE 0x3B98BC Scalar_FLOAT32_IEEE 0 PubIfStateVSM_MDL_CM_single -3.4e+38 3.4e+38 /end CHARACTERISTIC
/begin CHARACTERISTIC P_VSM_ELK_State_Eps_enable "" VALUE 0x3B98C0 Scalar_FLOAT32_IEEE 0 PubIfStateVSM_MDL_CM_single -3.4e+38 3.4e+38 /end CHARACTERISTIC
/begin CHARACTERISTIC P_VSM_ELK_State_Failsafe_enable "" VALUE 0x3B98C4 Scalar_FLOAT32_IEEE 0 PubIfStateVSM_MDL_CM_single -3.4e+38 3.4e+38 /end CHARACTERISTIC
/begin CHARACTERISTIC P_VSM_ELK_State_GEAR_enable "" VALUE 0x3B98C8 Scalar_FLOAT32_IEEE 0 PubIfStateVSM_MDL_CM_single -3.4e+38 3.4e+38 /end CHARACTERISTIC
/begin CHARACTERISTIC P_VSM_ELK_State_Headingangle_enable "" VALUE 0x3B98CC Scalar_FLOAT32_IEEE 0 PubIfStateVSM_MDL_CM_single -3.4e+38 3.4e+38 /end CHARACTERISTIC
/begin CHARACTERISTIC P_VSM_ELK_State_LaneChange_enable "" VALUE 0x3B98D0 Scalar_FLOAT32_IEEE 0 PubIfStateVSM_MDL_CM_single -3.4e+38 3.4e+38 /end CHARACTERISTIC
/begin CHARACTERISTIC P_VSM_ELK_State_Lane_enable "" VALUE 0x3B98D4 Scalar_FLOAT32_IEEE 0 PubIfStateVSM_MDL_CM_single -3.4e+38 3.4e+38 /end CHARACTERISTIC
/begin CHARACTERISTIC P_VSM_ELK_State_Lanecurve_enable "" VALUE 0x3B98D8 Scalar_FLOAT32_IEEE 0 PubIfStateVSM_MDL_CM_single -3.4e+38 3.4e+38 /end CHARACTERISTIC
/begin CHARACTERISTIC P_VSM_ELK_State_LateralAcce_enable "" VALUE 0x3B98DC Scalar_FLOAT32_IEEE 0 PubIfStateVSM_MDL_CM_single -3.4e+38 3.4e+38 /end CHARACTERISTIC
/begin CHARACTERISTIC P_VSM_ELK_State_LongitudeAcc_enable "" VALUE 0x3B98E0 Scalar_FLOAT32_IEEE 0 PubIfStateVSM_MDL_CM_single -3.4e+38 3.4e+38 /end CHARACTERISTIC
/begin CHARACTERISTIC P_VSM_ELK_State_Overide_enable "" VALUE 0x3B98E4 Scalar_FLOAT32_IEEE 0 PubIfStateVSM_MDL_CM_single -3.4e+38 3.4e+38 /end CHARACTERISTIC
/begin CHARACTERISTIC P_VSM_ELK_State_Param_AngleOffset "" VALUE 0x3B98E8 Scalar_FLOAT32_IEEE 0 PubIfStateVSM_MDL_CM_single -3.4e+38 3.4e+38 /end CHARACTERISTIC
/begin CHARACTERISTIC P_VSM_ELK_State_Param_OnTime "" VAL_BLK 0x3B98EC Scalar_FLOAT32_IEEE 0 PubIfStateVSM_MDL_CM_single -3.4e+38 3.4e+38 MATRIX_DIM 1 16 1 /end CHARACTERISTIC
/begin CHARACTERISTIC P_VSM_ELK_State_Param_Oncoming "" VALUE 0x3B992C Scalar_FLOAT32_IEEE 0 PubIfStateVSM_MDL_CM_single -3.4e+38 3.4e+38 /end CHARACTERISTIC
/begin CHARACTERISTIC P_VSM_ELK_State_Param_OutOffset "" VALUE 0x3B9930 Scalar_FLOAT32_IEEE 0 PubIfStateVSM_MDL_CM_single -3.4e+38 3.4e+38 /end CHARACTERISTIC
/begin CHARACTERISTIC P_VSM_ELK_State_Param_OvTime "" VAL_BLK 0x3B9934 Scalar_FLOAT32_IEEE 0 PubIfStateVSM_MDL_CM_single -3.4e+38 3.4e+38 MATRIX_DIM 1 16 1 /end CHARACTERISTIC
/begin CHARACTERISTIC P_VSM_ELK_State_Param_Over "" VALUE 0x3B9974 Scalar_FLOAT32_IEEE 0 PubIfStateVSM_MDL_CM_single -3.4e+38 3.4e+38 /end CHARACTERISTIC
/begin CHARACTERISTIC P_VSM_ELK_State_Param_Speed "" VAL_BLK 0x3B9978 Scalar_FLOAT32_IEEE 0 PubIfStateVSM_MDL_CM_single -3.4e+38 3.4e+38 MATRIX_DIM 1 16 1 /end CHARACTERISTIC
/begin CHARACTERISTIC P_VSM_ELK_State_SteerWheelAngle_enable "" VALUE 0x3B99B8 Scalar_FLOAT32_IEEE 0 PubIfStateVSM_MDL_CM_single -3.4e+38 3.4e+38 /end CHARACTERISTIC
/begin CHARACTERISTIC P_VSM_ELK_State_SteerWheelSpd_enable "" VALUE 0x3B99BC Scalar_FLOAT32_IEEE 0 PubIfStateVSM_MDL_CM_single -3.4e+38 3.4e+38 /end CHARACTERISTIC
/begin CHARACTERISTIC P_VSM_ELK_State_Vehspeed_enable "" VALUE 0x3B99C0 Scalar_FLOAT32_IEEE 0 PubIfStateVSM_MDL_CM_single -3.4e+38 3.4e+38 /end CHARACTERISTIC
/begin CHARACTERISTIC P_VSM_ELK_State_Yawsup_enable "" VALUE 0x3B99C4 Scalar_FLOAT32_IEEE 0 PubIfStateVSM_MDL_CM_single -3.4e+38 3.4e+38 /end CHARACTERISTIC
/begin CHARACTERISTIC P_VSM_ESS_AEBFlag_enable "" VALUE 0x3B9F48 Scalar_BOOLEAN 0 PubIfStateVSM_MDL_CM_boolean 0 1 BIT_MASK 0x1 /end CHARACTERISTIC
/begin CHARACTERISTIC P_VSM_ESS_AccPedlPosn_Param "" VALUE 0x3B99CC Scalar_FLOAT32_IEEE 0 PubIfStateVSM_MDL_CM_single -3.4e+38 3.4e+38 /end CHARACTERISTIC
/begin CHARACTERISTIC P_VSM_ESS_AccelPed_enable "" VALUE 0x3B9F49 Scalar_BOOLEAN 0 PubIfStateVSM_MDL_CM_boolean 0 1 BIT_MASK 0x1 /end CHARACTERISTIC
/begin CHARACTERISTIC P_VSM_ESS_DangerPlausLeft "" VALUE 0x3B99E8 Scalar_FLOAT32_IEEE 0 PubIfStateVSM_MDL_CM_single -3.4e+38 3.4e+38 /end CHARACTERISTIC
/begin CHARACTERISTIC P_VSM_ESS_DangerPlausRight "" VALUE 0x3B99EC Scalar_FLOAT32_IEEE 0 PubIfStateVSM_MDL_CM_single -3.4e+38 3.4e+38 /end CHARACTERISTIC
/begin CHARACTERISTIC P_VSM_ESS_DoorSts_enable "" VALUE 0x3B9F4A Scalar_BOOLEAN 0 PubIfStateVSM_MDL_CM_boolean 0 1 BIT_MASK 0x1 /end CHARACTERISTIC
/begin CHARACTERISTIC P_VSM_ESS_DriverInputTrq_Param "" VALUE 0x3B99F0 Scalar_FLOAT32_IEEE 0 PubIfStateVSM_MDL_CM_single -3.4e+38 3.4e+38 /end CHARACTERISTIC
/begin CHARACTERISTIC P_VSM_ESS_DrvOverTime_Param "" VALUE 0x3B99F4 Scalar_FLOAT32_IEEE 0 PubIfStateVSM_MDL_CM_single -3.4e+38 3.4e+38 /end CHARACTERISTIC
/begin CHARACTERISTIC P_VSM_ESS_DrvSBR_enable "" VALUE 0x3B9F4B Scalar_BOOLEAN 0 PubIfStateVSM_MDL_CM_boolean 0 1 BIT_MASK 0x1 /end CHARACTERISTIC
/begin CHARACTERISTIC P_VSM_ESS_ESPActive_enable "" VALUE 0x3B9F4C Scalar_BOOLEAN 0 PubIfStateVSM_MDL_CM_boolean 0 1 BIT_MASK 0x1 /end CHARACTERISTIC
/begin CHARACTERISTIC P_VSM_ESS_ESPFuncOffSts_enable "" VALUE 0x3B9F4D Scalar_BOOLEAN 0 PubIfStateVSM_MDL_CM_boolean 0 1 BIT_MASK 0x1 /end CHARACTERISTIC
/begin CHARACTERISTIC P_VSM_ESS_FcwDisFlag_enable "" VALUE 0x3B9F4E Scalar_BOOLEAN 0 PubIfStateVSM_MDL_CM_boolean 0 1 BIT_MASK 0x1 /end CHARACTERISTIC
/begin CHARACTERISTIC P_VSM_ESS_FcwSw_enable "" VALUE 0x3B9F4F Scalar_BOOLEAN 0 PubIfStateVSM_MDL_CM_boolean 0 1 BIT_MASK 0x1 /end CHARACTERISTIC
/begin CHARACTERISTIC P_VSM_ESS_HiLoBeam_enable "" VALUE 0x3B9F50 Scalar_BOOLEAN 0 PubIfStateVSM_MDL_CM_boolean 0 1 BIT_MASK 0x1 /end CHARACTERISTIC
/begin AXIS_PTS P_VSM_ESS_IPSpeed_kmh "" 0x3B99F8 NO_INPUT_QUANTITY Lookup1D_X_FLOAT32_IEEE 0 PubIfStateVSM_MDL_CM_single 6 -3.4e+38 3.4e+38 DEPOSIT ABSOLUTE /end AXIS_PTS
/begin CHARACTERISTIC P_VSM_ESS_LateralAccel_enable "" VALUE 0x3B9F51 Scalar_BOOLEAN 0 PubIfStateVSM_MDL_CM_boolean 0 1 BIT_MASK 0x1 /end CHARACTERISTIC
/begin CHARACTERISTIC P_VSM_ESS_LgtAccelLower_Param "" VALUE 0x3B9A10 Scalar_FLOAT32_IEEE 0 PubIfStateVSM_MDL_CM_single -3.4e+38 3.4e+38 /end CHARACTERISTIC
/begin CHARACTERISTIC P_VSM_ESS_LgtAccelUpper_Param "" VALUE 0x3B9A14 Scalar_FLOAT32_IEEE 0 PubIfStateVSM_MDL_CM_single -3.4e+38 3.4e+38 /end CHARACTERISTIC
/begin CHARACTERISTIC P_VSM_ESS_MasterCylindBrake "" VALUE 0x3B9A18 Scalar_FLOAT32_IEEE 0 PubIfStateVSM_MDL_CM_single -3.4e+38 3.4e+38 /end CHARACTERISTIC
/begin CHARACTERISTIC P_VSM_ESS_MaxLateral_mss "" CURVE 0x3B9A1C Lookup1D_FLOAT32_IEEE 0 PubIfStateVSM_MDL_CM_single -3.4e+38 3.4e+38
 /begin AXIS_DESCR COM_AXIS NO_INPUT_QUANTITY PubIfStateVSM_MDL_CM_single 6 -3.4e+38 3.4e+38 DEPOSIT ABSOLUTE AXIS_PTS_REF P_VSM_ESS_IPSpeed_kmh /end AXIS_DESCR
/end CHARACTERISTIC
/begin CHARACTERISTIC P_VSM_ESS_SteerWheelSpd_Param "" VALUE 0x3B9A68 Scalar_FLOAT32_IEEE 0 PubIfStateVSM_MDL_CM_single -3.4e+38 3.4e+38 /end CHARACTERISTIC
/begin CHARACTERISTIC P_VSM_ESS_SteerWheelSpd_enable "" VALUE 0x3B9F52 Scalar_BOOLEAN 0 PubIfStateVSM_MDL_CM_boolean 0 1 BIT_MASK 0x1 /end CHARACTERISTIC
/begin CHARACTERISTIC P_VSM_ESS_StopA0_Param "" VALUE 0x3B9A6C Scalar_FLOAT32_IEEE 0 PubIfStateVSM_MDL_CM_single -3.4e+38 3.4e+38 /end CHARACTERISTIC
/begin CHARACTERISTIC P_VSM_ESS_StopA1Time_Param "" VALUE 0x3B9A70 Scalar_FLOAT32_IEEE 0 PubIfStateVSM_MDL_CM_single -3.4e+38 3.4e+38 /end CHARACTERISTIC
/begin CHARACTERISTIC P_VSM_ESS_StopA1_Param "" VALUE 0x3B9A74 Scalar_FLOAT32_IEEE 0 PubIfStateVSM_MDL_CM_single -3.4e+38 3.4e+38 /end CHARACTERISTIC
/begin CHARACTERISTIC P_VSM_ESS_TrailerSts_enable "" VALUE 0x3B9F53 Scalar_BOOLEAN 0 PubIfStateVSM_MDL_CM_boolean 0 1 BIT_MASK 0x1 /end CHARACTERISTIC
/begin CHARACTERISTIC P_VSM_ESS_VehLgtAccel_enable "" VALUE 0x3B9F54 Scalar_BOOLEAN 0 PubIfStateVSM_MDL_CM_boolean 0 1 BIT_MASK 0x1 /end CHARACTERISTIC
/begin CHARACTERISTIC P_VSM_ESS_Vehspeed_enable "" VALUE 0x3B9F55 Scalar_BOOLEAN 0 PubIfStateVSM_MDL_CM_boolean 0 1 BIT_MASK 0x1 /end CHARACTERISTIC
/begin CHARACTERISTIC P_VSM_ESS_WiprReq_enable "" VALUE 0x3B9F56 Scalar_BOOLEAN 0 PubIfStateVSM_MDL_CM_boolean 0 1 BIT_MASK 0x1 /end CHARACTERISTIC
/begin CHARACTERISTIC P_VSM_HOD_DrvTrqFlterTIme "" VALUE 0x3B9A78 Scalar_FLOAT32_IEEE 0 PubIfStateVSM_MDL_CM_single -3.4e+38 3.4e+38 /end CHARACTERISTIC
/begin CHARACTERISTIC P_VSM_LCK_AbsEspInTime "" VALUE 0x3B4B50 Scalar_FLOAT64_IEEE 0 PubIfStateVSM_MDL_CM_double -1.7e+308 1.7e+308 /end CHARACTERISTIC
/begin CHARACTERISTIC P_VSM_LCK_AccRateIn "" VALUE 0x3B9C4C Scalar_FLOAT32_IEEE 0 PubIfStateVSM_MDL_CM_single -3.4e+38 3.4e+38 /end CHARACTERISTIC
/begin CHARACTERISTIC P_VSM_LCK_AccRateInTime "" VALUE 0x3B4B58 Scalar_FLOAT64_IEEE 0 PubIfStateVSM_MDL_CM_double -1.7e+308 1.7e+308 /end CHARACTERISTIC
/begin CHARACTERISTIC P_VSM_LCK_AccRateOut "" VALUE 0x3B9C50 Scalar_FLOAT32_IEEE 0 PubIfStateVSM_MDL_CM_single -3.4e+38 3.4e+38 /end CHARACTERISTIC
/begin CHARACTERISTIC P_VSM_LCK_AccrPelOut "" VALUE 0x3B9C54 Scalar_FLOAT32_IEEE 0 PubIfStateVSM_MDL_CM_single -3.4e+38 3.4e+38 /end CHARACTERISTIC
/begin CHARACTERISTIC P_VSM_LCK_AccrPelRateOut "" VALUE 0x3CAFF0 Scalar_FLOAT64_IEEE 0 PubIfStateVSM_MDL_CM_double -1.7e+308 1.7e+308 /end CHARACTERISTIC
/begin CHARACTERISTIC P_VSM_LCK_BrakePressIn "" VALUE 0x3B9C58 Scalar_FLOAT32_IEEE 0 PubIfStateVSM_MDL_CM_single -3.4e+38 3.4e+38 /end CHARACTERISTIC
/begin CHARACTERISTIC P_VSM_LCK_BrakePressInTime "" VALUE 0x3B4B60 Scalar_FLOAT64_IEEE 0 PubIfStateVSM_MDL_CM_double -1.7e+308 1.7e+308 /end CHARACTERISTIC
/begin CHARACTERISTIC P_VSM_LCK_BrakePressOut "" VALUE 0x3B9C5C Scalar_FLOAT32_IEEE 0 PubIfStateVSM_MDL_CM_single -3.4e+38 3.4e+38 /end CHARACTERISTIC
/begin CHARACTERISTIC P_VSM_LCK_DrvInputTrqValueIn "" VALUE 0x3B9C60 Scalar_FLOAT32_IEEE 0 PubIfStateVSM_MDL_CM_single -3.4e+38 3.4e+38 /end CHARACTERISTIC
/begin CHARACTERISTIC P_VSM_LCK_DrvInputTrqValueInTime "" VALUE 0x3B4B68 Scalar_FLOAT64_IEEE 0 PubIfStateVSM_MDL_CM_double -1.7e+308 1.7e+308 /end CHARACTERISTIC
/begin CHARACTERISTIC P_VSM_LCK_DrvInputTrqValueOut "" VALUE 0x3B9C64 Scalar_FLOAT32_IEEE 0 PubIfStateVSM_MDL_CM_single -3.4e+38 3.4e+38 /end CHARACTERISTIC
/begin CHARACTERISTIC P_VSM_LCK_IdleInTime "" VALUE 0x3B9C68 Scalar_FLOAT32_IEEE 0 PubIfStateVSM_MDL_CM_single -3.4e+38 3.4e+38 /end CHARACTERISTIC
/begin CHARACTERISTIC P_VSM_LCK_LCDrvInputTrqValueOut "" VALUE 0x3B9C6C Scalar_FLOAT32_IEEE 0 PubIfStateVSM_MDL_CM_single -3.4e+38 3.4e+38 /end CHARACTERISTIC
/begin CHARACTERISTIC P_VSM_LCK_LCOverrideTime "" VALUE 0x3B4B70 Scalar_FLOAT64_IEEE 0 PubIfStateVSM_MDL_CM_double -1.7e+308 1.7e+308 /end CHARACTERISTIC
/begin CHARACTERISTIC P_VSM_LCK_LCOverrideValue "" VALUE 0x3B9C70 Scalar_FLOAT32_IEEE 0 PubIfStateVSM_MDL_CM_single -3.4e+38 3.4e+38 /end CHARACTERISTIC
/begin CHARACTERISTIC P_VSM_LCK_LateralAcceIn "" VALUE 0x3B9C74 Scalar_FLOAT32_IEEE 0 PubIfStateVSM_MDL_CM_single -3.4e+38 3.4e+38 /end CHARACTERISTIC
/begin CHARACTERISTIC P_VSM_LCK_LateralAcceInTime "" VALUE 0x3B4B78 Scalar_FLOAT64_IEEE 0 PubIfStateVSM_MDL_CM_double -1.7e+308 1.7e+308 /end CHARACTERISTIC
/begin CHARACTERISTIC P_VSM_LCK_LateralAcceOut "" VALUE 0x3B9C78 Scalar_FLOAT32_IEEE 0 PubIfStateVSM_MDL_CM_single -3.4e+38 3.4e+38 /end CHARACTERISTIC
/begin CHARACTERISTIC P_VSM_LCK_LongitudeAccIn "" VALUE 0x3B9C7C Scalar_FLOAT32_IEEE 0 PubIfStateVSM_MDL_CM_single -3.4e+38 3.4e+38 /end CHARACTERISTIC
/begin CHARACTERISTIC P_VSM_LCK_LongitudeAccInTime "" VALUE 0x3B4B80 Scalar_FLOAT64_IEEE 0 PubIfStateVSM_MDL_CM_double -1.7e+308 1.7e+308 /end CHARACTERISTIC
/begin CHARACTERISTIC P_VSM_LCK_LongitudeAccOut "" VALUE 0x3B9C80 Scalar_FLOAT32_IEEE 0 PubIfStateVSM_MDL_CM_single -3.4e+38 3.4e+38 /end CHARACTERISTIC
/begin CHARACTERISTIC P_VSM_LCK_OverrideInTime "" VALUE 0x3B4B88 Scalar_FLOAT64_IEEE 0 PubIfStateVSM_MDL_CM_double -1.7e+308 1.7e+308 /end CHARACTERISTIC
/begin CHARACTERISTIC P_VSM_LCK_OverrideTime "" VALUE 0x3B4B90 Scalar_FLOAT64_IEEE 0 PubIfStateVSM_MDL_CM_double -1.7e+308 1.7e+308 /end CHARACTERISTIC
/begin CHARACTERISTIC P_VSM_LCK_OverrideValue "" VALUE 0x3B9C84 Scalar_FLOAT32_IEEE 0 PubIfStateVSM_MDL_CM_single -3.4e+38 3.4e+38 /end CHARACTERISTIC
/begin CHARACTERISTIC P_VSM_LCK_PreTime "" VALUE 0x3B4B98 Scalar_FLOAT64_IEEE 0 PubIfStateVSM_MDL_CM_double -1.7e+308 1.7e+308 /end CHARACTERISTIC
/begin CHARACTERISTIC P_VSM_LCK_State_Absesp_enable "" VALUE 0x3B9C88 Scalar_FLOAT32_IEEE 0 PubIfStateVSM_MDL_CM_single -3.4e+38 3.4e+38 /end CHARACTERISTIC
/begin CHARACTERISTIC P_VSM_LCK_State_Accpedalrate_enable "" VALUE 0x3CB070 Scalar_FLOAT32_IEEE 0 PubIfStateVSM_MDL_CM_single -3.4e+38 3.4e+38 /end CHARACTERISTIC
/begin CHARACTERISTIC P_VSM_LCK_State_Breakpressure_enable "" VALUE 0x3B9C8C Scalar_FLOAT32_IEEE 0 PubIfStateVSM_MDL_CM_single -3.4e+38 3.4e+38 /end CHARACTERISTIC
/begin CHARACTERISTIC P_VSM_LCK_State_DriverInputTrqValue_enable "" VALUE 0x3B9C90 Scalar_FLOAT32_IEEE 0 PubIfStateVSM_MDL_CM_single -3.4e+38 3.4e+38 /end CHARACTERISTIC
/begin CHARACTERISTIC P_VSM_LCK_State_ESSSts_enable "" VALUE 0x3B4BA0 Scalar_FLOAT64_IEEE 0 PubIfStateVSM_MDL_CM_double -1.7e+308 1.7e+308 /end CHARACTERISTIC
/begin CHARACTERISTIC P_VSM_LCK_State_Eps_enable "" VALUE 0x3B9C94 Scalar_FLOAT32_IEEE 0 PubIfStateVSM_MDL_CM_single -3.4e+38 3.4e+38 /end CHARACTERISTIC
/begin CHARACTERISTIC P_VSM_LCK_State_GEAR_enable "" VALUE 0x3B9C98 Scalar_FLOAT32_IEEE 0 PubIfStateVSM_MDL_CM_single -3.4e+38 3.4e+38 /end CHARACTERISTIC
/begin CHARACTERISTIC P_VSM_LCK_State_Handson_enable "" VALUE 0x3B9C9C Scalar_FLOAT32_IEEE 0 PubIfStateVSM_MDL_CM_single -3.4e+38 3.4e+38 /end CHARACTERISTIC
/begin CHARACTERISTIC P_VSM_LCK_State_IdleInTime_enable "" VALUE 0x3CB074 Scalar_FLOAT32_IEEE 0 PubIfStateVSM_MDL_CM_single -3.4e+38 3.4e+38 /end CHARACTERISTIC
/begin CHARACTERISTIC P_VSM_LCK_State_LSMLine_enable "" VALUE 0x3B9CA0 Scalar_FLOAT32_IEEE 0 PubIfStateVSM_MDL_CM_single -3.4e+38 3.4e+38 /end CHARACTERISTIC
/begin CHARACTERISTIC P_VSM_LCK_State_LaneChange_enable "" VALUE 0x3CAFF8 Scalar_FLOAT64_IEEE 0 PubIfStateVSM_MDL_CM_double -1.7e+308 1.7e+308 /end CHARACTERISTIC
/begin CHARACTERISTIC P_VSM_LCK_State_LaneCurve_enable "" VALUE 0x3CB078 Scalar_FLOAT32_IEEE 0 PubIfStateVSM_MDL_CM_single -3.4e+38 3.4e+38 /end CHARACTERISTIC
/begin CHARACTERISTIC P_VSM_LCK_State_Lane_enable "" VALUE 0x3B9CA4 Scalar_FLOAT32_IEEE 0 PubIfStateVSM_MDL_CM_single -3.4e+38 3.4e+38 /end CHARACTERISTIC
/begin CHARACTERISTIC P_VSM_LCK_State_LateralAcce_enable "" VALUE 0x3B9CA8 Scalar_FLOAT32_IEEE 0 PubIfStateVSM_MDL_CM_single -3.4e+38 3.4e+38 /end CHARACTERISTIC
/begin CHARACTERISTIC P_VSM_LCK_State_LongitudeAcc_enable "" VALUE 0x3B9CAC Scalar_FLOAT32_IEEE 0 PubIfStateVSM_MDL_CM_single -3.4e+38 3.4e+38 /end CHARACTERISTIC
/begin CHARACTERISTIC P_VSM_LCK_State_Overide_enable "" VALUE 0x3B9CB0 Scalar_FLOAT32_IEEE 0 PubIfStateVSM_MDL_CM_single -3.4e+38 3.4e+38 /end CHARACTERISTIC
/begin CHARACTERISTIC P_VSM_LCK_State_SteerWheelAngle_enable "" VALUE 0x3B9CB4 Scalar_FLOAT32_IEEE 0 PubIfStateVSM_MDL_CM_single -3.4e+38 3.4e+38 /end CHARACTERISTIC
/begin CHARACTERISTIC P_VSM_LCK_State_SteerWheelSpd_enable "" VALUE 0x3B9CB8 Scalar_FLOAT32_IEEE 0 PubIfStateVSM_MDL_CM_single -3.4e+38 3.4e+38 /end CHARACTERISTIC
/begin CHARACTERISTIC P_VSM_LCK_State_TargetLaneIn_enable "" VALUE 0x3B9CBC Scalar_FLOAT32_IEEE 0 PubIfStateVSM_MDL_CM_single -3.4e+38 3.4e+38 /end CHARACTERISTIC
/begin CHARACTERISTIC P_VSM_LCK_State_TurnLight_enable "" VALUE 0x3B9CC0 Scalar_FLOAT32_IEEE 0 PubIfStateVSM_MDL_CM_single -3.4e+38 3.4e+38 /end CHARACTERISTIC
/begin CHARACTERISTIC P_VSM_LCK_State_Vehspeed_enable "" VALUE 0x3B9CC4 Scalar_FLOAT32_IEEE 0 PubIfStateVSM_MDL_CM_single -3.4e+38 3.4e+38 /end CHARACTERISTIC
/begin CHARACTERISTIC P_VSM_LCK_State_Yawsup_enable "" VALUE 0x3B9CC8 Scalar_FLOAT32_IEEE 0 PubIfStateVSM_MDL_CM_single -3.4e+38 3.4e+38 /end CHARACTERISTIC
/begin CHARACTERISTIC P_VSM_LCK_SteerAngleSpdIn "" VALUE 0x3B9CCC Scalar_FLOAT32_IEEE 0 PubIfStateVSM_MDL_CM_single -3.4e+38 3.4e+38 /end CHARACTERISTIC
/begin CHARACTERISTIC P_VSM_LCK_SteerAngleSpdInTime "" VALUE 0x3B4BA8 Scalar_FLOAT64_IEEE 0 PubIfStateVSM_MDL_CM_double -1.7e+308 1.7e+308 /end CHARACTERISTIC
/begin CHARACTERISTIC P_VSM_LCK_SteerAngleSpdOut "" VALUE 0x3B9CD0 Scalar_FLOAT32_IEEE 0 PubIfStateVSM_MDL_CM_single -3.4e+38 3.4e+38 /end CHARACTERISTIC
/begin CHARACTERISTIC P_VSM_LCK_SteerWheelAngleIn "" VALUE 0x3B9CD4 Scalar_FLOAT32_IEEE 0 PubIfStateVSM_MDL_CM_single -3.4e+38 3.4e+38 /end CHARACTERISTIC
/begin CHARACTERISTIC P_VSM_LCK_SteerWheelAngleInTime "" VALUE 0x3B4BB0 Scalar_FLOAT64_IEEE 0 PubIfStateVSM_MDL_CM_double -1.7e+308 1.7e+308 /end CHARACTERISTIC
/begin CHARACTERISTIC P_VSM_LCK_SteerWheelAngleOut "" VALUE 0x3B9CD8 Scalar_FLOAT32_IEEE 0 PubIfStateVSM_MDL_CM_single -3.4e+38 3.4e+38 /end CHARACTERISTIC
/begin CHARACTERISTIC P_VSM_LCK_T0 "" VALUE 0x3B4BB8 Scalar_FLOAT64_IEEE 0 PubIfStateVSM_MDL_CM_double -1.7e+308 1.7e+308 /end CHARACTERISTIC
/begin CHARACTERISTIC P_VSM_LCK_T1 "" VALUE 0x3B4BC0 Scalar_FLOAT64_IEEE 0 PubIfStateVSM_MDL_CM_double -1.7e+308 1.7e+308 /end CHARACTERISTIC
/begin CHARACTERISTIC P_VSM_LCK_Warnarea1 "" VALUE 0x3B9CDC Scalar_FLOAT32_IEEE 0 PubIfStateVSM_MDL_CM_single -3.4e+38 3.4e+38 /end CHARACTERISTIC
/begin CHARACTERISTIC P_VSM_LCK_Warnarea2 "" VALUE 0x3B9CE0 Scalar_FLOAT32_IEEE 0 PubIfStateVSM_MDL_CM_single -3.4e+38 3.4e+38 /end CHARACTERISTIC
/begin CHARACTERISTIC P_VSM_LCK_YawRateIn "" VALUE 0x3B9CE4 Scalar_FLOAT32_IEEE 0 PubIfStateVSM_MDL_CM_single -3.4e+38 3.4e+38 /end CHARACTERISTIC
/begin CHARACTERISTIC P_VSM_LCK_YawRateInTime "" VALUE 0x3B4BC8 Scalar_FLOAT64_IEEE 0 PubIfStateVSM_MDL_CM_double -1.7e+308 1.7e+308 /end CHARACTERISTIC
/begin CHARACTERISTIC P_VSM_LCK_YawRateOut "" VALUE 0x3B9CE8 Scalar_FLOAT32_IEEE 0 PubIfStateVSM_MDL_CM_single -3.4e+38 3.4e+38 /end CHARACTERISTIC
/begin CHARACTERISTIC P_VSM_LCK_absLongitudeAccIn "" VALUE 0x3B9CEC Scalar_FLOAT32_IEEE 0 PubIfStateVSM_MDL_CM_single -3.4e+38 3.4e+38 /end CHARACTERISTIC
/begin CHARACTERISTIC P_VSM_LCK_absLongitudeAccOut "" VALUE 0x3B9CF0 Scalar_FLOAT32_IEEE 0 PubIfStateVSM_MDL_CM_single -3.4e+38 3.4e+38 /end CHARACTERISTIC
/begin CHARACTERISTIC P_VSM_LDW_State_Param_LaneTime "" VAL_BLK 0x3B9D4C Scalar_FLOAT32_IEEE 0 PubIfStateVSM_MDL_CM_single -3.4e+38 3.4e+38 MATRIX_DIM 1 16 1 /end CHARACTERISTIC
/begin CHARACTERISTIC P_VSM_LDW_State_Param_Speed "" VAL_BLK 0x3B9DB8 Scalar_FLOAT32_IEEE 0 PubIfStateVSM_MDL_CM_single -3.4e+38 3.4e+38 MATRIX_DIM 1 16 1 /end CHARACTERISTIC
/begin CHARACTERISTIC P_VSM_SOSContinueTime "" VALUE 0x3B9F40 Scalar_UWORD 0 PubIfStateVSM_MDL_CM_uint16 0 65535 /end CHARACTERISTIC
/begin CHARACTERISTIC P_VSM_SOSSpdLimit "" VALUE 0x3CB010 Scalar_FLOAT64_IEEE 0 PubIfStateVSM_MDL_CM_double -1.7e+308 1.7e+308 /end CHARACTERISTIC
/begin MEASUREMENT VSM_ELKState "" UBYTE PubIfStateVSM_MDL_CM_uint8 0 0 0 255 ECU_ADDRESS 0x3FF6D7 /end MEASUREMENT
/begin MEASUREMENT VSM_ELK_Active2Ready "" UBYTE PubIfStateVSM_MDL_CM_boolean 0 0 0 1 BIT_MASK 0x1 ECU_ADDRESS 0x3FF7C0 /end MEASUREMENT
/begin MEASUREMENT VSM_ELK_Con_AbsEsp_Idle2Ready "" UBYTE PubIfStateVSM_MDL_CM_boolean 0 0 0 1 BIT_MASK 0x1 ECU_ADDRESS 0x3FF796 /end MEASUREMENT
/begin MEASUREMENT VSM_ELK_Con_AbsEsp_Ready2Idle "" UBYTE PubIfStateVSM_MDL_CM_boolean 0 0 0 1 BIT_MASK 0x1 ECU_ADDRESS 0x3FF7A1 /end MEASUREMENT
/begin MEASUREMENT VSM_ELK_Con_AccPedalRate_Active2Ready "" UBYTE PubIfStateVSM_MDL_CM_boolean 0 0 0 1 BIT_MASK 0x1 ECU_ADDRESS 0x3FF78B /end MEASUREMENT
/begin MEASUREMENT VSM_ELK_Con_AccPedalRate_Ready2Active "" UBYTE PubIfStateVSM_MDL_CM_boolean 0 0 0 1 BIT_MASK 0x1 ECU_ADDRESS 0x3FF7AF /end MEASUREMENT
/begin MEASUREMENT VSM_ELK_Con_BrakePressure_Active2Ready "" UBYTE PubIfStateVSM_MDL_CM_boolean 0 0 0 1 BIT_MASK 0x1 ECU_ADDRESS 0x3FF78C /end MEASUREMENT
/begin MEASUREMENT VSM_ELK_Con_BrakePressure_Ready2Active "" UBYTE PubIfStateVSM_MDL_CM_boolean 0 0 0 1 BIT_MASK 0x1 ECU_ADDRESS 0x3FF7AE /end MEASUREMENT
/begin MEASUREMENT VSM_ELK_Con_CURRENT_GEAR_Active2Ready "" UBYTE PubIfStateVSM_MDL_CM_boolean 0 0 0 1 BIT_MASK 0x1 ECU_ADDRESS 0x3FF7BE /end MEASUREMENT
/begin MEASUREMENT VSM_ELK_Con_CURRENT_GEAR_Ready2Active "" UBYTE PubIfStateVSM_MDL_CM_boolean 0 0 0 1 BIT_MASK 0x1 ECU_ADDRESS 0x3FF7B1 /end MEASUREMENT
/begin MEASUREMENT VSM_ELK_Con_DriverInput_Active2Ready "" UBYTE PubIfStateVSM_MDL_CM_boolean 0 0 0 1 BIT_MASK 0x1 ECU_ADDRESS 0x3FF7B9 /end MEASUREMENT
/begin MEASUREMENT VSM_ELK_Con_DriverInput_Ready2Active "" UBYTE PubIfStateVSM_MDL_CM_boolean 0 0 0 1 BIT_MASK 0x1 ECU_ADDRESS 0x3FF7AA /end MEASUREMENT
/begin MEASUREMENT VSM_ELK_Con_ESSSts_Idle2Ready "" UBYTE PubIfStateVSM_MDL_CM_boolean 0 0 0 1 BIT_MASK 0x1 ECU_ADDRESS 0x3FF79E /end MEASUREMENT
/begin MEASUREMENT VSM_ELK_Con_ESSSts_Ready2Idle "" UBYTE PubIfStateVSM_MDL_CM_boolean 0 0 0 1 BIT_MASK 0x1 ECU_ADDRESS 0x3FF7A7 /end MEASUREMENT
/begin MEASUREMENT VSM_ELK_Con_EpsSta_Active2Ready "" UBYTE PubIfStateVSM_MDL_CM_boolean 0 0 0 1 BIT_MASK 0x1 ECU_ADDRESS 0x3FF7BC /end MEASUREMENT
/begin MEASUREMENT VSM_ELK_Con_EpsSta_Ready2Active "" UBYTE PubIfStateVSM_MDL_CM_boolean 0 0 0 1 BIT_MASK 0x1 ECU_ADDRESS 0x3FF7B0 /end MEASUREMENT
/begin MEASUREMENT VSM_ELK_Con_Failsafe_Idle2Ready "" UBYTE PubIfStateVSM_MDL_CM_boolean 0 0 0 1 BIT_MASK 0x1 ECU_ADDRESS 0x3FF798 /end MEASUREMENT
/begin MEASUREMENT VSM_ELK_Con_Failsafe_Ready2Idle "" UBYTE PubIfStateVSM_MDL_CM_boolean 0 0 0 1 BIT_MASK 0x1 ECU_ADDRESS 0x3FF7A2 /end MEASUREMENT
/begin MEASUREMENT VSM_ELK_Con_Headingangel_Idle2Ready "" UBYTE PubIfStateVSM_MDL_CM_boolean 0 0 0 1 BIT_MASK 0x1 ECU_ADDRESS 0x3FF797 /end MEASUREMENT
/begin MEASUREMENT VSM_ELK_Con_Headingangle_Ready2Idle "" UBYTE PubIfStateVSM_MDL_CM_boolean 0 0 0 1 BIT_MASK 0x1 ECU_ADDRESS 0x3FF7A4 /end MEASUREMENT
/begin MEASUREMENT VSM_ELK_Con_LaneChange_Active2Ready "" UBYTE PubIfStateVSM_MDL_CM_boolean 0 0 0 1 BIT_MASK 0x1 ECU_ADDRESS 0x3FF7BF /end MEASUREMENT
/begin MEASUREMENT VSM_ELK_Con_LaneChange_Ready2Active "" UBYTE PubIfStateVSM_MDL_CM_boolean 0 0 0 1 BIT_MASK 0x1 ECU_ADDRESS 0x3FF7B7 /end MEASUREMENT
/begin MEASUREMENT VSM_ELK_Con_LaneCurve_Idle2Ready "" UBYTE PubIfStateVSM_MDL_CM_boolean 0 0 0 1 BIT_MASK 0x1 ECU_ADDRESS 0x3FF799 /end MEASUREMENT
/begin MEASUREMENT VSM_ELK_Con_LaneCurve_Ready2Idle "" UBYTE PubIfStateVSM_MDL_CM_boolean 0 0 0 1 BIT_MASK 0x1 ECU_ADDRESS 0x3FF7A3 /end MEASUREMENT
/begin MEASUREMENT VSM_ELK_Con_Lane_Idle2Ready "" UBYTE PubIfStateVSM_MDL_CM_boolean 0 0 0 1 BIT_MASK 0x1 ECU_ADDRESS 0x3FF79D /end MEASUREMENT
/begin MEASUREMENT VSM_ELK_Con_Lane_Ready2Idle "" UBYTE PubIfStateVSM_MDL_CM_boolean 0 0 0 1 BIT_MASK 0x1 ECU_ADDRESS 0x3FF7A6 /end MEASUREMENT
/begin MEASUREMENT VSM_ELK_Con_LateralAcc_Active2Ready "" UBYTE PubIfStateVSM_MDL_CM_boolean 0 0 0 1 BIT_MASK 0x1 ECU_ADDRESS 0x3FF7BA /end MEASUREMENT
/begin MEASUREMENT VSM_ELK_Con_LateralAcc_Ready2Active "" UBYTE PubIfStateVSM_MDL_CM_boolean 0 0 0 1 BIT_MASK 0x1 ECU_ADDRESS 0x3FF7AC /end MEASUREMENT
/begin MEASUREMENT VSM_ELK_Con_LongitudeAcc_Active2Ready "" UBYTE PubIfStateVSM_MDL_CM_boolean 0 0 0 1 BIT_MASK 0x1 ECU_ADDRESS 0x3FF7BB /end MEASUREMENT
/begin MEASUREMENT VSM_ELK_Con_LongitudeAcc_Ready2Active "" UBYTE PubIfStateVSM_MDL_CM_boolean 0 0 0 1 BIT_MASK 0x1 ECU_ADDRESS 0x3FF7AD /end MEASUREMENT
/begin MEASUREMENT VSM_ELK_Con_OverRide_Active2Ready "" UBYTE PubIfStateVSM_MDL_CM_boolean 0 0 0 1 BIT_MASK 0x1 ECU_ADDRESS 0x3FF7BD /end MEASUREMENT
/begin MEASUREMENT VSM_ELK_Con_Override_Ready2Active "" UBYTE PubIfStateVSM_MDL_CM_boolean 0 0 0 1 BIT_MASK 0x1 ECU_ADDRESS 0x3FF7B2 /end MEASUREMENT
/begin MEASUREMENT VSM_ELK_Con_SteerWheelAngle_Active2Ready "" UBYTE PubIfStateVSM_MDL_CM_boolean 0 0 0 1 BIT_MASK 0x1 ECU_ADDRESS 0x3FF78D /end MEASUREMENT
/begin MEASUREMENT VSM_ELK_Con_SteerWheelAngle_Ready2Active "" UBYTE PubIfStateVSM_MDL_CM_boolean 0 0 0 1 BIT_MASK 0x1 ECU_ADDRESS 0x3FF7A9 /end MEASUREMENT
/begin MEASUREMENT VSM_ELK_Con_SteerWheelSpd_Active2Ready "" UBYTE PubIfStateVSM_MDL_CM_boolean 0 0 0 1 BIT_MASK 0x1 ECU_ADDRESS 0x3FF78E /end MEASUREMENT
/begin MEASUREMENT VSM_ELK_Con_SteerWheelSpd_Ready2Active "" UBYTE PubIfStateVSM_MDL_CM_boolean 0 0 0 1 BIT_MASK 0x1 ECU_ADDRESS 0x3FF7AB /end MEASUREMENT
/begin MEASUREMENT VSM_ELK_Con_VehicleSpeed_Idle2ReadyELK "" UBYTE PubIfStateVSM_MDL_CM_boolean 0 0 0 1 BIT_MASK 0x1 ECU_ADDRESS 0x3FF79A /end MEASUREMENT
/begin MEASUREMENT VSM_ELK_Con_VehicleSpeed_Ready2Idle "" UBYTE PubIfStateVSM_MDL_CM_boolean 0 0 0 1 BIT_MASK 0x1 ECU_ADDRESS 0x3FF7A5 /end MEASUREMENT
/begin MEASUREMENT VSM_ELK_Con_YawRate_Idle2Ready "" UBYTE PubIfStateVSM_MDL_CM_boolean 0 0 0 1 BIT_MASK 0x1 ECU_ADDRESS 0x3FF795 /end MEASUREMENT
/begin MEASUREMENT VSM_ELK_Con_YawRate_Ready2Idle "" UBYTE PubIfStateVSM_MDL_CM_boolean 0 0 0 1 BIT_MASK 0x1 ECU_ADDRESS 0x3FF7A0 /end MEASUREMENT
/begin MEASUREMENT VSM_ELK_Counter "" UBYTE PubIfStateVSM_MDL_CM_uint8 0 0 0 255 ECU_ADDRESS 0x3FF6D8 /end MEASUREMENT
/begin MEASUREMENT VSM_ELK_Idle2Ready "" UBYTE PubIfStateVSM_MDL_CM_boolean 0 0 0 1 BIT_MASK 0x1 ECU_ADDRESS 0x3FF79F /end MEASUREMENT
/begin MEASUREMENT VSM_ELK_Lane_valid "" UBYTE PubIfStateVSM_MDL_CM_boolean 0 0 0 1 BIT_MASK 0x1 ECU_ADDRESS 0x3FF79B /end MEASUREMENT
/begin MEASUREMENT VSM_ELK_Lwidth_Valid "" UBYTE PubIfStateVSM_MDL_CM_boolean 0 0 0 1 BIT_MASK 0x1 ECU_ADDRESS 0x3FF79C /end MEASUREMENT
/begin MEASUREMENT VSM_ELK_OnComing_LOnComing "" UBYTE PubIfStateVSM_MDL_CM_boolean 0 0 0 1 BIT_MASK 0x1 ECU_ADDRESS 0x3FF7EE /end MEASUREMENT
/begin MEASUREMENT VSM_ELK_OnComing_LOut "" UBYTE PubIfStateVSM_MDL_CM_boolean 0 0 0 1 BIT_MASK 0x1 ECU_ADDRESS 0x3FF86A /end MEASUREMENT
/begin MEASUREMENT VSM_ELK_OnComing_LetfCondition "" UBYTE PubIfStateVSM_MDL_CM_boolean 0 0 0 1 BIT_MASK 0x1 ECU_ADDRESS 0x3FF7F2 /end MEASUREMENT
/begin MEASUREMENT VSM_ELK_OnComing_Llateral "" FLOAT32_IEEE PubIfStateVSM_MDL_CM_single 0 0 -3.4e+38 3.4e+38 ECU_ADDRESS 0x3FF69C /end MEASUREMENT
/begin MEASUREMENT VSM_ELK_OnComing_Lttc "" UBYTE PubIfStateVSM_MDL_CM_boolean 0 0 0 1 BIT_MASK 0x1 ECU_ADDRESS 0x3FF7EF /end MEASUREMENT
/begin MEASUREMENT VSM_ELK_OnComing_Lv_re "" FLOAT32_IEEE PubIfStateVSM_MDL_CM_single 0 0 -3.4e+38 3.4e+38 ECU_ADDRESS 0x3FF698 /end MEASUREMENT
/begin MEASUREMENT VSM_ELK_OnComing_ROnComing "" UBYTE PubIfStateVSM_MDL_CM_boolean 0 0 0 1 BIT_MASK 0x1 ECU_ADDRESS 0x3FF7F0 /end MEASUREMENT
/begin MEASUREMENT VSM_ELK_OnComing_ROut "" UBYTE PubIfStateVSM_MDL_CM_boolean 0 0 0 1 BIT_MASK 0x1 ECU_ADDRESS 0x3FF86B /end MEASUREMENT
/begin MEASUREMENT VSM_ELK_OnComing_RightCondition "" UBYTE PubIfStateVSM_MDL_CM_boolean 0 0 0 1 BIT_MASK 0x1 ECU_ADDRESS 0x3FF7F3 /end MEASUREMENT
/begin MEASUREMENT VSM_ELK_OnComing_Rlateral "" FLOAT32_IEEE PubIfStateVSM_MDL_CM_single 0 0 -3.4e+38 3.4e+38 ECU_ADDRESS 0x3FF694 /end MEASUREMENT
/begin MEASUREMENT VSM_ELK_OnComing_Rttc "" UBYTE PubIfStateVSM_MDL_CM_boolean 0 0 0 1 BIT_MASK 0x1 ECU_ADDRESS 0x3FF7F1 /end MEASUREMENT
/begin MEASUREMENT VSM_ELK_OnComing_Rv_re "" FLOAT32_IEEE PubIfStateVSM_MDL_CM_single 0 0 -3.4e+38 3.4e+38 ECU_ADDRESS 0x3FF690 /end MEASUREMENT
/begin MEASUREMENT VSM_ELK_Other2Idle "" UBYTE PubIfStateVSM_MDL_CM_boolean 0 0 0 1 BIT_MASK 0x1 ECU_ADDRESS 0x3FF7A8 /end MEASUREMENT
/begin MEASUREMENT VSM_ELK_OverTaking_LLateral "" UBYTE PubIfStateVSM_MDL_CM_boolean 0 0 0 1 BIT_MASK 0x1 ECU_ADDRESS 0x3FF7F4 /end MEASUREMENT
/begin MEASUREMENT VSM_ELK_OverTaking_LOut "" UBYTE PubIfStateVSM_MDL_CM_boolean 0 0 0 1 BIT_MASK 0x1 ECU_ADDRESS 0x3FF866 /end MEASUREMENT
/begin MEASUREMENT VSM_ELK_OverTaking_LeftCondition "" UBYTE PubIfStateVSM_MDL_CM_boolean 0 0 0 1 BIT_MASK 0x1 ECU_ADDRESS 0x3FF7F6 /end MEASUREMENT
/begin MEASUREMENT VSM_ELK_OverTaking_RLateral "" UBYTE PubIfStateVSM_MDL_CM_boolean 0 0 0 1 BIT_MASK 0x1 ECU_ADDRESS 0x3FF7F5 /end MEASUREMENT
/begin MEASUREMENT VSM_ELK_OverTaking_ROut "" UBYTE PubIfStateVSM_MDL_CM_boolean 0 0 0 1 BIT_MASK 0x1 ECU_ADDRESS 0x3FF867 /end MEASUREMENT
/begin MEASUREMENT VSM_ELK_OverTaking_RightCondition "" UBYTE PubIfStateVSM_MDL_CM_boolean 0 0 0 1 BIT_MASK 0x1 ECU_ADDRESS 0x3FF7F7 /end MEASUREMENT
/begin MEASUREMENT VSM_ELK_OverTaking_leftcar "" UBYTE PubIfStateVSM_MDL_CM_boolean 0 0 0 1 BIT_MASK 0x1 ECU_ADDRESS 0x3FF869 /end MEASUREMENT
/begin MEASUREMENT VSM_ELK_OverTaking_rightcar "" UBYTE PubIfStateVSM_MDL_CM_boolean 0 0 0 1 BIT_MASK 0x1 ECU_ADDRESS 0x3FF868 /end MEASUREMENT
/begin MEASUREMENT VSM_ELK_Ready2Active "" UBYTE PubIfStateVSM_MDL_CM_boolean 0 0 0 1 BIT_MASK 0x1 ECU_ADDRESS 0x3FF7B8 /end MEASUREMENT
/begin MEASUREMENT VSM_ELK_VehConfigELK "" UBYTE PubIfStateVSM_MDL_CM_uint8 0 0 0 255 ECU_ADDRESS 0x3FF6CB /end MEASUREMENT
/begin MEASUREMENT VSM_ELK_Warning "" FLOAT32_IEEE PubIfStateVSM_MDL_CM_single 0 0 -3.4e+38 3.4e+38 ECU_ADDRESS 0x3FF68C /end MEASUREMENT
/begin MEASUREMENT VSM_ESS_ACTIVE2IDLE "" UBYTE PubIfStateVSM_MDL_CM_boolean 0 0 0 1 BIT_MASK 0x1 ECU_ADDRESS 0x3FF761 /end MEASUREMENT
/begin MEASUREMENT VSM_ESS_AEBFlag_READY2ACTIVE "" UBYTE PubIfStateVSM_MDL_CM_boolean 0 0 0 1 BIT_MASK 0x1 ECU_ADDRESS 0x3FF755 /end MEASUREMENT
/begin MEASUREMENT VSM_ESS_AEBTrigFlag_ACTIVE2IDLE "" UBYTE PubIfStateVSM_MDL_CM_boolean 0 0 0 1 BIT_MASK 0x1 ECU_ADDRESS 0x3FF75E /end MEASUREMENT
/begin MEASUREMENT VSM_ESS_AEBVehFlag_Ready2Active "" UBYTE PubIfStateVSM_MDL_CM_boolean 0 0 0 1 BIT_MASK 0x1 ECU_ADDRESS 0x3FF753 /end MEASUREMENT
/begin MEASUREMENT VSM_ESS_AEBVruFlag_Ready2Active "" UBYTE PubIfStateVSM_MDL_CM_boolean 0 0 0 1 BIT_MASK 0x1 ECU_ADDRESS 0x3FF754 /end MEASUREMENT
/begin MEASUREMENT VSM_ESS_AccelPed_READY2ACTIVE "" UBYTE PubIfStateVSM_MDL_CM_boolean 0 0 0 1 BIT_MASK 0x1 ECU_ADDRESS 0x3FF756 /end MEASUREMENT
/begin MEASUREMENT VSM_ESS_DPC_L_Active2Ready "" UBYTE PubIfStateVSM_MDL_CM_boolean 0 0 0 1 BIT_MASK 0x1 ECU_ADDRESS 0x3FF762 /end MEASUREMENT
/begin MEASUREMENT VSM_ESS_DPC_R_Active2Ready "" UBYTE PubIfStateVSM_MDL_CM_boolean 0 0 0 1 BIT_MASK 0x1 ECU_ADDRESS 0x3FF769 /end MEASUREMENT
/begin MEASUREMENT VSM_ESS_DangerPlausLeft_Ready2Active "" UBYTE PubIfStateVSM_MDL_CM_boolean 0 0 0 1 BIT_MASK 0x1 ECU_ADDRESS 0x3FF770 /end MEASUREMENT
/begin MEASUREMENT VSM_ESS_DangerPlausRight_Ready2Active "" UBYTE PubIfStateVSM_MDL_CM_boolean 0 0 0 1 BIT_MASK 0x1 ECU_ADDRESS 0x3FF776 /end MEASUREMENT
/begin MEASUREMENT VSM_ESS_DoorSts_ACTIVE2IDLE "" UBYTE PubIfStateVSM_MDL_CM_boolean 0 0 0 1 BIT_MASK 0x1 ECU_ADDRESS 0x3FF75C /end MEASUREMENT
/begin MEASUREMENT VSM_ESS_DoorSts_IDLE2READY "" UBYTE PubIfStateVSM_MDL_CM_boolean 0 0 0 1 BIT_MASK 0x1 ECU_ADDRESS 0x3FF73E /end MEASUREMENT
/begin MEASUREMENT VSM_ESS_DoorSts_READY2IDLE "" UBYTE PubIfStateVSM_MDL_CM_boolean 0 0 0 1 BIT_MASK 0x1 ECU_ADDRESS 0x3FF748 /end MEASUREMENT
/begin MEASUREMENT VSM_ESS_DrvOver_Active2Ready "" UBYTE PubIfStateVSM_MDL_CM_boolean 0 0 0 1 BIT_MASK 0x1 ECU_ADDRESS 0x3FF765 /end MEASUREMENT
/begin MEASUREMENT VSM_ESS_DrvSBR_ACTIVE2IDLE "" UBYTE PubIfStateVSM_MDL_CM_boolean 0 0 0 1 BIT_MASK 0x1 ECU_ADDRESS 0x3FF75D /end MEASUREMENT
/begin MEASUREMENT VSM_ESS_DrvSBR_IDLE2READY "" UBYTE PubIfStateVSM_MDL_CM_boolean 0 0 0 1 BIT_MASK 0x1 ECU_ADDRESS 0x3FF73F /end MEASUREMENT
/begin MEASUREMENT VSM_ESS_DrvSBR_READY2IDLE "" UBYTE PubIfStateVSM_MDL_CM_boolean 0 0 0 1 BIT_MASK 0x1 ECU_ADDRESS 0x3FF749 /end MEASUREMENT
/begin MEASUREMENT VSM_ESS_ESPActive_ACTIVE2IDLE "" UBYTE PubIfStateVSM_MDL_CM_boolean 0 0 0 1 BIT_MASK 0x1 ECU_ADDRESS 0x3FF759 /end MEASUREMENT
/begin MEASUREMENT VSM_ESS_ESPActive_IDLE2READY "" UBYTE PubIfStateVSM_MDL_CM_boolean 0 0 0 1 BIT_MASK 0x1 ECU_ADDRESS 0x3FF743 /end MEASUREMENT
/begin MEASUREMENT VSM_ESS_ESPActive_READY2IDLE "" UBYTE PubIfStateVSM_MDL_CM_boolean 0 0 0 1 BIT_MASK 0x1 ECU_ADDRESS 0x3FF74D /end MEASUREMENT
/begin MEASUREMENT VSM_ESS_ESPFuncOffSts_ACTIVE2IDLE "" UBYTE PubIfStateVSM_MDL_CM_boolean 0 0 0 1 BIT_MASK 0x1 ECU_ADDRESS 0x3FF75B /end MEASUREMENT
/begin MEASUREMENT VSM_ESS_ESPFuncOffSts_IDLE2READY "" UBYTE PubIfStateVSM_MDL_CM_boolean 0 0 0 1 BIT_MASK 0x1 ECU_ADDRESS 0x3FF73D /end MEASUREMENT
/begin MEASUREMENT VSM_ESS_ESPFuncOffSts_READY2IDLE "" UBYTE PubIfStateVSM_MDL_CM_boolean 0 0 0 1 BIT_MASK 0x1 ECU_ADDRESS 0x3FF747 /end MEASUREMENT
/begin MEASUREMENT VSM_ESS_FcwDisFlag_Ready2Active "" UBYTE PubIfStateVSM_MDL_CM_boolean 0 0 0 1 BIT_MASK 0x1 ECU_ADDRESS 0x3FF751 /end MEASUREMENT
/begin MEASUREMENT VSM_ESS_FcwFlag_READY2ACTIVE "" UBYTE PubIfStateVSM_MDL_CM_boolean 0 0 0 1 BIT_MASK 0x1 ECU_ADDRESS 0x3FF752 /end MEASUREMENT
/begin MEASUREMENT VSM_ESS_FcwWarn_Ready2Active "" UBYTE PubIfStateVSM_MDL_CM_boolean 0 0 0 1 BIT_MASK 0x1 ECU_ADDRESS 0x3FF750 /end MEASUREMENT
/begin MEASUREMENT VSM_ESS_HiLoBeam_IDLE2READY "" UBYTE PubIfStateVSM_MDL_CM_boolean 0 0 0 1 BIT_MASK 0x1 ECU_ADDRESS 0x3FF742 /end MEASUREMENT
/begin MEASUREMENT VSM_ESS_HiLoBeam_READY2IDLE "" UBYTE PubIfStateVSM_MDL_CM_boolean 0 0 0 1 BIT_MASK 0x1 ECU_ADDRESS 0x3FF74C /end MEASUREMENT
/begin MEASUREMENT VSM_ESS_IDLE2READY "" UBYTE PubIfStateVSM_MDL_CM_boolean 0 0 0 1 BIT_MASK 0x1 ECU_ADDRESS 0x3FF745 /end MEASUREMENT
/begin MEASUREMENT VSM_ESS_LValid_Active2Ready "" UBYTE PubIfStateVSM_MDL_CM_boolean 0 0 0 1 BIT_MASK 0x1 ECU_ADDRESS 0x3FF767 /end MEASUREMENT
/begin MEASUREMENT VSM_ESS_L_ACTIVE2READY "" UBYTE PubIfStateVSM_MDL_CM_boolean 0 0 0 1 BIT_MASK 0x1 ECU_ADDRESS 0x3FF768 /end MEASUREMENT
/begin MEASUREMENT VSM_ESS_L_Oncoming_Active2Ready "" UBYTE PubIfStateVSM_MDL_CM_boolean 0 0 0 1 BIT_MASK 0x1 ECU_ADDRESS 0x3FF766 /end MEASUREMENT
/begin MEASUREMENT VSM_ESS_L_SteerWheelSpdSign_Ready2Active "" UBYTE PubIfStateVSM_MDL_CM_boolean 0 0 0 1 BIT_MASK 0x1 ECU_ADDRESS 0x3FF76D /end MEASUREMENT
/begin MEASUREMENT VSM_ESS_LateralAccel_ACTIVE2IDLE "" UBYTE PubIfStateVSM_MDL_CM_boolean 0 0 0 1 BIT_MASK 0x1 ECU_ADDRESS 0x3FF75A /end MEASUREMENT
/begin MEASUREMENT VSM_ESS_LateralAccel_IDLE2READY "" UBYTE PubIfStateVSM_MDL_CM_boolean 0 0 0 1 BIT_MASK 0x1 ECU_ADDRESS 0x3FF744 /end MEASUREMENT
/begin MEASUREMENT VSM_ESS_LateralAccel_READY2IDLE "" UBYTE PubIfStateVSM_MDL_CM_boolean 0 0 0 1 BIT_MASK 0x1 ECU_ADDRESS 0x3FF74E /end MEASUREMENT
/begin MEASUREMENT VSM_ESS_LeftOncoming_Ready2Active "" UBYTE PubIfStateVSM_MDL_CM_boolean 0 0 0 1 BIT_MASK 0x1 ECU_ADDRESS 0x3FF76F /end MEASUREMENT
/begin MEASUREMENT VSM_ESS_Left_READY2ACTIVE "" UBYTE PubIfStateVSM_MDL_CM_boolean 0 0 0 1 BIT_MASK 0x1 ECU_ADDRESS 0x3FF772 /end MEASUREMENT
/begin MEASUREMENT VSM_ESS_LineA0_Active2Ready "" UBYTE PubIfStateVSM_MDL_CM_boolean 0 0 0 1 BIT_MASK 0x1 ECU_ADDRESS 0x3FF764 /end MEASUREMENT
/begin MEASUREMENT VSM_ESS_LineA1_Active2Ready "" UBYTE PubIfStateVSM_MDL_CM_boolean 0 0 0 1 BIT_MASK 0x1 ECU_ADDRESS 0x3FF763 /end MEASUREMENT
/begin MEASUREMENT VSM_ESS_LineLValid_Ready2Active "" UBYTE PubIfStateVSM_MDL_CM_boolean 0 0 0 1 BIT_MASK 0x1 ECU_ADDRESS 0x3FF76E /end MEASUREMENT
/begin MEASUREMENT VSM_ESS_LineRValid_Ready2Active "" UBYTE PubIfStateVSM_MDL_CM_boolean 0 0 0 1 BIT_MASK 0x1 ECU_ADDRESS 0x3FF774 /end MEASUREMENT
/begin MEASUREMENT VSM_ESS_MasterCylindBrakePress_ACTIVE2IDLE "" UBYTE PubIfStateVSM_MDL_CM_boolean 0 0 0 1 BIT_MASK 0x1 ECU_ADDRESS 0x3FF760 /end MEASUREMENT
/begin MEASUREMENT VSM_ESS_READY2ACTIVE "" UBYTE PubIfStateVSM_MDL_CM_boolean 0 0 0 1 BIT_MASK 0x1 ECU_ADDRESS 0x3FF758 /end MEASUREMENT
/begin MEASUREMENT VSM_ESS_READY2IDLE "" UBYTE PubIfStateVSM_MDL_CM_boolean 0 0 0 1 BIT_MASK 0x1 ECU_ADDRESS 0x3FF74F /end MEASUREMENT
/begin MEASUREMENT VSM_ESS_RValid_Active2Ready "" UBYTE PubIfStateVSM_MDL_CM_boolean 0 0 0 1 BIT_MASK 0x1 ECU_ADDRESS 0x3FF76B /end MEASUREMENT
/begin MEASUREMENT VSM_ESS_R_ACTIVE2READY "" UBYTE PubIfStateVSM_MDL_CM_boolean 0 0 0 1 BIT_MASK 0x1 ECU_ADDRESS 0x3FF76C /end MEASUREMENT
/begin MEASUREMENT VSM_ESS_R_Oncoming_Active2Ready "" UBYTE PubIfStateVSM_MDL_CM_boolean 0 0 0 1 BIT_MASK 0x1 ECU_ADDRESS 0x3FF76A /end MEASUREMENT
/begin MEASUREMENT VSM_ESS_R_SteerWheelSpdSign_Ready2Active "" UBYTE PubIfStateVSM_MDL_CM_boolean 0 0 0 1 BIT_MASK 0x1 ECU_ADDRESS 0x3FF773 /end MEASUREMENT
/begin MEASUREMENT VSM_ESS_RightOncoming_Ready2Active "" UBYTE PubIfStateVSM_MDL_CM_boolean 0 0 0 1 BIT_MASK 0x1 ECU_ADDRESS 0x3FF775 /end MEASUREMENT
/begin MEASUREMENT VSM_ESS_Right_READY2ACTIVE "" UBYTE PubIfStateVSM_MDL_CM_boolean 0 0 0 1 BIT_MASK 0x1 ECU_ADDRESS 0x3FF777 /end MEASUREMENT
/begin MEASUREMENT VSM_ESS_SteerWheelSpd_READY2ACTIVE "" UBYTE PubIfStateVSM_MDL_CM_boolean 0 0 0 1 BIT_MASK 0x1 ECU_ADDRESS 0x3FF771 /end MEASUREMENT
/begin MEASUREMENT VSM_ESS_TrailerSts_IDLE2READY "" UBYTE PubIfStateVSM_MDL_CM_boolean 0 0 0 1 BIT_MASK 0x1 ECU_ADDRESS 0x3FF740 /end MEASUREMENT
/begin MEASUREMENT VSM_ESS_TrailerSts_READY2IDLE "" UBYTE PubIfStateVSM_MDL_CM_boolean 0 0 0 1 BIT_MASK 0x1 ECU_ADDRESS 0x3FF74A /end MEASUREMENT
/begin MEASUREMENT VSM_ESS_VehLgtAccel_READY2ACTIVE "" UBYTE PubIfStateVSM_MDL_CM_boolean 0 0 0 1 BIT_MASK 0x1 ECU_ADDRESS 0x3FF757 /end MEASUREMENT
/begin MEASUREMENT VSM_ESS_VehicleSpd_ACTIVE2IDLE "" UBYTE PubIfStateVSM_MDL_CM_boolean 0 0 0 1 BIT_MASK 0x1 ECU_ADDRESS 0x3FF75F /end MEASUREMENT
/begin MEASUREMENT VSM_ESS_VehicleSpd_IDLE2READY "" UBYTE PubIfStateVSM_MDL_CM_boolean 0 0 0 1 BIT_MASK 0x1 ECU_ADDRESS 0x3FF73C /end MEASUREMENT
/begin MEASUREMENT VSM_ESS_VehicleSpd_READY2IDLE "" UBYTE PubIfStateVSM_MDL_CM_boolean 0 0 0 1 BIT_MASK 0x1 ECU_ADDRESS 0x3FF746 /end MEASUREMENT
/begin MEASUREMENT VSM_ESS_WiprReq_IDLE2READY "" UBYTE PubIfStateVSM_MDL_CM_boolean 0 0 0 1 BIT_MASK 0x1 ECU_ADDRESS 0x3FF741 /end MEASUREMENT
/begin MEASUREMENT VSM_ESS_WiprReq_READY2IDLE "" UBYTE PubIfStateVSM_MDL_CM_boolean 0 0 0 1 BIT_MASK 0x1 ECU_ADDRESS 0x3FF74B /end MEASUREMENT
/begin MEASUREMENT VSM_FLWhelDy "" FLOAT32_IEEE PubIfStateVSM_MDL_CM_single 0 0 -3.4e+38 3.4e+38 ECU_ADDRESS 0x3FF5B0 /end MEASUREMENT
/begin MEASUREMENT VSM_FRWhelDy "" FLOAT32_IEEE PubIfStateVSM_MDL_CM_single 0 0 -3.4e+38 3.4e+38 ECU_ADDRESS 0x3FF5B4 /end MEASUREMENT
/begin MEASUREMENT VSM_HOD_DrvTrqFilted "" FLOAT32_IEEE PubIfStateVSM_MDL_CM_single 0 0 -3.4e+38 3.4e+38 ECU_ADDRESS 0x3FF57C /end MEASUREMENT
/begin MEASUREMENT VSM_LCKIE_State "" UBYTE PubIfStateVSM_MDL_CM_uint8 0 0 0 255 ECU_ADDRESS 0x3FF6DB /end MEASUREMENT
/begin MEASUREMENT VSM_LCKIE_SubModel_Number "" UWORD PubIfStateVSM_MDL_CM_uint16 0 0 0 65535 ECU_ADDRESS 0x3FF6B8 /end MEASUREMENT
/begin MEASUREMENT VSM_LCKIE_SubModel_VERSION "" ULONG PubIfStateVSM_MDL_CM_uint32 0 0 0 4294967295 ECU_ADDRESS 0x3FF568 /end MEASUREMENT
/begin MEASUREMENT VSM_LCKState "" UBYTE PubIfStateVSM_MDL_CM_uint8 0 0 0 255 ECU_ADDRESS 0x3FF6D9 /end MEASUREMENT
/begin MEASUREMENT VSM_LCK_Active2Ready "" UBYTE PubIfStateVSM_MDL_CM_boolean 0 0 0 1 BIT_MASK 0x1 ECU_ADDRESS 0x3FF81E /end MEASUREMENT
/begin MEASUREMENT VSM_LCK_Con_AbsEsp_Idle2Ready "" UBYTE PubIfStateVSM_MDL_CM_boolean 0 0 0 1 BIT_MASK 0x1 ECU_ADDRESS 0x3FF7FD /end MEASUREMENT
/begin MEASUREMENT VSM_LCK_Con_AbsEsp_Ready2Idle "" UBYTE PubIfStateVSM_MDL_CM_boolean 0 0 0 1 BIT_MASK 0x1 ECU_ADDRESS 0x3FF802 /end MEASUREMENT
/begin MEASUREMENT VSM_LCK_Con_AccPedalRate_Active2Ready "" UBYTE PubIfStateVSM_MDL_CM_boolean 0 0 0 1 BIT_MASK 0x1 ECU_ADDRESS 0x3FF78F /end MEASUREMENT
/begin MEASUREMENT VSM_LCK_Con_AccPedalRate_Ready2Active "" UBYTE PubIfStateVSM_MDL_CM_boolean 0 0 0 1 BIT_MASK 0x1 ECU_ADDRESS 0x3FF80E /end MEASUREMENT
/begin MEASUREMENT VSM_LCK_Con_BrakePress_Active2Ready "" UBYTE PubIfStateVSM_MDL_CM_boolean 0 0 0 1 BIT_MASK 0x1 ECU_ADDRESS 0x3FF790 /end MEASUREMENT
/begin MEASUREMENT VSM_LCK_Con_BrakePress_Ready2Active "" UBYTE PubIfStateVSM_MDL_CM_boolean 0 0 0 1 BIT_MASK 0x1 ECU_ADDRESS 0x3FF80D /end MEASUREMENT
/begin MEASUREMENT VSM_LCK_Con_CURRENT_GEAR_Active2Ready "" UBYTE PubIfStateVSM_MDL_CM_boolean 0 0 0 1 BIT_MASK 0x1 ECU_ADDRESS 0x3FF81C /end MEASUREMENT
/begin MEASUREMENT VSM_LCK_Con_CURRENT_GEAR_Ready2Active "" UBYTE PubIfStateVSM_MDL_CM_boolean 0 0 0 1 BIT_MASK 0x1 ECU_ADDRESS 0x3FF813 /end MEASUREMENT
/begin MEASUREMENT VSM_LCK_Con_DriverInput_Active2Ready "" UBYTE PubIfStateVSM_MDL_CM_boolean 0 0 0 1 BIT_MASK 0x1 ECU_ADDRESS 0x3FF780 /end MEASUREMENT
/begin MEASUREMENT VSM_LCK_Con_DrvInputTrqValue_Ready2Active "" UBYTE PubIfStateVSM_MDL_CM_boolean 0 0 0 1 BIT_MASK 0x1 ECU_ADDRESS 0x3FF810 /end MEASUREMENT
/begin MEASUREMENT VSM_LCK_Con_ESSSts_Idle2Ready "" UBYTE PubIfStateVSM_MDL_CM_boolean 0 0 0 1 BIT_MASK 0x1 ECU_ADDRESS 0x3FF7F8 /end MEASUREMENT
/begin MEASUREMENT VSM_LCK_Con_ESSSts_Ready2Idle "" UBYTE PubIfStateVSM_MDL_CM_boolean 0 0 0 1 BIT_MASK 0x1 ECU_ADDRESS 0x3FF7FE /end MEASUREMENT
/begin MEASUREMENT VSM_LCK_Con_EpsSta_Active2Ready "" UBYTE PubIfStateVSM_MDL_CM_boolean 0 0 0 1 BIT_MASK 0x1 ECU_ADDRESS 0x3FF819 /end MEASUREMENT
/begin MEASUREMENT VSM_LCK_Con_EpsSts_Ready2Active "" UBYTE PubIfStateVSM_MDL_CM_boolean 0 0 0 1 BIT_MASK 0x1 ECU_ADDRESS 0x3FF815 /end MEASUREMENT
/begin MEASUREMENT VSM_LCK_Con_HandsOff_Ready2Idle "" UBYTE PubIfStateVSM_MDL_CM_boolean 0 0 0 1 BIT_MASK 0x1 ECU_ADDRESS 0x3FF7FB /end MEASUREMENT
/begin MEASUREMENT VSM_LCK_Con_Handson_Idle2Ready "" UBYTE PubIfStateVSM_MDL_CM_boolean 0 0 0 1 BIT_MASK 0x1 ECU_ADDRESS 0x3FF7FC /end MEASUREMENT
/begin MEASUREMENT VSM_LCK_Con_InTime_Idle2Ready "" UBYTE PubIfStateVSM_MDL_CM_boolean 0 0 0 1 BIT_MASK 0x1 ECU_ADDRESS 0x3FF805 /end MEASUREMENT
/begin MEASUREMENT VSM_LCK_Con_LSMLine_Idle2Ready "" UBYTE PubIfStateVSM_MDL_CM_boolean 0 0 0 1 BIT_MASK 0x1 ECU_ADDRESS 0x3FF809 /end MEASUREMENT
/begin MEASUREMENT VSM_LCK_Con_LSMLine_Ready2Idle "" UBYTE PubIfStateVSM_MDL_CM_boolean 0 0 0 1 BIT_MASK 0x1 ECU_ADDRESS 0x3FF801 /end MEASUREMENT
/begin MEASUREMENT VSM_LCK_Con_LaneChange_Active2Ready "" UBYTE PubIfStateVSM_MDL_CM_boolean 0 0 0 1 BIT_MASK 0x1 ECU_ADDRESS 0x3FF81D /end MEASUREMENT
/begin MEASUREMENT VSM_LCK_Con_LaneChange_Ready2Active "" UBYTE PubIfStateVSM_MDL_CM_boolean 0 0 0 1 BIT_MASK 0x1 ECU_ADDRESS 0x3FF816 /end MEASUREMENT
/begin MEASUREMENT VSM_LCK_Con_LaneCurve_Idle2Ready "" UBYTE PubIfStateVSM_MDL_CM_boolean 0 0 0 1 BIT_MASK 0x1 ECU_ADDRESS 0x3FF806 /end MEASUREMENT
/begin MEASUREMENT VSM_LCK_Con_LaneCurve_Ready2Idle "" UBYTE PubIfStateVSM_MDL_CM_boolean 0 0 0 1 BIT_MASK 0x1 ECU_ADDRESS 0x3FF803 /end MEASUREMENT
/begin MEASUREMENT VSM_LCK_Con_Lane_Idle2Ready "" UBYTE PubIfStateVSM_MDL_CM_boolean 0 0 0 1 BIT_MASK 0x1 ECU_ADDRESS 0x3FF85E /end MEASUREMENT
/begin MEASUREMENT VSM_LCK_Con_Lane_Ready2Idle "" UBYTE PubIfStateVSM_MDL_CM_boolean 0 0 0 1 BIT_MASK 0x1 ECU_ADDRESS 0x3FF860 /end MEASUREMENT
/begin MEASUREMENT VSM_LCK_Con_LateralAcc_Active2Ready "" UBYTE PubIfStateVSM_MDL_CM_boolean 0 0 0 1 BIT_MASK 0x1 ECU_ADDRESS 0x3FF81A /end MEASUREMENT
/begin MEASUREMENT VSM_LCK_Con_LateralAcc_Ready2Active "" UBYTE PubIfStateVSM_MDL_CM_boolean 0 0 0 1 BIT_MASK 0x1 ECU_ADDRESS 0x3FF811 /end MEASUREMENT
/begin MEASUREMENT VSM_LCK_Con_LongitudeAcc_Active2Ready "" UBYTE PubIfStateVSM_MDL_CM_boolean 0 0 0 1 BIT_MASK 0x1 ECU_ADDRESS 0x3FF81B /end MEASUREMENT
/begin MEASUREMENT VSM_LCK_Con_LongitudeAcc_Ready2Active "" UBYTE PubIfStateVSM_MDL_CM_boolean 0 0 0 1 BIT_MASK 0x1 ECU_ADDRESS 0x3FF812 /end MEASUREMENT
/begin MEASUREMENT VSM_LCK_Con_OverRide_Active2Ready "" UBYTE PubIfStateVSM_MDL_CM_boolean 0 0 0 1 BIT_MASK 0x1 ECU_ADDRESS 0x3FF77E /end MEASUREMENT
/begin MEASUREMENT VSM_LCK_Con_OverRide_Ready2Active "" UBYTE PubIfStateVSM_MDL_CM_boolean 0 0 0 1 BIT_MASK 0x1 ECU_ADDRESS 0x3FF814 /end MEASUREMENT
/begin MEASUREMENT VSM_LCK_Con_SteerAngleSpd_Active2Ready "" UBYTE PubIfStateVSM_MDL_CM_boolean 0 0 0 1 BIT_MASK 0x1 ECU_ADDRESS 0x3FF77D /end MEASUREMENT
/begin MEASUREMENT VSM_LCK_Con_SteerAngleSpd_Ready2Active "" UBYTE PubIfStateVSM_MDL_CM_boolean 0 0 0 1 BIT_MASK 0x1 ECU_ADDRESS 0x3FF80C /end MEASUREMENT
/begin MEASUREMENT VSM_LCK_Con_SteerWheelAngle_Active2Ready "" UBYTE PubIfStateVSM_MDL_CM_boolean 0 0 0 1 BIT_MASK 0x1 ECU_ADDRESS 0x3FF77F /end MEASUREMENT
/begin MEASUREMENT VSM_LCK_Con_SteerWheelAngle_Ready2Active "" UBYTE PubIfStateVSM_MDL_CM_boolean 0 0 0 1 BIT_MASK 0x1 ECU_ADDRESS 0x3FF80F /end MEASUREMENT
/begin MEASUREMENT VSM_LCK_Con_TJAHandson_Idle2Ready "" UBYTE PubIfStateVSM_MDL_CM_boolean 0 0 0 1 BIT_MASK 0x1 ECU_ADDRESS 0x3FF862 /end MEASUREMENT
/begin MEASUREMENT VSM_LCK_Con_TJALane_Idle2Ready "" UBYTE PubIfStateVSM_MDL_CM_boolean 0 0 0 1 BIT_MASK 0x1 ECU_ADDRESS 0x3FF861 /end MEASUREMENT
/begin MEASUREMENT VSM_LCK_Con_TJALane_Ready2Idle "" UBYTE PubIfStateVSM_MDL_CM_boolean 0 0 0 1 BIT_MASK 0x1 ECU_ADDRESS 0x3FF85F /end MEASUREMENT
/begin MEASUREMENT VSM_LCK_Con_TJAVehicleSpd_Idle2Ready "" UBYTE PubIfStateVSM_MDL_CM_boolean 0 0 0 1 BIT_MASK 0x1 ECU_ADDRESS 0x3FF85C /end MEASUREMENT
/begin MEASUREMENT VSM_LCK_Con_TJAVehicleSpd_Ready2Idle "" UBYTE PubIfStateVSM_MDL_CM_boolean 0 0 0 1 BIT_MASK 0x1 ECU_ADDRESS 0x3FF85D /end MEASUREMENT
/begin MEASUREMENT VSM_LCK_Con_TargetLaneIn_Idle2Ready "" UBYTE PubIfStateVSM_MDL_CM_boolean 0 0 0 1 BIT_MASK 0x1 ECU_ADDRESS 0x3FF808 /end MEASUREMENT
/begin MEASUREMENT VSM_LCK_Con_TurnLight_Active2Ready "" UBYTE PubIfStateVSM_MDL_CM_boolean 0 0 0 1 BIT_MASK 0x1 ECU_ADDRESS 0x3FF818 /end MEASUREMENT
/begin MEASUREMENT VSM_LCK_Con_TurnLight_Ready2Active "" UBYTE PubIfStateVSM_MDL_CM_boolean 0 0 0 1 BIT_MASK 0x1 ECU_ADDRESS 0x3FF80B /end MEASUREMENT
/begin MEASUREMENT VSM_LCK_Con_VehicleSpd_Idle2Ready "" UBYTE PubIfStateVSM_MDL_CM_boolean 0 0 0 1 BIT_MASK 0x1 ECU_ADDRESS 0x3FF7FA /end MEASUREMENT
/begin MEASUREMENT VSM_LCK_Con_VehicleSpd_Ready2Idle "" UBYTE PubIfStateVSM_MDL_CM_boolean 0 0 0 1 BIT_MASK 0x1 ECU_ADDRESS 0x3FF800 /end MEASUREMENT
/begin MEASUREMENT VSM_LCK_Con_YawRate_Idle2Ready "" UBYTE PubIfStateVSM_MDL_CM_boolean 0 0 0 1 BIT_MASK 0x1 ECU_ADDRESS 0x3FF7F9 /end MEASUREMENT
/begin MEASUREMENT VSM_LCK_Con_YawRate_Ready2Idle "" UBYTE PubIfStateVSM_MDL_CM_boolean 0 0 0 1 BIT_MASK 0x1 ECU_ADDRESS 0x3FF7FF /end MEASUREMENT
/begin MEASUREMENT VSM_LCK_Counter "" UBYTE PubIfStateVSM_MDL_CM_uint8 0 0 0 255 ECU_ADDRESS 0x3FF6DA /end MEASUREMENT
/begin MEASUREMENT VSM_LCK_Idle2Ready "" UBYTE PubIfStateVSM_MDL_CM_boolean 0 0 0 1 BIT_MASK 0x1 ECU_ADDRESS 0x3FF80A /end MEASUREMENT
/begin MEASUREMENT VSM_LCK_Ready2Active "" UBYTE PubIfStateVSM_MDL_CM_boolean 0 0 0 1 BIT_MASK 0x1 ECU_ADDRESS 0x3FF817 /end MEASUREMENT
/begin MEASUREMENT VSM_LCK_Ready2Idle "" UBYTE PubIfStateVSM_MDL_CM_boolean 0 0 0 1 BIT_MASK 0x1 ECU_ADDRESS 0x3FF804 /end MEASUREMENT
/begin MEASUREMENT VSM_LCK_TJAIdle2Ready "" UBYTE PubIfStateVSM_MDL_CM_boolean 0 0 0 1 BIT_MASK 0x1 ECU_ADDRESS 0x3FF863 /end MEASUREMENT
/begin MEASUREMENT VSM_LCK_TJAReady2Idle "" UBYTE PubIfStateVSM_MDL_CM_boolean 0 0 0 1 BIT_MASK 0x1 ECU_ADDRESS 0x3FF864 /end MEASUREMENT
/begin MEASUREMENT VSM_LCK_TargetLaneIn_A0 "" UBYTE PubIfStateVSM_MDL_CM_boolean 0 0 0 1 BIT_MASK 0x1 ECU_ADDRESS 0x3FF807 /end MEASUREMENT
/begin MEASUREMENT VSM_LCK_VERSION "" ULONG PubIfStateVSM_MDL_CM_uint32 0 0 0 4294967295 ECU_ADDRESS 0x3FF564 /end MEASUREMENT
/begin MEASUREMENT VSM_LCK_Warning "" FLOAT64_IEEE PubIfStateVSM_MDL_CM_double 0 0 -1.7e+308 1.7e+308 ECU_ADDRESS 0x3FF540 /end MEASUREMENT
/begin MEASUREMENT VSM_TJALCKState "" UBYTE PubIfStateVSM_MDL_CM_LCK_STATE 0 0 0 7 ECU_ADDRESS 0x3FF872 /end MEASUREMENT
/begin MEASUREMENT VSM_TarDangerLevel "" UBYTE PubIfStateVSM_MDL_CM_uint8 0 0 0 255 ECU_ADDRESS 0x3FF6CD /end MEASUREMENT
/begin MEASUREMENT VSM_preFLWhelDy "" FLOAT32_IEEE PubIfStateVSM_MDL_CM_single 0 0 -3.4e+38 3.4e+38 ECU_ADDRESS 0x3FF5A8 /end MEASUREMENT
/begin MEASUREMENT VSM_preFRWhelDy "" FLOAT32_IEEE PubIfStateVSM_MDL_CM_single 0 0 -3.4e+38 3.4e+38 ECU_ADDRESS 0x3FF5AC /end MEASUREMENT
/begin GROUP S583_ESS_Condition "PubIfStateVSM_MDL/Subsystem Reference/Subsystem/StateManage/ESS/ESS/Subsystem1/ESS_StateMachine/ESS_Condition"
 /begin REF_CHARACTERISTIC P_VSM_ESS_AEBFlag_enable P_VSM_ESS_AccPedlPosn_Param P_VSM_ESS_AccelPed_enable P_VSM_ESS_DangerPlausLeft P_VSM_ESS_DangerPlausRight P_VSM_ESS_DoorSts_enable P_VSM_ESS_DriverInputTrq_Param P_VSM_ESS_DrvOverTime_Param P_VSM_ESS_DrvSBR_enable P_VSM_ESS_ESPActive_enable P_VSM_ESS_ESPFuncOffSts_enable P_VSM_ESS_FcwDisFlag_enable P_VSM_ESS_FcwSw_enable P_VSM_ESS_HiLoBeam_enable P_VSM_ESS_IPSpeed_kmh P_VSM_ESS_LateralAccel_enable P_VSM_ESS_LgtAccelLower_Param P_VSM_ESS_LgtAccelUpper_Param P_VSM_ESS_MasterCylindBrake P_VSM_ESS_MaxLateral_mss P_VSM_ESS_SteerWheelSpd_Param P_VSM_ESS_SteerWheelSpd_enable P_VSM_ESS_StopA0_Param P_VSM_ESS_StopA1Time_Param P_VSM_ESS_StopA1_Param P_VSM_ESS_TrailerSts_enable P_VSM_ESS_VehLgtAccel_enable P_VSM_ESS_Vehspeed_enable P_VSM_ESS_WiprReq_enable /end REF_CHARACTERISTIC
 /begin REF_MEASUREMENT VSM_ESS_ACTIVE2IDLE VSM_ESS_AEBFlag_READY2ACTIVE VSM_ESS_AEBTrigFlag_ACTIVE2IDLE VSM_ESS_AEBVehFlag_Ready2Active VSM_ESS_AEBVruFlag_Ready2Active VSM_ESS_AccelPed_READY2ACTIVE VSM_ESS_DPC_L_Active2Ready VSM_ESS_DPC_R_Active2Ready VSM_ESS_DangerPlausLeft_Ready2Active VSM_ESS_DangerPlausRight_Ready2Active VSM_ESS_DoorSts_ACTIVE2IDLE VSM_ESS_DoorSts_IDLE2READY VSM_ESS_DoorSts_READY2IDLE VSM_ESS_DrvOver_Active2Ready VSM_ESS_DrvSBR_ACTIVE2IDLE VSM_ESS_DrvSBR_IDLE2READY VSM_ESS_DrvSBR_READY2IDLE VSM_ESS_ESPActive_ACTIVE2IDLE VSM_ESS_ESPActive_IDLE2READY VSM_ESS_ESPActive_READY2IDLE VSM_ESS_ESPFuncOffSts_ACTIVE2IDLE VSM_ESS_ESPFuncOffSts_IDLE2READY VSM_ESS_ESPFuncOffSts_READY2IDLE VSM_ESS_FcwDisFlag_Ready2Active VSM_ESS_FcwFlag_READY2ACTIVE VSM_ESS_FcwWarn_Ready2Active VSM_ESS_HiLoBeam_IDLE2READY VSM_ESS_HiLoBeam_READY2IDLE VSM_ESS_IDLE2READY VSM_ESS_LValid_Active2Ready VSM_ESS_L_ACTIVE2READY VSM_ESS_L_Oncoming_Active2Ready VSM_ESS_L_SteerWheelSpdSign_Ready2Active VSM_ESS_LateralAccel_ACTIVE2IDLE VSM_ESS_LateralAccel_IDLE2READY VSM_ESS_LateralAccel_READY2IDLE VSM_ESS_LeftOncoming_Ready2Active VSM_ESS_Left_READY2ACTIVE VSM_ESS_LineA0_Active2Ready VSM_ESS_LineA1_Active2Ready VSM_ESS_LineLValid_Ready2Active VSM_ESS_LineRValid_Ready2Active VSM_ESS_MasterCylindBrakePress_ACTIVE2IDLE VSM_ESS_READY2ACTIVE VSM_ESS_READY2IDLE VSM_ESS_RValid_Active2Ready VSM_ESS_R_ACTIVE2READY VSM_ESS_R_Oncoming_Active2Ready VSM_ESS_R_SteerWheelSpdSign_Ready2Active VSM_ESS_RightOncoming_Ready2Active VSM_ESS_Right_READY2ACTIVE VSM_ESS_SteerWheelSpd_READY2ACTIVE VSM_ESS_TrailerSts_IDLE2READY VSM_ESS_TrailerSts_READY2IDLE VSM_ESS_VehLgtAccel_READY2ACTIVE VSM_ESS_VehicleSpd_ACTIVE2IDLE VSM_ESS_VehicleSpd_IDLE2READY VSM_ESS_VehicleSpd_READY2IDLE VSM_ESS_WiprReq_IDLE2READY VSM_ESS_WiprReq_READY2IDLE /end REF_MEASUREMENT
/end GROUP
/begin GROUP S60_CurvatureMix "PubIfDecisionPLAN_MDL/PLAN/Subsystem Reference/AP/AP/IC/CurvatureOfRoadCalc/If Action Subsystem/CurvatureMix"
 /begin REF_CHARACTERISTIC P_LongCtrl_ICcoefCurvatureCharX1 P_LongCtrl_ICcoefCurvatureCharX2 P_LongCtrl_ICcoefCurvatureCharY /end REF_CHARACTERISTIC
 /begin REF_MEASUREMENT LongCtrl_coefCurvatureNoC3 LongCtrl_coefCurvatureWithC3 LongCtrl_curvatureForCurveDecelRaw LongCtrl_curvatureNoC3 LongCtrl_curvatureWithC3 /end REF_MEASUREMENT
/end GROUP
/begin GROUP S61_AngleControlTest "PubIfControlLATC_MDL/Subsystem Reference/Subsystem/LateralControl/LCS_Angle/Subsystem4/PID/AngleControlTest" /begin REF_MEASUREMENT LCS_Torq_D LCS_Torq_I LCS_Torq_P /end REF_MEASUREMENT /end GROUP
/begin GROUP S6_axvClosedLoopControlCalc "PubIfControlLONC_MDL/Subsystem/VLC/Vlc/axvClosedLoopControlCalc" /begin REF_MEASUREMENT LongCtrl_axvClosedLoopControl LongCtrl_axvDiff /end REF_MEASUREMENT /end GROUP
/begin GROUP S6_axvModelResidualCalc "PubIfControlLONC_MDL/Subsystem/VLC/Vlc/axvModelResidualCalc"
 /begin REF_MEASUREMENT LongCtrl_axvModelDiff LongCtrl_axvModelRef LongCtrl_axvModelResidual /end REF_MEASUREMENT
/end GROUP
/begin GROUP S6_axvTracActMean_calc "PubIfControlLONC_MDL/Subsystem/VLC/Vlc/axvTracActMean_calc"
 /begin REF_CHARACTERISTIC P_Global_Weight_N P_LongCtrl_VLCcoefFXAxis P_LongCtrl_VLCcoefFYAxis /end REF_CHARACTERISTIC
 /begin REF_MEASUREMENT LongCtrl_Fz LongCtrl_axvTracActMean /end REF_MEASUREMENT
/end GROUP
/begin GROUP S6_axvTracMin_calc "PubIfControlLONC_MDL/Subsystem/VLC/Vlc/axvTracMin_calc"
 /begin REF_CHARACTERISTIC P_Global_Weight_N P_LongCtrl_VLCcoefFXAxis P_LongCtrl_VLCcoefFYAxis /end REF_CHARACTERISTIC
 /begin REF_MEASUREMENT LongCtrl_axvTracMin /end REF_MEASUREMENT
/end GROUP
/begin GROUP S6_Cruise "PubIfStateVSM_MDL/Subsystem Reference/Subsystem/StateManage/Cruise" /begin SUB_GROUP S19_Cruise /end SUB_GROUP /end GROUP
/begin GROUP S6_DC "PubIfControlLONC_MDL/Subsystem/VLC/Vlc/DC"
 /begin REF_CHARACTERISTIC P_LongCtrl_VLCaccelMinHoldXAxis P_LongCtrl_VLCaccelMinHoldYAxis P_LongCtrl_VLCjerkHoldXAxis P_LongCtrl_VLCjerkHoldYAxis /end REF_CHARACTERISTIC
 /begin REF_MEASUREMENT LongCtrl_ACC_Decel_ReqValue /end REF_MEASUREMENT
/end GROUP
/begin GROUP S6_EC "PubIfControlLONC_MDL/Subsystem/VLC/Vlc/EC"
 /begin REF_CHARACTERISTIC P_Global_Weight_N P_LongCtrl_VLCCounterDC2ECTorqDelay P_LongCtrl_VLCCounterDrvOff2EC /end REF_CHARACTERISTIC
 /begin REF_MEASUREMENT LongCtrl_ACC_EngTrqReq /end REF_MEASUREMENT
/end GROUP
/begin GROUP S6_Enlong2s1 "PubIfStateVSM_MDL/Subsystem Reference/Subsystem/StateManage/Enlong2s1" /begin REF_CHARACTERISTIC P_VSM_SOSContinueTime P_VSM_SOSSpdLimit /end REF_CHARACTERISTIC /end GROUP
/begin GROUP S6_ESS "PubIfStateVSM_MDL/Subsystem Reference/Subsystem/StateManage/ESS" /begin SUB_GROUP S21_ESS /end SUB_GROUP /end GROUP
/begin GROUP S6_FF_Control "PubIfControlLONC_MDL/Subsystem/VLC/Vlc/FF_Control" /begin REF_CHARACTERISTIC P_Global_Weight_N /end REF_CHARACTERISTIC /begin REF_MEASUREMENT LongCtrl_FF_NetEngTorqInc LongCtrl_FF_NetEngTorqMax /end REF_MEASUREMENT /end GROUP
/begin GROUP S6_HMI "Noa_Nofusion/Chassis1/HMI" /begin SUB_GROUP PubIfChassisHMI_MDL /end SUB_GROUP /end GROUP
/begin GROUP S6_HOD "PubIfStateVSM_MDL/Subsystem Reference/Subsystem/StateManage/HOD" /begin SUB_GROUP S23_HOD /end SUB_GROUP /end GROUP
/begin GROUP S6_LSS "PubIfStateVSM_MDL/Subsystem Reference/Subsystem/StateManage/LSS" /begin SUB_GROUP S24_LCK_LKA_LDW_ELKStateMachine3 S24_TLS /end SUB_GROUP /end GROUP
/begin GROUP S6_PI_Control "PubIfControlLONC_MDL/Subsystem/VLC/Vlc/PI_Control"
 /begin REF_CHARACTERISTIC P_LongCtrl_VLCAxTarDtThreEnableI P_LongCtrl_VLCIACompensionNeg P_LongCtrl_VLCIACompensionPos P_LongCtrl_VLCcoefIFadeOut1Calc P_LongCtrl_VLCcoefIFadeOut1Condition P_LongCtrl_VLCcoefIFadeOut2Calc P_LongCtrl_VLCcoefIFadeOut2Condition P_LongCtrl_VLCcoefIFadeOut3Calc P_LongCtrl_VLCcoefIFadeOut3Condition /end REF_CHARACTERISTIC
 /begin REF_MEASUREMENT LongCtrl_PI_NetEngTorqInc /end REF_MEASUREMENT
/end GROUP
/begin GROUP S6_Subsystem "PubIfStateVSM_MDL/Subsystem Reference/Subsystem/StateManage/Subsystem" /begin SUB_GROUP S27_TSR /end SUB_GROUP /end GROUP
/begin GROUP S6_SwitchToBrakeMode "PubIfControlLONC_MDL/Subsystem/VLC/Vlc/SwitchToBrakeMode"
 /begin REF_CHARACTERISTIC P_LongCtrl_VLCAxvTracMinDC1FullFillXAxis P_LongCtrl_VLCAxvTracMinDC1FullFillYAxis P_LongCtrl_VLCCounterAxvTracMinTimeout P_LongCtrl_VLCDtAxvRef2UpperBandDC5 P_LongCtrl_VLCTorqDiffThreAxvTracMinTimeout P_LongCtrl_VLCVlcAccThresAxvTracMinTimeout P_LongCtrl_VLCaxvRoadSlopeDC4CharXAxis P_LongCtrl_VLCaxvRoadSlopeDC4CharYAxis /end REF_CHARACTERISTIC
 /begin REF_MEASUREMENT LongCtrl_Sw2DC1 LongCtrl_Sw2DC2 LongCtrl_Sw2DC3 LongCtrl_Sw2DC4 LongCtrl_Sw2DC5 LongCtrl_Sw2DC6 LongCtrl_Sw2DC7 /end REF_MEASUREMENT
/end GROUP
/begin GROUP S6_SwitchToDriveMode "PubIfControlLONC_MDL/Subsystem/VLC/Vlc/SwitchToDriveMode"
 /begin REF_MEASUREMENT LongCtrl_Sw2EC1 LongCtrl_Sw2EC2 LongCtrl_Sw2EC3 LongCtrl_Sw2EC4 LongCtrl_Sw2EC5 /end REF_MEASUREMENT
/end GROUP
/begin GROUP S6_UOM "PubIfStateVSM_MDL/Subsystem Reference/Subsystem/StateManage/UOM" /begin SUB_GROUP S28_GW_V71 /end SUB_GROUP /begin REF_CHARACTERISTIC P_VSM_CruiseFunUserInputMappingWays /end REF_CHARACTERISTIC /end GROUP
/begin GROUP S6_UpdateFlagCalc "PubIfControlLONC_MDL/Subsystem/VLC/Vlc/UpdateFlagCalc" /begin REF_MEASUREMENT LongCtrl_UpdateEnable_axvModeldiff /end REF_MEASUREMENT /end GROUP
/begin GROUP S701_LP_filter "PubIfStateVSM_MDL/Subsystem Reference/Subsystem/StateManage/HOD/HOD/LP filter" /begin REF_CHARACTERISTIC P_VSM_HOD_DrvTrqFlterTIme /end REF_CHARACTERISTIC /begin REF_MEASUREMENT VSM_HOD_DrvTrqFilted /end REF_MEASUREMENT /end GROUP
/begin GROUP S722_ELKState_Machine "PubIfStateVSM_MDL/Subsystem Reference/Subsystem/StateManage/LSS/LCK_LKA_LDW_ELKStateMachine3/ELKState_Machine" /begin SUB_GROUP S724_ELK /end SUB_GROUP /end GROUP
/begin GROUP S722_LCK "PubIfStateVSM_MDL/Subsystem Reference/Subsystem/StateManage/LSS/LCK_LKA_LDW_ELKStateMachine3/LCK" /begin SUB_GROUP S726_LCK /end SUB_GROUP /end GROUP
/begin GROUP S722_LCKIE "PubIfStateVSM_MDL/Subsystem Reference/Subsystem/StateManage/LSS/LCK_LKA_LDW_ELKStateMachine3/LCKIE" /begin SUB_GROUP S727_LCKIE /end SUB_GROUP /end GROUP
/begin GROUP S722_LDW "PubIfStateVSM_MDL/Subsystem Reference/Subsystem/StateManage/LSS/LCK_LKA_LDW_ELKStateMachine3/LDW" /begin SUB_GROUP S728_LDW /end SUB_GROUP /end GROUP
/begin GROUP S722_LKA "PubIfStateVSM_MDL/Subsystem Reference/Subsystem/StateManage/LSS/LCK_LKA_LDW_ELKStateMachine3/LKA" /begin SUB_GROUP S729_LKA /end SUB_GROUP /end GROUP
/begin GROUP S722_Signal_calculate "PubIfStateVSM_MDL/Subsystem Reference/Subsystem/StateManage/LSS/LCK_LKA_LDW_ELKStateMachine3/Signal_calculate" /begin SUB_GROUP S731_LKA_LDW_SignalProcess S731_LaneAndRe_SignalProcess /end SUB_GROUP /end GROUP
/begin GROUP S723_TargetLineSelect "PubIfStateVSM_MDL/Subsystem Reference/Subsystem/StateManage/LSS/TLS/TargetLineSelect" /begin REF_MEASUREMENT VSM_TarDangerLevel /end REF_MEASUREMENT /end GROUP
/begin GROUP S724_ELK "PubIfStateVSM_MDL/Subsystem Reference/Subsystem/StateManage/LSS/LCK_LKA_LDW_ELKStateMachine3/ELKState_Machine/ELK" /begin SUB_GROUP S732_ELK_Condition S732_ELK_OnComing_OverTaking /end SUB_GROUP
 /begin REF_MEASUREMENT VSM_ELKState VSM_ELK_Counter VSM_ELK_VehConfigELK VSM_ELK_Warning /end REF_MEASUREMENT
/end GROUP
/begin GROUP S726_LCK "PubIfStateVSM_MDL/Subsystem Reference/Subsystem/StateManage/LSS/LCK_LKA_LDW_ELKStateMachine3/LCK/LCK" /begin SUB_GROUP S927_LCK2 /end SUB_GROUP /end GROUP
/begin GROUP S727_LCKIE "PubIfStateVSM_MDL/Subsystem Reference/Subsystem/StateManage/LSS/LCK_LKA_LDW_ELKStateMachine3/LCKIE/LCKIE" /begin SUB_GROUP S1192_LCKIE_StateMachine S1192_Subsystem1 /end SUB_GROUP
 /begin REF_MEASUREMENT VSM_LCKIE_State VSM_LCKIE_SubModel_Number VSM_LCKIE_SubModel_VERSION /end REF_MEASUREMENT
/end GROUP
/begin GROUP S728_LDW "PubIfStateVSM_MDL/Subsystem Reference/Subsystem/StateManage/LSS/LCK_LKA_LDW_ELKStateMachine3/LDW/LDW" /begin SUB_GROUP S1284_LDW2 /end SUB_GROUP /end GROUP
/begin GROUP S729_LKA "PubIfStateVSM_MDL/Subsystem Reference/Subsystem/StateManage/LSS/LCK_LKA_LDW_ELKStateMachine3/LKA/LKA" /begin SUB_GROUP S1413_LKA2 /end SUB_GROUP /end GROUP
/begin GROUP S731_LaneAndRe_SignalProcess "PubIfStateVSM_MDL/Subsystem Reference/Subsystem/StateManage/LSS/LCK_LKA_LDW_ELKStateMachine3/Signal_calculate/LaneAndRe_SignalProcess" /begin SUB_GROUP S1602_InCondition1 S1602_LaneRage_Handle /end SUB_GROUP /end GROUP
/begin GROUP S731_LKA_LDW_SignalProcess "PubIfStateVSM_MDL/Subsystem Reference/Subsystem/StateManage/LSS/LCK_LKA_LDW_ELKStateMachine3/Signal_calculate/LKA_LDW_SignalProcess" /begin REF_CHARACTERISTIC P_VSM_LDW_State_Param_LaneTime P_VSM_LDW_State_Param_Speed /end REF_CHARACTERISTIC /begin REF_MEASUREMENT VSM_FLWhelDy VSM_FRWhelDy VSM_preFLWhelDy VSM_preFRWhelDy /end REF_MEASUREMENT /end GROUP
/begin GROUP S732_ELK_Condition "PubIfStateVSM_MDL/Subsystem Reference/Subsystem/StateManage/LSS/LCK_LKA_LDW_ELKStateMachine3/ELKState_Machine/ELK/ELK_Condition"
 /begin SUB_GROUP S734_Subsystem S734_Subsystem1 S734_Subsystem10 S734_Subsystem11 S734_Subsystem12 S734_Subsystem15 S734_Subsystem17 S734_Subsystem4 S734_Subsystem5 S734_Subsystem6 S734_Subsystem7 S734_Subsystem8 S734_Subsystem9 /end SUB_GROUP
 /begin REF_CHARACTERISTIC P_VSM_ELK_State_Absesp_enable P_VSM_ELK_State_Accpedalrate_enable P_VSM_ELK_State_Breakpressure_enable P_VSM_ELK_State_DriverInputTrqValue_enable P_VSM_ELK_State_ESSSts_enable P_VSM_ELK_State_Eps_enable P_VSM_ELK_State_Failsafe_enable P_VSM_ELK_State_GEAR_enable P_VSM_ELK_State_Headingangle_enable P_VSM_ELK_State_LaneChange_enable P_VSM_ELK_State_Lane_enable P_VSM_ELK_State_Lanecurve_enable P_VSM_ELK_State_LateralAcce_enable P_VSM_ELK_State_LongitudeAcc_enable P_VSM_ELK_State_Overide_enable P_VSM_ELK_State_SteerWheelAngle_enable P_VSM_ELK_State_SteerWheelSpd_enable P_VSM_ELK_State_Vehspeed_enable P_VSM_ELK_State_Yawsup_enable /end REF_CHARACTERISTIC
 /begin REF_MEASUREMENT VSM_ELK_Active2Ready VSM_ELK_Con_AbsEsp_Idle2Ready VSM_ELK_Con_AbsEsp_Ready2Idle VSM_ELK_Con_AccPedalRate_Active2Ready VSM_ELK_Con_AccPedalRate_Ready2Active VSM_ELK_Con_BrakePressure_Active2Ready VSM_ELK_Con_BrakePressure_Ready2Active VSM_ELK_Con_CURRENT_GEAR_Active2Ready VSM_ELK_Con_CURRENT_GEAR_Ready2Active VSM_ELK_Con_DriverInput_Active2Ready VSM_ELK_Con_DriverInput_Ready2Active VSM_ELK_Con_ESSSts_Idle2Ready VSM_ELK_Con_ESSSts_Ready2Idle VSM_ELK_Con_EpsSta_Active2Ready VSM_ELK_Con_EpsSta_Ready2Active VSM_ELK_Con_Failsafe_Idle2Ready VSM_ELK_Con_Failsafe_Ready2Idle VSM_ELK_Con_Headingangel_Idle2Ready VSM_ELK_Con_Headingangle_Ready2Idle VSM_ELK_Con_LaneChange_Active2Ready VSM_ELK_Con_LaneChange_Ready2Active VSM_ELK_Con_LaneCurve_Idle2Ready VSM_ELK_Con_LaneCurve_Ready2Idle VSM_ELK_Con_Lane_Idle2Ready VSM_ELK_Con_Lane_Ready2Idle VSM_ELK_Con_LateralAcc_Active2Ready VSM_ELK_Con_LateralAcc_Ready2Active VSM_ELK_Con_LongitudeAcc_Active2Ready VSM_ELK_Con_LongitudeAcc_Ready2Active VSM_ELK_Con_OverRide_Active2Ready VSM_ELK_Con_Override_Ready2Active VSM_ELK_Con_SteerWheelAngle_Active2Ready VSM_ELK_Con_SteerWheelAngle_Ready2Active VSM_ELK_Con_SteerWheelSpd_Active2Ready VSM_ELK_Con_SteerWheelSpd_Ready2Active VSM_ELK_Con_VehicleSpeed_Idle2ReadyELK VSM_ELK_Con_VehicleSpeed_Ready2Idle VSM_ELK_Con_YawRate_Idle2Ready VSM_ELK_Con_YawRate_Ready2Idle VSM_ELK_Idle2Ready VSM_ELK_Other2Idle VSM_ELK_Ready2Active /end REF_MEASUREMENT
/end GROUP
/begin GROUP S732_ELK_OnComing_OverTaking "PubIfStateVSM_MDL/Subsystem Reference/Subsystem/StateManage/LSS/LCK_LKA_LDW_ELKStateMachine3/ELKState_Machine/ELK/ELK_OnComing_OverTaking"
 /begin SUB_GROUP S735_OnComing S735_OverTaking S735_Subsystem S735_Subsystem2 S735_Subsystem3 /end SUB_GROUP
 /begin REF_CHARACTERISTIC P_VSM_ELK_Lane_Width_Table P_VSM_ELK_Lane_Width_Table_Calibration P_VSM_ELK_Sensitive_Table P_VSM_ELK_Sensitive_Table_Calibration P_VSM_ELK_State_Param_AngleOffset P_VSM_ELK_State_Param_OnTime P_VSM_ELK_State_Param_Oncoming P_VSM_ELK_State_Param_OutOffset P_VSM_ELK_State_Param_OvTime P_VSM_ELK_State_Param_Over P_VSM_ELK_State_Param_Speed /end REF_CHARACTERISTIC
/end GROUP
/begin GROUP S735_OnComing "PubIfStateVSM_MDL/Subsystem Reference/Subsystem/StateManage/LSS/LCK_LKA_LDW_ELKStateMachine3/ELKState_Machine/ELK/ELK_OnComing_OverTaking/OnComing"
 /begin REF_CHARACTERISTIC P_Global_IEnvironment_RefPX_Front_Bumper P_VSM_ELK_OnComing_Lateral P_VSM_ELK_OnComing_TTC /end REF_CHARACTERISTIC
 /begin REF_MEASUREMENT VSM_ELK_OnComing_LOnComing VSM_ELK_OnComing_LOut VSM_ELK_OnComing_LetfCondition VSM_ELK_OnComing_Llateral VSM_ELK_OnComing_Lttc VSM_ELK_OnComing_Lv_re VSM_ELK_OnComing_ROnComing VSM_ELK_OnComing_ROut VSM_ELK_OnComing_RightCondition VSM_ELK_OnComing_Rlateral VSM_ELK_OnComing_Rttc VSM_ELK_OnComing_Rv_re /end REF_MEASUREMENT
/end GROUP
/begin GROUP S735_OverTaking "PubIfStateVSM_MDL/Subsystem Reference/Subsystem/StateManage/LSS/LCK_LKA_LDW_ELKStateMachine3/ELKState_Machine/ELK/ELK_OnComing_OverTaking/OverTaking"
 /begin REF_CHARACTERISTIC P_Global_IEnvironment_RefPX_Front_Bumper P_VSM_ELK_OverTaking_Lateral P_VSM_ELK_OverTaking_TTC /end REF_CHARACTERISTIC
 /begin REF_MEASUREMENT VSM_ELK_OverTaking_LLateral VSM_ELK_OverTaking_LOut VSM_ELK_OverTaking_LeftCondition VSM_ELK_OverTaking_RLateral VSM_ELK_OverTaking_ROut VSM_ELK_OverTaking_RightCondition VSM_ELK_OverTaking_leftcar VSM_ELK_OverTaking_rightcar /end REF_MEASUREMENT
/end GROUP
/begin GROUP S735_Subsystem "PubIfStateVSM_MDL/Subsystem Reference/Subsystem/StateManage/LSS/LCK_LKA_LDW_ELKStateMachine3/ELKState_Machine/ELK/ELK_OnComing_OverTaking/Subsystem" /begin SUB_GROUP S865_Subsystem1 S865_Subsystem4 S865_Subsystem7 /end SUB_GROUP /begin REF_CHARACTERISTIC P_Global_IEnvironment_RefPX_Front_Bumper /end REF_CHARACTERISTIC /begin REF_MEASUREMENT VSM_ELK_Lane_valid VSM_ELK_Lwidth_Valid /end REF_MEASUREMENT /end GROUP
/begin GROUP S79_AccelSupression "PubIfDecisionPLAN_MDL/PLAN/Subsystem Reference/AP/AP/LCObjChoose+FollowCtrl/FollowCtrl/AccelSupression"
 /begin REF_CHARACTERISTIC P_LongCtrl_ALCAccLimitByDangerXAxis P_LongCtrl_ALCAccLimitByDangerYAxis P_LongCtrl_FollowaccelMinAccelSupressionEnter P_LongCtrl_FollowaccelMinAccelSupressionExit P_LongCtrl_FollowaccelSupressionAccelThres /end REF_CHARACTERISTIC
 /begin REF_MEASUREMENT LongCtrl_accelFollowAfterLaneChangeSupress LongCtrl_accelSupressionEnable LongCtrl_distAccelSupressionEnter LongCtrl_distAccelSupressionExit LongCtrl_tStartDecel /end REF_MEASUREMENT
/end GROUP
/begin GROUP S79_AccelTargAbsEnableJudge "PubIfDecisionPLAN_MDL/PLAN/Subsystem Reference/AP/AP/LCObjChoose+FollowCtrl/FollowCtrl/AccelTargAbsEnableJudge"
 /begin REF_CHARACTERISTIC P_LongCtrl_FollowaccelTargAbsEnableNegJerk P_LongCtrl_FollowaccelTargAbsEnableNegMax P_LongCtrl_FollowaccelTargAbsEnablePosJerk P_LongCtrl_FollowaccelTargAbsEnableRangeMax P_LongCtrl_FollowaccelTargAbsExitNegMin P_LongCtrl_FollowdistTargRelEnableAccelTargAbsThres /end REF_CHARACTERISTIC
 /begin REF_MEASUREMENT LongCtrl_accelTargAbsEnable /end REF_MEASUREMENT
/end GROUP
/begin GROUP S79_DecelToStopCtrl "PubIfDecisionPLAN_MDL/PLAN/Subsystem Reference/AP/AP/LCObjChoose+FollowCtrl/FollowCtrl/DecelToStopCtrl" /begin SUB_GROUP S84_DecelToStopCtrl /end SUB_GROUP /end GROUP
/begin GROUP S79_DistDesCalc "PubIfDecisionPLAN_MDL/PLAN/Subsystem Reference/AP/AP/LCObjChoose+FollowCtrl/FollowCtrl/DistDesCalc"
 /begin REF_CHARACTERISTIC P_LongCtrl_FollowDistDesCompensionVelRelThresMax P_LongCtrl_FollowDistDesCompensionVelRelThresMin P_LongCtrl_FollowdistDesCompensionXAxis P_LongCtrl_FollowdistDesCompensionYAxis P_LongCtrl_FollowdistDesX2Axis /end REF_CHARACTERISTIC
 /begin REF_MEASUREMENT LongCtrl_distDesCur LongCtrl_distDesPlanCorr /end REF_MEASUREMENT
/end GROUP
/begin GROUP S79_FollowBandJerkCalc "PubIfDecisionPLAN_MDL/PLAN/Subsystem Reference/AP/AP/LCObjChoose+FollowCtrl/FollowCtrl/FollowBandJerkCalc"
 /begin SUB_GROUP S87_AccelFollowAfterJerk S87_DecelFollowJerkCalc S87_LP S87_Subsystem /end SUB_GROUP
 /begin REF_MEASUREMENT LongCtrl_lowerJerkFollow LongCtrl_upperJerkFollow /end REF_MEASUREMENT
/end GROUP
/begin GROUP S79_LaneChangeAccelLimit "PubIfDecisionPLAN_MDL/PLAN/Subsystem Reference/AP/AP/LCObjChoose+FollowCtrl/FollowCtrl/LaneChangeAccelLimit" /begin REF_CHARACTERISTIC P_LongCtrl_LC_AccelMinSafeDis P_LongCtrl_LC_TimeKeepLimit /end REF_CHARACTERISTIC
 /begin REF_MEASUREMENT LongCtrl_LC_LimitEnable LongCtrl_LC_SafeDisEnable LongCtrl_LC_SafeDisMin LongCtrl_LC_ShiftInProgress LongCtrl_accelFollow /end REF_MEASUREMENT
/end GROUP
/begin GROUP S79_PlausibilityCheck "PubIfDecisionPLAN_MDL/PLAN/Subsystem Reference/AP/AP/LCObjChoose+FollowCtrl/FollowCtrl/PlausibilityCheck" /begin SUB_GROUP S89_StandstillOverrideAccelLimit S89_Subsystem /end SUB_GROUP
 /begin REF_MEASUREMENT LongCtrl_coefStandstillOverride LongCtrl_followAccel_Plau LongCtrl_standstillOverrideCondition /end REF_MEASUREMENT
/end GROUP
/begin GROUP S79_SlopeStartupAssist "PubIfDecisionPLAN_MDL/PLAN/Subsystem Reference/AP/AP/LCObjChoose+FollowCtrl/FollowCtrl/SlopeStartupAssist"
 /begin REF_CHARACTERISTIC P_LongCtrl_FollowAccelAddSlopeAssistXAxis P_LongCtrl_FollowAccelAddSlopeAssistYAxis P_LongCtrl_FollowAccelSlopeAssistStep /end REF_CHARACTERISTIC
 /begin REF_MEASUREMENT LongCtrl_accelFollowSlopeAssist LongCtrl_slopeStartupAssist /end REF_MEASUREMENT
/end GROUP
/begin GROUP S79_VelPlan "PubIfDecisionPLAN_MDL/PLAN/Subsystem Reference/AP/AP/LCObjChoose+FollowCtrl/FollowCtrl/VelPlan"
 /begin REF_CHARACTERISTIC P_LongCtrl_FollowRateJConditionStep P_LongCtrl_FollowRateJDirStep P_LongCtrl_FollowVelSubjNegToleranceAddX1Axis P_LongCtrl_FollowVelSubjNegToleranceAddX2Axis P_LongCtrl_FollowVelSubjNegToleranceAddYAxis P_LongCtrl_FollowVelTargetAbsSmoothNum P_LongCtrl_FollowWdCoefXAxis P_LongCtrl_FollowWdCoefYAxis P_LongCtrl_FollowWvCoefXAxis P_LongCtrl_FollowWvCoefYAxis P_LongCtrl_FollowcoefDistEnlargeDecToStop P_LongCtrl_FollowcoefVelEnlargeDecToStop /end REF_CHARACTERISTIC
 /begin REF_MEASUREMENT LongCtrl_J LongCtrl_JadtA LongCtrl_JadtADist LongCtrl_accelSubjDesCorr LongCtrl_accelSubjDesRaw LongCtrl_accelSubjPlanOpt LongCtrl_asum LongCtrl_coefJEnlarge LongCtrl_distRelDesDistRelPlanNumMin LongCtrl_distRelPlanMin LongCtrl_distRelPlanOpt LongCtrl_num LongCtrl_velPlanRelOpt LongCtrl_velSubjPlanOpt /end REF_MEASUREMENT
/end GROUP
/begin GROUP S79_VelTargPlanTerminateCalc "PubIfDecisionPLAN_MDL/PLAN/Subsystem Reference/AP/AP/LCObjChoose+FollowCtrl/FollowCtrl/VelTargPlanTerminateCalc" /begin REF_MEASUREMENT LongCtrl_velTargAbsPlanTerminate /end REF_MEASUREMENT /end GROUP
/begin GROUP S7_AP "PubIfDecisionPLAN_MDL/PLAN/Subsystem Reference/AP/AP"
 /begin SUB_GROUP S8_AL S8_Arbitrate S8_CCCtrl S8_IC S8_LCObjChoose_FollowCtrl S8_ORD S8_SJ S8_Subsystem S8_VlcInternalAccCalc /end SUB_GROUP
 /begin REF_CHARACTERISTIC P_LongCtrl_tCycle /end REF_CHARACTERISTIC
/end GROUP
/begin GROUP S7_Subsystem "PubIfChassisHMI_MDL/Subsystem/HMI2.12/HWA//ACC//TJA_Signal1/Subsystem" /begin REF_CHARACTERISTIC P_HMI_ObjectTypeFilter /end REF_CHARACTERISTIC /end GROUP
/begin GROUP S7_Subsystem1 "PubIfChassisHMI_MDL/Subsystem/HMI2.12/HWA//ACC//TJA_Signal1/Subsystem1" /begin REF_CHARACTERISTIC P_HMI_ObjectTypeFilter /end REF_CHARACTERISTIC /end GROUP
/begin GROUP S7_Subsystem2 "PubIfChassisHMI_MDL/Subsystem/HMI2.12/HWA//ACC//TJA_Signal1/Subsystem2" /begin REF_CHARACTERISTIC P_HMI_ObjectTypeFilter /end REF_CHARACTERISTIC /end GROUP
/begin GROUP S7_Subsystem3 "PubIfChassisHMI_MDL/Subsystem/HMI2.12/HWA//ACC//TJA_Signal1/Subsystem3" /begin REF_CHARACTERISTIC P_HMI_ObjectTypeFilter /end REF_CHARACTERISTIC /end GROUP
/begin GROUP S7_Subsystem4 "PubIfChassisHMI_MDL/Subsystem/HMI2.12/HWA//ACC//TJA_Signal1/Subsystem4" /begin REF_CHARACTERISTIC P_HMI_ObjectTypeFilter /end REF_CHARACTERISTIC /end GROUP
/begin GROUP S7_Subsystem5 "PubIfChassisHMI_MDL/Subsystem/HMI2.12/HWA//ACC//TJA_Signal1/Subsystem5" /begin REF_CHARACTERISTIC P_HMI_ObjectTypeFilter /end REF_CHARACTERISTIC /end GROUP
/begin GROUP S7_VxvRef_Calc "PubIfCommonVIE_MDL/VIE/VIE/VxvRef_Calc/VxvRef_Calc" /begin SUB_GROUP S18_Enabled_Subsystem /end SUB_GROUP /end GROUP
/begin GROUP S80_OptimalSpace "PubIfDecisionPLAN_MDL/PLAN/Subsystem Reference/AP/AP/LCObjChoose+FollowCtrl/LaneChangeObjectChoose/OptimalSpace"
 /begin REF_CHARACTERISTIC P_LongCtrl_LC_OptimalSpaceIntervalTime P_LongCtrl_LC_OptimalSpaceStartTime P_LongCtrl_LC_OptimalSpaceStopTime P_LongCtrl_ORDdecelEnable /end REF_CHARACTERISTIC
 /begin REF_MEASUREMENT LongCtrl_LC_OptimalSpaceSts LongCtrl_LC_OptimalSpace_jb LongCtrl_LC_OptimalSpace_jf LongCtrl_LC_OptimalSpace_jz /end REF_MEASUREMENT
/end GROUP
/begin GROUP S80_Subsystem "PubIfDecisionPLAN_MDL/PLAN/Subsystem Reference/AP/AP/LCObjChoose+FollowCtrl/LaneChangeObjectChoose/Subsystem" /begin REF_CHARACTERISTIC P_LongCtrl_LC_OptimalSpaceEnable /end REF_CHARACTERISTIC /end GROUP
/begin GROUP S80_Virtual_target_and_desired_distance "PubIfDecisionPLAN_MDL/PLAN/Subsystem Reference/AP/AP/LCObjChoose+FollowCtrl/LaneChangeObjectChoose/Virtual target and desired distance" /begin SUB_GROUP S140_Subsystem /end SUB_GROUP
 /begin REF_CHARACTERISTIC P_LongCtrl_LC_AccelMinSafeDis P_LongCtrl_LC_DisAwayLocation /end REF_CHARACTERISTIC
 /begin REF_MEASUREMENT LongCtrl_LC_F_Alive LongCtrl_LC_F_Ax_AbsFilter LongCtrl_LC_F_ID LongCtrl_LC_F_Range LongCtrl_LC_F_Vx LongCtrl_LC_R_Alive LongCtrl_LC_R_Ax_AbsFilter LongCtrl_LC_R_ID LongCtrl_LC_R_Range LongCtrl_LC_R_Vx LongCtrl_accelTargAbsFilt_P0 /end REF_MEASUREMENT
/end GROUP
/begin GROUP S84_DecelToStopCtrl "PubIfDecisionPLAN_MDL/PLAN/Subsystem Reference/AP/AP/LCObjChoose+FollowCtrl/FollowCtrl/DecelToStopCtrl/DecelToStopCtrl" /begin SUB_GROUP S99_P_LongCtrl_velSubjThresEnableStopAdd S99_Subsystem /end SUB_GROUP
 /begin REF_CHARACTERISTIC P_LongCtrl_FollowaccelStopMax P_LongCtrl_FollowaccelTargThresEnableStop P_LongCtrl_FollowaccelTargThresForceStop P_LongCtrl_FollowdistThresEnableStop P_LongCtrl_FollowvelSubjThresEnableStop P_LongCtrl_FollowvelTarAbsThresForceStop /end REF_CHARACTERISTIC
 /begin REF_MEASUREMENT LongCtrl_ForceStop LongCtrl_accelFollowAfterDecelToStop /end REF_MEASUREMENT
/end GROUP
/begin GROUP S87_AccelFollowAfterJerk "PubIfDecisionPLAN_MDL/PLAN/Subsystem Reference/AP/AP/LCObjChoose+FollowCtrl/FollowCtrl/FollowBandJerkCalc/AccelFollowAfterJerk" /begin REF_MEASUREMENT LongCtrl_accelFollowAfterJerk /end REF_MEASUREMENT /end GROUP
/begin GROUP S87_DecelFollowJerkCalc "PubIfDecisionPLAN_MDL/PLAN/Subsystem Reference/AP/AP/LCObjChoose+FollowCtrl/FollowCtrl/FollowBandJerkCalc/DecelFollowJerkCalc"
 /begin REF_CHARACTERISTIC P_LongCtrl_FollowDecelJerkDiffTTC2GapCorrEnableTTCThres P_LongCtrl_FollowDecelJerkDiffTTC2GapCorrEnableVelSubjThres P_LongCtrl_FollowDecelJerkDiffTTC2GapCorrXAxis P_LongCtrl_FollowDecelJerkDiffTTC2GapCorrYAxis P_LongCtrl_FollowDecelJerkForceSlopeXAxis P_LongCtrl_FollowDecelJerkForceSlopeYAxis P_LongCtrl_FollowdecelJerkCharXAxis P_LongCtrl_FollowdecelJerkCharYAxis P_LongCtrl_FollowttcCorrDecelJerkXAxis P_LongCtrl_FollowttcCorrDecelJerkYAxis /end REF_CHARACTERISTIC
/end GROUP
/begin GROUP S87_LP "PubIfDecisionPLAN_MDL/PLAN/Subsystem Reference/AP/AP/LCObjChoose+FollowCtrl/FollowCtrl/FollowBandJerkCalc/LP" /begin REF_MEASUREMENT LongCtrl_accelFollowFilt /end REF_MEASUREMENT /end GROUP
/begin GROUP S87_Subsystem "PubIfDecisionPLAN_MDL/PLAN/Subsystem Reference/AP/AP/LCObjChoose+FollowCtrl/FollowCtrl/FollowBandJerkCalc/Subsystem" /begin REF_MEASUREMENT LongCtrl_lowerBandFollow LongCtrl_upperBandFollow /end REF_MEASUREMENT /end GROUP
/begin GROUP S89_StandstillOverrideAccelLimit "PubIfDecisionPLAN_MDL/PLAN/Subsystem Reference/AP/AP/LCObjChoose+FollowCtrl/FollowCtrl/PlausibilityCheck/StandstillOverrideAccelLimit" /begin REF_CHARACTERISTIC P_LongCtrl_FollowQuickDecelAccelDesMax /end REF_CHARACTERISTIC /begin REF_MEASUREMENT LongCtrl_FollowAcceleStandstillOverride /end REF_MEASUREMENT /end GROUP
/begin GROUP S89_Subsystem "PubIfDecisionPLAN_MDL/PLAN/Subsystem Reference/AP/AP/LCObjChoose+FollowCtrl/FollowCtrl/PlausibilityCheck/Subsystem"
 /begin REF_CHARACTERISTIC P_LongCtrl_FollowQuickAccelTargAbsEnableThres P_LongCtrl_FollowQuickDecelDiffDistRel2DesThres P_LongCtrl_FollowQuickDecelVelSubjThres P_LongCtrl_FollowQuickDecelVelTargRelThres /end REF_CHARACTERISTIC
 /begin REF_MEASUREMENT LongCtrl_quickDecel /end REF_MEASUREMENT
/end GROUP
/begin GROUP S8_AL "PubIfDecisionPLAN_MDL/PLAN/Subsystem Reference/AP/AP/AL"
 /begin REF_CHARACTERISTIC P_LongCtrl_ALaLowerChar P_LongCtrl_ALaUpperCharEco P_LongCtrl_ALaUpperCharNormal P_LongCtrl_ALaUpperCharSport P_LongCtrl_ALvAcceleLowerChar P_LongCtrl_ALvAcceleUpperCharEco P_LongCtrl_ALvAcceleUpperCharNormal P_LongCtrl_ALvAcceleUpperCharSport /end REF_CHARACTERISTIC
 /begin REF_MEASUREMENT LongCtrl_accelAL LongCtrl_lowerBandAL LongCtrl_lowerJerkAL LongCtrl_upperBandAL LongCtrl_upperJerkAL /end REF_MEASUREMENT
/end GROUP
/begin GROUP S8_Arbitrate "PubIfDecisionPLAN_MDL/PLAN/Subsystem Reference/AP/AP/Arbitrate" /begin SUB_GROUP S10_Subsystem /end SUB_GROUP
 /begin REF_MEASUREMENT LongCtrl_ArbFlag LongCtrl_accelArb LongCtrl_lowerBandArb LongCtrl_lowerJerkArb LongCtrl_upperBandArb LongCtrl_upperJerkArb /end REF_MEASUREMENT
/end GROUP
/begin GROUP S8_CCCtrl "PubIfDecisionPLAN_MDL/PLAN/Subsystem Reference/AP/AP/CCCtrl"
 /begin SUB_GROUP S11_AccelCCCalc S11_AccelCCLimit S11_AcceleBandCC S11_accelCCJerkSelect S11_accelJerkCalc S11_velPlanCC /end SUB_GROUP
 /begin REF_CHARACTERISTIC C_LongCtrl_0_Uint8 P_LongCtrl_CCLCIncSetSpdAdd P_LongCtrl_CCLCIncSetSpdAddCntStartValue /end REF_CHARACTERISTIC
 /begin REF_MEASUREMENT LongCtrl_lowerBandCC LongCtrl_upperBandCC /end REF_MEASUREMENT
/end GROUP
/begin GROUP S8_IC "PubIfDecisionPLAN_MDL/PLAN/Subsystem Reference/AP/AP/IC"
 /begin SUB_GROUP S14_AccelArbIC S14_AccelBandIC S14_AccelCurvature S14_AccelKap S14_CurvatureOfMapCalc S14_CurvatureOfRoadCalc S14_JerkIC S14_Subsystem1 /end SUB_GROUP
/end GROUP
/begin GROUP S8_LCObjChoose_FollowCtrl "PubIfDecisionPLAN_MDL/PLAN/Subsystem Reference/AP/AP/LCObjChoose+FollowCtrl" /begin SUB_GROUP S15_FollowCtrl S15_LaneChangeObjectChoose /end SUB_GROUP /end GROUP
/begin GROUP S8_ORD "PubIfDecisionPLAN_MDL/PLAN/Subsystem Reference/AP/AP/ORD" /begin SUB_GROUP S16_ORD /end SUB_GROUP
 /begin REF_CHARACTERISTIC P_LongCtrl_ORDdecelEnable P_LongCtrl_ORDvelDeltaEnableThres /end REF_CHARACTERISTIC
 /begin REF_MEASUREMENT LongCtrl_accelORD /end REF_MEASUREMENT
/end GROUP
/begin GROUP S8_SJ "PubIfDecisionPLAN_MDL/PLAN/Subsystem Reference/AP/AP/SJ"
 /begin SUB_GROUP S17_BrakePreferJudge S17_DeceleToStop S17_DisBar S17_DriverOffConditionFulfilled S17_TakeOver /end SUB_GROUP
/end GROUP
/begin GROUP S8_Subsystem "PubIfDecisionPLAN_MDL/PLAN/Subsystem Reference/AP/AP/Subsystem"
 /begin REF_MEASUREMENT LongCtrl_IN_ACCModeSts LongCtrl_IN_ACC_SpdSetValue LongCtrl_IN_ALC_intention LongCtrl_IN_DrivingMode LongCtrl_IN_HWAIsLaneChange LongCtrl_IN_IDP0 LongCtrl_IN_IDP2 LongCtrl_IN_IDP3 LongCtrl_IN_IP_VehSpdUnit LongCtrl_IN_L1bIsLineExist LongCtrl_IN_L1dC0V LongCtrl_IN_L1dC1V LongCtrl_IN_L1dC2V LongCtrl_IN_L1dC3V LongCtrl_IN_L1dDisFront LongCtrl_IN_Object_AX LongCtrl_IN_Object_Age LongCtrl_IN_Object_DX LongCtrl_IN_Object_DY LongCtrl_IN_Object_ExistProb LongCtrl_IN_Object_Fus_Type LongCtrl_IN_Object_HeadingAngle LongCtrl_IN_Object_Hight LongCtrl_IN_Object_ID LongCtrl_IN_Object_Length LongCtrl_IN_Object_ObstacleProb LongCtrl_IN_Object_Type LongCtrl_IN_Object_VX LongCtrl_IN_Object_VY LongCtrl_IN_Object_Width LongCtrl_IN_P2_Exist LongCtrl_IN_P3_Exist LongCtrl_IN_R1bIsLineExis LongCtrl_IN_R1dC0V LongCtrl_IN_R1dC1V LongCtrl_IN_R1dC2V LongCtrl_IN_R1dC3V LongCtrl_IN_R1dDisFront LongCtrl_IN_RFM_UpdateCnt LongCtrl_IN_SafeStopActive LongCtrl_IN_TOS_UpdateCnt LongCtrl_IN_VlcInternalAccK1 LongCtrl_IN_accelSubj LongCtrl_IN_accelTargAbsP0 LongCtrl_IN_accelTargAbsP2 LongCtrl_IN_accelTargAbsP3 LongCtrl_IN_axvRoadSlopeMs2 LongCtrl_IN_dangerLevel LongCtrl_IN_distRamp2Cur LongCtrl_IN_distTargRel LongCtrl_IN_distTargRelP2 LongCtrl_IN_distTargRelP3 LongCtrl_IN_i_road_curvature LongCtrl_IN_i_road_curvature_distance_matrix LongCtrl_IN_i_road_curvature_far LongCtrl_IN_i_road_curvature_far_distance LongCtrl_IN_i_road_curvature_matrix_size LongCtrl_IN_i_road_curvature_value_matrix LongCtrl_IN_kap LongCtrl_IN_laneChangeEnable LongCtrl_IN_targetExistP0 LongCtrl_IN_timeGap LongCtrl_IN_vSetBelowMin LongCtrl_IN_vehicleSpd LongCtrl_IN_velOffRampLimit LongCtrl_IN_velSubj LongCtrl_IN_velTargRel /end REF_MEASUREMENT
/end GROUP
/begin GROUP S8_VlcInternalAccCalc "PubIfDecisionPLAN_MDL/PLAN/Subsystem Reference/AP/AP/VlcInternalAccCalc" /begin REF_MEASUREMENT LongCtrl_VlcInternalAccK20 /end REF_MEASUREMENT /end GROUP
/begin GROUP S927_LCK2 "PubIfStateVSM_MDL/Subsystem Reference/Subsystem/StateManage/LSS/LCK_LKA_LDW_ELKStateMachine3/LCK/LCK/LCK2" /begin SUB_GROUP S928_LCK S928_LCK_Condition1 /end SUB_GROUP
 /begin REF_MEASUREMENT VSM_LCKState VSM_LCK_Counter VSM_LCK_VERSION VSM_TJALCKState /end REF_MEASUREMENT
/end GROUP
/begin GROUP S928_LCK "PubIfStateVSM_MDL/Subsystem Reference/Subsystem/StateManage/LSS/LCK_LKA_LDW_ELKStateMachine3/LCK/LCK/LCK2/LCK" /begin SUB_GROUP S930_Subsystem2 S930_Subsystem3 /end SUB_GROUP
 /begin REF_CHARACTERISTIC P_VSM_LCK_PreTime P_VSM_LCK_T0 P_VSM_LCK_T1 P_VSM_LCK_Warnarea1 P_VSM_LCK_Warnarea2 /end REF_CHARACTERISTIC
 /begin REF_MEASUREMENT VSM_LCK_TargetLaneIn_A0 VSM_LCK_Warning /end REF_MEASUREMENT
/end GROUP
/begin GROUP S928_LCK_Condition1 "PubIfStateVSM_MDL/Subsystem Reference/Subsystem/StateManage/LSS/LCK_LKA_LDW_ELKStateMachine3/LCK/LCK/LCK2/LCK_Condition1"
 /begin SUB_GROUP S931_Subsystem1 S931_Subsystem10 S931_Subsystem11 S931_Subsystem12 S931_Subsystem13 S931_Subsystem14 S931_Subsystem15 S931_Subsystem16 S931_Subsystem17 S931_Subsystem18 S931_Subsystem19 S931_Subsystem2 S931_Subsystem20 S931_Subsystem21 S931_Subsystem3 S931_Subsystem4 S931_Subsystem5 S931_Subsystem7 S931_Subsystem8 S931_Subsystem9 /end SUB_GROUP
 /begin REF_CHARACTERISTIC P_VSM_LCK_AbsEspInTime P_VSM_LCK_AccRateIn P_VSM_LCK_AccRateInTime P_VSM_LCK_AccRateOut P_VSM_LCK_AccrPelOut P_VSM_LCK_AccrPelRateOut P_VSM_LCK_BrakePressIn P_VSM_LCK_BrakePressInTime P_VSM_LCK_BrakePressOut P_VSM_LCK_DrvInputTrqValueIn P_VSM_LCK_DrvInputTrqValueInTime P_VSM_LCK_DrvInputTrqValueOut P_VSM_LCK_IdleInTime P_VSM_LCK_LCDrvInputTrqValueOut P_VSM_LCK_LCOverrideTime P_VSM_LCK_LCOverrideValue P_VSM_LCK_LateralAcceIn P_VSM_LCK_LateralAcceInTime P_VSM_LCK_LateralAcceOut P_VSM_LCK_LongitudeAccIn P_VSM_LCK_LongitudeAccInTime P_VSM_LCK_LongitudeAccOut P_VSM_LCK_OverrideInTime P_VSM_LCK_OverrideTime P_VSM_LCK_OverrideValue P_VSM_LCK_State_Absesp_enable P_VSM_LCK_State_Accpedalrate_enable P_VSM_LCK_State_Breakpressure_enable P_VSM_LCK_State_DriverInputTrqValue_enable P_VSM_LCK_State_ESSSts_enable P_VSM_LCK_State_Eps_enable P_VSM_LCK_State_GEAR_enable P_VSM_LCK_State_Handson_enable P_VSM_LCK_State_IdleInTime_enable P_VSM_LCK_State_LSMLine_enable P_VSM_LCK_State_LaneChange_enable P_VSM_LCK_State_LaneCurve_enable P_VSM_LCK_State_Lane_enable P_VSM_LCK_State_LateralAcce_enable P_VSM_LCK_State_LongitudeAcc_enable P_VSM_LCK_State_Overide_enable P_VSM_LCK_State_SteerWheelAngle_enable P_VSM_LCK_State_SteerWheelSpd_enable P_VSM_LCK_State_TargetLaneIn_enable P_VSM_LCK_State_TurnLight_enable P_VSM_LCK_State_Vehspeed_enable P_VSM_LCK_State_Yawsup_enable P_VSM_LCK_SteerAngleSpdIn P_VSM_LCK_SteerAngleSpdInTime P_VSM_LCK_SteerAngleSpdOut P_VSM_LCK_SteerWheelAngleIn P_VSM_LCK_SteerWheelAngleInTime P_VSM_LCK_SteerWheelAngleOut P_VSM_LCK_YawRateIn P_VSM_LCK_YawRateInTime P_VSM_LCK_YawRateOut P_VSM_LCK_absLongitudeAccIn P_VSM_LCK_absLongitudeAccOut /end REF_CHARACTERISTIC
 /begin REF_MEASUREMENT VSM_LCK_Active2Ready VSM_LCK_Con_AbsEsp_Idle2Ready VSM_LCK_Con_AbsEsp_Ready2Idle VSM_LCK_Con_AccPedalRate_Active2Ready VSM_LCK_Con_AccPedalRate_Ready2Active VSM_LCK_Con_BrakePress_Active2Ready VSM_LCK_Con_BrakePress_Ready2Active VSM_LCK_Con_CURRENT_GEAR_Active2Ready VSM_LCK_Con_CURRENT_GEAR_Ready2Active VSM_LCK_Con_DriverInput_Active2Ready VSM_LCK_Con_DrvInputTrqValue_Ready2Active VSM_LCK_Con_ESSSts_Idle2Ready VSM_LCK_Con_ESSSts_Ready2Idle VSM_LCK_Con_EpsSta_Active2Ready VSM_LCK_Con_EpsSts_Ready2Active VSM_LCK_Con_HandsOff_Ready2Idle VSM_LCK_Con_Handson_Idle2Ready VSM_LCK_Con_InTime_Idle2Ready VSM_LCK_Con_LSMLine_Idle2Ready VSM_LCK_Con_LSMLine_Ready2Idle VSM_LCK_Con_LaneChange_Active2Ready VSM_LCK_Con_LaneChange_Ready2Active VSM_LCK_Con_LaneCurve_Idle2Ready VSM_LCK_Con_LaneCurve_Ready2Idle VSM_LCK_Con_Lane_Idle2Ready VSM_LCK_Con_Lane_Ready2Idle VSM_LCK_Con_LateralAcc_Active2Ready VSM_LCK_Con_LateralAcc_Ready2Active VSM_LCK_Con_LongitudeAcc_Active2Ready VSM_LCK_Con_LongitudeAcc_Ready2Active VSM_LCK_Con_OverRide_Active2Ready VSM_LCK_Con_OverRide_Ready2Active VSM_LCK_Con_SteerAngleSpd_Active2Ready VSM_LCK_Con_SteerAngleSpd_Ready2Active VSM_LCK_Con_SteerWheelAngle_Active2Ready VSM_LCK_Con_SteerWheelAngle_Ready2Active VSM_LCK_Con_TJAHandson_Idle2Ready VSM_LCK_Con_TJALane_Idle2Ready VSM_LCK_Con_TJALane_Ready2Idle VSM_LCK_Con_TJAVehicleSpd_Idle2Ready VSM_LCK_Con_TJAVehicleSpd_Ready2Idle VSM_LCK_Con_TargetLaneIn_Idle2Ready VSM_LCK_Con_TurnLight_Active2Ready VSM_LCK_Con_TurnLight_Ready2Active VSM_LCK_Con_VehicleSpd_Idle2Ready VSM_LCK_Con_VehicleSpd_Ready2Idle VSM_LCK_Con_YawRate_Idle2Ready VSM_LCK_Con_YawRate_Ready2Idle VSM_LCK_Idle2Ready VSM_LCK_Ready2Active VSM_LCK_Ready2Idle VSM_LCK_TJAIdle2Ready VSM_LCK_TJAReady2Idle /end REF_MEASUREMENT
/end GROUP
/begin GROUP S99_P_LongCtrl_velSubjThresEnableStopAdd "PubIfDecisionPLAN_MDL/PLAN/Subsystem Reference/AP/AP/LCObjChoose+FollowCtrl/FollowCtrl/DecelToStopCtrl/DecelToStopCtrl/P_LongCtrl_velSubjThresEnableStopAdd"
 /begin REF_CHARACTERISTIC P_LongCtrl_FollowDistDiff2VelSubjThresEnableStop P_LongCtrl_FollowaccelFollowDesThresEnableStopXAxis P_LongCtrl_FollowaccelFollowDesThresEnableStopYAxis P_LongCtrl_FollowdistDesStopMin P_LongCtrl_FollowvelSubjThresEnableStop P_LongCtrl_FollowvelSubjThresEnableStopAddXAxis P_LongCtrl_FollowvelSubjThresEnableStopAddYAxis /end REF_CHARACTERISTIC
/end GROUP
/begin GROUP S99_Subsystem "PubIfDecisionPLAN_MDL/PLAN/Subsystem Reference/AP/AP/LCObjChoose+FollowCtrl/FollowCtrl/DecelToStopCtrl/DecelToStopCtrl/Subsystem"
 /begin REF_CHARACTERISTIC P_LongCtrl_FollowVelSubjThresForceStopXAxis P_LongCtrl_FollowVelSubjThresForceStopYAxis P_LongCtrl_FollowaccelForceStopMinCharXAxis P_LongCtrl_FollowaccelForceStopMinCharYAxis P_LongCtrl_FollowjerkForceStopCharXAxis P_LongCtrl_FollowjerkForceStopCharYAxis /end REF_CHARACTERISTIC
/end GROUP
/begin GROUP S9_AngSlopeCalc "PubIfControlLATC_MDL/Subsystem Reference/Subsystem/LateralControl/LCS_Angle/AngSlopeCalc" /begin SUB_GROUP S13_Switch_Case_Action_Subsystem /end SUB_GROUP
 /begin REF_CHARACTERISTIC P_LCS_AngleSlope_ELK P_LCS_AngleSlope_ESS P_LCS_AngleSlope_LCK P_LCS_AngleSlope_LCKIE P_LCS_AngleSlope_LC_Cancel P_LCS_AngleSlope_LC_Eco P_LCS_AngleSlope_LC_Nomal P_LCS_AngleSlope_LC_Sport P_LCS_AngleSlope_LKA P_LCS_AngleSlope_Spd_BP P_LCS_LCcancel_detaA0 P_LCS_StateHold_time /end REF_CHARACTERISTIC
 /begin REF_MEASUREMENT LCS_AngleSlope_Cnt LCS_AngleSlope_Flg LCS_AngleSlope_LCcancel LCS_HoldTime LCS_StateActive_AngleSlope LCS_State_AngleSlope LCS_TarDangerLevelProc LCS_TarSteerAngleSlope /end REF_MEASUREMENT
/end GROUP
/begin GROUP S9_LP_filter2 "PubIfControlLATC_MDL/Subsystem Reference/Subsystem/LateralControl/LCS_Angle/LP filter2" /begin REF_MEASUREMENT LCS_SteerAngleFilter_deg /end REF_MEASUREMENT /end GROUP
/begin GROUP S9_LP_filter3 "PubIfControlLATC_MDL/Subsystem Reference/Subsystem/LateralControl/LCS_Angle/LP filter3" /begin REF_MEASUREMENT LCS_SteerAngleSpdFilter_degs /end REF_MEASUREMENT /end GROUP
/begin GROUP S9_OverRideDetect "PubIfControlLATC_MDL/Subsystem Reference/Subsystem/LateralControl/LCS_Angle/OverRideDetect" /begin REF_MEASUREMENT LCS_IsOverRide /end REF_MEASUREMENT /end GROUP
/begin GROUP S9_Subsystem1 "PubIfControlLATC_MDL/Subsystem Reference/Subsystem/LateralControl/LCS_Angle/Subsystem1" /begin REF_MEASUREMENT LCS_EpsTrqReqValue LCS_EpsTrqReqValueVld /end REF_MEASUREMENT /end GROUP
/begin GROUP S9_Subsystem4 "PubIfControlLATC_MDL/Subsystem Reference/Subsystem/LateralControl/LCS_Angle/Subsystem4" /begin SUB_GROUP S24_FF S24_LP_filter S24_PID S24_Subsystem1 /end SUB_GROUP
 /begin REF_CHARACTERISTIC P_LCS_AngleErrorReversTorq_LC_TarAngleBp P_LCS_AngleErrorReversTorq_LC_TarAngleFac P_LCS_AngleErrorReversTorq_LC_VehSpdBp P_LCS_AngleErrorReversTorq_LC_VehSpdVal P_LCS_FF_EnableSpd /end REF_CHARACTERISTIC
 /begin REF_MEASUREMENT LCS_AngleErrorReversTorq LCS_TorqFFPID_OUT LCS_Torq_FF /end REF_MEASUREMENT
/end GROUP
/begin GROUP S9_TargetSteerAngleCalc "PubIfControlLATC_MDL/Subsystem Reference/Subsystem/LateralControl/LCS_Angle/TargetSteerAngleCalc" /begin SUB_GROUP S25_LP_filter /end SUB_GROUP
 /begin REF_CHARACTERISTIC P_LCS_AngleFilterTime P_LCS_DeltaEps_SpdBp P_LCS_DeltaEps_TimeVal /end REF_CHARACTERISTIC
 /begin REF_MEASUREMENT LCS_Q LCS_TarSteerAngle LCS_TarSteerAngleCalc_Num LCS_TarSteerAngleEnd /end REF_MEASUREMENT
/end GROUP
/begin RECORD_LAYOUT Lookup1D_FLOAT32_IEEE FNC_VALUES 1 FLOAT32_IEEE ROW_DIR DIRECT /end RECORD_LAYOUT
/begin RECORD_LAYOUT Lookup1D_X_FLOAT32_IEEE AXIS_PTS_X 1 FLOAT32_IEEE INDEX_INCR DIRECT /end RECORD_LAYOUT
/begin RECORD_LAYOUT Lookup2D_FLOAT32_IEEE FNC_VALUES 1 FLOAT32_IEEE ROW_DIR DIRECT /end RECORD_LAYOUT
/begin RECORD_LAYOUT Lookup2D_X_FLOAT32_IEEE AXIS_PTS_X 1 FLOAT32_IEEE INDEX_INCR DIRECT /end RECORD_LAYOUT
/begin RECORD_LAYOUT Scalar_BOOLEAN FNC_VALUES 1 UBYTE ROW_DIR DIRECT /end RECORD_LAYOUT
/begin RECORD_LAYOUT Scalar_FLOAT32_IEEE FNC_VALUES 1 FLOAT32_IEEE ROW_DIR DIRECT /end RECORD_LAYOUT
/begin RECORD_LAYOUT Scalar_FLOAT64_IEEE FNC_VALUES 1 FLOAT64_IEEE ROW_DIR DIRECT /end RECORD_LAYOUT
/begin RECORD_LAYOUT Scalar_SWORD FNC_VALUES 1 SWORD ROW_DIR DIRECT /end RECORD_LAYOUT
/begin RECORD_LAYOUT Scalar_UBYTE FNC_VALUES 1 UBYTE ROW_DIR DIRECT /end RECORD_LAYOUT
/begin RECORD_LAYOUT Scalar_UWORD FNC_VALUES 1 UWORD ROW_DIR DIRECT /end RECORD_LAYOUT
/begin RECORD_LAYOUT __UBYTE_S FNC_VALUES 1 UBYTE COLUMN_DIR DIRECT /end RECORD_LAYOUT
/begin RECORD_LAYOUT __UWORD_S FNC_VALUES 1 UWORD COLUMN_DIR DIRECT /end RECORD_LAYOUT
/begin RECORD_LAYOUT __ULONG_S FNC_VALUES 1 ULONG COLUMN_DIR DIRECT /end RECORD_LAYOUT
/begin RECORD_LAYOUT __SBYTE_S FNC_VALUES 1 SBYTE COLUMN_DIR DIRECT /end RECORD_LAYOUT
/begin RECORD_LAYOUT __SWORD_S FNC_VALUES 1 SWORD COLUMN_DIR DIRECT /end RECORD_LAYOUT
/begin RECORD_LAYOUT __SLONG_S FNC_VALUES 1 SLONG COLUMN_DIR DIRECT /end RECORD_LAYOUT
/begin RECORD_LAYOUT __FLOAT32_IEEE_S FNC_VALUES 1 FLOAT32_IEEE COLUMN_DIR DIRECT /end RECORD_LAYOUT
/begin RECORD_LAYOUT __FLOAT64_IEEE_S FNC_VALUES 1 FLOAT64_IEEE COLUMN_DIR DIRECT /end RECORD_LAYOUT
/begin RECORD_LAYOUT SSV__UBYTE_S AXIS_PTS_X 1 UBYTE INDEX_INCR DIRECT /end RECORD_LAYOUT
/begin RECORD_LAYOUT SSV__UWORD_S AXIS_PTS_X 1 UWORD INDEX_INCR DIRECT /end RECORD_LAYOUT
/begin RECORD_LAYOUT SSV__ULONG_S AXIS_PTS_X 1 ULONG INDEX_INCR DIRECT /end RECORD_LAYOUT
/begin RECORD_LAYOUT SSV__SBYTE_S AXIS_PTS_X 1 SBYTE INDEX_INCR DIRECT /end RECORD_LAYOUT
/begin RECORD_LAYOUT SSV__SWORD_S AXIS_PTS_X 1 SWORD INDEX_INCR DIRECT /end RECORD_LAYOUT
/begin RECORD_LAYOUT SSV__SLONG_S AXIS_PTS_X 1 SLONG INDEX_INCR DIRECT /end RECORD_LAYOUT
/begin RECORD_LAYOUT SSV__FLOAT32_IEEE_S AXIS_PTS_X 1 FLOAT32_IEEE INDEX_INCR DIRECT /end RECORD_LAYOUT
/begin RECORD_LAYOUT SSV__FLOAT64_IEEE_S AXIS_PTS_X 1 FLOAT64_IEEE INDEX_INCR DIRECT /end RECORD_LAYOUT
/begin RECORD_LAYOUT __A_UINT64_Z FNC_VALUES 1 A_UINT64 ROW_DIR DIRECT /end RECORD_LAYOUT
/begin RECORD_LAYOUT __A_INT64_Z FNC_VALUES 1 A_INT64 ROW_DIR DIRECT /end RECORD_LAYOUT
/begin RECORD_LAYOUT __A_UINT64_S FNC_VALUES 1 A_UINT64 COLUMN_DIR DIRECT /end RECORD_LAYOUT
/begin RECORD_LAYOUT __A_INT64_S FNC_VALUES 1 A_INT64 COLUMN_DIR DIRECT /end RECORD_LAYOUT
/begin RECORD_LAYOUT SSV__A_UINT64_S AXIS_PTS_X 1 A_UINT64 INDEX_INCR DIRECT /end RECORD_LAYOUT
/begin RECORD_LAYOUT SSV__A_INT64_S AXIS_PTS_X 1 A_INT64 INDEX_INCR DIRECT /end RECORD_LAYOUT
/end MODULE
/end PROJECT
