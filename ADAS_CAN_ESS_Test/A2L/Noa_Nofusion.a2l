ASAP2_VERSION 1 61
/begin PROJECT Noa_Nofusion ""
/begin MODULE Noa_Nofusion ""
/begin MOD_COMMON "" DEPOSIT ABSOLUTE BYTE_ORDER MSB_LAST ALIGNMENT_BYTE 1 ALIGNMENT_WORD 2 ALIGNMENT_LONG 4 ALIGNMENT_INT64 1 ALIGNMENT_FLOAT32_IEEE 4 ALIGNMENT_FLOAT64_IEEE 8 /end MOD_COMMON
/begin COMPU_VTAB VTAB_FOR_PubIfStateVSM_MDL_CM_ACC_STATE "Enumerated data type: ACC_STATE" TAB_VERB 9 0 "ACC_STATE_ACC_Off" 1 "ACC_STATE_ACC_Reject" 2 "ACC_STATE_ACC_Standby" 3 "ACC_STATE_ACC_ActiveControl" 4 "ACC_STATE_ACC_BrakeOnly" 5 "ACC_STATE_ACC_Override" 6 "ACC_STATE_ACC_StandWait" 7 "ACC_STATE_ACC_Failure" 9 "ACC_STATE_ACC_StandActive" DEFAULT_VALUE "" /end COMPU_VTAB
/begin COMPU_VTAB VTAB_FOR_PubIfStateVSM_MDL_CM_HWA_STATE "Enumerated data type: HWA_STATE" TAB_VERB 12 0 "HWA_STATE_HWA_Off" 1 "HWA_STATE_HWA_Idle" 2 "HWA_STATE_HWA_Ready" 3 "HWA_STATE_HWA_CCAct" 4 "HWA_STATE_HWA_Pause" 5 "HWA_STATE_HWA_LeftTurn" 6 "HWA_STATE_HWA_RightTurn" 7 "HWA_STATE_HWA_Error" 9 "HWA_STATE_HWA_SafeStop" 10 "HWA_STATE_HWA_SlowRetreat" 11 "HWA_STATE_HWA_LeftTurnPrepare" 12 "HWA_STATE_HWA_RightTurnPrepare" DEFAULT_VALUE "" /end COMPU_VTAB
/begin COMPU_VTAB VTAB_FOR_PubIfStateVSM_MDL_CM_TJA_STATE "Enumerated data type: TJA_STATE" TAB_VERB 8 0 "TJA_STATE_TJA_Off" 1 "TJA_STATE_TJA_Idle" 2 "TJA_STATE_TJA_Ready" 3 "TJA_STATE_TJA_Active" 6 "TJA_STATE_TJA_Wait" 7 "TJA_STATE_TJA_Error" 9 "TJA_STATE_TJA_SafeStop" 10 "TJA_STATE_TJA_SlowRetreat" DEFAULT_VALUE "" /end COMPU_VTAB
/begin COMPU_METHOD PubIfChassisHMI_MDL_CM_single "Q = V" IDENTICAL "%8.6" "" /end COMPU_METHOD
/begin COMPU_METHOD PubIfCommonVIE_MDL_CM_single "Q = V" IDENTICAL "%8.6" "" /end COMPU_METHOD
/begin COMPU_METHOD PubIfCommonVIE_MDL_CM_single_m "Q = V" IDENTICAL "%8.6" "m" /end COMPU_METHOD
/begin COMPU_METHOD PubIfCommonVIE_MDL_CM_single_m_s "Q = V" IDENTICAL "%8.6" "m/s" /end COMPU_METHOD
/begin COMPU_METHOD PubIfControlLATC_MDL_CM_boolean "Q = V" IDENTICAL "%1.0" "" /end COMPU_METHOD
/begin COMPU_METHOD PubIfControlLATC_MDL_CM_double "Q = V" IDENTICAL "%15.10" "" /end COMPU_METHOD
/begin COMPU_METHOD PubIfControlLATC_MDL_CM_single "Q = V" IDENTICAL "%8.6" "" /end COMPU_METHOD
/begin COMPU_METHOD PubIfControlLATC_MDL_CM_uint32 "Q = V" IDENTICAL "%10.0" "" /end COMPU_METHOD
/begin COMPU_METHOD PubIfControlLATC_MDL_CM_uint8 "Q = V" IDENTICAL "%3.0" "" /end COMPU_METHOD
/begin COMPU_METHOD PubIfControlLONC_MDL_CM_boolean "Q = V" IDENTICAL "%1.0" "" /end COMPU_METHOD
/begin COMPU_METHOD PubIfControlLONC_MDL_CM_single "Q = V" IDENTICAL "%8.6" "" /end COMPU_METHOD
/begin COMPU_METHOD PubIfControlLONC_MDL_CM_single_m "Q = V" IDENTICAL "%8.6" "m" /end COMPU_METHOD
/begin COMPU_METHOD PubIfDecisionLSM_MDL_CM_boolean "Q = V" IDENTICAL "%1.0" "" /end COMPU_METHOD
/begin COMPU_METHOD PubIfDecisionLSM_MDL_CM_double "Q = V" IDENTICAL "%15.10" "" /end COMPU_METHOD
/begin COMPU_METHOD PubIfDecisionLSM_MDL_CM_int8 "Q = V" IDENTICAL "%3.0" "" /end COMPU_METHOD
/begin COMPU_METHOD PubIfDecisionLSM_MDL_CM_single "Q = V" IDENTICAL "%8.6" "" /end COMPU_METHOD
/begin COMPU_METHOD PubIfDecisionLSM_MDL_CM_uint32 "Q = V" IDENTICAL "%10.0" "" /end COMPU_METHOD
/begin COMPU_METHOD PubIfDecisionLSM_MDL_CM_uint8 "Q = V" IDENTICAL "%3.0" "" /end COMPU_METHOD
/begin COMPU_METHOD PubIfDecisionPLAN_MDL_CM_boolean "Q = V" IDENTICAL "%1.0" "" /end COMPU_METHOD
/begin COMPU_METHOD PubIfDecisionPLAN_MDL_CM_double "Q = V" IDENTICAL "%15.10" "" /end COMPU_METHOD
/begin COMPU_METHOD PubIfDecisionPLAN_MDL_CM_single "Q = V" IDENTICAL "%8.6" "" /end COMPU_METHOD
/begin COMPU_METHOD PubIfDecisionPLAN_MDL_CM_single_m "Q = V" IDENTICAL "%8.6" "m" /end COMPU_METHOD
/begin COMPU_METHOD PubIfDecisionPLAN_MDL_CM_single_m_s "Q = V" IDENTICAL "%8.6" "m/s" /end COMPU_METHOD
/begin COMPU_METHOD PubIfDecisionPLAN_MDL_CM_single_m_s_2 "Q = V" IDENTICAL "%8.6" "m/s^2" /end COMPU_METHOD
/begin COMPU_METHOD PubIfDecisionPLAN_MDL_CM_single_s "Q = V" IDENTICAL "%8.6" "s" /end COMPU_METHOD
/begin COMPU_METHOD PubIfDecisionPLAN_MDL_CM_uint16 "Q = V" IDENTICAL "%5.0" "" /end COMPU_METHOD
/begin COMPU_METHOD PubIfDecisionPLAN_MDL_CM_uint32 "Q = V" IDENTICAL "%10.0" "" /end COMPU_METHOD
/begin COMPU_METHOD PubIfDecisionPLAN_MDL_CM_uint8 "Q = V" IDENTICAL "%3.0" "" /end COMPU_METHOD
/begin COMPU_METHOD PubIfStateVSM_MDL_CM_ACC_STATE "Enumerated data type: ACC_STATE" TAB_VERB "%10.6" "" COMPU_TAB_REF VTAB_FOR_PubIfStateVSM_MDL_CM_ACC_STATE /end COMPU_METHOD
/begin COMPU_METHOD PubIfStateVSM_MDL_CM_boolean "Q = V" IDENTICAL "%1.0" "" /end COMPU_METHOD
/begin COMPU_METHOD PubIfStateVSM_MDL_CM_double "Q = V" IDENTICAL "%15.10" "" /end COMPU_METHOD
/begin COMPU_METHOD PubIfStateVSM_MDL_CM_HWA_STATE "Enumerated data type: HWA_STATE" TAB_VERB "%10.6" "" COMPU_TAB_REF VTAB_FOR_PubIfStateVSM_MDL_CM_HWA_STATE /end COMPU_METHOD
/begin COMPU_METHOD PubIfStateVSM_MDL_CM_single "Q = V" IDENTICAL "%8.6" "" /end COMPU_METHOD
/begin COMPU_METHOD PubIfStateVSM_MDL_CM_TJA_STATE "Enumerated data type: TJA_STATE" TAB_VERB "%10.6" "" COMPU_TAB_REF VTAB_FOR_PubIfStateVSM_MDL_CM_TJA_STATE /end COMPU_METHOD
/begin COMPU_METHOD PubIfStateVSM_MDL_CM_uint16 "Q = V" IDENTICAL "%5.0" "" /end COMPU_METHOD
/begin COMPU_METHOD PubIfStateVSM_MDL_CM_uint16__S_ "Q = V" IDENTICAL "%5.0" "<S>" /end COMPU_METHOD
/begin COMPU_METHOD PubIfStateVSM_MDL_CM_uint16_num "Q = V" IDENTICAL "%5.0" "num" /end COMPU_METHOD
/begin COMPU_METHOD PubIfStateVSM_MDL_CM_uint16_s "Q = V" IDENTICAL "%5.0" "s" /end COMPU_METHOD
/begin COMPU_METHOD PubIfStateVSM_MDL_CM_uint32 "Q = V" IDENTICAL "%10.0" "" /end COMPU_METHOD
/begin COMPU_METHOD PubIfStateVSM_MDL_CM_uint8 "Q = V" IDENTICAL "%3.0" "" /end COMPU_METHOD
/begin COMPU_METHOD PubIfStateVSM_MDL_CM_uint8_s "Q = V" IDENTICAL "%3.0" "s" /end COMPU_METHOD
/begin CHARACTERISTIC C_LongCtrl_Mph2Kph "" VALUE 0x3B4CD0 Scalar_FLOAT32_IEEE 0 PubIfDecisionPLAN_MDL_CM_single -3.4e+38 3.4e+38 /end CHARACTERISTIC
/begin MEASUREMENT LA_Adjacent_Count "" UBYTE PubIfDecisionLSM_MDL_CM_uint8 0 0 0 255 ECU_ADDRESS 0x3FE97A /end MEASUREMENT
/begin MEASUREMENT LA_ELEM_0_Availability_State "" UBYTE PubIfDecisionLSM_MDL_CM_uint8 0 0 0 255 ECU_ADDRESS 0x3FE95E /end MEASUREMENT
/begin MEASUREMENT LA_ELEM_0_C0 "" FLOAT32_IEEE PubIfDecisionLSM_MDL_CM_single 0 0 -3.4e+38 3.4e+38 ECU_ADDRESS 0x3FE8D0 /end MEASUREMENT
/begin MEASUREMENT LA_ELEM_0_C1 "" FLOAT32_IEEE PubIfDecisionLSM_MDL_CM_single 0 0 -3.4e+38 3.4e+38 ECU_ADDRESS 0x3FE7F0 /end MEASUREMENT
/begin MEASUREMENT LA_ELEM_0_C2 "" FLOAT32_IEEE PubIfDecisionLSM_MDL_CM_single 0 0 -3.4e+38 3.4e+38 ECU_ADDRESS 0x3FE7FC /end MEASUREMENT
/begin MEASUREMENT LA_ELEM_0_C3 "" FLOAT32_IEEE PubIfDecisionLSM_MDL_CM_single 0 0 -3.4e+38 3.4e+38 ECU_ADDRESS 0x3FE800 /end MEASUREMENT
/begin MEASUREMENT LA_ELEM_0_Confidence "" FLOAT32_IEEE PubIfDecisionLSM_MDL_CM_single 0 0 -3.4e+38 3.4e+38 ECU_ADDRESS 0x3FE810 /end MEASUREMENT
/begin MEASUREMENT LA_ELEM_0_DLM_Type "" UBYTE PubIfDecisionLSM_MDL_CM_uint8 0 0 0 255 ECU_ADDRESS 0x3FE960 /end MEASUREMENT
/begin MEASUREMENT LA_ELEM_0_Lanemark_Type "" UBYTE PubIfDecisionLSM_MDL_CM_uint8 0 0 0 255 ECU_ADDRESS 0x3FE95F /end MEASUREMENT
/begin MEASUREMENT LA_ELEM_0_Line_Side "" UBYTE PubIfDecisionLSM_MDL_CM_uint8 0 0 0 255 ECU_ADDRESS 0x3FE961 /end MEASUREMENT
/begin MEASUREMENT LA_ELEM_0_Marker_Width "" FLOAT32_IEEE PubIfDecisionLSM_MDL_CM_single 0 0 -3.4e+38 3.4e+38 ECU_ADDRESS 0x3FE80C /end MEASUREMENT
/begin MEASUREMENT LA_ELEM_0_Range_End "" FLOAT32_IEEE PubIfDecisionLSM_MDL_CM_single 0 0 -3.4e+38 3.4e+38 ECU_ADDRESS 0x3FE808 /end MEASUREMENT
/begin MEASUREMENT LA_ELEM_0_Range_Start "" FLOAT32_IEEE PubIfDecisionLSM_MDL_CM_single 0 0 -3.4e+38 3.4e+38 ECU_ADDRESS 0x3FE804 /end MEASUREMENT
/begin MEASUREMENT LA_ELEM_1_Availability_State "" UBYTE PubIfDecisionLSM_MDL_CM_uint8 0 0 0 255 ECU_ADDRESS 0x3FE963 /end MEASUREMENT
/begin MEASUREMENT LA_ELEM_1_C0 "" FLOAT32_IEEE PubIfDecisionLSM_MDL_CM_single 0 0 -3.4e+38 3.4e+38 ECU_ADDRESS 0x3FE814 /end MEASUREMENT
/begin MEASUREMENT LA_ELEM_1_C1 "" FLOAT32_IEEE PubIfDecisionLSM_MDL_CM_single 0 0 -3.4e+38 3.4e+38 ECU_ADDRESS 0x3FE818 /end MEASUREMENT
/begin MEASUREMENT LA_ELEM_1_C2 "" FLOAT32_IEEE PubIfDecisionLSM_MDL_CM_single 0 0 -3.4e+38 3.4e+38 ECU_ADDRESS 0x3FE81C /end MEASUREMENT
/begin MEASUREMENT LA_ELEM_1_C3 "" FLOAT32_IEEE PubIfDecisionLSM_MDL_CM_single 0 0 -3.4e+38 3.4e+38 ECU_ADDRESS 0x3FE820 /end MEASUREMENT
/begin MEASUREMENT LA_ELEM_1_Confidence "" FLOAT32_IEEE PubIfDecisionLSM_MDL_CM_single 0 0 -3.4e+38 3.4e+38 ECU_ADDRESS 0x3FE830 /end MEASUREMENT
/begin MEASUREMENT LA_ELEM_1_DLM_Type "" UBYTE PubIfDecisionLSM_MDL_CM_uint8 0 0 0 255 ECU_ADDRESS 0x3FE965 /end MEASUREMENT
/begin MEASUREMENT LA_ELEM_1_Lanemark_Type "" UBYTE PubIfDecisionLSM_MDL_CM_uint8 0 0 0 255 ECU_ADDRESS 0x3FE964 /end MEASUREMENT
/begin MEASUREMENT LA_ELEM_1_Line_Side "" UBYTE PubIfDecisionLSM_MDL_CM_uint8 0 0 0 255 ECU_ADDRESS 0x3FE966 /end MEASUREMENT
/begin MEASUREMENT LA_ELEM_1_Marker_Width "" FLOAT32_IEEE PubIfDecisionLSM_MDL_CM_single 0 0 -3.4e+38 3.4e+38 ECU_ADDRESS 0x3FE834 /end MEASUREMENT
/begin MEASUREMENT LA_ELEM_1_Range_End "" FLOAT32_IEEE PubIfDecisionLSM_MDL_CM_single 0 0 -3.4e+38 3.4e+38 ECU_ADDRESS 0x3FE828 /end MEASUREMENT
/begin MEASUREMENT LA_ELEM_1_Range_Start "" FLOAT32_IEEE PubIfDecisionLSM_MDL_CM_single 0 0 -3.4e+38 3.4e+38 ECU_ADDRESS 0x3FE824 /end MEASUREMENT
/begin MEASUREMENT LA_ELEM_2_Availability_State "" UBYTE PubIfDecisionLSM_MDL_CM_uint8 0 0 0 255 ECU_ADDRESS 0x3FE967 /end MEASUREMENT
/begin MEASUREMENT LA_ELEM_2_C0 "" FLOAT32_IEEE PubIfDecisionLSM_MDL_CM_single 0 0 -3.4e+38 3.4e+38 ECU_ADDRESS 0x3FE838 /end MEASUREMENT
/begin MEASUREMENT LA_ELEM_2_C1 "" FLOAT32_IEEE PubIfDecisionLSM_MDL_CM_single 0 0 -3.4e+38 3.4e+38 ECU_ADDRESS 0x3FE83C /end MEASUREMENT
/begin MEASUREMENT LA_ELEM_2_C2 "" FLOAT32_IEEE PubIfDecisionLSM_MDL_CM_single 0 0 -3.4e+38 3.4e+38 ECU_ADDRESS 0x3FE840 /end MEASUREMENT
/begin MEASUREMENT LA_ELEM_2_C3 "" FLOAT32_IEEE PubIfDecisionLSM_MDL_CM_single 0 0 -3.4e+38 3.4e+38 ECU_ADDRESS 0x3FE844 /end MEASUREMENT
/begin MEASUREMENT LA_ELEM_2_Confidence "" FLOAT32_IEEE PubIfDecisionLSM_MDL_CM_single 0 0 -3.4e+38 3.4e+38 ECU_ADDRESS 0x3FE850 /end MEASUREMENT
/begin MEASUREMENT LA_ELEM_2_DLM_Type "" UBYTE PubIfDecisionLSM_MDL_CM_uint8 0 0 0 255 ECU_ADDRESS 0x3FE96A /end MEASUREMENT
/begin MEASUREMENT LA_ELEM_2_Lanemark_Type "" UBYTE PubIfDecisionLSM_MDL_CM_uint8 0 0 0 255 ECU_ADDRESS 0x3FE969 /end MEASUREMENT
/begin MEASUREMENT LA_ELEM_2_Line_Side "" UBYTE PubIfDecisionLSM_MDL_CM_uint8 0 0 0 255 ECU_ADDRESS 0x3FE96B /end MEASUREMENT
/begin MEASUREMENT LA_ELEM_2_Marker_Width "" FLOAT32_IEEE PubIfDecisionLSM_MDL_CM_single 0 0 -3.4e+38 3.4e+38 ECU_ADDRESS 0x3FE854 /end MEASUREMENT
/begin MEASUREMENT LA_ELEM_2_Range_End "" FLOAT32_IEEE PubIfDecisionLSM_MDL_CM_single 0 0 -3.4e+38 3.4e+38 ECU_ADDRESS 0x3FE84C /end MEASUREMENT
/begin MEASUREMENT LA_ELEM_2_Range_Start "" FLOAT32_IEEE PubIfDecisionLSM_MDL_CM_single 0 0 -3.4e+38 3.4e+38 ECU_ADDRESS 0x3FE848 /end MEASUREMENT
/begin MEASUREMENT LA_ELEM_3_Availability_State "" UBYTE PubIfDecisionLSM_MDL_CM_uint8 0 0 0 255 ECU_ADDRESS 0x3FE96C /end MEASUREMENT
/begin MEASUREMENT LA_ELEM_3_C0 "" FLOAT32_IEEE PubIfDecisionLSM_MDL_CM_single 0 0 -3.4e+38 3.4e+38 ECU_ADDRESS 0x3FE858 /end MEASUREMENT
/begin MEASUREMENT LA_ELEM_3_C1 "" FLOAT32_IEEE PubIfDecisionLSM_MDL_CM_single 0 0 -3.4e+38 3.4e+38 ECU_ADDRESS 0x3FE85C /end MEASUREMENT
/begin MEASUREMENT LA_ELEM_3_C2 "" FLOAT32_IEEE PubIfDecisionLSM_MDL_CM_single 0 0 -3.4e+38 3.4e+38 ECU_ADDRESS 0x3FE860 /end MEASUREMENT
/begin MEASUREMENT LA_ELEM_3_C3 "" FLOAT32_IEEE PubIfDecisionLSM_MDL_CM_single 0 0 -3.4e+38 3.4e+38 ECU_ADDRESS 0x3FE864 /end MEASUREMENT
/begin MEASUREMENT LA_ELEM_3_Confidence "" FLOAT32_IEEE PubIfDecisionLSM_MDL_CM_single 0 0 -3.4e+38 3.4e+38 ECU_ADDRESS 0x3FE874 /end MEASUREMENT
/begin MEASUREMENT LA_ELEM_3_DLM_Type "" UBYTE PubIfDecisionLSM_MDL_CM_uint8 0 0 0 255 ECU_ADDRESS 0x3FE96E /end MEASUREMENT
/begin MEASUREMENT LA_ELEM_3_Lanemark_Type "" UBYTE PubIfDecisionLSM_MDL_CM_uint8 0 0 0 255 ECU_ADDRESS 0x3FE96D /end MEASUREMENT
/begin MEASUREMENT LA_ELEM_3_Line_Side "" UBYTE PubIfDecisionLSM_MDL_CM_uint8 0 0 0 255 ECU_ADDRESS 0x3FE96F /end MEASUREMENT
/begin MEASUREMENT LA_ELEM_3_Marker_Width "" FLOAT32_IEEE PubIfDecisionLSM_MDL_CM_single 0 0 -3.4e+38 3.4e+38 ECU_ADDRESS 0x3FE878 /end MEASUREMENT
/begin MEASUREMENT LA_ELEM_3_Range_End "" FLOAT32_IEEE PubIfDecisionLSM_MDL_CM_single 0 0 -3.4e+38 3.4e+38 ECU_ADDRESS 0x3FE870 /end MEASUREMENT
/begin MEASUREMENT LA_ELEM_3_Range_Start "" FLOAT32_IEEE PubIfDecisionLSM_MDL_CM_single 0 0 -3.4e+38 3.4e+38 ECU_ADDRESS 0x3FE868 /end MEASUREMENT
/begin MEASUREMENT LCS_AngCmdReqValVld "" UBYTE PubIfControlLATC_MDL_CM_uint8 0 0 0 255 ECU_ADDRESS 0x3F1955 /end MEASUREMENT
/begin MEASUREMENT LCS_ControlAngleError "" FLOAT32_IEEE PubIfControlLATC_MDL_CM_single 0 0 -3.4e+38 3.4e+38 ECU_ADDRESS 0x3F1900 /end MEASUREMENT
/begin MEASUREMENT LCS_Counter "" UBYTE PubIfControlLATC_MDL_CM_uint8 0 0 0 255 ECU_ADDRESS 0x3F1956 /end MEASUREMENT
/begin MEASUREMENT LCS_DangerLevelisNotESS "" UBYTE PubIfControlLATC_MDL_CM_boolean 0 0 0 1 BIT_MASK 0x1 ECU_ADDRESS 0x3F195D /end MEASUREMENT
/begin MEASUREMENT LCS_DisplaySpd_kph "" FLOAT32_IEEE PubIfControlLATC_MDL_CM_single 0 0 -3.4e+38 3.4e+38 ECU_ADDRESS 0x3F1894 /end MEASUREMENT
/begin MEASUREMENT LCS_EPSFault "" UBYTE PubIfControlLATC_MDL_CM_uint8 0 0 0 255 ECU_ADDRESS 0x3F195A /end MEASUREMENT
/begin MEASUREMENT LCS_ESS_TarAngle "" FLOAT32_IEEE PubIfControlLATC_MDL_CM_single 0 0 -3.4e+38 3.4e+38 ECU_ADDRESS 0x3F1908 /end MEASUREMENT
/begin MEASUREMENT LCS_ESS_TarTorq "" FLOAT32_IEEE PubIfControlLATC_MDL_CM_single 0 0 -3.4e+38 3.4e+38 ECU_ADDRESS 0x3F192C /end MEASUREMENT
/begin MEASUREMENT LCS_EqA0 "" FLOAT32_IEEE PubIfControlLATC_MDL_CM_single 0 0 -3.4e+38 3.4e+38 ECU_ADDRESS 0x3F18A4 /end MEASUREMENT
/begin MEASUREMENT LCS_IN_CurSteerAngle_deg "" FLOAT32_IEEE PubIfControlLATC_MDL_CM_single 0 0 -3.4e+38 3.4e+38 ECU_ADDRESS 0x3F1898 /end MEASUREMENT
/begin MEASUREMENT LCS_IN_CurrentLaneWidth "" FLOAT32_IEEE PubIfControlLATC_MDL_CM_single 0 0 -3.4e+38 3.4e+38 ECU_ADDRESS 0x3F1884 /end MEASUREMENT
/begin MEASUREMENT LCS_IN_EPS_DrvInpTrqVal "" FLOAT32_IEEE PubIfControlLATC_MDL_CM_single 0 0 -3.4e+38 3.4e+38 ECU_ADDRESS 0x3F1880 /end MEASUREMENT
/begin MEASUREMENT LCS_IN_EPS_LKATorqOvrlDlvd "" FLOAT32_IEEE PubIfControlLATC_MDL_CM_single 0 0 -3.4e+38 3.4e+38 ECU_ADDRESS 0x3F1888 /end MEASUREMENT
/begin MEASUREMENT LCS_IN_EPS_LKATorqOvrlDlvdVld "" FLOAT32_IEEE PubIfControlLATC_MDL_CM_single 0 0 -3.4e+38 3.4e+38 ECU_ADDRESS 0x3F188C /end MEASUREMENT
/begin CHARACTERISTIC LCS_IN_Offset_Test_Value "" VALUE 0x3CB01C Scalar_FLOAT32_IEEE 0 PubIfControlLATC_MDL_CM_single -3.4e+38 3.4e+38 /end CHARACTERISTIC
/begin MEASUREMENT LCS_IN_SteerAngOffset_deg "" FLOAT32_IEEE PubIfControlLATC_MDL_CM_single 0 0 -3.4e+38 3.4e+38 ECU_ADDRESS 0x3F189C /end MEASUREMENT
/begin MEASUREMENT LCS_IN_SteerAngleSpd_degs "" FLOAT32_IEEE PubIfControlLATC_MDL_CM_single 0 0 -3.4e+38 3.4e+38 ECU_ADDRESS 0x3F1918 /end MEASUREMENT
/begin MEASUREMENT LCS_IN_SteerWheelAng "" FLOAT32_IEEE PubIfControlLATC_MDL_CM_single 0 0 -3.4e+38 3.4e+38 ECU_ADDRESS 0x3F187C /end MEASUREMENT
/begin MEASUREMENT LCS_IN_SteerWheelAngleSign "" FLOAT32_IEEE PubIfControlLATC_MDL_CM_single 0 0 -3.4e+38 3.4e+38 ECU_ADDRESS 0x3F1874 /end MEASUREMENT
/begin MEASUREMENT LCS_IN_SteerWheelSpd "" FLOAT32_IEEE PubIfControlLATC_MDL_CM_single 0 0 -3.4e+38 3.4e+38 ECU_ADDRESS 0x3F1878 /end MEASUREMENT
/begin MEASUREMENT LCS_IN_SteerWheelSpdSign "" FLOAT32_IEEE PubIfControlLATC_MDL_CM_single 0 0 -3.4e+38 3.4e+38 ECU_ADDRESS 0x3F1870 /end MEASUREMENT
/begin MEASUREMENT LCS_IN_TarDangerLevel "" UBYTE PubIfControlLATC_MDL_CM_uint8 0 0 0 255 ECU_ADDRESS 0x3F1952 /end MEASUREMENT
/begin MEASUREMENT LCS_IN_alpSideSlipAngle "" FLOAT32_IEEE PubIfControlLATC_MDL_CM_single 0 0 -3.4e+38 3.4e+38 ECU_ADDRESS 0x3F193C /end MEASUREMENT
/begin MEASUREMENT LCS_IN_axvRefMs2 "" FLOAT32_IEEE PubIfControlLATC_MDL_CM_single 0 0 -3.4e+38 3.4e+38 ECU_ADDRESS 0x3F18F0 /end MEASUREMENT
/begin MEASUREMENT LCS_IN_ayvRefMs2 "" FLOAT32_IEEE PubIfControlLATC_MDL_CM_single 0 0 -3.4e+38 3.4e+38 ECU_ADDRESS 0x3F1938 /end MEASUREMENT
/begin MEASUREMENT LCS_IN_desLaneA0 "" FLOAT32_IEEE PubIfControlLATC_MDL_CM_single 0 0 -3.4e+38 3.4e+38 ECU_ADDRESS 0x3F1860 /end MEASUREMENT
/begin MEASUREMENT LCS_IN_desLaneA1 "" FLOAT32_IEEE PubIfControlLATC_MDL_CM_single 0 0 -3.4e+38 3.4e+38 ECU_ADDRESS 0x3F1868 /end MEASUREMENT
/begin MEASUREMENT LCS_IN_desLaneA2 "" FLOAT32_IEEE PubIfControlLATC_MDL_CM_single 0 0 -3.4e+38 3.4e+38 ECU_ADDRESS 0x3F1864 /end MEASUREMENT
/begin MEASUREMENT LCS_IN_desLaneA3 "" FLOAT32_IEEE PubIfControlLATC_MDL_CM_single 0 0 -3.4e+38 3.4e+38 ECU_ADDRESS 0x3F186C /end MEASUREMENT
/begin MEASUREMENT LCS_IN_desLaneValid "" UBYTE PubIfControlLATC_MDL_CM_boolean 0 0 0 1 BIT_MASK 0x1 ECU_ADDRESS 0x3F195B /end MEASUREMENT
/begin MEASUREMENT LCS_IN_kapTraj "" FLOAT32_IEEE PubIfControlLATC_MDL_CM_single 0 0 -3.4e+38 3.4e+38 ECU_ADDRESS 0x3F1904 /end MEASUREMENT
/begin MEASUREMENT LCS_IN_psiDtOpt "" FLOAT32_IEEE PubIfControlLATC_MDL_CM_single 0 0 -3.4e+38 3.4e+38 ECU_ADDRESS 0x3F18EC /end MEASUREMENT
/begin MEASUREMENT LCS_IN_vxvRefMs "" FLOAT32_IEEE PubIfControlLATC_MDL_CM_single 0 0 -3.4e+38 3.4e+38 ECU_ADDRESS 0x3F1890 /end MEASUREMENT
/begin MEASUREMENT LCS_LCKPredis "" FLOAT32_IEEE PubIfControlLATC_MDL_CM_single 0 0 -3.4e+38 3.4e+38 ECU_ADDRESS 0x3F18C4 /end MEASUREMENT
/begin MEASUREMENT LCS_LCKPredisFac "" FLOAT32_IEEE PubIfControlLATC_MDL_CM_single 0 0 -3.4e+38 3.4e+38 ECU_ADDRESS 0x3F18C0 /end MEASUREMENT
/begin MEASUREMENT LCS_LCType "" UBYTE PubIfControlLATC_MDL_CM_uint8 0 0 0 255 ECU_ADDRESS 0x3F1953 /end MEASUREMENT
/begin MEASUREMENT LCS_LC_ELKPredis "" FLOAT32_IEEE PubIfControlLATC_MDL_CM_single 0 0 -3.4e+38 3.4e+38 ECU_ADDRESS 0x3F18CC /end MEASUREMENT
/begin MEASUREMENT LCS_LC_ELKPredisFac "" FLOAT32_IEEE PubIfControlLATC_MDL_CM_single 0 0 -3.4e+38 3.4e+38 ECU_ADDRESS 0x3F18C8 /end MEASUREMENT
/begin MEASUREMENT LCS_LC_ESSAESPredisFac "" FLOAT32_IEEE PubIfControlLATC_MDL_CM_single 0 0 -3.4e+38 3.4e+38 ECU_ADDRESS 0x3F18D0 /end MEASUREMENT
/begin MEASUREMENT LCS_LC_ESSPredis "" FLOAT32_IEEE PubIfControlLATC_MDL_CM_single 0 0 -3.4e+38 3.4e+38 ECU_ADDRESS 0x3F18D4 /end MEASUREMENT
/begin MEASUREMENT LCS_LC_EcoPredis "" FLOAT32_IEEE PubIfControlLATC_MDL_CM_single 0 0 -3.4e+38 3.4e+38 ECU_ADDRESS 0x3F18B4 /end MEASUREMENT
/begin MEASUREMENT LCS_LC_EcoPredisFac "" FLOAT32_IEEE PubIfControlLATC_MDL_CM_single 0 0 -3.4e+38 3.4e+38 ECU_ADDRESS 0x3F18B0 /end MEASUREMENT
/begin MEASUREMENT LCS_LC_NomalPredis "" FLOAT32_IEEE PubIfControlLATC_MDL_CM_single 0 0 -3.4e+38 3.4e+38 ECU_ADDRESS 0x3F18AC /end MEASUREMENT
/begin MEASUREMENT LCS_LC_NomalPredisFac "" FLOAT32_IEEE PubIfControlLATC_MDL_CM_single 0 0 -3.4e+38 3.4e+38 ECU_ADDRESS 0x3F18A8 /end MEASUREMENT
/begin MEASUREMENT LCS_LC_SportPredis "" FLOAT32_IEEE PubIfControlLATC_MDL_CM_single 0 0 -3.4e+38 3.4e+38 ECU_ADDRESS 0x3F18BC /end MEASUREMENT
/begin MEASUREMENT LCS_LC_SportPredisFac "" FLOAT32_IEEE PubIfControlLATC_MDL_CM_single 0 0 -3.4e+38 3.4e+38 ECU_ADDRESS 0x3F18B8 /end MEASUREMENT
/begin MEASUREMENT LCS_OffSetUpdate_Flg "" UBYTE PubIfControlLATC_MDL_CM_boolean 0 0 0 1 BIT_MASK 0x1 ECU_ADDRESS 0x3F195C /end MEASUREMENT
/begin MEASUREMENT LCS_Predis_BaseDis "" FLOAT32_IEEE PubIfControlLATC_MDL_CM_single 0 0 -3.4e+38 3.4e+38 ECU_ADDRESS 0x3F18A0 /end MEASUREMENT
/begin MEASUREMENT LCS_ReqEPSTrgAngle "" FLOAT32_IEEE PubIfControlLATC_MDL_CM_single 0 0 -3.4e+38 3.4e+38 ECU_ADDRESS 0x3F18F8 /end MEASUREMENT
/begin MEASUREMENT LCS_SubModel_Number "" ULONG PubIfControlLATC_MDL_CM_uint32 0 0 0 4294967295 ECU_ADDRESS 0x3F185C /end MEASUREMENT
/begin MEASUREMENT LCS_SubModel_VERSION "" ULONG PubIfControlLATC_MDL_CM_uint32 0 0 0 4294967295 ECU_ADDRESS 0x3F1858 /end MEASUREMENT
/begin MEASUREMENT LCS_TarSteerAngle_Filter "" FLOAT32_IEEE PubIfControlLATC_MDL_CM_single 0 0 -3.4e+38 3.4e+38 ECU_ADDRESS 0x3F18F4 /end MEASUREMENT
/begin MEASUREMENT LCS_Torq_FFAdd "" FLOAT32_IEEE PubIfControlLATC_MDL_CM_single 0 0 -3.4e+38 3.4e+38 ECU_ADDRESS 0x3F1914 /end MEASUREMENT
/begin MEASUREMENT LCS_Torq_OUT "" FLOAT32_IEEE PubIfControlLATC_MDL_CM_single 0 0 -3.4e+38 3.4e+38 ECU_ADDRESS 0x3F1930 /end MEASUREMENT
/begin MEASUREMENT LCS_Torq_PID "" FLOAT64_IEEE PubIfControlLATC_MDL_CM_double 0 0 -1.7e+308 1.7e+308 ECU_ADDRESS 0x3F1848 /end MEASUREMENT
/begin MEASUREMENT LCS_finalPredis "" FLOAT32_IEEE PubIfControlLATC_MDL_CM_single 0 0 -3.4e+38 3.4e+38 ECU_ADDRESS 0x3F18D8 /end MEASUREMENT
/begin MEASUREMENT LH_Count "" UBYTE PubIfDecisionLSM_MDL_CM_uint8 0 0 0 255 ECU_ADDRESS 0x3FE970 /end MEASUREMENT
/begin MEASUREMENT LH_ELEM_0_Availability_State "" UBYTE PubIfDecisionLSM_MDL_CM_uint8 0 0 0 255 ECU_ADDRESS 0x3FE972 /end MEASUREMENT
/begin MEASUREMENT LH_ELEM_0_C0 "" FLOAT32_IEEE PubIfDecisionLSM_MDL_CM_single 0 0 -3.4e+38 3.4e+38 ECU_ADDRESS 0x3FE87C /end MEASUREMENT
/begin MEASUREMENT LH_ELEM_0_C1 "" FLOAT32_IEEE PubIfDecisionLSM_MDL_CM_single 0 0 -3.4e+38 3.4e+38 ECU_ADDRESS 0x3FE880 /end MEASUREMENT
/begin MEASUREMENT LH_ELEM_0_C2 "" FLOAT32_IEEE PubIfDecisionLSM_MDL_CM_single 0 0 -3.4e+38 3.4e+38 ECU_ADDRESS 0x3FE884 /end MEASUREMENT
/begin MEASUREMENT LH_ELEM_0_C3 "" FLOAT32_IEEE PubIfDecisionLSM_MDL_CM_single 0 0 -3.4e+38 3.4e+38 ECU_ADDRESS 0x3FE88C /end MEASUREMENT
/begin MEASUREMENT LH_ELEM_0_Confidence "" FLOAT32_IEEE PubIfDecisionLSM_MDL_CM_single 0 0 -3.4e+38 3.4e+38 ECU_ADDRESS 0x3FE888 /end MEASUREMENT
/begin MEASUREMENT LH_ELEM_0_Crossing "" UBYTE PubIfDecisionLSM_MDL_CM_uint8 0 0 0 255 ECU_ADDRESS 0x3FE976 /end MEASUREMENT
/begin MEASUREMENT LH_ELEM_0_DLM_Type "" UBYTE PubIfDecisionLSM_MDL_CM_uint8 0 0 0 255 ECU_ADDRESS 0x3FE974 /end MEASUREMENT
/begin MEASUREMENT LH_ELEM_0_Lanemark_Type "" UBYTE PubIfDecisionLSM_MDL_CM_uint8 0 0 0 255 ECU_ADDRESS 0x3FE973 /end MEASUREMENT
/begin MEASUREMENT LH_ELEM_0_Line_Side "" UBYTE PubIfDecisionLSM_MDL_CM_uint8 0 0 0 255 ECU_ADDRESS 0x3FE975 /end MEASUREMENT
/begin MEASUREMENT LH_ELEM_0_Marker_Width "" FLOAT32_IEEE PubIfDecisionLSM_MDL_CM_single 0 0 -3.4e+38 3.4e+38 ECU_ADDRESS 0x3FE894 /end MEASUREMENT
/begin MEASUREMENT LH_ELEM_0_VR_End "" FLOAT32_IEEE PubIfDecisionLSM_MDL_CM_single 0 0 -3.4e+38 3.4e+38 ECU_ADDRESS 0x3FE890 /end MEASUREMENT
/begin MEASUREMENT LH_ELEM_0_VR_Start "" FLOAT32_IEEE PubIfDecisionLSM_MDL_CM_single 0 0 -3.4e+38 3.4e+38 ECU_ADDRESS 0x3FE89C /end MEASUREMENT
/begin MEASUREMENT LH_ELEM_1_Availability_State "" UBYTE PubIfDecisionLSM_MDL_CM_uint8 0 0 0 255 ECU_ADDRESS 0x3FE977 /end MEASUREMENT
/begin MEASUREMENT LH_ELEM_1_C0 "" FLOAT32_IEEE PubIfDecisionLSM_MDL_CM_single 0 0 -3.4e+38 3.4e+38 ECU_ADDRESS 0x3FE8A0 /end MEASUREMENT
/begin MEASUREMENT LH_ELEM_1_C1 "" FLOAT32_IEEE PubIfDecisionLSM_MDL_CM_single 0 0 -3.4e+38 3.4e+38 ECU_ADDRESS 0x3FE8A4 /end MEASUREMENT
/begin MEASUREMENT LH_ELEM_1_C2 "" FLOAT32_IEEE PubIfDecisionLSM_MDL_CM_single 0 0 -3.4e+38 3.4e+38 ECU_ADDRESS 0x3FE8A8 /end MEASUREMENT
/begin MEASUREMENT LH_ELEM_1_C3 "" FLOAT32_IEEE PubIfDecisionLSM_MDL_CM_single 0 0 -3.4e+38 3.4e+38 ECU_ADDRESS 0x3FE8B0 /end MEASUREMENT
/begin MEASUREMENT LH_ELEM_1_Confidence "" FLOAT32_IEEE PubIfDecisionLSM_MDL_CM_single 0 0 -3.4e+38 3.4e+38 ECU_ADDRESS 0x3FE8AC /end MEASUREMENT
/begin MEASUREMENT LH_ELEM_1_Crossing "" UBYTE PubIfDecisionLSM_MDL_CM_uint8 0 0 0 255 ECU_ADDRESS 0x3FE97C /end MEASUREMENT
/begin MEASUREMENT LH_ELEM_1_DLM_Type "" UBYTE PubIfDecisionLSM_MDL_CM_uint8 0 0 0 255 ECU_ADDRESS 0x3FE979 /end MEASUREMENT
/begin MEASUREMENT LH_ELEM_1_Lanemark_Type "" UBYTE PubIfDecisionLSM_MDL_CM_uint8 0 0 0 255 ECU_ADDRESS 0x3FE978 /end MEASUREMENT
/begin MEASUREMENT LH_ELEM_1_Line_Side "" UBYTE PubIfDecisionLSM_MDL_CM_uint8 0 0 0 255 ECU_ADDRESS 0x3FE97B /end MEASUREMENT
/begin MEASUREMENT LH_ELEM_1_Marker_Width "" FLOAT32_IEEE PubIfDecisionLSM_MDL_CM_single 0 0 -3.4e+38 3.4e+38 ECU_ADDRESS 0x3FE8B8 /end MEASUREMENT
/begin MEASUREMENT LH_ELEM_1_VR_End "" FLOAT32_IEEE PubIfDecisionLSM_MDL_CM_single 0 0 -3.4e+38 3.4e+38 ECU_ADDRESS 0x3FE8BC /end MEASUREMENT
/begin MEASUREMENT LH_ELEM_1_VR_Start "" FLOAT32_IEEE PubIfDecisionLSM_MDL_CM_single 0 0 -3.4e+38 3.4e+38 ECU_ADDRESS 0x3FE8B4 /end MEASUREMENT
/begin MEASUREMENT LRE_Count "" UBYTE PubIfDecisionLSM_MDL_CM_uint8 0 0 0 255 ECU_ADDRESS 0x3FE97D /end MEASUREMENT
/begin MEASUREMENT LRE_ELEM_0_Availability_State "" UBYTE PubIfDecisionLSM_MDL_CM_uint8 0 0 0 255 ECU_ADDRESS 0x3FE97F /end MEASUREMENT
/begin MEASUREMENT LRE_ELEM_0_C0 "" FLOAT32_IEEE PubIfDecisionLSM_MDL_CM_single 0 0 -3.4e+38 3.4e+38 ECU_ADDRESS 0x3FE8D8 /end MEASUREMENT
/begin MEASUREMENT LRE_ELEM_0_C1 "" FLOAT32_IEEE PubIfDecisionLSM_MDL_CM_single 0 0 -3.4e+38 3.4e+38 ECU_ADDRESS 0x3FE8C0 /end MEASUREMENT
/begin MEASUREMENT LRE_ELEM_0_C2 "" FLOAT32_IEEE PubIfDecisionLSM_MDL_CM_single 0 0 -3.4e+38 3.4e+38 ECU_ADDRESS 0x3FE8C4 /end MEASUREMENT
/begin MEASUREMENT LRE_ELEM_0_C3 "" FLOAT32_IEEE PubIfDecisionLSM_MDL_CM_single 0 0 -3.4e+38 3.4e+38 ECU_ADDRESS 0x3FE8C8 /end MEASUREMENT
/begin MEASUREMENT LRE_ELEM_0_Confidence "" FLOAT32_IEEE PubIfDecisionLSM_MDL_CM_single 0 0 -3.4e+38 3.4e+38 ECU_ADDRESS 0x3FE8DC /end MEASUREMENT
/begin MEASUREMENT LRE_ELEM_0_Line_Side "" UBYTE PubIfDecisionLSM_MDL_CM_uint8 0 0 0 255 ECU_ADDRESS 0x3FE97E /end MEASUREMENT
/begin MEASUREMENT LRE_ELEM_0_Range_End "" FLOAT32_IEEE PubIfDecisionLSM_MDL_CM_single 0 0 -3.4e+38 3.4e+38 ECU_ADDRESS 0x3FE8CC /end MEASUREMENT
/begin MEASUREMENT LRE_ELEM_0_Range_Start "" FLOAT32_IEEE PubIfDecisionLSM_MDL_CM_single 0 0 -3.4e+38 3.4e+38 ECU_ADDRESS 0x3FE8D4 /end MEASUREMENT
/begin MEASUREMENT LRE_ELEM_1_Availability_State "" UBYTE PubIfDecisionLSM_MDL_CM_uint8 0 0 0 255 ECU_ADDRESS 0x3FE980 /end MEASUREMENT
/begin MEASUREMENT LRE_ELEM_1_C0 "" FLOAT32_IEEE PubIfDecisionLSM_MDL_CM_single 0 0 -3.4e+38 3.4e+38 ECU_ADDRESS 0x3FE7F4 /end MEASUREMENT
/begin MEASUREMENT LRE_ELEM_1_C1 "" FLOAT32_IEEE PubIfDecisionLSM_MDL_CM_single 0 0 -3.4e+38 3.4e+38 ECU_ADDRESS 0x3FE8E4 /end MEASUREMENT
/begin MEASUREMENT LRE_ELEM_1_C2 "" FLOAT32_IEEE PubIfDecisionLSM_MDL_CM_single 0 0 -3.4e+38 3.4e+38 ECU_ADDRESS 0x3FE8E8 /end MEASUREMENT
/begin MEASUREMENT LRE_ELEM_1_C3 "" FLOAT32_IEEE PubIfDecisionLSM_MDL_CM_single 0 0 -3.4e+38 3.4e+38 ECU_ADDRESS 0x3FE8EC /end MEASUREMENT
/begin MEASUREMENT LRE_ELEM_1_Confidence "" FLOAT32_IEEE PubIfDecisionLSM_MDL_CM_single 0 0 -3.4e+38 3.4e+38 ECU_ADDRESS 0x3FE8E0 /end MEASUREMENT
/begin MEASUREMENT LRE_ELEM_1_Line_Side "" UBYTE PubIfDecisionLSM_MDL_CM_uint8 0 0 0 255 ECU_ADDRESS 0x3FE95D /end MEASUREMENT
/begin MEASUREMENT LRE_ELEM_1_Range_End "" FLOAT32_IEEE PubIfDecisionLSM_MDL_CM_single 0 0 -3.4e+38 3.4e+38 ECU_ADDRESS 0x3FE8F0 /end MEASUREMENT
/begin MEASUREMENT LRE_ELEM_1_Range_Start "" FLOAT32_IEEE PubIfDecisionLSM_MDL_CM_single 0 0 -3.4e+38 3.4e+38 ECU_ADDRESS 0x3FE7F8 /end MEASUREMENT
/begin MEASUREMENT LSM_DoubleLineLost_b "" UBYTE PubIfDecisionLSM_MDL_CM_boolean 0 0 0 1 BIT_MASK 0x1 ECU_ADDRESS 0x3FE98D /end MEASUREMENT
/begin MEASUREMENT LSM_EN_C0 "" FLOAT32_IEEE PubIfDecisionLSM_MDL_CM_single 0 0 -3.4e+38 3.4e+38 ECU_ADDRESS 0x3FE8F4 /end MEASUREMENT
/begin MEASUREMENT LSM_EN_C1 "" FLOAT32_IEEE PubIfDecisionLSM_MDL_CM_single 0 0 -3.4e+38 3.4e+38 ECU_ADDRESS 0x3FE8F8 /end MEASUREMENT
/begin MEASUREMENT LSM_EN_C2 "" FLOAT32_IEEE PubIfDecisionLSM_MDL_CM_single 0 0 -3.4e+38 3.4e+38 ECU_ADDRESS 0x3FE8FC /end MEASUREMENT
/begin MEASUREMENT LSM_EN_C3 "" FLOAT32_IEEE PubIfDecisionLSM_MDL_CM_single 0 0 -3.4e+38 3.4e+38 ECU_ADDRESS 0x3FE900 /end MEASUREMENT
/begin MEASUREMENT LSM_EN_Front "" FLOAT32_IEEE PubIfDecisionLSM_MDL_CM_single 0 0 -3.4e+38 3.4e+38 ECU_ADDRESS 0x3FE908 /end MEASUREMENT
/begin MEASUREMENT LSM_EN_Start "" FLOAT32_IEEE PubIfDecisionLSM_MDL_CM_single 0 0 -3.4e+38 3.4e+38 ECU_ADDRESS 0x3FE904 /end MEASUREMENT
/begin MEASUREMENT LSM_EN_Valid "" UBYTE PubIfDecisionLSM_MDL_CM_uint8 0 0 0 255 ECU_ADDRESS 0x3FE981 /end MEASUREMENT
/begin MEASUREMENT LSM_ESSLeLineC0 "" FLOAT32_IEEE PubIfDecisionLSM_MDL_CM_single 0 0 -3.4e+38 3.4e+38 ECU_ADDRESS 0x3FE754 /end MEASUREMENT
/begin MEASUREMENT LSM_ESSLeLineC1 "" FLOAT32_IEEE PubIfDecisionLSM_MDL_CM_single 0 0 -3.4e+38 3.4e+38 ECU_ADDRESS 0x3FE76C /end MEASUREMENT
/begin MEASUREMENT LSM_ESSLeLineC2 "" FLOAT32_IEEE PubIfDecisionLSM_MDL_CM_single 0 0 -3.4e+38 3.4e+38 ECU_ADDRESS 0x3FE768 /end MEASUREMENT
/begin MEASUREMENT LSM_ESSLeLineC3 "" FLOAT32_IEEE PubIfDecisionLSM_MDL_CM_single 0 0 -3.4e+38 3.4e+38 ECU_ADDRESS 0x3FE748 /end MEASUREMENT
/begin MEASUREMENT LSM_ESSLeLineValid "" UBYTE PubIfDecisionLSM_MDL_CM_boolean 0 0 0 1 BIT_MASK 0x1 ECU_ADDRESS 0x3FE98E /end MEASUREMENT
/begin MEASUREMENT LSM_ESSLeRange "" FLOAT32_IEEE PubIfDecisionLSM_MDL_CM_single 0 0 -3.4e+38 3.4e+38 ECU_ADDRESS 0x3FE758 /end MEASUREMENT
/begin MEASUREMENT LSM_ESSLineC0 "" FLOAT32_IEEE PubIfDecisionLSM_MDL_CM_single 0 0 -3.4e+38 3.4e+38 ECU_ADDRESS 0x3FE740 /end MEASUREMENT
/begin MEASUREMENT LSM_ESSLineC1 "" FLOAT32_IEEE PubIfDecisionLSM_MDL_CM_single 0 0 -3.4e+38 3.4e+38 ECU_ADDRESS 0x3FE73C /end MEASUREMENT
/begin MEASUREMENT LSM_ESSLineC2 "" FLOAT32_IEEE PubIfDecisionLSM_MDL_CM_single 0 0 -3.4e+38 3.4e+38 ECU_ADDRESS 0x3FE738 /end MEASUREMENT
/begin MEASUREMENT LSM_ESSLineC3 "" FLOAT32_IEEE PubIfDecisionLSM_MDL_CM_single 0 0 -3.4e+38 3.4e+38 ECU_ADDRESS 0x3FE750 /end MEASUREMENT
/begin MEASUREMENT LSM_ESSLineValid "" UBYTE PubIfDecisionLSM_MDL_CM_boolean 0 0 0 1 BIT_MASK 0x1 ECU_ADDRESS 0x3FE98F /end MEASUREMENT
/begin MEASUREMENT LSM_ESSRange "" FLOAT32_IEEE PubIfDecisionLSM_MDL_CM_single 0 0 -3.4e+38 3.4e+38 ECU_ADDRESS 0x3FE744 /end MEASUREMENT
/begin MEASUREMENT LSM_ESSRiLineC0 "" FLOAT32_IEEE PubIfDecisionLSM_MDL_CM_single 0 0 -3.4e+38 3.4e+38 ECU_ADDRESS 0x3FE770 /end MEASUREMENT
/begin MEASUREMENT LSM_ESSRiLineC1 "" FLOAT32_IEEE PubIfDecisionLSM_MDL_CM_single 0 0 -3.4e+38 3.4e+38 ECU_ADDRESS 0x3FE764 /end MEASUREMENT
/begin MEASUREMENT LSM_ESSRiLineC2 "" FLOAT32_IEEE PubIfDecisionLSM_MDL_CM_single 0 0 -3.4e+38 3.4e+38 ECU_ADDRESS 0x3FE760 /end MEASUREMENT
/begin MEASUREMENT LSM_ESSRiLineC3 "" FLOAT32_IEEE PubIfDecisionLSM_MDL_CM_single 0 0 -3.4e+38 3.4e+38 ECU_ADDRESS 0x3FE75C /end MEASUREMENT
/begin MEASUREMENT LSM_ESSRiLineValid "" UBYTE PubIfDecisionLSM_MDL_CM_boolean 0 0 0 1 BIT_MASK 0x1 ECU_ADDRESS 0x3FE990 /end MEASUREMENT
/begin MEASUREMENT LSM_ESSRiRange "" FLOAT32_IEEE PubIfDecisionLSM_MDL_CM_single 0 0 -3.4e+38 3.4e+38 ECU_ADDRESS 0x3FE778 /end MEASUREMENT
/begin MEASUREMENT LSM_Exit_C0 "" FLOAT32_IEEE PubIfDecisionLSM_MDL_CM_single 0 0 -3.4e+38 3.4e+38 ECU_ADDRESS 0x3FE90C /end MEASUREMENT
/begin MEASUREMENT LSM_Exit_C1 "" FLOAT32_IEEE PubIfDecisionLSM_MDL_CM_single 0 0 -3.4e+38 3.4e+38 ECU_ADDRESS 0x3FE910 /end MEASUREMENT
/begin MEASUREMENT LSM_Exit_C2 "" FLOAT32_IEEE PubIfDecisionLSM_MDL_CM_single 0 0 -3.4e+38 3.4e+38 ECU_ADDRESS 0x3FE914 /end MEASUREMENT
/begin MEASUREMENT LSM_Exit_C3 "" FLOAT32_IEEE PubIfDecisionLSM_MDL_CM_single 0 0 -3.4e+38 3.4e+38 ECU_ADDRESS 0x3FE918 /end MEASUREMENT
/begin MEASUREMENT LSM_Exit_Front "" FLOAT32_IEEE PubIfDecisionLSM_MDL_CM_single 0 0 -3.4e+38 3.4e+38 ECU_ADDRESS 0x3FE920 /end MEASUREMENT
/begin MEASUREMENT LSM_Exit_Start "" FLOAT32_IEEE PubIfDecisionLSM_MDL_CM_single 0 0 -3.4e+38 3.4e+38 ECU_ADDRESS 0x3FE91C /end MEASUREMENT
/begin MEASUREMENT LSM_Exit_Valid "" UBYTE PubIfDecisionLSM_MDL_CM_uint8 0 0 0 255 ECU_ADDRESS 0x3FE982 /end MEASUREMENT
/begin MEASUREMENT LSM_HWALeLineC0 "" FLOAT32_IEEE PubIfDecisionLSM_MDL_CM_single 0 0 -3.4e+38 3.4e+38 ECU_ADDRESS 0x3FE708 /end MEASUREMENT
/begin MEASUREMENT LSM_HWALeLineC1 "" FLOAT32_IEEE PubIfDecisionLSM_MDL_CM_single 0 0 -3.4e+38 3.4e+38 ECU_ADDRESS 0x3FE704 /end MEASUREMENT
/begin MEASUREMENT LSM_HWALeLineC2 "" FLOAT32_IEEE PubIfDecisionLSM_MDL_CM_single 0 0 -3.4e+38 3.4e+38 ECU_ADDRESS 0x3FE700 /end MEASUREMENT
/begin MEASUREMENT LSM_HWALeLineC3 "" FLOAT32_IEEE PubIfDecisionLSM_MDL_CM_single 0 0 -3.4e+38 3.4e+38 ECU_ADDRESS 0x3FE6FC /end MEASUREMENT
/begin MEASUREMENT LSM_HWALeLineValid "" UBYTE PubIfDecisionLSM_MDL_CM_boolean 0 0 0 1 BIT_MASK 0x1 ECU_ADDRESS 0x3FE98B /end MEASUREMENT
/begin MEASUREMENT LSM_HWALeRange "" FLOAT32_IEEE PubIfDecisionLSM_MDL_CM_single 0 0 -3.4e+38 3.4e+38 ECU_ADDRESS 0x3FE710 /end MEASUREMENT
/begin MEASUREMENT LSM_HWALineC0 "" FLOAT32_IEEE PubIfDecisionLSM_MDL_CM_single 0 0 -3.4e+38 3.4e+38 ECU_ADDRESS 0x3FE714 /end MEASUREMENT
/begin MEASUREMENT LSM_HWALineC1 "" FLOAT32_IEEE PubIfDecisionLSM_MDL_CM_single 0 0 -3.4e+38 3.4e+38 ECU_ADDRESS 0x3FE6F8 /end MEASUREMENT
/begin MEASUREMENT LSM_HWALineC2 "" FLOAT32_IEEE PubIfDecisionLSM_MDL_CM_single 0 0 -3.4e+38 3.4e+38 ECU_ADDRESS 0x3FE6F4 /end MEASUREMENT
/begin MEASUREMENT LSM_HWALineC3 "" FLOAT32_IEEE PubIfDecisionLSM_MDL_CM_single 0 0 -3.4e+38 3.4e+38 ECU_ADDRESS 0x3FE6F0 /end MEASUREMENT
/begin MEASUREMENT LSM_HWALineValid "" UBYTE PubIfDecisionLSM_MDL_CM_boolean 0 0 0 1 BIT_MASK 0x1 ECU_ADDRESS 0x3FE989 /end MEASUREMENT
/begin MEASUREMENT LSM_HWARange "" FLOAT32_IEEE PubIfDecisionLSM_MDL_CM_single 0 0 -3.4e+38 3.4e+38 ECU_ADDRESS 0x3FE718 /end MEASUREMENT
/begin MEASUREMENT LSM_HWARiLineC0 "" FLOAT32_IEEE PubIfDecisionLSM_MDL_CM_single 0 0 -3.4e+38 3.4e+38 ECU_ADDRESS 0x3FE720 /end MEASUREMENT
/begin MEASUREMENT LSM_HWARiLineC1 "" FLOAT32_IEEE PubIfDecisionLSM_MDL_CM_single 0 0 -3.4e+38 3.4e+38 ECU_ADDRESS 0x3FE71C /end MEASUREMENT
/begin MEASUREMENT LSM_HWARiLineC2 "" FLOAT32_IEEE PubIfDecisionLSM_MDL_CM_single 0 0 -3.4e+38 3.4e+38 ECU_ADDRESS 0x3FE734 /end MEASUREMENT
/begin MEASUREMENT LSM_HWARiLineC3 "" FLOAT32_IEEE PubIfDecisionLSM_MDL_CM_single 0 0 -3.4e+38 3.4e+38 ECU_ADDRESS 0x3FE730 /end MEASUREMENT
/begin MEASUREMENT LSM_HWARiLineValid "" UBYTE PubIfDecisionLSM_MDL_CM_boolean 0 0 0 1 BIT_MASK 0x1 ECU_ADDRESS 0x3FE98A /end MEASUREMENT
/begin MEASUREMENT LSM_HWARiRange "" FLOAT32_IEEE PubIfDecisionLSM_MDL_CM_single 0 0 -3.4e+38 3.4e+38 ECU_ADDRESS 0x3FE724 /end MEASUREMENT
/begin MEASUREMENT LSM_HeadAngDiff "" FLOAT32_IEEE PubIfDecisionLSM_MDL_CM_single 0 0 -3.4e+38 3.4e+38 ECU_ADDRESS 0x3FE72C /end MEASUREMENT
/begin MEASUREMENT LSM_L1_A0 "" FLOAT32_IEEE PubIfDecisionLSM_MDL_CM_single 0 0 -3.4e+38 3.4e+38 ECU_ADDRESS 0x3FE944 /end MEASUREMENT
/begin MEASUREMENT LSM_L1_AvaliDis "" FLOAT32_IEEE PubIfDecisionLSM_MDL_CM_single 0 0 -3.4e+38 3.4e+38 ECU_ADDRESS 0x3FE92C /end MEASUREMENT
/begin MEASUREMENT LSM_L1_AvaliTime "" FLOAT32_IEEE PubIfDecisionLSM_MDL_CM_single 0 0 -3.4e+38 3.4e+38 ECU_ADDRESS 0x3FE934 /end MEASUREMENT
/begin MEASUREMENT LSM_L1_Conf "" UBYTE PubIfDecisionLSM_MDL_CM_uint8 0 0 0 255 ECU_ADDRESS 0x3FE95C /end MEASUREMENT
/begin MEASUREMENT LSM_L1_Range "" FLOAT32_IEEE PubIfDecisionLSM_MDL_CM_single 0 0 -3.4e+38 3.4e+38 ECU_ADDRESS 0x3FE7EC /end MEASUREMENT
/begin MEASUREMENT LSM_L2_A0 "" FLOAT32_IEEE PubIfDecisionLSM_MDL_CM_single 0 0 -3.4e+38 3.4e+38 ECU_ADDRESS 0x3FE948 /end MEASUREMENT
/begin MEASUREMENT LSM_L2_AvaliDis "" FLOAT32_IEEE PubIfDecisionLSM_MDL_CM_single 0 0 -3.4e+38 3.4e+38 ECU_ADDRESS 0x3FE930 /end MEASUREMENT
/begin MEASUREMENT LSM_L2_AvaliTime "" FLOAT32_IEEE PubIfDecisionLSM_MDL_CM_single 0 0 -3.4e+38 3.4e+38 ECU_ADDRESS 0x3FE928 /end MEASUREMENT
/begin MEASUREMENT LSM_L2_Conf "" UBYTE PubIfDecisionLSM_MDL_CM_uint8 0 0 0 255 ECU_ADDRESS 0x3FE962 /end MEASUREMENT
/begin MEASUREMENT LSM_L2_Range "" FLOAT32_IEEE PubIfDecisionLSM_MDL_CM_single 0 0 -3.4e+38 3.4e+38 ECU_ADDRESS 0x3FE82C /end MEASUREMENT
/begin MEASUREMENT LSM_L3_A0 "" FLOAT32_IEEE PubIfDecisionLSM_MDL_CM_single 0 0 -3.4e+38 3.4e+38 ECU_ADDRESS 0x3FE94C /end MEASUREMENT
/begin MEASUREMENT LSM_L3_AvaliDis "" FLOAT32_IEEE PubIfDecisionLSM_MDL_CM_single 0 0 -3.4e+38 3.4e+38 ECU_ADDRESS 0x3FE93C /end MEASUREMENT
/begin MEASUREMENT LSM_L3_AvaliTime "" FLOAT32_IEEE PubIfDecisionLSM_MDL_CM_single 0 0 -3.4e+38 3.4e+38 ECU_ADDRESS 0x3FE924 /end MEASUREMENT
/begin MEASUREMENT LSM_L3_Conf "" UBYTE PubIfDecisionLSM_MDL_CM_uint8 0 0 0 255 ECU_ADDRESS 0x3FE968 /end MEASUREMENT
/begin MEASUREMENT LSM_L3_Range "" FLOAT32_IEEE PubIfDecisionLSM_MDL_CM_single 0 0 -3.4e+38 3.4e+38 ECU_ADDRESS 0x3FE86C /end MEASUREMENT
/begin MEASUREMENT LSM_L4_A0 "" FLOAT32_IEEE PubIfDecisionLSM_MDL_CM_single 0 0 -3.4e+38 3.4e+38 ECU_ADDRESS 0x3FE950 /end MEASUREMENT
/begin MEASUREMENT LSM_L4_AvaliDis "" FLOAT32_IEEE PubIfDecisionLSM_MDL_CM_single 0 0 -3.4e+38 3.4e+38 ECU_ADDRESS 0x3FE940 /end MEASUREMENT
/begin MEASUREMENT LSM_L4_AvaliTime "" FLOAT32_IEEE PubIfDecisionLSM_MDL_CM_single 0 0 -3.4e+38 3.4e+38 ECU_ADDRESS 0x3FE938 /end MEASUREMENT
/begin MEASUREMENT LSM_L4_Conf "" UBYTE PubIfDecisionLSM_MDL_CM_uint8 0 0 0 255 ECU_ADDRESS 0x3FE971 /end MEASUREMENT
/begin MEASUREMENT LSM_L4_Range "" FLOAT32_IEEE PubIfDecisionLSM_MDL_CM_single 0 0 -3.4e+38 3.4e+38 ECU_ADDRESS 0x3FE898 /end MEASUREMENT
/begin MEASUREMENT LSM_LCKLineC0 "" FLOAT32_IEEE PubIfDecisionLSM_MDL_CM_single 0 0 -3.4e+38 3.4e+38 ECU_ADDRESS 0x3FE6E8 /end MEASUREMENT
/begin MEASUREMENT LSM_LCKLineC1 "" FLOAT32_IEEE PubIfDecisionLSM_MDL_CM_single 0 0 -3.4e+38 3.4e+38 ECU_ADDRESS 0x3FE78C /end MEASUREMENT
/begin MEASUREMENT LSM_LCKLineC2 "" FLOAT32_IEEE PubIfDecisionLSM_MDL_CM_single 0 0 -3.4e+38 3.4e+38 ECU_ADDRESS 0x3FE788 /end MEASUREMENT
/begin MEASUREMENT LSM_LCKLineC3 "" FLOAT32_IEEE PubIfDecisionLSM_MDL_CM_single 0 0 -3.4e+38 3.4e+38 ECU_ADDRESS 0x3FE784 /end MEASUREMENT
/begin MEASUREMENT LSM_LCKLineValid "" UBYTE PubIfDecisionLSM_MDL_CM_boolean 0 0 0 1 BIT_MASK 0x1 ECU_ADDRESS 0x3FE991 /end MEASUREMENT
/begin MEASUREMENT LSM_LCKRange "" FLOAT32_IEEE PubIfDecisionLSM_MDL_CM_single 0 0 -3.4e+38 3.4e+38 ECU_ADDRESS 0x3FE6EC /end MEASUREMENT
/begin MEASUREMENT LSM_LeftLaneChange "" UBYTE PubIfDecisionLSM_MDL_CM_boolean 0 0 0 1 BIT_MASK 0x1 ECU_ADDRESS 0x3FE993 /end MEASUREMENT
/begin MEASUREMENT LSM_LeftMostLane "" UBYTE PubIfDecisionLSM_MDL_CM_boolean 0 0 0 1 BIT_MASK 0x1 ECU_ADDRESS 0x3FE987 /end MEASUREMENT
/begin MEASUREMENT LSM_LockCounter "" UBYTE PubIfDecisionLSM_MDL_CM_uint8 0 0 0 255 ECU_ADDRESS 0x3FE983 /end MEASUREMENT
/begin MEASUREMENT LSM_LockID "" SBYTE PubIfDecisionLSM_MDL_CM_int8 0 0 -128 127 ECU_ADDRESS 0x3FE986 /end MEASUREMENT
/begin MEASUREMENT LSM_MLeLane "" UBYTE PubIfDecisionLSM_MDL_CM_boolean 0 0 0 1 BIT_MASK 0x1 ECU_ADDRESS 0x3FE992 /end MEASUREMENT
/begin MEASUREMENT LSM_MoveID "" SBYTE PubIfDecisionLSM_MDL_CM_int8 0 0 -128 127 ECU_ADDRESS 0x3FE985 /end MEASUREMENT
/begin MEASUREMENT LSM_OTL_A0 "" FLOAT32_IEEE PubIfDecisionLSM_MDL_CM_single 0 0 -3.4e+38 3.4e+38 ECU_ADDRESS 0x3FE79C /end MEASUREMENT
/begin MEASUREMENT LSM_OTL_A1 "" FLOAT32_IEEE PubIfDecisionLSM_MDL_CM_single 0 0 -3.4e+38 3.4e+38 ECU_ADDRESS 0x3FE798 /end MEASUREMENT
/begin MEASUREMENT LSM_OTL_A2 "" FLOAT32_IEEE PubIfDecisionLSM_MDL_CM_single 0 0 -3.4e+38 3.4e+38 ECU_ADDRESS 0x3FE794 /end MEASUREMENT
/begin MEASUREMENT LSM_OTL_A3 "" FLOAT32_IEEE PubIfDecisionLSM_MDL_CM_single 0 0 -3.4e+38 3.4e+38 ECU_ADDRESS 0x3FE790 /end MEASUREMENT
/begin MEASUREMENT LSM_OTL_Count "" UBYTE PubIfDecisionLSM_MDL_CM_uint8 0 0 0 255 ECU_ADDRESS 0x3FE958 /end MEASUREMENT
/begin MEASUREMENT LSM_OTL_Range "" FLOAT32_IEEE PubIfDecisionLSM_MDL_CM_single 0 0 -3.4e+38 3.4e+38 ECU_ADDRESS 0x3FE7A0 /end MEASUREMENT
/begin MEASUREMENT LSM_OTLineValid "" UBYTE PubIfDecisionLSM_MDL_CM_boolean 0 0 0 1 BIT_MASK 0x1 ECU_ADDRESS 0x3FE995 /end MEASUREMENT
/begin MEASUREMENT LSM_RightLaneChange "" UBYTE PubIfDecisionLSM_MDL_CM_boolean 0 0 0 1 BIT_MASK 0x1 ECU_ADDRESS 0x3FE994 /end MEASUREMENT
/begin MEASUREMENT LSM_RoadWidth "" FLOAT32_IEEE PubIfDecisionLSM_MDL_CM_single 0 0 -3.4e+38 3.4e+38 ECU_ADDRESS 0x3FE780 /end MEASUREMENT
/begin MEASUREMENT LSM_SingleLineLost_b "" UBYTE PubIfDecisionLSM_MDL_CM_boolean 0 0 0 1 BIT_MASK 0x1 ECU_ADDRESS 0x3FE98C /end MEASUREMENT
/begin MEASUREMENT LSM_TJALineC0 "" FLOAT32_IEEE PubIfDecisionLSM_MDL_CM_single 0 0 -3.4e+38 3.4e+38 ECU_ADDRESS 0x3FE74C /end MEASUREMENT
/begin MEASUREMENT LSM_TJALineC1 "" FLOAT32_IEEE PubIfDecisionLSM_MDL_CM_single 0 0 -3.4e+38 3.4e+38 ECU_ADDRESS 0x3FE728 /end MEASUREMENT
/begin MEASUREMENT LSM_TJALineC2 "" FLOAT32_IEEE PubIfDecisionLSM_MDL_CM_single 0 0 -3.4e+38 3.4e+38 ECU_ADDRESS 0x3FE70C /end MEASUREMENT
/begin MEASUREMENT LSM_TJALineC3 "" FLOAT32_IEEE PubIfDecisionLSM_MDL_CM_single 0 0 -3.4e+38 3.4e+38 ECU_ADDRESS 0x3FE6E4 /end MEASUREMENT
/begin MEASUREMENT LSM_TJALineValid "" UBYTE PubIfDecisionLSM_MDL_CM_boolean 0 0 0 1 BIT_MASK 0x1 ECU_ADDRESS 0x3FE988 /end MEASUREMENT
/begin MEASUREMENT LSM_TJARange "" FLOAT32_IEEE PubIfDecisionLSM_MDL_CM_single 0 0 -3.4e+38 3.4e+38 ECU_ADDRESS 0x3FE774 /end MEASUREMENT
/begin MEASUREMENT LSM_UpdateCnt "" ULONG PubIfDecisionLSM_MDL_CM_uint32 0 0 0 4294967295 ECU_ADDRESS 0x3FE6E0 /end MEASUREMENT
/begin MEASUREMENT LSM_dyDiff "" FLOAT32_IEEE PubIfDecisionLSM_MDL_CM_single 0 0 -3.4e+38 3.4e+38 ECU_ADDRESS 0x3FE77C /end MEASUREMENT
/begin MEASUREMENT LongCtrl_ALC_dangerLevel "" FLOAT32_IEEE PubIfDecisionPLAN_MDL_CM_single 0 0 -3.4e+38 3.4e+38 ECU_ADDRESS 0x3F2AB0 /end MEASUREMENT
/begin MEASUREMENT LongCtrl_ALC_laneChangeEnable "" UBYTE PubIfDecisionPLAN_MDL_CM_boolean 0 0 0 1 BIT_MASK 0x1 ECU_ADDRESS 0x3F35B2 /end MEASUREMENT
/begin MEASUREMENT LongCtrl_AP_SW_VERSION "" ULONG PubIfDecisionPLAN_MDL_CM_uint32 0 0 0 4294967295 ECU_ADDRESS 0x3F28D0 /end MEASUREMENT
/begin MEASUREMENT LongCtrl_CurvatureOfMap "" FLOAT32_IEEE PubIfDecisionPLAN_MDL_CM_single 0 0 -3.4e+38 3.4e+38 ECU_ADDRESS 0x3F2DF8 /end MEASUREMENT
/begin MEASUREMENT LongCtrl_CurvatureOfRoad "" FLOAT32_IEEE PubIfDecisionPLAN_MDL_CM_single 0 0 -3.4e+38 3.4e+38 ECU_ADDRESS 0x3F2E14 /end MEASUREMENT
/begin MEASUREMENT LongCtrl_DCEnable "" UBYTE PubIfControlLONC_MDL_CM_boolean 0 0 0 1 BIT_MASK 0x1 ECU_ADDRESS 0x3F24B1 /end MEASUREMENT
/begin MEASUREMENT LongCtrl_ECEnable "" UBYTE PubIfControlLONC_MDL_CM_boolean 0 0 0 1 BIT_MASK 0x1 ECU_ADDRESS 0x3F24B0 /end MEASUREMENT
/begin MEASUREMENT LongCtrl_FF_NetEngTorq "" FLOAT32_IEEE PubIfControlLONC_MDL_CM_single 0 0 -3.4e+38 3.4e+38 ECU_ADDRESS 0x3F2490 /end MEASUREMENT
/begin MEASUREMENT LongCtrl_OverrideToDC "" FLOAT32_IEEE PubIfControlLONC_MDL_CM_single 0 0 -3.4e+38 3.4e+38 ECU_ADDRESS 0x3F245C /end MEASUREMENT
/begin MEASUREMENT LongCtrl_PI_NetEngTorq "" FLOAT32_IEEE PubIfControlLONC_MDL_CM_single 0 0 -3.4e+38 3.4e+38 ECU_ADDRESS 0x3F248C /end MEASUREMENT
/begin MEASUREMENT LongCtrl_Sw2DC "" UBYTE PubIfControlLONC_MDL_CM_boolean 0 0 0 1 BIT_MASK 0x1 ECU_ADDRESS 0x3F24A2 /end MEASUREMENT
/begin MEASUREMENT LongCtrl_Sw2EC "" UBYTE PubIfControlLONC_MDL_CM_boolean 0 0 0 1 BIT_MASK 0x1 ECU_ADDRESS 0x3F24A1 /end MEASUREMENT
/begin MEASUREMENT LongCtrl_Tr_Ratio "" FLOAT32_IEEE PubIfControlLONC_MDL_CM_single 0 0 -3.4e+38 3.4e+38 ECU_ADDRESS 0x3F2460 /end MEASUREMENT
/begin MEASUREMENT LongCtrl_tor "" UBYTE PubIfDecisionPLAN_MDL_CM_boolean 0 0 0 1 BIT_MASK 0x1 ECU_ADDRESS 0x3F35C3 /end MEASUREMENT
/begin MEASUREMENT PLAN_ALC_LSMPilotTurnSts "" UBYTE PubIfDecisionPLAN_MDL_CM_uint8 0 0 0 255 ECU_ADDRESS 0x3F3526 /end MEASUREMENT
/begin MEASUREMENT PLAN_ALC_LampReq "" UBYTE PubIfDecisionPLAN_MDL_CM_uint8 0 0 0 255 ECU_ADDRESS 0x3F3527 /end MEASUREMENT
/begin MEASUREMENT PLAN_ALC_LaneChange "" UBYTE PubIfDecisionPLAN_MDL_CM_uint8 0 0 0 255 ECU_ADDRESS 0x3F352C /end MEASUREMENT
/begin MEASUREMENT PLAN_ALC_LaneChangeReq "" UBYTE PubIfDecisionPLAN_MDL_CM_uint8 0 0 0 255 ECU_ADDRESS 0x3F352B /end MEASUREMENT
/begin MEASUREMENT PLAN_ALC_LcCancelLe_CancelOverTk "" UBYTE PubIfDecisionPLAN_MDL_CM_boolean 0 0 0 1 BIT_MASK 0x1 ECU_ADDRESS 0x3F35AA /end MEASUREMENT
/begin MEASUREMENT PLAN_ALC_LcCancelLe_DPC "" UBYTE PubIfDecisionPLAN_MDL_CM_boolean 0 0 0 1 BIT_MASK 0x1 ECU_ADDRESS 0x3F35A7 /end MEASUREMENT
/begin MEASUREMENT PLAN_ALC_LcCancelLe_Drv "" UBYTE PubIfDecisionPLAN_MDL_CM_boolean 0 0 0 1 BIT_MASK 0x1 ECU_ADDRESS 0x3F35A6 /end MEASUREMENT
/begin MEASUREMENT PLAN_ALC_LcCancelLe_DrvCmpl "" UBYTE PubIfDecisionPLAN_MDL_CM_boolean 0 0 0 1 BIT_MASK 0x1 ECU_ADDRESS 0x3F35A5 /end MEASUREMENT
/begin MEASUREMENT PLAN_ALC_LcCancelLe_LineValid "" UBYTE PubIfDecisionPLAN_MDL_CM_boolean 0 0 0 1 BIT_MASK 0x1 ECU_ADDRESS 0x3F35A8 /end MEASUREMENT
/begin MEASUREMENT PLAN_ALC_LcCancelLe_Oncoming "" UBYTE PubIfDecisionPLAN_MDL_CM_boolean 0 0 0 1 BIT_MASK 0x1 ECU_ADDRESS 0x3F35A9 /end MEASUREMENT
/begin MEASUREMENT PLAN_ALC_LcCancelRi_CancelOverTk "" UBYTE PubIfDecisionPLAN_MDL_CM_boolean 0 0 0 1 BIT_MASK 0x1 ECU_ADDRESS 0x3F35B0 /end MEASUREMENT
/begin MEASUREMENT PLAN_ALC_LcCancelRi_DPC "" UBYTE PubIfDecisionPLAN_MDL_CM_boolean 0 0 0 1 BIT_MASK 0x1 ECU_ADDRESS 0x3F35AD /end MEASUREMENT
/begin MEASUREMENT PLAN_ALC_LcCancelRi_Drv "" UBYTE PubIfDecisionPLAN_MDL_CM_boolean 0 0 0 1 BIT_MASK 0x1 ECU_ADDRESS 0x3F35AC /end MEASUREMENT
/begin MEASUREMENT PLAN_ALC_LcCancelRi_DrvCmpl "" UBYTE PubIfDecisionPLAN_MDL_CM_boolean 0 0 0 1 BIT_MASK 0x1 ECU_ADDRESS 0x3F35AB /end MEASUREMENT
/begin MEASUREMENT PLAN_ALC_LcCancelRi_LineValid "" UBYTE PubIfDecisionPLAN_MDL_CM_boolean 0 0 0 1 BIT_MASK 0x1 ECU_ADDRESS 0x3F35AE /end MEASUREMENT
/begin MEASUREMENT PLAN_ALC_LcCancelRi_Oncoming "" UBYTE PubIfDecisionPLAN_MDL_CM_boolean 0 0 0 1 BIT_MASK 0x1 ECU_ADDRESS 0x3F35AF /end MEASUREMENT
/begin MEASUREMENT PLAN_ALC_LcDrvLe_DPC "" UBYTE PubIfDecisionPLAN_MDL_CM_boolean 0 0 0 1 BIT_MASK 0x1 ECU_ADDRESS 0x3F3572 /end MEASUREMENT
/begin MEASUREMENT PLAN_ALC_LcDrvLe_DPCHoldCnt "" UWORD PubIfDecisionPLAN_MDL_CM_uint16 0 0 0 65535 ECU_ADDRESS 0x3F351C /end MEASUREMENT
/begin MEASUREMENT PLAN_ALC_LcDrvLe_IPVehSpd "" UBYTE PubIfDecisionPLAN_MDL_CM_boolean 0 0 0 1 BIT_MASK 0x1 ECU_ADDRESS 0x3F35BA /end MEASUREMENT
/begin MEASUREMENT PLAN_ALC_LcDrvLe_LciDrv "" UBYTE PubIfDecisionPLAN_MDL_CM_boolean 0 0 0 1 BIT_MASK 0x1 ECU_ADDRESS 0x3F3574 /end MEASUREMENT
/begin MEASUREMENT PLAN_ALC_LcDrvLe_LineValid "" UBYTE PubIfDecisionPLAN_MDL_CM_boolean 0 0 0 1 BIT_MASK 0x1 ECU_ADDRESS 0x3F3573 /end MEASUREMENT
/begin MEASUREMENT PLAN_ALC_LcDrvLe_NoLcCancelFlag "" UBYTE PubIfDecisionPLAN_MDL_CM_boolean 0 0 0 1 BIT_MASK 0x1 ECU_ADDRESS 0x3F356F /end MEASUREMENT
/begin MEASUREMENT PLAN_ALC_LcDrvLe_NoLcFinishFlag "" UBYTE PubIfDecisionPLAN_MDL_CM_boolean 0 0 0 1 BIT_MASK 0x1 ECU_ADDRESS 0x3F3570 /end MEASUREMENT
/begin MEASUREMENT PLAN_ALC_LcDrvLe_dyDiff "" UBYTE PubIfDecisionPLAN_MDL_CM_boolean 0 0 0 1 BIT_MASK 0x1 ECU_ADDRESS 0x3F3571 /end MEASUREMENT
/begin MEASUREMENT PLAN_ALC_LcDrvRi_DPC "" UBYTE PubIfDecisionPLAN_MDL_CM_boolean 0 0 0 1 BIT_MASK 0x1 ECU_ADDRESS 0x3F3578 /end MEASUREMENT
/begin MEASUREMENT PLAN_ALC_LcDrvRi_DPCHoldCnt "" UWORD PubIfDecisionPLAN_MDL_CM_uint16 0 0 0 65535 ECU_ADDRESS 0x3F351E /end MEASUREMENT
/begin MEASUREMENT PLAN_ALC_LcDrvRi_IPVehSpd "" UBYTE PubIfDecisionPLAN_MDL_CM_boolean 0 0 0 1 BIT_MASK 0x1 ECU_ADDRESS 0x3F35B9 /end MEASUREMENT
/begin MEASUREMENT PLAN_ALC_LcDrvRi_LciDrv "" UBYTE PubIfDecisionPLAN_MDL_CM_boolean 0 0 0 1 BIT_MASK 0x1 ECU_ADDRESS 0x3F357A /end MEASUREMENT
/begin MEASUREMENT PLAN_ALC_LcDrvRi_LineValid "" UBYTE PubIfDecisionPLAN_MDL_CM_boolean 0 0 0 1 BIT_MASK 0x1 ECU_ADDRESS 0x3F3579 /end MEASUREMENT
/begin MEASUREMENT PLAN_ALC_LcDrvRi_NoLcCancelFlag "" UBYTE PubIfDecisionPLAN_MDL_CM_boolean 0 0 0 1 BIT_MASK 0x1 ECU_ADDRESS 0x3F3575 /end MEASUREMENT
/begin MEASUREMENT PLAN_ALC_LcDrvRi_NoLcFinishFlag "" UBYTE PubIfDecisionPLAN_MDL_CM_boolean 0 0 0 1 BIT_MASK 0x1 ECU_ADDRESS 0x3F3576 /end MEASUREMENT
/begin MEASUREMENT PLAN_ALC_LcDrvRi_dyDiff "" UBYTE PubIfDecisionPLAN_MDL_CM_boolean 0 0 0 1 BIT_MASK 0x1 ECU_ADDRESS 0x3F3577 /end MEASUREMENT
/begin MEASUREMENT PLAN_ALC_LcFinish "" UBYTE PubIfDecisionPLAN_MDL_CM_boolean 0 0 0 1 BIT_MASK 0x1 ECU_ADDRESS 0x3F35B1 /end MEASUREMENT
/begin MEASUREMENT PLAN_ALC_LcMrcRi_DPC "" UBYTE PubIfDecisionPLAN_MDL_CM_boolean 0 0 0 1 BIT_MASK 0x1 ECU_ADDRESS 0x3F356C /end MEASUREMENT
/begin MEASUREMENT PLAN_ALC_LcMrcRi_IPVehSpd "" UBYTE PubIfDecisionPLAN_MDL_CM_boolean 0 0 0 1 BIT_MASK 0x1 ECU_ADDRESS 0x3F356B /end MEASUREMENT
/begin MEASUREMENT PLAN_ALC_LcMrcRi_LciMrc "" UBYTE PubIfDecisionPLAN_MDL_CM_boolean 0 0 0 1 BIT_MASK 0x1 ECU_ADDRESS 0x3F356E /end MEASUREMENT
/begin MEASUREMENT PLAN_ALC_LcMrcRi_LineValid "" UBYTE PubIfDecisionPLAN_MDL_CM_boolean 0 0 0 1 BIT_MASK 0x1 ECU_ADDRESS 0x3F356D /end MEASUREMENT
/begin MEASUREMENT PLAN_ALC_LcMrcRi_NoTurnLamp "" UBYTE PubIfDecisionPLAN_MDL_CM_boolean 0 0 0 1 BIT_MASK 0x1 ECU_ADDRESS 0x3F3569 /end MEASUREMENT
/begin MEASUREMENT PLAN_ALC_LcMrcRi_dyDiff "" UBYTE PubIfDecisionPLAN_MDL_CM_boolean 0 0 0 1 BIT_MASK 0x1 ECU_ADDRESS 0x3F356A /end MEASUREMENT
/begin MEASUREMENT PLAN_ALC_LcNohLe_DPC "" UBYTE PubIfDecisionPLAN_MDL_CM_boolean 0 0 0 1 BIT_MASK 0x1 ECU_ADDRESS 0x3F357E /end MEASUREMENT
/begin MEASUREMENT PLAN_ALC_LcNohLe_IPVehSpd "" UBYTE PubIfDecisionPLAN_MDL_CM_boolean 0 0 0 1 BIT_MASK 0x1 ECU_ADDRESS 0x3F357D /end MEASUREMENT
/begin MEASUREMENT PLAN_ALC_LcNohLe_LciNoh "" UBYTE PubIfDecisionPLAN_MDL_CM_boolean 0 0 0 1 BIT_MASK 0x1 ECU_ADDRESS 0x3F3580 /end MEASUREMENT
/begin MEASUREMENT PLAN_ALC_LcNohLe_LineValid "" UBYTE PubIfDecisionPLAN_MDL_CM_boolean 0 0 0 1 BIT_MASK 0x1 ECU_ADDRESS 0x3F357F /end MEASUREMENT
/begin MEASUREMENT PLAN_ALC_LcNohLe_NoTurnLamp "" UBYTE PubIfDecisionPLAN_MDL_CM_boolean 0 0 0 1 BIT_MASK 0x1 ECU_ADDRESS 0x3F357B /end MEASUREMENT
/begin MEASUREMENT PLAN_ALC_LcNohLe_dyDiff "" UBYTE PubIfDecisionPLAN_MDL_CM_boolean 0 0 0 1 BIT_MASK 0x1 ECU_ADDRESS 0x3F357C /end MEASUREMENT
/begin MEASUREMENT PLAN_ALC_LcNohRi_DPC "" UBYTE PubIfDecisionPLAN_MDL_CM_boolean 0 0 0 1 BIT_MASK 0x1 ECU_ADDRESS 0x3F3584 /end MEASUREMENT
/begin MEASUREMENT PLAN_ALC_LcNohRi_IPVehSpd "" UBYTE PubIfDecisionPLAN_MDL_CM_boolean 0 0 0 1 BIT_MASK 0x1 ECU_ADDRESS 0x3F3583 /end MEASUREMENT
/begin MEASUREMENT PLAN_ALC_LcNohRi_LciNoh "" UBYTE PubIfDecisionPLAN_MDL_CM_boolean 0 0 0 1 BIT_MASK 0x1 ECU_ADDRESS 0x3F3586 /end MEASUREMENT
/begin MEASUREMENT PLAN_ALC_LcNohRi_LineValid "" UBYTE PubIfDecisionPLAN_MDL_CM_boolean 0 0 0 1 BIT_MASK 0x1 ECU_ADDRESS 0x3F3585 /end MEASUREMENT
/begin MEASUREMENT PLAN_ALC_LcNohRi_NoTurnLamp "" UBYTE PubIfDecisionPLAN_MDL_CM_boolean 0 0 0 1 BIT_MASK 0x1 ECU_ADDRESS 0x3F3581 /end MEASUREMENT
/begin MEASUREMENT PLAN_ALC_LcNohRi_dyDiff "" UBYTE PubIfDecisionPLAN_MDL_CM_boolean 0 0 0 1 BIT_MASK 0x1 ECU_ADDRESS 0x3F3582 /end MEASUREMENT
/begin MEASUREMENT PLAN_ALC_LcOverTkLe "" UBYTE PubIfDecisionPLAN_MDL_CM_boolean 0 0 0 1 BIT_MASK 0x1 ECU_ADDRESS 0x3F3595 /end MEASUREMENT
/begin MEASUREMENT PLAN_ALC_LcOverTkLe_ALCSwtOn "" UBYTE PubIfDecisionPLAN_MDL_CM_boolean 0 0 0 1 BIT_MASK 0x1 ECU_ADDRESS 0x3F3587 /end MEASUREMENT
/begin MEASUREMENT PLAN_ALC_LcOverTkLe_DPC "" UBYTE PubIfDecisionPLAN_MDL_CM_boolean 0 0 0 1 BIT_MASK 0x1 ECU_ADDRESS 0x3F358F /end MEASUREMENT
/begin MEASUREMENT PLAN_ALC_LcOverTkLe_DPCLongConfirm "" UBYTE PubIfDecisionPLAN_MDL_CM_boolean 0 0 0 1 BIT_MASK 0x1 ECU_ADDRESS 0x3F358E /end MEASUREMENT
/begin MEASUREMENT PLAN_ALC_LcOverTkLe_IPVehSpd "" UBYTE PubIfDecisionPLAN_MDL_CM_boolean 0 0 0 1 BIT_MASK 0x1 ECU_ADDRESS 0x3F358D /end MEASUREMENT
/begin MEASUREMENT PLAN_ALC_LcOverTkLe_LaneAvailable "" UBYTE PubIfDecisionPLAN_MDL_CM_boolean 0 0 0 1 BIT_MASK 0x1 ECU_ADDRESS 0x3F3588 /end MEASUREMENT
/begin MEASUREMENT PLAN_ALC_LcOverTkLe_LineCurvatureValid "" UBYTE PubIfDecisionPLAN_MDL_CM_boolean 0 0 0 1 BIT_MASK 0x1 ECU_ADDRESS 0x3F3594 /end MEASUREMENT
/begin MEASUREMENT PLAN_ALC_LcOverTkLe_LineValid "" UBYTE PubIfDecisionPLAN_MDL_CM_boolean 0 0 0 1 BIT_MASK 0x1 ECU_ADDRESS 0x3F3590 /end MEASUREMENT
/begin MEASUREMENT PLAN_ALC_LcOverTkLe_NoLcFinishFlag "" UBYTE PubIfDecisionPLAN_MDL_CM_boolean 0 0 0 1 BIT_MASK 0x1 ECU_ADDRESS 0x3F358B /end MEASUREMENT
/begin MEASUREMENT PLAN_ALC_LcOverTkLe_NoTurnLampReq "" UBYTE PubIfDecisionPLAN_MDL_CM_boolean 0 0 0 1 BIT_MASK 0x1 ECU_ADDRESS 0x3F358A /end MEASUREMENT
/begin MEASUREMENT PLAN_ALC_LcOverTkLe_NotInDrvCancelArea "" UBYTE PubIfDecisionPLAN_MDL_CM_boolean 0 0 0 1 BIT_MASK 0x1 ECU_ADDRESS 0x3F3591 /end MEASUREMENT
/begin MEASUREMENT PLAN_ALC_LcOverTkLe_OverTkTrigger "" UBYTE PubIfDecisionPLAN_MDL_CM_boolean 0 0 0 1 BIT_MASK 0x1 ECU_ADDRESS 0x3F3593 /end MEASUREMENT
/begin MEASUREMENT PLAN_ALC_LcOverTkLe_P0NotCutOut "" UBYTE PubIfDecisionPLAN_MDL_CM_boolean 0 0 0 1 BIT_MASK 0x1 ECU_ADDRESS 0x3F3592 /end MEASUREMENT
/begin MEASUREMENT PLAN_ALC_LcOverTkLe_PilotLaneAvailable "" UBYTE PubIfDecisionPLAN_MDL_CM_boolean 0 0 0 1 BIT_MASK 0x1 ECU_ADDRESS 0x3F3589 /end MEASUREMENT
/begin MEASUREMENT PLAN_ALC_LcOverTkLe_dyDiff "" UBYTE PubIfDecisionPLAN_MDL_CM_boolean 0 0 0 1 BIT_MASK 0x1 ECU_ADDRESS 0x3F358C /end MEASUREMENT
/begin MEASUREMENT PLAN_ALC_LcOverTkRi "" UBYTE PubIfDecisionPLAN_MDL_CM_boolean 0 0 0 1 BIT_MASK 0x1 ECU_ADDRESS 0x3F35A4 /end MEASUREMENT
/begin MEASUREMENT PLAN_ALC_LcOverTkRi_ALCSwtOn "" UBYTE PubIfDecisionPLAN_MDL_CM_boolean 0 0 0 1 BIT_MASK 0x1 ECU_ADDRESS 0x3F3596 /end MEASUREMENT
/begin MEASUREMENT PLAN_ALC_LcOverTkRi_DPC "" UBYTE PubIfDecisionPLAN_MDL_CM_boolean 0 0 0 1 BIT_MASK 0x1 ECU_ADDRESS 0x3F359E /end MEASUREMENT
/begin MEASUREMENT PLAN_ALC_LcOverTkRi_DPCLongConfirm "" UBYTE PubIfDecisionPLAN_MDL_CM_boolean 0 0 0 1 BIT_MASK 0x1 ECU_ADDRESS 0x3F359D /end MEASUREMENT
/begin MEASUREMENT PLAN_ALC_LcOverTkRi_IPVehSpd "" UBYTE PubIfDecisionPLAN_MDL_CM_boolean 0 0 0 1 BIT_MASK 0x1 ECU_ADDRESS 0x3F359C /end MEASUREMENT
/begin MEASUREMENT PLAN_ALC_LcOverTkRi_LaneAvailable "" UBYTE PubIfDecisionPLAN_MDL_CM_boolean 0 0 0 1 BIT_MASK 0x1 ECU_ADDRESS 0x3F3597 /end MEASUREMENT
/begin MEASUREMENT PLAN_ALC_LcOverTkRi_LineCurvatureValid "" UBYTE PubIfDecisionPLAN_MDL_CM_boolean 0 0 0 1 BIT_MASK 0x1 ECU_ADDRESS 0x3F35A3 /end MEASUREMENT
/begin MEASUREMENT PLAN_ALC_LcOverTkRi_LineValid "" UBYTE PubIfDecisionPLAN_MDL_CM_boolean 0 0 0 1 BIT_MASK 0x1 ECU_ADDRESS 0x3F359F /end MEASUREMENT
/begin MEASUREMENT PLAN_ALC_LcOverTkRi_NoLcFinishFlag "" UBYTE PubIfDecisionPLAN_MDL_CM_boolean 0 0 0 1 BIT_MASK 0x1 ECU_ADDRESS 0x3F359A /end MEASUREMENT
/begin MEASUREMENT PLAN_ALC_LcOverTkRi_NoTurnLampReq "" UBYTE PubIfDecisionPLAN_MDL_CM_boolean 0 0 0 1 BIT_MASK 0x1 ECU_ADDRESS 0x3F3599 /end MEASUREMENT
/begin MEASUREMENT PLAN_ALC_LcOverTkRi_NotInDrvCancelArea "" UBYTE PubIfDecisionPLAN_MDL_CM_boolean 0 0 0 1 BIT_MASK 0x1 ECU_ADDRESS 0x3F35A0 /end MEASUREMENT
/begin MEASUREMENT PLAN_ALC_LcOverTkRi_OverTkTrigger "" UBYTE PubIfDecisionPLAN_MDL_CM_boolean 0 0 0 1 BIT_MASK 0x1 ECU_ADDRESS 0x3F35A2 /end MEASUREMENT
/begin MEASUREMENT PLAN_ALC_LcOverTkRi_P0NotCutOut "" UBYTE PubIfDecisionPLAN_MDL_CM_boolean 0 0 0 1 BIT_MASK 0x1 ECU_ADDRESS 0x3F35A1 /end MEASUREMENT
/begin MEASUREMENT PLAN_ALC_LcOverTkRi_PilotLaneAvailable "" UBYTE PubIfDecisionPLAN_MDL_CM_boolean 0 0 0 1 BIT_MASK 0x1 ECU_ADDRESS 0x3F3598 /end MEASUREMENT
/begin MEASUREMENT PLAN_ALC_LcOverTkRi_dyDiff "" UBYTE PubIfDecisionPLAN_MDL_CM_boolean 0 0 0 1 BIT_MASK 0x1 ECU_ADDRESS 0x3F359B /end MEASUREMENT
/begin MEASUREMENT PLAN_ALC_LcReason "" UBYTE PubIfDecisionPLAN_MDL_CM_uint8 0 0 0 255 ECU_ADDRESS 0x3F352E /end MEASUREMENT
/begin MEASUREMENT PLAN_ALC_OveTkrSupDist "" FLOAT32_IEEE PubIfDecisionPLAN_MDL_CM_single 0 0 -3.4e+38 3.4e+38 ECU_ADDRESS 0x3F2AC8 /end MEASUREMENT
/begin MEASUREMENT PLAN_ALC_PreP0Dy "" FLOAT64_IEEE PubIfDecisionPLAN_MDL_CM_double 0 0 -1.7e+308 1.7e+308 ECU_ADDRESS 0x3F28B8 /end MEASUREMENT
/begin MEASUREMENT PLAN_ALC_SW_VERSION "" ULONG PubIfDecisionPLAN_MDL_CM_uint32 0 0 0 4294967295 ECU_ADDRESS 0x3F28D4 /end MEASUREMENT
/begin MEASUREMENT PLAN_ALC_UpdateCnt "" UBYTE PubIfDecisionPLAN_MDL_CM_uint8 0 0 0 255 ECU_ADDRESS 0x3F3528 /end MEASUREMENT
/begin MEASUREMENT PLAN_ALC_sts "" UBYTE PubIfDecisionPLAN_MDL_CM_uint8 0 0 0 255 ECU_ADDRESS 0x3F352D /end MEASUREMENT
/begin MEASUREMENT PLAN_DPC_ESS_DangerPlaus_FL "" FLOAT32_IEEE PubIfDecisionPLAN_MDL_CM_single 0 0 -3.4e+38 3.4e+38 ECU_ADDRESS 0x3F2938 MATRIX_DIM 11 1 1 LAYOUT ROW_DIR /end MEASUREMENT
/begin MEASUREMENT PLAN_DPC_ESS_DangerPlaus_FR "" FLOAT32_IEEE PubIfDecisionPLAN_MDL_CM_single 0 0 -3.4e+38 3.4e+38 ECU_ADDRESS 0x3F2A18 MATRIX_DIM 11 1 1 LAYOUT ROW_DIR /end MEASUREMENT
/begin MEASUREMENT PLAN_DPC_ESS_DangerPlaus_L "" FLOAT32_IEEE PubIfDecisionPLAN_MDL_CM_single 0 0 -3.4e+38 3.4e+38 ECU_ADDRESS 0x3F29BC /end MEASUREMENT
/begin MEASUREMENT PLAN_DPC_ESS_DangerPlaus_R "" FLOAT32_IEEE PubIfDecisionPLAN_MDL_CM_single 0 0 -3.4e+38 3.4e+38 ECU_ADDRESS 0x3F2A9C /end MEASUREMENT
/begin MEASUREMENT PLAN_DPC_ESS_DangerPlaus_RL "" FLOAT32_IEEE PubIfDecisionPLAN_MDL_CM_single 0 0 -3.4e+38 3.4e+38 ECU_ADDRESS 0x3F2990 MATRIX_DIM 11 1 1 LAYOUT ROW_DIR /end MEASUREMENT
/begin MEASUREMENT PLAN_DPC_ESS_DangerPlaus_RR "" FLOAT32_IEEE PubIfDecisionPLAN_MDL_CM_single 0 0 -3.4e+38 3.4e+38 ECU_ADDRESS 0x3F2A70 MATRIX_DIM 11 1 1 LAYOUT ROW_DIR /end MEASUREMENT
/begin MEASUREMENT PLAN_DPC_ESS_L_Oncoming_flag "" UBYTE PubIfDecisionPLAN_MDL_CM_boolean 0 0 0 1 BIT_MASK 0x1 ECU_ADDRESS 0x3F35B7 /end MEASUREMENT
/begin MEASUREMENT PLAN_DPC_ESS_R_Oncoming_flag "" UBYTE PubIfDecisionPLAN_MDL_CM_boolean 0 0 0 1 BIT_MASK 0x1 ECU_ADDRESS 0x3F35B8 /end MEASUREMENT
/begin MEASUREMENT PLAN_DPC_ESS_X_Factor_FL "" FLOAT32_IEEE PubIfDecisionPLAN_MDL_CM_single 0 0 -3.4e+38 3.4e+38 ECU_ADDRESS 0x3F28E0 MATRIX_DIM 11 1 1 LAYOUT ROW_DIR /end MEASUREMENT
/begin MEASUREMENT PLAN_DPC_ESS_X_Factor_FR "" FLOAT32_IEEE PubIfDecisionPLAN_MDL_CM_single 0 0 -3.4e+38 3.4e+38 ECU_ADDRESS 0x3F29C0 MATRIX_DIM 11 1 1 LAYOUT ROW_DIR /end MEASUREMENT
/begin MEASUREMENT PLAN_DPC_ESS_X_Factor_RL "" FLOAT32_IEEE PubIfDecisionPLAN_MDL_CM_single 0 0 -3.4e+38 3.4e+38 ECU_ADDRESS 0x3F2964 MATRIX_DIM 11 1 1 LAYOUT ROW_DIR /end MEASUREMENT
/begin MEASUREMENT PLAN_DPC_ESS_X_Factor_RR "" FLOAT32_IEEE PubIfDecisionPLAN_MDL_CM_single 0 0 -3.4e+38 3.4e+38 ECU_ADDRESS 0x3F2A44 MATRIX_DIM 11 1 1 LAYOUT ROW_DIR /end MEASUREMENT
/begin MEASUREMENT PLAN_DPC_ESS_Y_Factor_L "" FLOAT32_IEEE PubIfDecisionPLAN_MDL_CM_single 0 0 -3.4e+38 3.4e+38 ECU_ADDRESS 0x3F290C MATRIX_DIM 11 1 1 LAYOUT ROW_DIR /end MEASUREMENT
/begin MEASUREMENT PLAN_DPC_ESS_Y_Factor_R "" FLOAT32_IEEE PubIfDecisionPLAN_MDL_CM_single 0 0 -3.4e+38 3.4e+38 ECU_ADDRESS 0x3F29EC MATRIX_DIM 11 1 1 LAYOUT ROW_DIR /end MEASUREMENT
/begin MEASUREMENT PLAN_DPC_HWA_DPCold_C "" FLOAT32_IEEE PubIfDecisionPLAN_MDL_CM_single 0 0 -3.4e+38 3.4e+38 ECU_ADDRESS 0x3F2AB4 /end MEASUREMENT
/begin MEASUREMENT PLAN_DPC_HWA_DPCold_L "" FLOAT32_IEEE PubIfDecisionPLAN_MDL_CM_single 0 0 -3.4e+38 3.4e+38 ECU_ADDRESS 0x3F2AA0 /end MEASUREMENT
/begin MEASUREMENT PLAN_DPC_HWA_DPCold_R "" FLOAT32_IEEE PubIfDecisionPLAN_MDL_CM_single 0 0 -3.4e+38 3.4e+38 ECU_ADDRESS 0x3F2AA8 /end MEASUREMENT
/begin MEASUREMENT PLAN_DPC_HWA_DangerPlaus_L "" FLOAT32_IEEE PubIfDecisionPLAN_MDL_CM_single 0 0 -3.4e+38 3.4e+38 ECU_ADDRESS 0x3F2AA4 /end MEASUREMENT
/begin MEASUREMENT PLAN_DPC_HWA_DangerPlaus_R "" FLOAT32_IEEE PubIfDecisionPLAN_MDL_CM_single 0 0 -3.4e+38 3.4e+38 ECU_ADDRESS 0x3F2AAC /end MEASUREMENT
/begin MEASUREMENT PLAN_DPC_HWA_NearestObjDx_L "" FLOAT32_IEEE PubIfDecisionPLAN_MDL_CM_single 0 0 -3.4e+38 3.4e+38 ECU_ADDRESS 0x3F2AC0 /end MEASUREMENT
/begin MEASUREMENT PLAN_DPC_HWA_NearestObjDx_R "" FLOAT32_IEEE PubIfDecisionPLAN_MDL_CM_single 0 0 -3.4e+38 3.4e+38 ECU_ADDRESS 0x3F2AB8 /end MEASUREMENT
/begin MEASUREMENT PLAN_DPC_HWA_NearestObjSpeed_L "" FLOAT32_IEEE PubIfDecisionPLAN_MDL_CM_single 0 0 -3.4e+38 3.4e+38 ECU_ADDRESS 0x3F2AC4 /end MEASUREMENT
/begin MEASUREMENT PLAN_DPC_HWA_NearestObjSpeed_R "" FLOAT32_IEEE PubIfDecisionPLAN_MDL_CM_single 0 0 -3.4e+38 3.4e+38 ECU_ADDRESS 0x3F2ABC /end MEASUREMENT
/begin MEASUREMENT PLAN_DPC_HWA_NearestObjValid_L "" UBYTE PubIfDecisionPLAN_MDL_CM_boolean 0 0 0 1 BIT_MASK 0x1 ECU_ADDRESS 0x3F35B6 /end MEASUREMENT
/begin MEASUREMENT PLAN_DPC_HWA_NearestObjValid_R "" UBYTE PubIfDecisionPLAN_MDL_CM_boolean 0 0 0 1 BIT_MASK 0x1 ECU_ADDRESS 0x3F35B4 /end MEASUREMENT
/begin MEASUREMENT PLAN_DPC_HWA_OncomingFlag_Le "" UBYTE PubIfDecisionPLAN_MDL_CM_boolean 0 0 0 1 BIT_MASK 0x1 ECU_ADDRESS 0x3F35B5 /end MEASUREMENT
/begin MEASUREMENT PLAN_DPC_HWA_OncomingFlag_Ri "" UBYTE PubIfDecisionPLAN_MDL_CM_boolean 0 0 0 1 BIT_MASK 0x1 ECU_ADDRESS 0x3F35B3 /end MEASUREMENT
/begin CHARACTERISTIC P_Global_CharSpd_ms "车辆特征车速（过渡转向和转向不足的临界车速，ESP提供）" VALUE 0x3B4CD4 Scalar_FLOAT32_IEEE 0 PubIfCommonVIE_MDL_CM_single_m_s -3.4e+38 3.4e+38 /end CHARACTERISTIC
/begin CHARACTERISTIC P_Global_DxvRearBumper_m "后轴中心到后杠后边缘中心的X向位置" VALUE 0x3B4CD8 Scalar_FLOAT32_IEEE 0 PubIfDecisionPLAN_MDL_CM_single_m -3.4e+38 3.4e+38 /end CHARACTERISTIC
/begin CHARACTERISTIC P_Global_FrontAxleToCenter_m "前轴距到车辆质心距离" VALUE 0x3B4CE0 Scalar_FLOAT32_IEEE 0 PubIfCommonVIE_MDL_CM_single_m -3.4e+38 3.4e+38 /end CHARACTERISTIC
/begin CHARACTERISTIC P_Global_RearAxleToCenter_m "后轴到车辆质心的X向位置" VALUE 0x3B4CE8 Scalar_FLOAT32_IEEE 0 PubIfCommonVIE_MDL_CM_single_m -3.4e+38 3.4e+38 /end CHARACTERISTIC
/begin CHARACTERISTIC P_Global_SideSlipAnglefactor "侧滑角系数" VALUE 0x3B4CEC Scalar_FLOAT32_IEEE 0 PubIfCommonVIE_MDL_CM_single -3.4e+38 3.4e+38 /end CHARACTERISTIC
/begin CHARACTERISTIC P_Global_TireRadius_m "轮胎半径" VALUE 0x3B4CF4 Scalar_FLOAT32_IEEE 0 PubIfControlLONC_MDL_CM_single_m -3.4e+38 3.4e+38 /end CHARACTERISTIC
/begin CHARACTERISTIC P_Global_WheelBase_m "轴距" VALUE 0x3B4D04 Scalar_FLOAT32_IEEE 0 PubIfCommonVIE_MDL_CM_single_m -3.4e+38 3.4e+38 /end CHARACTERISTIC
/begin CHARACTERISTIC P_Global_WheelTrack_m "轮距" VALUE 0x3B4D08 Scalar_FLOAT32_IEEE 0 PubIfCommonVIE_MDL_CM_single_m -3.4e+38 3.4e+38 /end CHARACTERISTIC
/begin CHARACTERISTIC P_HMI_LDW_LKAWarnTime "" VALUE 0x3B4D0C Scalar_FLOAT32_IEEE 0 PubIfChassisHMI_MDL_CM_single -3.4e+38 3.4e+38 /end CHARACTERISTIC
/begin AXIS_PTS P_LCS_A0_Dis_BP "" 0x3B4D14 LCS_EqA0 Lookup2D_X_FLOAT32_IEEE 0 PubIfControlLATC_MDL_CM_single 19 -3.4e+38 3.4e+38 DEPOSIT ABSOLUTE /end AXIS_PTS
/begin AXIS_PTS P_LCS_A2_LatAcc_BP "" 0x3B4D60 NO_INPUT_QUANTITY Lookup1D_X_FLOAT32_IEEE 0 PubIfControlLATC_MDL_CM_single 5 -3.4e+38 3.4e+38 DEPOSIT ABSOLUTE /end AXIS_PTS
/begin CHARACTERISTIC P_LCS_CurAngleFiltEnable "" VALUE 0x3B9F44 Scalar_BOOLEAN 0 PubIfControlLATC_MDL_CM_boolean 0 1 BIT_MASK 0x1 /end CHARACTERISTIC
/begin CHARACTERISTIC P_LCS_CurAngleFilterFC "" VALUE 0x3B6E78 Scalar_FLOAT32_IEEE 0 PubIfControlLATC_MDL_CM_single -3.4e+38 3.4e+38 /end CHARACTERISTIC
/begin CHARACTERISTIC P_LCS_DangerLevel_ManualSW "" VALUE 0x3CB092 Scalar_UBYTE 0 PubIfControlLATC_MDL_CM_uint8 0 255 /end CHARACTERISTIC
/begin CHARACTERISTIC P_LCS_DangerLevel_ManualValue "" VALUE 0x3B9F5A Scalar_UBYTE 0 PubIfControlLATC_MDL_CM_uint8 0 255 /end CHARACTERISTIC
/begin CHARACTERISTIC P_LCS_ESS_preDis_Nomal "" CURVE 0x3B6EFC Lookup1D_FLOAT32_IEEE 0 PubIfControlLATC_MDL_CM_single -3.4e+38 3.4e+38
 /begin AXIS_DESCR COM_AXIS LCS_DisplaySpd_kph PubIfControlLATC_MDL_CM_single 16 -3.4e+38 3.4e+38 DEPOSIT ABSOLUTE AXIS_PTS_REF P_LCS_preDis_spd /end AXIS_DESCR
/end CHARACTERISTIC
/begin CHARACTERISTIC P_LCS_FFW_Torq_AngleBp "" VAL_BLK 0x3B4920 Scalar_FLOAT64_IEEE 0 PubIfControlLATC_MDL_CM_double -1.7e+308 1.7e+308 MATRIX_DIM 1 39 1 /end CHARACTERISTIC
/begin CHARACTERISTIC P_LCS_FFW_Torq_SpdBp "" VAL_BLK 0x3B4A58 Scalar_FLOAT64_IEEE 0 PubIfControlLATC_MDL_CM_double -1.7e+308 1.7e+308 MATRIX_DIM 1 8 1 /end CHARACTERISTIC
/begin CHARACTERISTIC P_LCS_IN_Offset_Test_SW "" VALUE 0x3CB093 Scalar_UBYTE 0 PubIfControlLATC_MDL_CM_uint8 0 255 /end CHARACTERISTIC
/begin CHARACTERISTIC P_LCS_LCK_preDis_Nomal "" CURVE 0x3B6F40 Lookup1D_FLOAT32_IEEE 0 PubIfControlLATC_MDL_CM_single -3.4e+38 3.4e+38
 /begin AXIS_DESCR COM_AXIS LCS_DisplaySpd_kph PubIfControlLATC_MDL_CM_single 16 -3.4e+38 3.4e+38 DEPOSIT ABSOLUTE AXIS_PTS_REF P_LCS_preDis_spd /end AXIS_DESCR
/end CHARACTERISTIC
/begin CHARACTERISTIC P_LCS_Offset_Switch "" VALUE 0x3B4A98 Scalar_FLOAT64_IEEE 0 PubIfControlLATC_MDL_CM_double -1.7e+308 1.7e+308 /end CHARACTERISTIC
/begin CHARACTERISTIC P_LCS_PID_DisableKi_CurveVal "" VALUE 0x3B6F88 Scalar_FLOAT32_IEEE 0 PubIfControlLATC_MDL_CM_single -3.4e+38 3.4e+38 /end CHARACTERISTIC
/begin AXIS_PTS P_LCS_PID_DrvTorqFacBp "" 0x3B6F8C NO_INPUT_QUANTITY Lookup1D_X_FLOAT32_IEEE 0 PubIfControlLATC_MDL_CM_single 4 -3.4e+38 3.4e+38 DEPOSIT ABSOLUTE /end AXIS_PTS
/begin CHARACTERISTIC P_LCS_PID_DrvTorqFacVal "" CURVE 0x3B6F9C Lookup1D_FLOAT32_IEEE 0 PubIfControlLATC_MDL_CM_single -3.4e+38 3.4e+38
 /begin AXIS_DESCR COM_AXIS NO_INPUT_QUANTITY PubIfControlLATC_MDL_CM_single 4 -3.4e+38 3.4e+38 DEPOSIT ABSOLUTE AXIS_PTS_REF P_LCS_PID_DrvTorqFacBp /end AXIS_DESCR
/end CHARACTERISTIC
/begin CHARACTERISTIC P_LCS_TarAngleAddOffset_enable "" VALUE 0x3CAFE0 Scalar_FLOAT64_IEEE 0 PubIfControlLATC_MDL_CM_double -1.7e+308 1.7e+308 /end CHARACTERISTIC
/begin CHARACTERISTIC P_LCS_TarAngleFilterEnable "TarAngle滤波使能" VALUE 0x3B9F45 Scalar_BOOLEAN 0 PubIfControlLATC_MDL_CM_boolean 0 1 BIT_MASK 0x1 /end CHARACTERISTIC
/begin AXIS_PTS P_LCS_TarAngleFilterFC_spdBp "" 0x3B709C LCS_DisplaySpd_kph Lookup1D_X_FLOAT32_IEEE 0 PubIfControlLATC_MDL_CM_single 8 -3.4e+38 3.4e+38 DEPOSIT ABSOLUTE /end AXIS_PTS
/begin CHARACTERISTIC P_LCS_TarAngleFilterFC_spdVal "" CURVE 0x3B70BC Lookup1D_FLOAT32_IEEE 0 PubIfControlLATC_MDL_CM_single -3.4e+38 3.4e+38
 /begin AXIS_DESCR COM_AXIS LCS_DisplaySpd_kph PubIfControlLATC_MDL_CM_single 8 -3.4e+38 3.4e+38 DEPOSIT ABSOLUTE AXIS_PTS_REF P_LCS_TarAngleFilterFC_spdBp /end AXIS_DESCR
/end CHARACTERISTIC
/begin CHARACTERISTIC P_LCS_TestAngleSwitch "" VALUE 0x3CB020 Scalar_FLOAT32_IEEE 0 PubIfControlLATC_MDL_CM_single -3.4e+38 3.4e+38 /end CHARACTERISTIC
/begin CHARACTERISTIC P_LCS_TestTarAngle "" VALUE 0x3CB024 Scalar_FLOAT32_IEEE 0 PubIfControlLATC_MDL_CM_single -3.4e+38 3.4e+38 /end CHARACTERISTIC
/begin CHARACTERISTIC P_LCS_Trq_Switch "" VALUE 0x3CB094 Scalar_UBYTE 0 PubIfControlLATC_MDL_CM_uint8 0 255 /end CHARACTERISTIC
/begin CHARACTERISTIC P_LCS_preDis_ELK_Fac "" MAP 0x3B70DC Lookup2D_FLOAT32_IEEE 0 PubIfControlLATC_MDL_CM_single -3.4e+38 3.4e+38
 /begin AXIS_DESCR COM_AXIS LCS_EqA0 PubIfControlLATC_MDL_CM_single 19 -3.4e+38 3.4e+38 DEPOSIT ABSOLUTE AXIS_PTS_REF P_LCS_A0_Dis_BP /end AXIS_DESCR
 /begin AXIS_DESCR COM_AXIS LCS_DisplaySpd_kph PubIfControlLATC_MDL_CM_single 16 -3.4e+38 3.4e+38 DEPOSIT ABSOLUTE AXIS_PTS_REF P_LCS_preDis_spd /end AXIS_DESCR
/end CHARACTERISTIC
/begin CHARACTERISTIC P_LCS_preDis_ESS_Fac "" MAP 0x3B759C Lookup2D_FLOAT32_IEEE 0 PubIfControlLATC_MDL_CM_single -3.4e+38 3.4e+38
 /begin AXIS_DESCR COM_AXIS LCS_EqA0 PubIfControlLATC_MDL_CM_single 19 -3.4e+38 3.4e+38 DEPOSIT ABSOLUTE AXIS_PTS_REF P_LCS_A0_Dis_BP /end AXIS_DESCR
 /begin AXIS_DESCR COM_AXIS LCS_DisplaySpd_kph PubIfControlLATC_MDL_CM_single 16 -3.4e+38 3.4e+38 DEPOSIT ABSOLUTE AXIS_PTS_REF P_LCS_preDis_spd /end AXIS_DESCR
/end CHARACTERISTIC
/begin CHARACTERISTIC P_LCS_preDis_LCK_A2Curve_Fac "" CURVE 0x3B7A5C Lookup1D_FLOAT32_IEEE 0 PubIfControlLATC_MDL_CM_single -3.4e+38 3.4e+38
 /begin AXIS_DESCR COM_AXIS NO_INPUT_QUANTITY PubIfControlLATC_MDL_CM_single 5 -3.4e+38 3.4e+38 DEPOSIT ABSOLUTE AXIS_PTS_REF P_LCS_A2_LatAcc_BP /end AXIS_DESCR
/end CHARACTERISTIC
/begin CHARACTERISTIC P_LCS_preDis_LCK_Fac "" MAP 0x3B7A70 Lookup2D_FLOAT32_IEEE 0 PubIfControlLATC_MDL_CM_single -3.4e+38 3.4e+38
 /begin AXIS_DESCR COM_AXIS LCS_EqA0 PubIfControlLATC_MDL_CM_single 19 -3.4e+38 3.4e+38 DEPOSIT ABSOLUTE AXIS_PTS_REF P_LCS_A0_Dis_BP /end AXIS_DESCR
 /begin AXIS_DESCR COM_AXIS LCS_DisplaySpd_kph PubIfControlLATC_MDL_CM_single 16 -3.4e+38 3.4e+38 DEPOSIT ABSOLUTE AXIS_PTS_REF P_LCS_preDis_spd /end AXIS_DESCR
/end CHARACTERISTIC
/begin CHARACTERISTIC P_LCS_preDis_LC_Eco_Fac "" MAP 0x3B7F30 Lookup2D_FLOAT32_IEEE 0 PubIfControlLATC_MDL_CM_single -3.4e+38 3.4e+38
 /begin AXIS_DESCR COM_AXIS LCS_EqA0 PubIfControlLATC_MDL_CM_single 19 -3.4e+38 3.4e+38 DEPOSIT ABSOLUTE AXIS_PTS_REF P_LCS_A0_Dis_BP /end AXIS_DESCR
 /begin AXIS_DESCR COM_AXIS LCS_DisplaySpd_kph PubIfControlLATC_MDL_CM_single 16 -3.4e+38 3.4e+38 DEPOSIT ABSOLUTE AXIS_PTS_REF P_LCS_preDis_spd /end AXIS_DESCR
/end CHARACTERISTIC
/begin CHARACTERISTIC P_LCS_preDis_LC_Nomal_Fac "" MAP 0x3B83F0 Lookup2D_FLOAT32_IEEE 0 PubIfControlLATC_MDL_CM_single -3.4e+38 3.4e+38
 /begin AXIS_DESCR COM_AXIS LCS_EqA0 PubIfControlLATC_MDL_CM_single 19 -3.4e+38 3.4e+38 DEPOSIT ABSOLUTE AXIS_PTS_REF P_LCS_A0_Dis_BP /end AXIS_DESCR
 /begin AXIS_DESCR COM_AXIS LCS_DisplaySpd_kph PubIfControlLATC_MDL_CM_single 16 -3.4e+38 3.4e+38 DEPOSIT ABSOLUTE AXIS_PTS_REF P_LCS_preDis_spd /end AXIS_DESCR
/end CHARACTERISTIC
/begin CHARACTERISTIC P_LCS_preDis_LC_Sport_Fac "" MAP 0x3B88B0 Lookup2D_FLOAT32_IEEE 0 PubIfControlLATC_MDL_CM_single -3.4e+38 3.4e+38
 /begin AXIS_DESCR COM_AXIS LCS_EqA0 PubIfControlLATC_MDL_CM_single 19 -3.4e+38 3.4e+38 DEPOSIT ABSOLUTE AXIS_PTS_REF P_LCS_A0_Dis_BP /end AXIS_DESCR
 /begin AXIS_DESCR COM_AXIS LCS_DisplaySpd_kph PubIfControlLATC_MDL_CM_single 16 -3.4e+38 3.4e+38 DEPOSIT ABSOLUTE AXIS_PTS_REF P_LCS_preDis_spd /end AXIS_DESCR
/end CHARACTERISTIC
/begin AXIS_PTS P_LCS_preDis_spd "" 0x3B8D70 LCS_DisplaySpd_kph Lookup2D_X_FLOAT32_IEEE 0 PubIfControlLATC_MDL_CM_single 16 -3.4e+38 3.4e+38 DEPOSIT ABSOLUTE /end AXIS_PTS
/begin CHARACTERISTIC P_LSM_ALC_Enable "" VALUE 0x3CB095 Scalar_UBYTE 0 PubIfDecisionLSM_MDL_CM_uint8 0 255 /end CHARACTERISTIC
/begin CHARACTERISTIC P_LSM_DOP2Line_Limit "" VALUE 0x3B4B18 Scalar_FLOAT64_IEEE 0 PubIfDecisionLSM_MDL_CM_double -1.7e+308 1.7e+308 /end CHARACTERISTIC
/begin CHARACTERISTIC P_LSM_DOP2Line_Reliable "" VALUE 0x3B4B20 Scalar_FLOAT64_IEEE 0 PubIfDecisionLSM_MDL_CM_double -1.7e+308 1.7e+308 /end CHARACTERISTIC
/begin CHARACTERISTIC P_LSM_Error_Limit "" VALUE 0x3B8DB4 Scalar_FLOAT32_IEEE 0 PubIfDecisionLSM_MDL_CM_single -3.4e+38 3.4e+38 /end CHARACTERISTIC
/begin CHARACTERISTIC P_LSM_IFV2CenterAxis "" VALUE 0x3CB028 Scalar_FLOAT32_IEEE 0 PubIfDecisionLSM_MDL_CM_single -3.4e+38 3.4e+38 /end CHARACTERISTIC
/begin CHARACTERISTIC P_LSM_IFV2RearAxis "" VALUE 0x3CB02C Scalar_FLOAT32_IEEE 0 PubIfDecisionLSM_MDL_CM_single -3.4e+38 3.4e+38 /end CHARACTERISTIC
/begin CHARACTERISTIC P_LSM_LineSTD_Limit "" VALUE 0x3B8DBC Scalar_FLOAT32_IEEE 0 PubIfDecisionLSM_MDL_CM_single -3.4e+38 3.4e+38 /end CHARACTERISTIC
/begin CHARACTERISTIC P_LSM_NOH_Switch "" VALUE 0x3CAFE8 Scalar_FLOAT64_IEEE 0 PubIfDecisionLSM_MDL_CM_double -1.7e+308 1.7e+308 /end CHARACTERISTIC
/begin CHARACTERISTIC P_LSM_OTL_C0_Factor "" VALUE 0x3B8DC0 Scalar_FLOAT32_IEEE 0 PubIfDecisionLSM_MDL_CM_single -3.4e+38 3.4e+38 /end CHARACTERISTIC
/begin CHARACTERISTIC P_LSM_OTL_C1_Factor "" VALUE 0x3B8DC4 Scalar_FLOAT32_IEEE 0 PubIfDecisionLSM_MDL_CM_single -3.4e+38 3.4e+38 /end CHARACTERISTIC
/begin CHARACTERISTIC P_LSM_OTL_C2_Factor "" VALUE 0x3B8DC8 Scalar_FLOAT32_IEEE 0 PubIfDecisionLSM_MDL_CM_single -3.4e+38 3.4e+38 /end CHARACTERISTIC
/begin CHARACTERISTIC P_LSM_Pre_t "" VALUE 0x3CB030 Scalar_FLOAT32_IEEE 0 PubIfDecisionLSM_MDL_CM_single -3.4e+38 3.4e+38 /end CHARACTERISTIC
/begin CHARACTERISTIC P_LongCtrl_CCaMinNegAcceleLowerBand "" VALUE 0x3B8F84 Scalar_FLOAT32_IEEE 0 PubIfDecisionPLAN_MDL_CM_single_m_s_2 -2 0 /end CHARACTERISTIC
/begin CHARACTERISTIC P_LongCtrl_CCaMinNegAcceleUpperBand "" VALUE 0x3B8F88 Scalar_FLOAT32_IEEE 0 PubIfDecisionPLAN_MDL_CM_single_m_s_2 0 2 /end CHARACTERISTIC
/begin CHARACTERISTIC P_LongCtrl_CCaMinPosAcceleLowerBand "" VALUE 0x3B8F8C Scalar_FLOAT32_IEEE 0 PubIfDecisionPLAN_MDL_CM_single_m_s_2 -2 0 /end CHARACTERISTIC
/begin CHARACTERISTIC P_LongCtrl_CCaMinPosAcceleUpperBand "" VALUE 0x3B8F90 Scalar_FLOAT32_IEEE 0 PubIfDecisionPLAN_MDL_CM_single_m_s_2 0 2 /end CHARACTERISTIC
/begin CHARACTERISTIC P_LongCtrl_CCfacNegAcceleLowerBand "" VALUE 0x3B8FB8 Scalar_FLOAT32_IEEE 0 PubIfDecisionPLAN_MDL_CM_single 0 2 /end CHARACTERISTIC
/begin CHARACTERISTIC P_LongCtrl_CCfacNegAcceleUpperBand "" VALUE 0x3B8FBC Scalar_FLOAT32_IEEE 0 PubIfDecisionPLAN_MDL_CM_single 0 2 /end CHARACTERISTIC
/begin CHARACTERISTIC P_LongCtrl_CCfacPosAcceleLowerBand "" VALUE 0x3B8FC0 Scalar_FLOAT32_IEEE 0 PubIfDecisionPLAN_MDL_CM_single 0 2 /end CHARACTERISTIC
/begin CHARACTERISTIC P_LongCtrl_CCfacPosAcceleUpperBand "" VALUE 0x3B8FC4 Scalar_FLOAT32_IEEE 0 PubIfDecisionPLAN_MDL_CM_single 0 2 /end CHARACTERISTIC
/begin CHARACTERISTIC P_LongCtrl_CCtAcceleTimeNeg "" VALUE 0x3B8FC8 Scalar_FLOAT32_IEEE 0 PubIfDecisionPLAN_MDL_CM_single_s 1 10 /end CHARACTERISTIC
/begin AXIS_PTS P_LongCtrl_CCtAcceleTimeNegCorrXAxis "" 0x3B8FCC NO_INPUT_QUANTITY Lookup1D_X_FLOAT32_IEEE 0 PubIfDecisionPLAN_MDL_CM_single_m_s 2 -5 0 DEPOSIT ABSOLUTE /end AXIS_PTS
/begin CHARACTERISTIC P_LongCtrl_CCtAcceleTimeNegCorrYAxis "" CURVE 0x3B8FD4 Lookup1D_FLOAT32_IEEE 0 PubIfDecisionPLAN_MDL_CM_single 0 1
 /begin AXIS_DESCR COM_AXIS NO_INPUT_QUANTITY PubIfDecisionPLAN_MDL_CM_single_m_s 2 -5 0 DEPOSIT ABSOLUTE AXIS_PTS_REF P_LongCtrl_CCtAcceleTimeNegCorrXAxis /end AXIS_DESCR
/end CHARACTERISTIC
/begin CHARACTERISTIC P_LongCtrl_CCtAcceleTimePos "" VALUE 0x3B8FDC Scalar_FLOAT32_IEEE 0 PubIfDecisionPLAN_MDL_CM_single_s 1 10 /end CHARACTERISTIC
/begin AXIS_PTS P_LongCtrl_CCtAcceleTimePosCorrXAxis "" 0x3B8FE0 NO_INPUT_QUANTITY Lookup1D_X_FLOAT32_IEEE 0 PubIfDecisionPLAN_MDL_CM_single_m_s 2 0 5 DEPOSIT ABSOLUTE /end AXIS_PTS
/begin CHARACTERISTIC P_LongCtrl_CCtAcceleTimePosCorrYAxis "" CURVE 0x3B8FE8 Lookup1D_FLOAT32_IEEE 0 PubIfDecisionPLAN_MDL_CM_single 0 1
 /begin AXIS_DESCR COM_AXIS NO_INPUT_QUANTITY PubIfDecisionPLAN_MDL_CM_single_m_s 2 0 5 DEPOSIT ABSOLUTE AXIS_PTS_REF P_LongCtrl_CCtAcceleTimePosCorrXAxis /end AXIS_DESCR
/end CHARACTERISTIC
/begin CHARACTERISTIC P_LongCtrl_FollowaccelThresActiveTOR "" VALUE 0x3B9144 Scalar_FLOAT32_IEEE 0 PubIfDecisionPLAN_MDL_CM_single_m_s_2 -10 0 /end CHARACTERISTIC
/begin CHARACTERISTIC P_LongCtrl_FollowcoefDistRelThresActiveTOR "" VALUE 0x3B914C Scalar_FLOAT32_IEEE 0 PubIfDecisionPLAN_MDL_CM_single 0 2 /end CHARACTERISTIC
/begin CHARACTERISTIC P_LongCtrl_FollowgapThresActiveTOR "" VALUE 0x3B9218 Scalar_FLOAT32_IEEE 0 PubIfDecisionPLAN_MDL_CM_single_s 0 10 /end CHARACTERISTIC
/begin CHARACTERISTIC P_LongCtrl_FollowvelTargRelThresActiveTOR "" VALUE 0x3B926C Scalar_FLOAT32_IEEE 0 PubIfDecisionPLAN_MDL_CM_single_m_s -5 0 /end CHARACTERISTIC
/begin CHARACTERISTIC P_LongCtrl_SJdStop "" VALUE 0x3B94BC Scalar_FLOAT32_IEEE 0 PubIfDecisionPLAN_MDL_CM_single 4 4 /end CHARACTERISTIC
/begin CHARACTERISTIC P_LongCtrl_VLCTrTatioMax "" VALUE 0x3B94F8 Scalar_FLOAT32_IEEE 0 PubIfControlLONC_MDL_CM_single 10 30 /end CHARACTERISTIC
/begin CHARACTERISTIC P_LongCtrl_VLCTrTatioMin "" VALUE 0x3B94FC Scalar_FLOAT32_IEEE 0 PubIfControlLONC_MDL_CM_single 0.1 1 /end CHARACTERISTIC
/begin CHARACTERISTIC P_LongCtrl_VLCaXCDeadZoneProp_Y "" VAL_BLK 0x3B9500 Scalar_FLOAT32_IEEE 0 PubIfControlLONC_MDL_CM_single -3.4e+38 3.4e+38 MATRIX_DIM 1 7 1 /end CHARACTERISTIC
/begin CHARACTERISTIC P_LongCtrl_VLCaXCKiCtrlDevChar_Y "" VAL_BLK 0x3B951C Scalar_FLOAT32_IEEE 0 PubIfControlLONC_MDL_CM_single -3.4e+38 3.4e+38 MATRIX_DIM 1 11 1 /end CHARACTERISTIC
/begin CHARACTERISTIC P_LongCtrl_VLCaxCtrlDevDeadZoneChar_Y "" VAL_BLK 0x3B9558 Scalar_FLOAT32_IEEE 0 PubIfControlLONC_MDL_CM_single -3.4e+38 3.4e+38 MATRIX_DIM 1 5 1 /end CHARACTERISTIC
/begin CHARACTERISTIC P_LongCtrl_VLCaxCtrlDevEC2DCMax "" VALUE 0x3B956C Scalar_FLOAT32_IEEE 0 PubIfControlLONC_MDL_CM_single -3.4e+38 3.4e+38 /end CHARACTERISTIC
/begin CHARACTERISTIC P_LongCtrl_VLCaxCtrlDevFastQuitDCMode "" VALUE 0x3B9570 Scalar_FLOAT32_IEEE 0 PubIfControlLONC_MDL_CM_single -3.4e+38 3.4e+38 /end CHARACTERISTIC
/begin CHARACTERISTIC P_LongCtrl_VLCaxCtrlDevThresAddEC2DC "" VAL_BLK 0x3B9574 Scalar_FLOAT32_IEEE 0 PubIfControlLONC_MDL_CM_single -3.4e+38 3.4e+38 MATRIX_DIM 1 5 1 /end CHARACTERISTIC
/begin CHARACTERISTIC P_LongCtrl_VLCaxCtrlDevTresAddDC2EC "" VAL_BLK 0x3B9588 Scalar_FLOAT32_IEEE 0 PubIfControlLONC_MDL_CM_single -3.4e+38 3.4e+38 MATRIX_DIM 1 5 1 /end CHARACTERISTIC
/begin CHARACTERISTIC P_LongCtrl_VLCdaxTarEC2DCMax "" VALUE 0x3B962C Scalar_FLOAT32_IEEE 0 PubIfControlLONC_MDL_CM_single -3.4e+38 3.4e+38 /end CHARACTERISTIC
/begin CHARACTERISTIC P_LongCtrl_VLCdriveOffAxUpLimXAxix "" VAL_BLK 0x3B9630 Scalar_FLOAT32_IEEE 0 PubIfControlLONC_MDL_CM_single -3.4e+38 3.4e+38 MATRIX_DIM 1 5 1 /end CHARACTERISTIC
/begin CHARACTERISTIC P_LongCtrl_VLCdriveOffAxUpLimYAxix "" VAL_BLK 0x3B9644 Scalar_FLOAT32_IEEE 0 PubIfControlLONC_MDL_CM_single -3.4e+38 3.4e+38 MATRIX_DIM 1 5 1 /end CHARACTERISTIC
/begin CHARACTERISTIC P_LongCtrl_VLCki "" VALUE 0x3B9668 Scalar_FLOAT32_IEEE 0 PubIfControlLONC_MDL_CM_single -3.4e+38 3.4e+38 /end CHARACTERISTIC
/begin CHARACTERISTIC P_LongCtrl_VLCkp "" VALUE 0x3B966C Scalar_FLOAT32_IEEE 0 PubIfControlLONC_MDL_CM_single -3.4e+38 3.4e+38 /end CHARACTERISTIC
/begin CHARACTERISTIC P_LongCtrl_VLCks "" VALUE 0x3B9670 Scalar_FLOAT32_IEEE 0 PubIfControlLONC_MDL_CM_single -3.4e+38 3.4e+38 /end CHARACTERISTIC
/begin CHARACTERISTIC P_PLAN_ALC_DPCConfimrTimeTableLcMrc "" VAL_BLK 0x3B96AC Scalar_FLOAT32_IEEE 0 PubIfDecisionPLAN_MDL_CM_single -3.4e+38 3.4e+38 MATRIX_DIM 1 5 1 /end CHARACTERISTIC
/begin CHARACTERISTIC P_PLAN_ALC_DPCConfirmTimeOverTk "" VALUE 0x3B96C0 Scalar_FLOAT32_IEEE 0 PubIfDecisionPLAN_MDL_CM_single -3.4e+38 3.4e+38 /end CHARACTERISTIC
/begin CHARACTERISTIC P_PLAN_ALC_DPCthresholdLcDrvLv1 "" VALUE 0x3B96C4 Scalar_FLOAT32_IEEE 0 PubIfDecisionPLAN_MDL_CM_single -3.4e+38 3.4e+38 /end CHARACTERISTIC
/begin CHARACTERISTIC P_PLAN_ALC_DPCthresholdLcDrvLv2 "" VALUE 0x3B96C8 Scalar_FLOAT32_IEEE 0 PubIfDecisionPLAN_MDL_CM_single -3.4e+38 3.4e+38 /end CHARACTERISTIC
/begin CHARACTERISTIC P_PLAN_ALC_DPCthresholdLcDrvLv3 "" VALUE 0x3B96CC Scalar_FLOAT32_IEEE 0 PubIfDecisionPLAN_MDL_CM_single -3.4e+38 3.4e+38 /end CHARACTERISTIC
/begin CHARACTERISTIC P_PLAN_ALC_DynamicDPCthreshold "" VALUE 0x3B96D0 Scalar_FLOAT32_IEEE 0 PubIfDecisionPLAN_MDL_CM_single -3.4e+38 3.4e+38 /end CHARACTERISTIC
/begin CHARACTERISTIC P_PLAN_ALC_LCDeltaTmeGap "超车换道不减速，提前时间" VALUE 0x3B96D4 Scalar_FLOAT32_IEEE 0 PubIfDecisionPLAN_MDL_CM_single -3.4e+38 3.4e+38 /end CHARACTERISTIC
/begin CHARACTERISTIC P_PLAN_ALC_LcCancelDPCThreshold "" VALUE 0x3B96D8 Scalar_FLOAT32_IEEE 0 PubIfDecisionPLAN_MDL_CM_single -3.4e+38 3.4e+38 /end CHARACTERISTIC
/begin CHARACTERISTIC P_PLAN_ALC_LcCancelLaneChangeReqDspTimeCnt "" VALUE 0x3B9F34 Scalar_UWORD 0 PubIfDecisionPLAN_MDL_CM_uint16 0 65535 /end CHARACTERISTIC
/begin AXIS_PTS P_PLAN_ALC_LcCurvatureInhibitionValueBrkPoints "" 0x3B96DC NO_INPUT_QUANTITY Lookup1D_X_FLOAT32_IEEE 0 PubIfDecisionPLAN_MDL_CM_single 14 -3.4e+38 3.4e+38 DEPOSIT ABSOLUTE /end AXIS_PTS
/begin CHARACTERISTIC P_PLAN_ALC_LcCurvatureInhibitionValueTable "" CURVE 0x3B9714 Lookup1D_FLOAT32_IEEE 0 PubIfDecisionPLAN_MDL_CM_single -3.4e+38 3.4e+38
 /begin AXIS_DESCR COM_AXIS NO_INPUT_QUANTITY PubIfDecisionPLAN_MDL_CM_single 14 -3.4e+38 3.4e+38 DEPOSIT ABSOLUTE AXIS_PTS_REF P_PLAN_ALC_LcCurvatureInhibitionValueBrkPoints /end AXIS_DESCR
/end CHARACTERISTIC
/begin CHARACTERISTIC P_PLAN_ALC_LcDelayCntSetNoh "" VALUE 0x3B9F60 Scalar_UBYTE 0 PubIfDecisionPLAN_MDL_CM_uint8 0 255 /end CHARACTERISTIC
/begin CHARACTERISTIC P_PLAN_ALC_LcDelayCntSetOverTk "" VALUE 0x3B9F61 Scalar_UBYTE 0 PubIfDecisionPLAN_MDL_CM_uint8 0 255 /end CHARACTERISTIC
/begin CHARACTERISTIC P_PLAN_ALC_LcDrvHMILineValidFtime "" VALUE 0x3B974C Scalar_FLOAT32_IEEE 0 PubIfDecisionPLAN_MDL_CM_single -3.4e+38 3.4e+38 /end CHARACTERISTIC
/begin CHARACTERISTIC P_PLAN_ALC_LcDrv_DyDiffThreshold "" VALUE 0x3B9750 Scalar_FLOAT32_IEEE 0 PubIfDecisionPLAN_MDL_CM_single -3.4e+38 3.4e+38 /end CHARACTERISTIC
/begin AXIS_PTS P_PLAN_ALC_LcFinishDyDiffBrkPoint "" 0x3B9754 NO_INPUT_QUANTITY Lookup1D_X_FLOAT32_IEEE 0 PubIfDecisionPLAN_MDL_CM_single 4 -3.4e+38 3.4e+38 DEPOSIT ABSOLUTE /end AXIS_PTS
/begin CHARACTERISTIC P_PLAN_ALC_LcFinishDyDiffRwFactorForAP "" VALUE 0x3B9764 Scalar_FLOAT32_IEEE 0 PubIfDecisionPLAN_MDL_CM_single -3.4e+38 3.4e+38 /end CHARACTERISTIC
/begin CHARACTERISTIC P_PLAN_ALC_LcFinishDyDiffRwFactorForHMI "" VALUE 0x3B9768 Scalar_FLOAT32_IEEE 0 PubIfDecisionPLAN_MDL_CM_single -3.4e+38 3.4e+38 /end CHARACTERISTIC
/begin CHARACTERISTIC P_PLAN_ALC_LcFinishDyDiffTableValue "" CURVE 0x3B976C Lookup1D_FLOAT32_IEEE 0 PubIfDecisionPLAN_MDL_CM_single -3.4e+38 3.4e+38
 /begin AXIS_DESCR COM_AXIS NO_INPUT_QUANTITY PubIfDecisionPLAN_MDL_CM_single 4 -3.4e+38 3.4e+38 DEPOSIT ABSOLUTE AXIS_PTS_REF P_PLAN_ALC_LcFinishDyDiffBrkPoint /end AXIS_DESCR
/end CHARACTERISTIC
/begin CHARACTERISTIC P_PLAN_ALC_LcOverTkDPCthreshold "" VALUE 0x3B977C Scalar_FLOAT32_IEEE 0 PubIfDecisionPLAN_MDL_CM_single -3.4e+38 3.4e+38 /end CHARACTERISTIC
/begin CHARACTERISTIC P_PLAN_ALC_LcOverTkManualTrigger "" VALUE 0x3CB096 Scalar_UBYTE 0 PubIfDecisionPLAN_MDL_CM_uint8 0 255 /end CHARACTERISTIC
/begin CHARACTERISTIC P_PLAN_ALC_LcOverTkManualTriggerTimeCnt "" VALUE 0x3B4B30 Scalar_FLOAT64_IEEE 0 PubIfDecisionPLAN_MDL_CM_double -1.7e+308 1.7e+308 /end CHARACTERISTIC
/begin CHARACTERISTIC P_PLAN_ALC_LciDrvExistDefaultDisp "" VALUE 0x3CB097 Scalar_UBYTE 0 PubIfDecisionPLAN_MDL_CM_uint8 0 255 /end CHARACTERISTIC
/begin CHARACTERISTIC P_PLAN_ALC_LciOverTkDeltaSpdLv1 "超车换道，前车与本车SetSpd最小差值" VALUE 0x3B9780 Scalar_FLOAT32_IEEE 0 PubIfDecisionPLAN_MDL_CM_single -3.4e+38 3.4e+38 /end CHARACTERISTIC
/begin CHARACTERISTIC P_PLAN_ALC_LciOverTkDeltaSpdLv2 "超车换道，前车与本车SetSpd最小差值" VALUE 0x3B9784 Scalar_FLOAT32_IEEE 0 PubIfDecisionPLAN_MDL_CM_single -3.4e+38 3.4e+38 /end CHARACTERISTIC
/begin CHARACTERISTIC P_PLAN_ALC_LciOverTkDeltaSpdLv3 "超车换道，前车与本车SetSpd最小差值" VALUE 0x3B9788 Scalar_FLOAT32_IEEE 0 PubIfDecisionPLAN_MDL_CM_single -3.4e+38 3.4e+38 /end CHARACTERISTIC
/begin CHARACTERISTIC P_PLAN_ALC_LciOverTkSpdSupTimeLv1 "" VALUE 0x3B978C Scalar_FLOAT32_IEEE 0 PubIfDecisionPLAN_MDL_CM_single -3.4e+38 3.4e+38 /end CHARACTERISTIC
/begin CHARACTERISTIC P_PLAN_ALC_LciOverTkSpdSupTimeLv2 "" VALUE 0x3B9790 Scalar_FLOAT32_IEEE 0 PubIfDecisionPLAN_MDL_CM_single -3.4e+38 3.4e+38 /end CHARACTERISTIC
/begin CHARACTERISTIC P_PLAN_ALC_LciOverTkSpdSupTimeLv3 "" VALUE 0x3B9794 Scalar_FLOAT32_IEEE 0 PubIfDecisionPLAN_MDL_CM_single -3.4e+38 3.4e+38 /end CHARACTERISTIC
/begin CHARACTERISTIC P_PLAN_ALC_NOHLcSwt "" VALUE 0x3B9F62 Scalar_UBYTE 0 PubIfDecisionPLAN_MDL_CM_uint8 0 255 /end CHARACTERISTIC
/begin CHARACTERISTIC P_PLAN_ALC_NOHTurnSts "" VALUE 0x3CB098 Scalar_UBYTE 0 PubIfDecisionPLAN_MDL_CM_uint8 0 255 /end CHARACTERISTIC
/begin CHARACTERISTIC P_PLAN_ALC_NotTouchLineCancelRWFactor "" VALUE 0x3B9798 Scalar_FLOAT32_IEEE 0 PubIfDecisionPLAN_MDL_CM_single -3.4e+38 3.4e+38 /end CHARACTERISTIC
/begin CHARACTERISTIC P_PLAN_ALC_OveTkrSupDist "" VALUE 0x3B979C Scalar_FLOAT32_IEEE 0 PubIfDecisionPLAN_MDL_CM_single -3.4e+38 3.4e+38 /end CHARACTERISTIC
/begin CHARACTERISTIC P_PLAN_ALC_OverTkCutOutDyRWFactor "" VALUE 0x3B4B38 Scalar_FLOAT64_IEEE 0 PubIfDecisionPLAN_MDL_CM_double -1.7e+308 1.7e+308 /end CHARACTERISTIC
/begin CHARACTERISTIC P_PLAN_ALC_PreCurvatureFactor "" VALUE 0x3B4B40 Scalar_FLOAT64_IEEE 0 PubIfDecisionPLAN_MDL_CM_double -1.7e+308 1.7e+308 /end CHARACTERISTIC
/begin CHARACTERISTIC P_PLAN_ALC_PreCurvaturePreTime "" VALUE 0x3B4B48 Scalar_FLOAT64_IEEE 0 PubIfDecisionPLAN_MDL_CM_double -1.7e+308 1.7e+308 /end CHARACTERISTIC
/begin CHARACTERISTIC P_PLAN_ALC_PreNotTouchLineCancelRWFactor "" VALUE 0x3B97A0 Scalar_FLOAT32_IEEE 0 PubIfDecisionPLAN_MDL_CM_single -3.4e+38 3.4e+38 /end CHARACTERISTIC
/begin CHARACTERISTIC P_PLAN_ALC_TurnLmpType "" VALUE 0x3CB099 Scalar_UBYTE 0 PubIfDecisionPLAN_MDL_CM_uint8 0 255 /end CHARACTERISTIC
/begin CHARACTERISTIC P_PLAN_ALC_tTimeLC "" VALUE 0x3B97A4 Scalar_FLOAT32_IEEE 0 PubIfDecisionPLAN_MDL_CM_single -3.4e+38 3.4e+38 /end CHARACTERISTIC
/begin CHARACTERISTIC P_PLAN_ALC_vMinPreLC_Drv "换道请求时的最低速度阈值" VALUE 0x3B97A8 Scalar_FLOAT32_IEEE 0 PubIfDecisionPLAN_MDL_CM_single -3.4e+38 3.4e+38 /end CHARACTERISTIC
/begin CHARACTERISTIC P_PLAN_ALC_vMinPreLC_Noh "" VALUE 0x3B97AC Scalar_FLOAT32_IEEE 0 PubIfDecisionPLAN_MDL_CM_single -3.4e+38 3.4e+38 /end CHARACTERISTIC
/begin CHARACTERISTIC P_PLAN_ALC_vMinPreLC_OverTk "" VALUE 0x3B97B0 Scalar_FLOAT32_IEEE 0 PubIfDecisionPLAN_MDL_CM_single -3.4e+38 3.4e+38 /end CHARACTERISTIC
/begin CHARACTERISTIC P_PLAN_DPC_BrkPointDxFactorF1 "" VALUE 0x3B97B4 Scalar_FLOAT32_IEEE 0 PubIfDecisionPLAN_MDL_CM_single 0 50 /end CHARACTERISTIC
/begin CHARACTERISTIC P_PLAN_DPC_BrkPointDxFactorF2 "" VALUE 0x3B97B8 Scalar_FLOAT32_IEEE 0 PubIfDecisionPLAN_MDL_CM_single 0 50 /end CHARACTERISTIC
/begin CHARACTERISTIC P_PLAN_DPC_BrkPointDxFactorF3 "" VALUE 0x3B97BC Scalar_FLOAT32_IEEE 0 PubIfDecisionPLAN_MDL_CM_single 0 50 /end CHARACTERISTIC
/begin CHARACTERISTIC P_PLAN_DPC_BrkPointDxFactorF4 "" VALUE 0x3B97C0 Scalar_FLOAT32_IEEE 0 PubIfDecisionPLAN_MDL_CM_single 0 50 /end CHARACTERISTIC
/begin CHARACTERISTIC P_PLAN_DPC_BrkPointDxFactorR1 "" VALUE 0x3B97C4 Scalar_FLOAT32_IEEE 0 PubIfDecisionPLAN_MDL_CM_single -50 0 /end CHARACTERISTIC
/begin CHARACTERISTIC P_PLAN_DPC_BrkPointDxFactorR2 "" VALUE 0x3B97C8 Scalar_FLOAT32_IEEE 0 PubIfDecisionPLAN_MDL_CM_single -50 0 /end CHARACTERISTIC
/begin CHARACTERISTIC P_PLAN_DPC_BrkPointDxFactorR3 "" VALUE 0x3B97CC Scalar_FLOAT32_IEEE 0 PubIfDecisionPLAN_MDL_CM_single -50 0 /end CHARACTERISTIC
/begin CHARACTERISTIC P_PLAN_DPC_BrkPointDxFactorR4 "" VALUE 0x3B97D0 Scalar_FLOAT32_IEEE 0 PubIfDecisionPLAN_MDL_CM_single -50 0 /end CHARACTERISTIC
/begin CHARACTERISTIC P_PLAN_DPC_BrkPointTTCFactor1 "" VALUE 0x3B97D4 Scalar_FLOAT32_IEEE 0 PubIfDecisionPLAN_MDL_CM_single -3.4e+38 3.4e+38 /end CHARACTERISTIC
/begin CHARACTERISTIC P_PLAN_DPC_BrkPointTTCFactor2 "" VALUE 0x3B97D8 Scalar_FLOAT32_IEEE 0 PubIfDecisionPLAN_MDL_CM_single -3.4e+38 3.4e+38 /end CHARACTERISTIC
/begin CHARACTERISTIC P_PLAN_DPC_BrkPointTTCFactor3 "" VALUE 0x3B97DC Scalar_FLOAT32_IEEE 0 PubIfDecisionPLAN_MDL_CM_single -3.4e+38 3.4e+38 /end CHARACTERISTIC
/begin CHARACTERISTIC P_PLAN_DPC_BrkPointTTCFactor4 "" VALUE 0x3B97E0 Scalar_FLOAT32_IEEE 0 PubIfDecisionPLAN_MDL_CM_single -3.4e+38 3.4e+38 /end CHARACTERISTIC
/begin CHARACTERISTIC P_PLAN_DPC_CriticalAccF "" VALUE 0x3B97E4 Scalar_FLOAT32_IEEE 0 PubIfDecisionPLAN_MDL_CM_single -3.4e+38 3.4e+38 /end CHARACTERISTIC
/begin CHARACTERISTIC P_PLAN_DPC_CriticalAccR "" VALUE 0x3B97E8 Scalar_FLOAT32_IEEE 0 PubIfDecisionPLAN_MDL_CM_single -3.4e+38 3.4e+38 /end CHARACTERISTIC
/begin CHARACTERISTIC P_PLAN_DPC_CriticalTG "" VALUE 0x3B97EC Scalar_FLOAT32_IEEE 0 PubIfDecisionPLAN_MDL_CM_single -3.4e+38 3.4e+38 /end CHARACTERISTIC
/begin CHARACTERISTIC P_PLAN_DPC_HWALineRearA2Factor "" VALUE 0x3B97F0 Scalar_FLOAT32_IEEE 0 PubIfDecisionPLAN_MDL_CM_single -3.4e+38 3.4e+38 /end CHARACTERISTIC
/begin CHARACTERISTIC P_PLAN_DPC_HWALineRearA3Factor "" VALUE 0x3B97F4 Scalar_FLOAT32_IEEE 0 PubIfDecisionPLAN_MDL_CM_single -3.4e+38 3.4e+38 /end CHARACTERISTIC
/begin CHARACTERISTIC P_PLAN_DPC_MaxObjNum "" VALUE 0x3B9F63 Scalar_UBYTE 0 PubIfDecisionPLAN_MDL_CM_uint8 1 32 /end CHARACTERISTIC
/begin CHARACTERISTIC P_PLAN_DPC_ObjAxLPalpha "" VALUE 0x3B97F8 Scalar_FLOAT32_IEEE 0 PubIfDecisionPLAN_MDL_CM_single -3.4e+38 3.4e+38 /end CHARACTERISTIC
/begin CHARACTERISTIC P_PLAN_DPC_ObjDxLPalpha "" VALUE 0x3B97FC Scalar_FLOAT32_IEEE 0 PubIfDecisionPLAN_MDL_CM_single -3.4e+38 3.4e+38 /end CHARACTERISTIC
/begin CHARACTERISTIC P_PLAN_DPC_ObjDyLPalpha "" VALUE 0x3B9800 Scalar_FLOAT32_IEEE 0 PubIfDecisionPLAN_MDL_CM_single -3.4e+38 3.4e+38 /end CHARACTERISTIC
/begin CHARACTERISTIC P_PLAN_DPC_ObjVxLPalpha "" VALUE 0x3B9804 Scalar_FLOAT32_IEEE 0 PubIfDecisionPLAN_MDL_CM_single -3.4e+38 3.4e+38 /end CHARACTERISTIC
/begin CHARACTERISTIC P_PLAN_DPC_SafeAccF "" VALUE 0x3B9808 Scalar_FLOAT32_IEEE 0 PubIfDecisionPLAN_MDL_CM_single -3.4e+38 3.4e+38 /end CHARACTERISTIC
/begin CHARACTERISTIC P_PLAN_DPC_SafeAccR "" VALUE 0x3B980C Scalar_FLOAT32_IEEE 0 PubIfDecisionPLAN_MDL_CM_single -3.4e+38 3.4e+38 /end CHARACTERISTIC
/begin AXIS_PTS P_PLAN_DPC_SafeDistBrkPoints "" 0x3B9810 NO_INPUT_QUANTITY Lookup1D_X_FLOAT32_IEEE 0 PubIfDecisionPLAN_MDL_CM_single 8 -3.4e+38 3.4e+38 DEPOSIT ABSOLUTE /end AXIS_PTS
/begin CHARACTERISTIC P_PLAN_DPC_SafeDistValue "" CURVE 0x3B9830 Lookup1D_FLOAT32_IEEE 0 PubIfDecisionPLAN_MDL_CM_single -3.4e+38 3.4e+38
 /begin AXIS_DESCR COM_AXIS NO_INPUT_QUANTITY PubIfDecisionPLAN_MDL_CM_single 8 -3.4e+38 3.4e+38 DEPOSIT ABSOLUTE AXIS_PTS_REF P_PLAN_DPC_SafeDistBrkPoints /end AXIS_DESCR
/end CHARACTERISTIC
/begin CHARACTERISTIC P_PLAN_DPC_SafeTG "" VALUE 0x3B9850 Scalar_FLOAT32_IEEE 0 PubIfDecisionPLAN_MDL_CM_single -3.4e+38 3.4e+38 /end CHARACTERISTIC
/begin CHARACTERISTIC P_PLAN_DPCswt "" VALUE 0x3CB07F Scalar_BOOLEAN 0 PubIfDecisionPLAN_MDL_CM_boolean 0 1 BIT_MASK 0x1 /end CHARACTERISTIC
/begin CHARACTERISTIC P_VSM_ACCExit_AccOverride "" VALUE 0x3B9F36 Scalar_UWORD 0 PubIfStateVSM_MDL_CM_uint16_s 0 1000 /end CHARACTERISTIC
/begin CHARACTERISTIC P_VSM_ACCExit_StandWaitTime "" VALUE 0x3B9F38 Scalar_UWORD 0 PubIfStateVSM_MDL_CM_uint16__S_ 0 1000 /end CHARACTERISTIC
/begin CHARACTERISTIC P_VSM_ACCSOS_SW "" VALUE 0x3B9F47 Scalar_BOOLEAN 0 PubIfStateVSM_MDL_CM_boolean 0 1 BIT_MASK 0x1 /end CHARACTERISTIC
/begin CHARACTERISTIC P_VSM_ACC_AutoGoSW "" VALUE 0x3CB080 Scalar_BOOLEAN 0 PubIfStateVSM_MDL_CM_boolean 0 1 BIT_MASK 0x1 /end CHARACTERISTIC
/begin CHARACTERISTIC P_VSM_ACC_BOMEntry_ACCDecReqValue "" VALUE 0x3B9858 Scalar_FLOAT32_IEEE 0 PubIfStateVSM_MDL_CM_single -2 0 /end CHARACTERISTIC
/begin CHARACTERISTIC P_VSM_ACC_BOMEntry_AxvRefMs2 "" VALUE 0x3B985C Scalar_FLOAT32_IEEE 0 PubIfStateVSM_MDL_CM_single -2 0 /end CHARACTERISTIC
/begin CHARACTERISTIC P_VSM_ACC_BOMExit_ACCDecReqValue "" VALUE 0x3B9860 Scalar_FLOAT32_IEEE 0 PubIfStateVSM_MDL_CM_single -2 0 /end CHARACTERISTIC
/begin CHARACTERISTIC P_VSM_ACC_BrakeOnlyNum "" VALUE 0x3B9F3A Scalar_UWORD 0 PubIfStateVSM_MDL_CM_uint16_num 0 600 /end CHARACTERISTIC
/begin CHARACTERISTIC P_VSM_ACC_RadarOffset "" VALUE 0x3B9864 Scalar_FLOAT32_IEEE 0 PubIfStateVSM_MDL_CM_single -3.4e+38 3.4e+38 /end CHARACTERISTIC
/begin CHARACTERISTIC P_VSM_ACC_StandActiveNumACCMode "" VALUE 0x3B9F3C Scalar_UWORD 0 PubIfStateVSM_MDL_CM_uint16_num 0 9000 /end CHARACTERISTIC
/begin CHARACTERISTIC P_VSM_ACC_StandActiveNumHWAMode "" VALUE 0x3B9F3E Scalar_UWORD 0 PubIfStateVSM_MDL_CM_uint16_num 0 9000 /end CHARACTERISTIC
/begin CHARACTERISTIC P_VSM_AESSwtReq "" VALUE 0x3CB081 Scalar_BOOLEAN 0 PubIfStateVSM_MDL_CM_boolean 0 1 BIT_MASK 0x1 /end CHARACTERISTIC
/begin CHARACTERISTIC P_VSM_ELKSwtReq "" VALUE 0x3CB083 Scalar_BOOLEAN 0 PubIfStateVSM_MDL_CM_boolean 0 1 BIT_MASK 0x1 /end CHARACTERISTIC
/begin CHARACTERISTIC P_VSM_ESS_ACtiveTime "" VALUE 0x3B99C8 Scalar_FLOAT32_IEEE 0 PubIfStateVSM_MDL_CM_single -3.4e+38 3.4e+38 /end CHARACTERISTIC
/begin CHARACTERISTIC P_VSM_ESS_AngleSpdTable_deg "" CURVE 0x3B99D0 Lookup1D_FLOAT32_IEEE 0 PubIfStateVSM_MDL_CM_single -3.4e+38 3.4e+38
 /begin AXIS_DESCR COM_AXIS NO_INPUT_QUANTITY PubIfStateVSM_MDL_CM_single 6 -3.4e+38 3.4e+38 DEPOSIT ABSOLUTE AXIS_PTS_REF P_VSM_ESS_SpdPoint_kmh /end AXIS_DESCR
/end CHARACTERISTIC
/begin CHARACTERISTIC P_VSM_ESS_SafeDistance_m "" VALUE 0x3B9A34 Scalar_FLOAT32_IEEE 0 PubIfStateVSM_MDL_CM_single -3.4e+38 3.4e+38 /end CHARACTERISTIC
/begin AXIS_PTS P_VSM_ESS_SpdPoint_kmh "" 0x3B9A38 NO_INPUT_QUANTITY Lookup1D_X_FLOAT32_IEEE 0 PubIfStateVSM_MDL_CM_single 6 -3.4e+38 3.4e+38 DEPOSIT ABSOLUTE /end AXIS_PTS
/begin CHARACTERISTIC P_VSM_ESS_SpdTime_s "" CURVE 0x3B9A50 Lookup1D_FLOAT32_IEEE 0 PubIfStateVSM_MDL_CM_single -3.4e+38 3.4e+38
 /begin AXIS_DESCR COM_AXIS NO_INPUT_QUANTITY PubIfStateVSM_MDL_CM_single 6 -3.4e+38 3.4e+38 DEPOSIT ABSOLUTE AXIS_PTS_REF P_VSM_ESS_SpdPoint_kmh /end AXIS_DESCR
/end CHARACTERISTIC
/begin CHARACTERISTIC P_VSM_ESS_VehSwtReq "" VALUE 0x3CB084 Scalar_BOOLEAN 0 PubIfStateVSM_MDL_CM_boolean 0 1 BIT_MASK 0x1 /end CHARACTERISTIC
/begin CHARACTERISTIC P_VSM_HOD_HWA_HandsOffLev1TimeCnt "" VALUE 0x3B9A7C Scalar_FLOAT32_IEEE 0 PubIfStateVSM_MDL_CM_single -3.4e+38 3.4e+38 /end CHARACTERISTIC
/begin CHARACTERISTIC P_VSM_HOD_HWA_HandsOffLev2TimeCnt "" VALUE 0x3B9A80 Scalar_FLOAT32_IEEE 0 PubIfStateVSM_MDL_CM_single -3.4e+38 3.4e+38 /end CHARACTERISTIC
/begin CHARACTERISTIC P_VSM_HOD_HWA_HandsOffLev3TimeCnt "" VALUE 0x3B9A84 Scalar_FLOAT32_IEEE 0 PubIfStateVSM_MDL_CM_single -3.4e+38 3.4e+38 /end CHARACTERISTIC
/begin CHARACTERISTIC P_VSM_HOD_HWA_HandsOffLev4TimeCnt "" VALUE 0x3B9A88 Scalar_FLOAT32_IEEE 0 PubIfStateVSM_MDL_CM_single -3.4e+38 3.4e+38 /end CHARACTERISTIC
/begin CHARACTERISTIC P_VSM_HOD_HandsOff_Tr "" VALUE 0x3B9A8C Scalar_FLOAT32_IEEE 0 PubIfStateVSM_MDL_CM_single -3.4e+38 3.4e+38 /end CHARACTERISTIC
/begin CHARACTERISTIC P_VSM_HOD_HandsOn_Tr "" VALUE 0x3B9A90 Scalar_FLOAT32_IEEE 0 PubIfStateVSM_MDL_CM_single -3.4e+38 3.4e+38 /end CHARACTERISTIC
/begin CHARACTERISTIC P_VSM_HOD_Handson_TimeInsertPoint "" CURVE 0x3B9A94 Lookup1D_FLOAT32_IEEE 0 PubIfStateVSM_MDL_CM_single -3.4e+38 3.4e+38
 /begin AXIS_DESCR COM_AXIS VSM_HOD_DrvTrqFilted PubIfStateVSM_MDL_CM_single 5 -3.4e+38 3.4e+38 DEPOSIT ABSOLUTE AXIS_PTS_REF P_VSM_HOD_Handson_TrqInsertPoint /end AXIS_DESCR
/end CHARACTERISTIC
/begin AXIS_PTS P_VSM_HOD_Handson_TrqInsertPoint "" 0x3B9AA8 VSM_HOD_DrvTrqFilted Lookup1D_X_FLOAT32_IEEE 0 PubIfStateVSM_MDL_CM_single 5 -3.4e+38 3.4e+38 DEPOSIT ABSOLUTE /end AXIS_PTS
/begin CHARACTERISTIC P_VSM_HOD_LCKTJA_HandsOffLev1TimeCnt "" VALUE 0x3B9ABC Scalar_FLOAT32_IEEE 0 PubIfStateVSM_MDL_CM_single -3.4e+38 3.4e+38 /end CHARACTERISTIC
/begin CHARACTERISTIC P_VSM_HOD_LCKTJA_HandsOffLev2TimeCnt "" VALUE 0x3B9AC0 Scalar_FLOAT32_IEEE 0 PubIfStateVSM_MDL_CM_single -3.4e+38 3.4e+38 /end CHARACTERISTIC
/begin CHARACTERISTIC P_VSM_HOD_LCKTJA_HandsOffLev3TimeCnt "" VALUE 0x3B9AC4 Scalar_FLOAT32_IEEE 0 PubIfStateVSM_MDL_CM_single -3.4e+38 3.4e+38 /end CHARACTERISTIC
/begin CHARACTERISTIC P_VSM_HOD_LCKTJA_HandsOffLev4TimeCnt "" VALUE 0x3B9AC8 Scalar_FLOAT32_IEEE 0 PubIfStateVSM_MDL_CM_single -3.4e+38 3.4e+38 /end CHARACTERISTIC
/begin CHARACTERISTIC P_VSM_HWAActivation_NOAMOd_Spd "" VALUE 0x3B9ACC Scalar_FLOAT32_IEEE 0 PubIfStateVSM_MDL_CM_single -3.4e+38 3.4e+38 /end CHARACTERISTIC
/begin CHARACTERISTIC P_VSM_HWAActivation_Spd_Low "" VALUE 0x3B9AD0 Scalar_FLOAT32_IEEE 0 PubIfStateVSM_MDL_CM_single -3.4e+38 3.4e+38 /end CHARACTERISTIC
/begin CHARACTERISTIC P_VSM_HWAActivation_Spd_Up "" VALUE 0x3B9AD4 Scalar_FLOAT32_IEEE 0 PubIfStateVSM_MDL_CM_single -3.4e+38 3.4e+38 /end CHARACTERISTIC
/begin CHARACTERISTIC P_VSM_HWA_ALCStsSW "" VALUE 0x3B9F57 Scalar_BOOLEAN 0 PubIfStateVSM_MDL_CM_boolean 0 1 BIT_MASK 0x1 /end CHARACTERISTIC
/begin CHARACTERISTIC P_VSM_HWA_EHR_Enable "EHR使能开关" VALUE 0x3CB085 Scalar_BOOLEAN 0 PubIfStateVSM_MDL_CM_boolean 0 1 BIT_MASK 0x1 /end CHARACTERISTIC
/begin CHARACTERISTIC P_VSM_ICA_HandsOffSwtReq "" VALUE 0x3CB086 Scalar_BOOLEAN 0 PubIfStateVSM_MDL_CM_boolean 0 1 BIT_MASK 0x1 /end CHARACTERISTIC
/begin CHARACTERISTIC P_VSM_ISLSwtReq "" VALUE 0x3CB087 Scalar_BOOLEAN 0 PubIfStateVSM_MDL_CM_boolean 0 1 BIT_MASK 0x1 /end CHARACTERISTIC
/begin CHARACTERISTIC P_VSM_ISL_TimeInformDis "" VALUE 0x3B9F66 Scalar_UBYTE 0 PubIfStateVSM_MDL_CM_uint8_s 1 255 /end CHARACTERISTIC
/begin CHARACTERISTIC P_VSM_ISL_TimeTakeOver "" VALUE 0x3B9F67 Scalar_UBYTE 0 PubIfStateVSM_MDL_CM_uint8_s 0 255 /end CHARACTERISTIC
/begin CHARACTERISTIC P_VSM_IntelligentEvaSwtReq "" VALUE 0x3CB088 Scalar_BOOLEAN 0 PubIfStateVSM_MDL_CM_boolean 0 1 BIT_MASK 0x1 /end CHARACTERISTIC
/begin CHARACTERISTIC P_VSM_LCKSwtReq "" VALUE 0x3CB089 Scalar_BOOLEAN 0 PubIfStateVSM_MDL_CM_boolean 0 1 BIT_MASK 0x1 /end CHARACTERISTIC
/begin CHARACTERISTIC P_VSM_LDWSwtReq "" VALUE 0x3CB08A Scalar_BOOLEAN 0 PubIfStateVSM_MDL_CM_boolean 0 1 BIT_MASK 0x1 /end CHARACTERISTIC
/begin CHARACTERISTIC P_VSM_LKASwtReq "" VALUE 0x3CB08B Scalar_BOOLEAN 0 PubIfStateVSM_MDL_CM_boolean 0 1 BIT_MASK 0x1 /end CHARACTERISTIC
/begin CHARACTERISTIC P_VSM_LSSSwtReq "" VALUE 0x3CB08C Scalar_BOOLEAN 0 PubIfStateVSM_MDL_CM_boolean 0 1 BIT_MASK 0x1 /end CHARACTERISTIC
/begin CHARACTERISTIC P_VSM_NOH_Act_Req "" VALUE 0x3B9F58 Scalar_BOOLEAN 0 PubIfStateVSM_MDL_CM_boolean 0 1 BIT_MASK 0x1 /end CHARACTERISTIC
/begin CHARACTERISTIC P_VSM_NOH_PilotSelc_SW "" VALUE 0x3CB09B Scalar_UBYTE 0 PubIfStateVSM_MDL_CM_uint8 0 255 /end CHARACTERISTIC
/begin CHARACTERISTIC P_VSM_NOH_Swt_Req "" VALUE 0x3B9F59 Scalar_BOOLEAN 0 PubIfStateVSM_MDL_CM_boolean 0 1 BIT_MASK 0x1 /end CHARACTERISTIC
/begin CHARACTERISTIC P_VSM_NOH_Swt_Req_SW "" VALUE 0x3CB008 Scalar_FLOAT64_IEEE 0 PubIfStateVSM_MDL_CM_double -1.7e+308 1.7e+308 /end CHARACTERISTIC
/begin CHARACTERISTIC P_VSM_TJA_ActiveWaitNum "" VALUE 0x3B9F42 Scalar_UWORD 0 PubIfStateVSM_MDL_CM_uint16_num 0 3000 /end CHARACTERISTIC
/begin CHARACTERISTIC P_VSM_TJA_MRCTrigger "" VALUE 0x3CB08D Scalar_BOOLEAN 0 PubIfStateVSM_MDL_CM_boolean 0 1 BIT_MASK 0x1 /end CHARACTERISTIC
/begin CHARACTERISTIC P_VSM_TSRSwtReq "" VALUE 0x3CB08E Scalar_BOOLEAN 0 PubIfStateVSM_MDL_CM_boolean 0 1 BIT_MASK 0x1 /end CHARACTERISTIC
/begin CHARACTERISTIC P_VSM_TSRWarnSwtReq "" VALUE 0x3CB08F Scalar_BOOLEAN 0 PubIfStateVSM_MDL_CM_boolean 0 1 BIT_MASK 0x1 /end CHARACTERISTIC
/begin MEASUREMENT VSM_ACCActCondF "" FLOAT64_IEEE PubIfStateVSM_MDL_CM_double 0 0 -1.7e+308 1.7e+308 ECU_ADDRESS 0x3FF548 /end MEASUREMENT
/begin MEASUREMENT VSM_ACCFastExit "" UBYTE PubIfStateVSM_MDL_CM_boolean 0 0 0 1 BIT_MASK 0x1 ECU_ADDRESS 0x3FF732 /end MEASUREMENT
/begin MEASUREMENT VSM_ACCFastExitCons_ACCError_Inhibit "" UBYTE PubIfStateVSM_MDL_CM_boolean 0 0 0 1 BIT_MASK 0x1 ECU_ADDRESS 0x3FF724 /end MEASUREMENT
/begin MEASUREMENT VSM_ACCFastExitCons_ACCOverride "" UBYTE PubIfStateVSM_MDL_CM_boolean 0 0 0 1 BIT_MASK 0x1 ECU_ADDRESS 0x3FF725 /end MEASUREMENT
/begin MEASUREMENT VSM_ACCFastExitCons_AEBTrigger "" UBYTE PubIfStateVSM_MDL_CM_boolean 0 0 0 1 BIT_MASK 0x1 ECU_ADDRESS 0x3FF720 /end MEASUREMENT
/begin MEASUREMENT VSM_ACCFastExitCons_APSGuidance "" UBYTE PubIfStateVSM_MDL_CM_boolean 0 0 0 1 BIT_MASK 0x1 ECU_ADDRESS 0x3FF723 /end MEASUREMENT
/begin MEASUREMENT VSM_ACCFastExitCons_BrakeDiskOverHeat "" UBYTE PubIfStateVSM_MDL_CM_boolean 0 0 0 1 BIT_MASK 0x1 ECU_ADDRESS 0x3FF719 /end MEASUREMENT
/begin MEASUREMENT VSM_ACCFastExitCons_Cancel "" UBYTE PubIfStateVSM_MDL_CM_boolean 0 0 0 1 BIT_MASK 0x1 ECU_ADDRESS 0x3FF71A /end MEASUREMENT
/begin MEASUREMENT VSM_ACCFastExitCons_DriveBrakeExit "" UBYTE PubIfStateVSM_MDL_CM_boolean 0 0 0 1 BIT_MASK 0x1 ECU_ADDRESS 0x3FF71D /end MEASUREMENT
/begin MEASUREMENT VSM_ACCFastExitCons_DriverDoorOpen "" UBYTE PubIfStateVSM_MDL_CM_boolean 0 0 0 1 BIT_MASK 0x1 ECU_ADDRESS 0x3FF71F /end MEASUREMENT
/begin MEASUREMENT VSM_ACCFastExitCons_DriverSBR "" UBYTE PubIfStateVSM_MDL_CM_boolean 0 0 0 1 BIT_MASK 0x1 ECU_ADDRESS 0x3FF72E /end MEASUREMENT
/begin MEASUREMENT VSM_ACCFastExitCons_DrivingModExit "" UBYTE PubIfStateVSM_MDL_CM_boolean 0 0 0 1 BIT_MASK 0x1 ECU_ADDRESS 0x3FF722 /end MEASUREMENT
/begin MEASUREMENT VSM_ACCFastExitCons_EPBClosed "" UBYTE PubIfStateVSM_MDL_CM_boolean 0 0 0 1 BIT_MASK 0x1 ECU_ADDRESS 0x3FF71E /end MEASUREMENT
/begin MEASUREMENT VSM_ACCFastExitCons_EngLimpHome "" UBYTE PubIfStateVSM_MDL_CM_boolean 0 0 0 1 BIT_MASK 0x1 ECU_ADDRESS 0x3FF865 /end MEASUREMENT
/begin MEASUREMENT VSM_ACCFastExitCons_EngineOff "" UBYTE PubIfStateVSM_MDL_CM_boolean 0 0 0 1 BIT_MASK 0x1 ECU_ADDRESS 0x3FF718 /end MEASUREMENT
/begin MEASUREMENT VSM_ACCFastExitCons_EspOff "" UBYTE PubIfStateVSM_MDL_CM_boolean 0 0 0 1 BIT_MASK 0x1 ECU_ADDRESS 0x3FF71B /end MEASUREMENT
/begin MEASUREMENT VSM_ACCFastExitCons_NoForwardGear "" UBYTE PubIfStateVSM_MDL_CM_boolean 0 0 0 1 BIT_MASK 0x1 ECU_ADDRESS 0x3FF71C /end MEASUREMENT
/begin MEASUREMENT VSM_ACCFastExitCons_RollingBack "" UBYTE PubIfStateVSM_MDL_CM_boolean 0 0 0 1 BIT_MASK 0x1 ECU_ADDRESS 0x3FF717 /end MEASUREMENT
/begin MEASUREMENT VSM_ACCFastExitCons_Standstill3min "" UBYTE PubIfStateVSM_MDL_CM_boolean 0 0 0 1 BIT_MASK 0x1 ECU_ADDRESS 0x3FF714 /end MEASUREMENT
/begin MEASUREMENT VSM_ACCFastExitCons_StandstillNoBrakeForce "" UBYTE PubIfStateVSM_MDL_CM_boolean 0 0 0 1 BIT_MASK 0x1 ECU_ADDRESS 0x3FF716 /end MEASUREMENT
/begin MEASUREMENT VSM_ACCFastExitCons_VehSpdExit "" UBYTE PubIfStateVSM_MDL_CM_boolean 0 0 0 1 BIT_MASK 0x1 ECU_ADDRESS 0x3FF721 /end MEASUREMENT
/begin MEASUREMENT VSM_ACCSlowExit "" UBYTE PubIfStateVSM_MDL_CM_boolean 0 0 0 1 BIT_MASK 0x1 ECU_ADDRESS 0x3FF733 /end MEASUREMENT
/begin MEASUREMENT VSM_ACCSlowExitCons_ABSactive400ms "" UBYTE PubIfStateVSM_MDL_CM_boolean 0 0 0 1 BIT_MASK 0x1 ECU_ADDRESS 0x3FF72B /end MEASUREMENT
/begin MEASUREMENT VSM_ACCSlowExitCons_EspActive400ms "" UBYTE PubIfStateVSM_MDL_CM_boolean 0 0 0 1 BIT_MASK 0x1 ECU_ADDRESS 0x3FF728 /end MEASUREMENT
/begin MEASUREMENT VSM_ACCSlowExitCons_HDCactive40ms "" UBYTE PubIfStateVSM_MDL_CM_boolean 0 0 0 1 BIT_MASK 0x1 ECU_ADDRESS 0x3FF72A /end MEASUREMENT
/begin MEASUREMENT VSM_ACCSlowExitCons_MSRactive800ms "" UBYTE PubIfStateVSM_MDL_CM_boolean 0 0 0 1 BIT_MASK 0x1 ECU_ADDRESS 0x3FF729 /end MEASUREMENT
/begin MEASUREMENT VSM_ACCSlowExitCons_TCS1active3000ms "" UBYTE PubIfStateVSM_MDL_CM_boolean 0 0 0 1 BIT_MASK 0x1 ECU_ADDRESS 0x3FF72C /end MEASUREMENT
/begin MEASUREMENT VSM_ACCSlowExitCons_TCS2active3000ms "" UBYTE PubIfStateVSM_MDL_CM_boolean 0 0 0 1 BIT_MASK 0x1 ECU_ADDRESS 0x3FF72D /end MEASUREMENT
/begin MEASUREMENT VSM_ACCStandActive2Active_DrvrSts "" UBYTE PubIfStateVSM_MDL_CM_boolean 0 0 0 1 BIT_MASK 0x1 ECU_ADDRESS 0x3FF737 /end MEASUREMENT
/begin MEASUREMENT VSM_ACCStandActive2Wait_DrvrSts "" UBYTE PubIfStateVSM_MDL_CM_boolean 0 0 0 1 BIT_MASK 0x1 ECU_ADDRESS 0x3FF736 /end MEASUREMENT
/begin MEASUREMENT VSM_ACCStandActive2Wait_USS "" UBYTE PubIfStateVSM_MDL_CM_boolean 0 0 0 1 BIT_MASK 0x1 ECU_ADDRESS 0x3FF730 /end MEASUREMENT
/begin MEASUREMENT VSM_ACCStandActiveTime "" UWORD PubIfStateVSM_MDL_CM_uint16 0 0 0 65535 ECU_ADDRESS 0x3FF6AC /end MEASUREMENT
/begin MEASUREMENT VSM_ACCSts "" SLONG PubIfStateVSM_MDL_CM_ACC_STATE 0 0 0 9 ECU_ADDRESS 0x3FF6A8 /end MEASUREMENT
/begin MEASUREMENT VSM_ACCTextDisp "" UBYTE PubIfStateVSM_MDL_CM_uint8 0 0 0 255 ECU_ADDRESS 0x3FF6D3 /end MEASUREMENT
/begin MEASUREMENT VSM_ACC_BOMExit "" UBYTE PubIfStateVSM_MDL_CM_boolean 0 0 0 1 BIT_MASK 0x1 ECU_ADDRESS 0x3FF735 /end MEASUREMENT
/begin MEASUREMENT VSM_ACC_DecReqValue "" FLOAT32_IEEE PubIfStateVSM_MDL_CM_single 0 0 -3.4e+38 3.4e+38 ECU_ADDRESS 0x3FF578 /end MEASUREMENT
/begin MEASUREMENT VSM_ACC_DrvOffReq "" UBYTE PubIfStateVSM_MDL_CM_boolean 0 0 0 1 BIT_MASK 0x1 ECU_ADDRESS 0x3FF794 /end MEASUREMENT
/begin MEASUREMENT VSM_ACC_HazActv "" UBYTE PubIfStateVSM_MDL_CM_uint8 0 0 0 255 ECU_ADDRESS 0x3FF711 /end MEASUREMENT
/begin MEASUREMENT VSM_ACC_ModeDisp "" UBYTE PubIfStateVSM_MDL_CM_uint8 0 0 0 255 ECU_ADDRESS 0x3FF6CE /end MEASUREMENT
/begin MEASUREMENT VSM_ACC_SpdSetValue "" FLOAT32_IEEE PubIfStateVSM_MDL_CM_single 0 0 -3.4e+38 3.4e+38 ECU_ADDRESS 0x3FF6A4 /end MEASUREMENT
/begin MEASUREMENT VSM_ACC_SubModel_Number "" UWORD PubIfStateVSM_MDL_CM_uint16 0 0 0 65535 ECU_ADDRESS 0x3FF6AE /end MEASUREMENT
/begin MEASUREMENT VSM_ACC_SubModel_VERSION "" ULONG PubIfStateVSM_MDL_CM_uint32 0 0 0 4294967295 ECU_ADDRESS 0x3FF550 /end MEASUREMENT
/begin MEASUREMENT VSM_ACC_VehCnfgACC "" UBYTE PubIfStateVSM_MDL_CM_boolean 0 0 0 1 BIT_MASK 0x1 ECU_ADDRESS 0x3FF734 /end MEASUREMENT
/begin MEASUREMENT VSM_ACC_VsetBelowMin "" UBYTE PubIfStateVSM_MDL_CM_boolean 0 0 0 1 BIT_MASK 0x1 ECU_ADDRESS 0x3FF793 /end MEASUREMENT
/begin MEASUREMENT VSM_AccOverride "" UBYTE PubIfStateVSM_MDL_CM_boolean 0 0 0 1 BIT_MASK 0x1 ECU_ADDRESS 0x3FF731 /end MEASUREMENT
/begin MEASUREMENT VSM_ActiveEnable "" UBYTE PubIfStateVSM_MDL_CM_boolean 0 0 0 1 BIT_MASK 0x1 ECU_ADDRESS 0x3FF72F /end MEASUREMENT
/begin MEASUREMENT VSM_Counter "" UBYTE PubIfStateVSM_MDL_CM_uint8 0 0 0 255 ECU_ADDRESS 0x3FF6DF /end MEASUREMENT
/begin MEASUREMENT VSM_Diagnostic_ACCError "" UBYTE PubIfStateVSM_MDL_CM_uint8 0 0 0 255 ECU_ADDRESS 0x3FF6C6 /end MEASUREMENT
/begin MEASUREMENT VSM_Diagnostic_HWAError "" UBYTE PubIfStateVSM_MDL_CM_uint8 0 0 0 255 ECU_ADDRESS 0x3FF6C8 /end MEASUREMENT
/begin MEASUREMENT VSM_Diagnostic_TJAError "" UBYTE PubIfStateVSM_MDL_CM_uint8 0 0 0 255 ECU_ADDRESS 0x3FF6CA /end MEASUREMENT
/begin MEASUREMENT VSM_DriveBrake "" UBYTE PubIfStateVSM_MDL_CM_boolean 0 0 0 1 BIT_MASK 0x1 ECU_ADDRESS 0x3FF727 /end MEASUREMENT
/begin MEASUREMENT VSM_ESSState "" UBYTE PubIfStateVSM_MDL_CM_uint8 0 0 0 255 ECU_ADDRESS 0x3FF710 /end MEASUREMENT
/begin MEASUREMENT VSM_ESS_LastPoint "" FLOAT32_IEEE PubIfStateVSM_MDL_CM_single 0 0 -3.4e+38 3.4e+38 ECU_ADDRESS 0x3FF6A0 /end MEASUREMENT
/begin MEASUREMENT VSM_ESS_PedSwtReq "" UBYTE PubIfStateVSM_MDL_CM_boolean 0 0 0 1 BIT_MASK 0x1 ECU_ADDRESS 0x3FF739 /end MEASUREMENT
/begin MEASUREMENT VSM_ESS_Sensor_idle2error "" UBYTE PubIfStateVSM_MDL_CM_boolean 0 0 0 1 BIT_MASK 0x1 ECU_ADDRESS 0x3FF73B /end MEASUREMENT
/begin MEASUREMENT VSM_ESS_SubModel_Number "" UWORD PubIfStateVSM_MDL_CM_uint16 0 0 0 65535 ECU_ADDRESS 0x3FF6B4 /end MEASUREMENT
/begin MEASUREMENT VSM_ESS_SubModel_VERSION "" ULONG PubIfStateVSM_MDL_CM_uint32 0 0 0 4294967295 ECU_ADDRESS 0x3FF55C /end MEASUREMENT
/begin MEASUREMENT VSM_ESS_VehCnfgESS "" UBYTE PubIfStateVSM_MDL_CM_uint8 0 0 0 255 ECU_ADDRESS 0x3FF6C9 /end MEASUREMENT
/begin MEASUREMENT VSM_ESS_VehSwtReq "" UBYTE PubIfStateVSM_MDL_CM_boolean 0 0 0 1 BIT_MASK 0x1 ECU_ADDRESS 0x3FF73A /end MEASUREMENT
/begin MEASUREMENT VSM_HOD_SubModel_Number "" UWORD PubIfStateVSM_MDL_CM_uint16 0 0 0 65535 ECU_ADDRESS 0x3FF6B6 /end MEASUREMENT
/begin MEASUREMENT VSM_HOD_SubModel_VERSION "" ULONG PubIfStateVSM_MDL_CM_uint32 0 0 0 4294967295 ECU_ADDRESS 0x3FF560 /end MEASUREMENT
/begin MEASUREMENT VSM_HWAActive "" UBYTE PubIfStateVSM_MDL_CM_boolean 0 0 0 1 BIT_MASK 0x1 ECU_ADDRESS 0x3FF86D /end MEASUREMENT
/begin MEASUREMENT VSM_HWAFastExit_b "" UBYTE PubIfStateVSM_MDL_CM_boolean 0 0 0 1 BIT_MASK 0x1 ECU_ADDRESS 0x3FF86F /end MEASUREMENT
/begin MEASUREMENT VSM_HWANOA_Mode "" UBYTE PubIfStateVSM_MDL_CM_uint8 0 0 0 255 ECU_ADDRESS 0x3FF6D0 /end MEASUREMENT
/begin MEASUREMENT VSM_HWASafeStopEn "" UBYTE PubIfStateVSM_MDL_CM_boolean 0 0 0 1 BIT_MASK 0x1 ECU_ADDRESS 0x3FF86E /end MEASUREMENT
/begin MEASUREMENT VSM_HWASlowExitConditions_b "" UBYTE PubIfStateVSM_MDL_CM_boolean 0 0 0 1 BIT_MASK 0x1 ECU_ADDRESS 0x3FF77B /end MEASUREMENT
/begin MEASUREMENT VSM_HWASlowExitCons_ACCError "" UBYTE PubIfStateVSM_MDL_CM_boolean 0 0 0 1 BIT_MASK 0x1 ECU_ADDRESS 0x3FF77A /end MEASUREMENT
/begin MEASUREMENT VSM_HWASlowExitCons_NotHighWayArterialRoad5s "" UBYTE PubIfStateVSM_MDL_CM_boolean 0 0 0 1 BIT_MASK 0x1 ECU_ADDRESS 0x3FF779 /end MEASUREMENT
/begin MEASUREMENT VSM_HWASlowExit_b "" UBYTE PubIfStateVSM_MDL_CM_boolean 0 0 0 1 BIT_MASK 0x1 ECU_ADDRESS 0x3FF870 /end MEASUREMENT
/begin MEASUREMENT VSM_HWASts "" UBYTE PubIfStateVSM_MDL_CM_HWA_STATE 0 0 0 12 ECU_ADDRESS 0x3FF873 /end MEASUREMENT
/begin MEASUREMENT VSM_HWATextDisp "" UBYTE PubIfStateVSM_MDL_CM_uint8 0 0 0 255 ECU_ADDRESS 0x3FF6D2 /end MEASUREMENT
/begin MEASUREMENT VSM_HWAWarningLevel "" UBYTE PubIfStateVSM_MDL_CM_uint8 0 0 0 255 ECU_ADDRESS 0x3FF713 /end MEASUREMENT
/begin MEASUREMENT VSM_HWA_LaneChangeReq "" UBYTE PubIfStateVSM_MDL_CM_uint8 0 0 0 255 ECU_ADDRESS 0x3FF6D5 /end MEASUREMENT
/begin MEASUREMENT VSM_HWA_ModeDisp "" UBYTE PubIfStateVSM_MDL_CM_uint8 0 0 0 255 ECU_ADDRESS 0x3FF6D6 /end MEASUREMENT
/begin MEASUREMENT VSM_HWA_TJA_SubModel_Number "" UWORD PubIfStateVSM_MDL_CM_uint16 0 0 0 65535 ECU_ADDRESS 0x3FF6B0 /end MEASUREMENT
/begin MEASUREMENT VSM_HWA_TJA_SubModel_VERSION "" ULONG PubIfStateVSM_MDL_CM_uint32 0 0 0 4294967295 ECU_ADDRESS 0x3FF554 /end MEASUREMENT
/begin MEASUREMENT VSM_HandsOff "" UBYTE PubIfStateVSM_MDL_CM_boolean 0 0 0 1 BIT_MASK 0x1 ECU_ADDRESS 0x3FF738 /end MEASUREMENT
/begin MEASUREMENT VSM_HandsOffDetd "" UBYTE PubIfStateVSM_MDL_CM_boolean 0 0 0 1 BIT_MASK 0x1 ECU_ADDRESS 0x3FF86C /end MEASUREMENT
/begin MEASUREMENT VSM_HandsOffWarningLevel "" UBYTE PubIfStateVSM_MDL_CM_uint8 0 0 0 255 ECU_ADDRESS 0x3FF70F /end MEASUREMENT
/begin MEASUREMENT VSM_HandsOn "" UBYTE PubIfStateVSM_MDL_CM_boolean 0 0 0 1 BIT_MASK 0x1 ECU_ADDRESS 0x3FF77C /end MEASUREMENT
/begin MEASUREMENT VSM_ISLPilotStage "" UBYTE PubIfStateVSM_MDL_CM_uint8 0 0 0 255 ECU_ADDRESS 0x3FF712 /end MEASUREMENT
/begin MEASUREMENT VSM_ISL_SubModel_Number "" UWORD PubIfStateVSM_MDL_CM_uint16 0 0 0 65535 ECU_ADDRESS 0x3FF6B2 /end MEASUREMENT
/begin MEASUREMENT VSM_ISL_SubModel_VERSION "" ULONG PubIfStateVSM_MDL_CM_uint32 0 0 0 4294967295 ECU_ADDRESS 0x3FF558 /end MEASUREMENT
/begin MEASUREMENT VSM_NOHTextDisp "" FLOAT64_IEEE PubIfStateVSM_MDL_CM_double 0 0 -1.7e+308 1.7e+308 ECU_ADDRESS 0x3FF538 /end MEASUREMENT
/begin MEASUREMENT VSM_SomeHWASafeStop2ExitConditions_b "" UBYTE PubIfStateVSM_MDL_CM_boolean 0 0 0 1 BIT_MASK 0x1 ECU_ADDRESS 0x3FF778 /end MEASUREMENT
/begin MEASUREMENT VSM_TJASts "" UBYTE PubIfStateVSM_MDL_CM_TJA_STATE 0 0 0 10 ECU_ADDRESS 0x3FF871 /end MEASUREMENT
/begin MEASUREMENT VSM_TJATextDisp "" UBYTE PubIfStateVSM_MDL_CM_uint8 0 0 0 255 ECU_ADDRESS 0x3FF6D1 /end MEASUREMENT
/begin MEASUREMENT VSM_TJA_ModeDisp "" UBYTE PubIfStateVSM_MDL_CM_uint8 0 0 0 255 ECU_ADDRESS 0x3FF6CF /end MEASUREMENT
/begin MEASUREMENT VSM_VehicleStandStill "" UBYTE PubIfStateVSM_MDL_CM_boolean 0 0 0 1 BIT_MASK 0x1 ECU_ADDRESS 0x3FF715 /end MEASUREMENT
/begin GROUP S17_TakeOver "PubIfDecisionPLAN_MDL/PLAN/Subsystem Reference/AP/AP/SJ/TakeOver"
 /begin REF_CHARACTERISTIC P_LongCtrl_FollowaccelThresActiveTOR P_LongCtrl_FollowcoefDistRelThresActiveTOR P_LongCtrl_FollowgapThresActiveTOR P_LongCtrl_FollowvelTargRelThresActiveTOR /end REF_CHARACTERISTIC
 /begin REF_MEASUREMENT LongCtrl_tor /end REF_MEASUREMENT
/end GROUP
/begin GROUP S17_VSM "Noa_Nofusion/LPV/VSM" /begin SUB_GROUP PubIfStateVSM_MDL /end SUB_GROUP /end GROUP
/begin GROUP S181_DresCalc "PubIfDecisionPLAN_MDL/PLAN/Subsystem Reference/AP/AP/SJ/DeceleToStop/DeceleToStop/DresCalc" /begin REF_CHARACTERISTIC P_LongCtrl_SJdStop /end REF_CHARACTERISTIC /end GROUP
/begin GROUP S193_LC2APadapter "PubIfDecisionPLAN_MDL/PLAN/Subsystem Reference1/ALC/LC2APadapter" /begin REF_CHARACTERISTIC P_PLAN_ALC_LcFinishDyDiffRwFactorForAP /end REF_CHARACTERISTIC /begin REF_MEASUREMENT LongCtrl_ALC_dangerLevel LongCtrl_ALC_laneChangeEnable /end REF_MEASUREMENT /end GROUP
/begin GROUP S193_LcCancelFinishCalc "PubIfDecisionPLAN_MDL/PLAN/Subsystem Reference1/ALC/LcCancelFinishCalc"
 /begin REF_CHARACTERISTIC P_PLAN_ALC_LcCancelDPCThreshold P_PLAN_ALC_LcFinishDyDiffBrkPoint P_PLAN_ALC_LcFinishDyDiffTableValue P_PLAN_ALC_LcOverTkDPCthreshold P_PLAN_ALC_NotTouchLineCancelRWFactor P_PLAN_ALC_PreNotTouchLineCancelRWFactor /end REF_CHARACTERISTIC
 /begin REF_MEASUREMENT PLAN_ALC_LcCancelLe_CancelOverTk PLAN_ALC_LcCancelLe_DPC PLAN_ALC_LcCancelLe_Drv PLAN_ALC_LcCancelLe_DrvCmpl PLAN_ALC_LcCancelLe_LineValid PLAN_ALC_LcCancelLe_Oncoming PLAN_ALC_LcCancelRi_CancelOverTk PLAN_ALC_LcCancelRi_DPC PLAN_ALC_LcCancelRi_Drv PLAN_ALC_LcCancelRi_DrvCmpl PLAN_ALC_LcCancelRi_LineValid PLAN_ALC_LcCancelRi_Oncoming PLAN_ALC_LcFinish /end REF_MEASUREMENT
/end GROUP
/begin GROUP S193_LcDrv "PubIfDecisionPLAN_MDL/PLAN/Subsystem Reference1/ALC/LcDrv" /begin SUB_GROUP S201_Subsystem S201_Subsystem1 S201_Subsystem2 /end SUB_GROUP /begin REF_CHARACTERISTIC P_PLAN_ALC_LcDrv_DyDiffThreshold P_PLAN_ALC_vMinPreLC_Drv /end REF_CHARACTERISTIC
 /begin REF_MEASUREMENT PLAN_ALC_LcDrvLe_DPC PLAN_ALC_LcDrvLe_IPVehSpd PLAN_ALC_LcDrvLe_LciDrv PLAN_ALC_LcDrvLe_LineValid PLAN_ALC_LcDrvLe_NoLcCancelFlag PLAN_ALC_LcDrvLe_NoLcFinishFlag PLAN_ALC_LcDrvLe_dyDiff PLAN_ALC_LcDrvRi_DPC PLAN_ALC_LcDrvRi_IPVehSpd PLAN_ALC_LcDrvRi_LciDrv PLAN_ALC_LcDrvRi_LineValid PLAN_ALC_LcDrvRi_NoLcCancelFlag PLAN_ALC_LcDrvRi_NoLcFinishFlag PLAN_ALC_LcDrvRi_dyDiff /end REF_MEASUREMENT
/end GROUP
/begin GROUP S193_LcMrc "PubIfDecisionPLAN_MDL/PLAN/Subsystem Reference1/ALC/LcMrc" /begin SUB_GROUP S202_Subsystem2 /end SUB_GROUP /begin REF_CHARACTERISTIC P_PLAN_ALC_DynamicDPCthreshold P_PLAN_ALC_vMinPreLC_Noh /end REF_CHARACTERISTIC
 /begin REF_MEASUREMENT PLAN_ALC_LcMrcRi_DPC PLAN_ALC_LcMrcRi_IPVehSpd PLAN_ALC_LcMrcRi_LciMrc PLAN_ALC_LcMrcRi_LineValid PLAN_ALC_LcMrcRi_NoTurnLamp PLAN_ALC_LcMrcRi_dyDiff /end REF_MEASUREMENT
/end GROUP
/begin GROUP S193_LcNoh "PubIfDecisionPLAN_MDL/PLAN/Subsystem Reference1/ALC/LcNoh"
 /begin REF_CHARACTERISTIC P_PLAN_ALC_DynamicDPCthreshold P_PLAN_ALC_vMinPreLC_Drv P_PLAN_ALC_vMinPreLC_Noh /end REF_CHARACTERISTIC
 /begin REF_MEASUREMENT PLAN_ALC_LcNohLe_DPC PLAN_ALC_LcNohLe_IPVehSpd PLAN_ALC_LcNohLe_LciNoh PLAN_ALC_LcNohLe_LineValid PLAN_ALC_LcNohLe_NoTurnLamp PLAN_ALC_LcNohLe_dyDiff PLAN_ALC_LcNohRi_DPC PLAN_ALC_LcNohRi_IPVehSpd PLAN_ALC_LcNohRi_LciNoh PLAN_ALC_LcNohRi_LineValid PLAN_ALC_LcNohRi_NoTurnLamp PLAN_ALC_LcNohRi_dyDiff /end REF_MEASUREMENT
/end GROUP
/begin GROUP S193_LcOverTk "PubIfDecisionPLAN_MDL/PLAN/Subsystem Reference1/ALC/LcOverTk"
 /begin SUB_GROUP S204_DrvCancelSup S204_Subsystem S204_Subsystem1 S204_Subsystem4 /end SUB_GROUP
 /begin REF_CHARACTERISTIC P_PLAN_ALC_DPCConfirmTimeOverTk P_PLAN_ALC_LcCurvatureInhibitionValueBrkPoints P_PLAN_ALC_LcCurvatureInhibitionValueTable P_PLAN_ALC_LcOverTkDPCthreshold P_PLAN_ALC_PreCurvatureFactor P_PLAN_ALC_PreCurvaturePreTime P_PLAN_ALC_vMinPreLC_OverTk /end REF_CHARACTERISTIC
 /begin REF_MEASUREMENT PLAN_ALC_LcOverTkLe PLAN_ALC_LcOverTkLe_ALCSwtOn PLAN_ALC_LcOverTkLe_DPC PLAN_ALC_LcOverTkLe_DPCLongConfirm PLAN_ALC_LcOverTkLe_IPVehSpd PLAN_ALC_LcOverTkLe_LaneAvailable PLAN_ALC_LcOverTkLe_LineCurvatureValid PLAN_ALC_LcOverTkLe_LineValid PLAN_ALC_LcOverTkLe_NoLcFinishFlag PLAN_ALC_LcOverTkLe_NoTurnLampReq PLAN_ALC_LcOverTkLe_NotInDrvCancelArea PLAN_ALC_LcOverTkLe_P0NotCutOut PLAN_ALC_LcOverTkLe_PilotLaneAvailable PLAN_ALC_LcOverTkLe_dyDiff PLAN_ALC_LcOverTkRi PLAN_ALC_LcOverTkRi_ALCSwtOn PLAN_ALC_LcOverTkRi_DPC PLAN_ALC_LcOverTkRi_DPCLongConfirm PLAN_ALC_LcOverTkRi_IPVehSpd PLAN_ALC_LcOverTkRi_LaneAvailable PLAN_ALC_LcOverTkRi_LineCurvatureValid PLAN_ALC_LcOverTkRi_LineValid PLAN_ALC_LcOverTkRi_NoLcFinishFlag PLAN_ALC_LcOverTkRi_NoTurnLampReq PLAN_ALC_LcOverTkRi_NotInDrvCancelArea PLAN_ALC_LcOverTkRi_P0NotCutOut PLAN_ALC_LcOverTkRi_PilotLaneAvailable PLAN_ALC_LcOverTkRi_dyDiff /end REF_MEASUREMENT
/end GROUP
/begin GROUP S193_PLAN_IPHMI "PubIfDecisionPLAN_MDL/PLAN/Subsystem Reference1/ALC/PLAN_IPHMI"
 /begin SUB_GROUP S205_LcCancelDisp S205_Subsystem S205_Subsystem1 S205_Subsystem2 S205_Subsystem3 S205_Subsystem4 /end SUB_GROUP
 /begin REF_CHARACTERISTIC P_PLAN_ALC_LcFinishDyDiffRwFactorForHMI P_PLAN_ALC_TurnLmpType /end REF_CHARACTERISTIC
 /begin REF_MEASUREMENT PLAN_ALC_LampReq PLAN_ALC_LaneChange PLAN_ALC_LaneChangeReq /end REF_MEASUREMENT
/end GROUP
/begin GROUP S195_DangerPlausCalc "PubIfDecisionPLAN_MDL/PLAN/Subsystem Reference1/DangerPlausCalc/DangerPlausCalc"
 /begin REF_CHARACTERISTIC P_Global_DxvRearBumper_m P_PLAN_DPC_HWALineRearA2Factor P_PLAN_DPC_HWALineRearA3Factor /end REF_CHARACTERISTIC
 /begin REF_MEASUREMENT PLAN_DPC_ESS_DangerPlaus_FL PLAN_DPC_ESS_DangerPlaus_FR PLAN_DPC_ESS_DangerPlaus_L PLAN_DPC_ESS_DangerPlaus_R PLAN_DPC_ESS_DangerPlaus_RL PLAN_DPC_ESS_DangerPlaus_RR PLAN_DPC_ESS_L_Oncoming_flag PLAN_DPC_ESS_R_Oncoming_flag PLAN_DPC_ESS_X_Factor_FL PLAN_DPC_ESS_X_Factor_FR PLAN_DPC_ESS_X_Factor_RL PLAN_DPC_ESS_X_Factor_RR PLAN_DPC_ESS_Y_Factor_L PLAN_DPC_ESS_Y_Factor_R /end REF_MEASUREMENT
/end GROUP
/begin GROUP S195_DangerPlausCalc1 "PubIfDecisionPLAN_MDL/PLAN/Subsystem Reference1/DangerPlausCalc/DangerPlausCalc1" /begin SUB_GROUP S478_HWALineETACalc S478_Subsystem1 /end SUB_GROUP
 /begin REF_CHARACTERISTIC P_Global_DxvRearBumper_m P_PLAN_DPC_BrkPointDxFactorF1 P_PLAN_DPC_BrkPointDxFactorF2 P_PLAN_DPC_BrkPointDxFactorF3 P_PLAN_DPC_BrkPointDxFactorF4 P_PLAN_DPC_BrkPointDxFactorR1 P_PLAN_DPC_BrkPointDxFactorR2 P_PLAN_DPC_BrkPointDxFactorR3 P_PLAN_DPC_BrkPointDxFactorR4 P_PLAN_DPC_BrkPointTTCFactor1 P_PLAN_DPC_BrkPointTTCFactor2 P_PLAN_DPC_BrkPointTTCFactor3 P_PLAN_DPC_BrkPointTTCFactor4 P_PLAN_DPC_HWALineRearA2Factor P_PLAN_DPC_HWALineRearA3Factor P_PLAN_DPC_MaxObjNum P_PLAN_DPC_SafeDistBrkPoints P_PLAN_DPC_SafeDistValue /end REF_CHARACTERISTIC
 /begin REF_MEASUREMENT PLAN_DPC_HWA_DPCold_C PLAN_DPC_HWA_DPCold_L PLAN_DPC_HWA_DPCold_R /end REF_MEASUREMENT
/end GROUP
/begin GROUP S195_DangerPlausCalc2 "PubIfDecisionPLAN_MDL/PLAN/Subsystem Reference1/DangerPlausCalc/DangerPlausCalc2" /begin SUB_GROUP S479_HWALineETACalc S479_Subsystem1 /end SUB_GROUP
 /begin REF_CHARACTERISTIC P_Global_DxvRearBumper_m P_PLAN_DPC_CriticalAccF P_PLAN_DPC_CriticalAccR P_PLAN_DPC_CriticalTG P_PLAN_DPC_HWALineRearA2Factor P_PLAN_DPC_HWALineRearA3Factor P_PLAN_DPC_MaxObjNum P_PLAN_DPC_SafeAccF P_PLAN_DPC_SafeAccR P_PLAN_DPC_SafeTG /end REF_CHARACTERISTIC
 /begin REF_MEASUREMENT PLAN_DPC_HWA_DangerPlaus_L PLAN_DPC_HWA_DangerPlaus_R PLAN_DPC_HWA_NearestObjDx_L PLAN_DPC_HWA_NearestObjDx_R PLAN_DPC_HWA_NearestObjSpeed_L PLAN_DPC_HWA_NearestObjSpeed_R PLAN_DPC_HWA_NearestObjValid_L PLAN_DPC_HWA_NearestObjValid_R PLAN_DPC_HWA_OncomingFlag_Le PLAN_DPC_HWA_OncomingFlag_Ri /end REF_MEASUREMENT
/end GROUP
/begin GROUP S19_Cruise "PubIfStateVSM_MDL/Subsystem Reference/Subsystem/StateManage/Cruise/Cruise" /begin SUB_GROUP S29_ACC S29_HWA S29_ISL S29_LngHMI S29_SetSpd /end SUB_GROUP
 /begin REF_MEASUREMENT VSM_ACC_VehCnfgACC VSM_Diagnostic_ACCError VSM_Diagnostic_HWAError VSM_Diagnostic_TJAError VSM_HandsOn /end REF_MEASUREMENT
/end GROUP
/begin GROUP S1_HMI2_12 "PubIfChassisHMI_MDL/Subsystem/HMI2.12" /begin SUB_GROUP S3_HWA__ACC__TJA_Signal1 S3_IFC_Signal1 /end SUB_GROUP /end GROUP
/begin GROUP S1_LSM_Signal "PubIfDecisionLSM_MDL/Subsystem1/LSM_Signal"
 /begin REF_MEASUREMENT LSM_DoubleLineLost_b LSM_ESSLeLineC0 LSM_ESSLeLineC1 LSM_ESSLeLineC2 LSM_ESSLeLineC3 LSM_ESSLeLineValid LSM_ESSLeRange LSM_ESSLineC0 LSM_ESSLineC1 LSM_ESSLineC2 LSM_ESSLineC3 LSM_ESSLineValid LSM_ESSRange LSM_ESSRiLineC0 LSM_ESSRiLineC1 LSM_ESSRiLineC2 LSM_ESSRiLineC3 LSM_ESSRiLineValid LSM_ESSRiRange LSM_HWALeLineC0 LSM_HWALeLineC1 LSM_HWALeLineC2 LSM_HWALeLineC3 LSM_HWALeLineValid LSM_HWALeRange LSM_HWALineC0 LSM_HWALineC1 LSM_HWALineC2 LSM_HWALineC3 LSM_HWALineValid LSM_HWARange LSM_HWARiLineC0 LSM_HWARiLineC1 LSM_HWARiLineC2 LSM_HWARiLineC3 LSM_HWARiLineValid LSM_HWARiRange LSM_HeadAngDiff LSM_LCKLineC0 LSM_LCKLineC1 LSM_LCKLineC2 LSM_LCKLineC3 LSM_LCKLineValid LSM_LCKRange LSM_LeftLaneChange LSM_MLeLane LSM_OTL_A0 LSM_OTL_A1 LSM_OTL_A2 LSM_OTL_A3 LSM_OTL_Count LSM_OTL_Range LSM_OTLineValid LSM_RightLaneChange LSM_RoadWidth LSM_SingleLineLost_b LSM_TJALineC0 LSM_TJALineC1 LSM_TJALineC2 LSM_TJALineC3 LSM_TJALineValid LSM_TJARange LSM_UpdateCnt LSM_dyDiff /end REF_MEASUREMENT
/end GROUP
/begin GROUP S1_Subsystem "PubIfControlLATC_MDL/Subsystem Reference/Subsystem" /begin SUB_GROUP S2_LateralControl /end SUB_GROUP /begin REF_CHARACTERISTIC P_LCS_Trq_Switch /end REF_CHARACTERISTIC /begin REF_MEASUREMENT LCS_Counter LCS_SubModel_Number LCS_SubModel_VERSION /end REF_MEASUREMENT /end GROUP
/begin GROUP S1_Subsystem1 "PubIfStateVSM_MDL/Subsystem Reference/Subsystem" /begin SUB_GROUP S2_StateManage /end SUB_GROUP /begin REF_MEASUREMENT VSM_Counter /end REF_MEASUREMENT /end GROUP
/begin GROUP S1_Subsystem_Reference "PubIfDecisionPLAN_MDL/PLAN/Subsystem Reference" /begin SUB_GROUP S3_AP /end SUB_GROUP /begin REF_MEASUREMENT LongCtrl_AP_SW_VERSION /end REF_MEASUREMENT /end GROUP
/begin GROUP S1_Subsystem_Reference1 "PubIfDecisionPLAN_MDL/PLAN/Subsystem Reference1" /begin SUB_GROUP S4_ALC S4_DangerPlausCalc /end SUB_GROUP /begin REF_CHARACTERISTIC P_PLAN_ALC_NOHLcSwt P_PLAN_ALC_NOHTurnSts /end REF_CHARACTERISTIC
 /begin REF_MEASUREMENT PLAN_ALC_LSMPilotTurnSts PLAN_ALC_SW_VERSION PLAN_ALC_UpdateCnt /end REF_MEASUREMENT
/end GROUP
/begin GROUP S1_TargetLineCalc_20ms "PubIfDecisionLSM_MDL/Subsystem1/TargetLineCalc_20ms" /begin SUB_GROUP S4_Simulink_Function S4_TargetLineCalc /end SUB_GROUP
 /begin REF_MEASUREMENT LA_Adjacent_Count LA_ELEM_0_Availability_State LA_ELEM_0_C0 LA_ELEM_0_C1 LA_ELEM_0_C2 LA_ELEM_0_C3 LA_ELEM_0_Confidence LA_ELEM_0_DLM_Type LA_ELEM_0_Lanemark_Type LA_ELEM_0_Line_Side LA_ELEM_0_Marker_Width LA_ELEM_0_Range_End LA_ELEM_0_Range_Start LA_ELEM_1_Availability_State LA_ELEM_1_C0 LA_ELEM_1_C1 LA_ELEM_1_C2 LA_ELEM_1_C3 LA_ELEM_1_Confidence LA_ELEM_1_DLM_Type LA_ELEM_1_Lanemark_Type LA_ELEM_1_Line_Side LA_ELEM_1_Marker_Width LA_ELEM_1_Range_End LA_ELEM_1_Range_Start LA_ELEM_2_Availability_State LA_ELEM_2_C0 LA_ELEM_2_C1 LA_ELEM_2_C2 LA_ELEM_2_C3 LA_ELEM_2_Confidence LA_ELEM_2_DLM_Type LA_ELEM_2_Lanemark_Type LA_ELEM_2_Line_Side LA_ELEM_2_Marker_Width LA_ELEM_2_Range_End LA_ELEM_2_Range_Start LA_ELEM_3_Availability_State LA_ELEM_3_C0 LA_ELEM_3_C1 LA_ELEM_3_C2 LA_ELEM_3_C3 LA_ELEM_3_Confidence LA_ELEM_3_DLM_Type LA_ELEM_3_Lanemark_Type LA_ELEM_3_Line_Side LA_ELEM_3_Marker_Width LA_ELEM_3_Range_End LA_ELEM_3_Range_Start LH_Count LH_ELEM_0_Availability_State LH_ELEM_0_C0 LH_ELEM_0_C1 LH_ELEM_0_C2 LH_ELEM_0_C3 LH_ELEM_0_Confidence LH_ELEM_0_Crossing LH_ELEM_0_DLM_Type LH_ELEM_0_Lanemark_Type LH_ELEM_0_Line_Side LH_ELEM_0_Marker_Width LH_ELEM_0_VR_End LH_ELEM_0_VR_Start LH_ELEM_1_Availability_State LH_ELEM_1_C0 LH_ELEM_1_C1 LH_ELEM_1_C2 LH_ELEM_1_C3 LH_ELEM_1_Confidence LH_ELEM_1_Crossing LH_ELEM_1_DLM_Type LH_ELEM_1_Lanemark_Type LH_ELEM_1_Line_Side LH_ELEM_1_Marker_Width LH_ELEM_1_VR_End LH_ELEM_1_VR_Start LRE_Count LRE_ELEM_0_Availability_State LRE_ELEM_0_C0 LRE_ELEM_0_C1 LRE_ELEM_0_C2 LRE_ELEM_0_C3 LRE_ELEM_0_Confidence LRE_ELEM_0_Line_Side LRE_ELEM_0_Range_End LRE_ELEM_0_Range_Start LRE_ELEM_1_Availability_State LRE_ELEM_1_C0 LRE_ELEM_1_C1 LRE_ELEM_1_C2 LRE_ELEM_1_C3 LRE_ELEM_1_Confidence LRE_ELEM_1_Line_Side LRE_ELEM_1_Range_End LRE_ELEM_1_Range_Start LSM_L1_Conf LSM_L1_Range LSM_L2_Conf LSM_L2_Range LSM_L3_Conf LSM_L3_Range LSM_L4_Conf LSM_L4_Range /end REF_MEASUREMENT
/end GROUP
/begin GROUP S1_VIE "PubIfCommonVIE_MDL/VIE/VIE" /begin SUB_GROUP S2_AxRef S2_VxvRef_Calc /end SUB_GROUP /begin REF_CHARACTERISTIC P_Global_WheelBase_m /end REF_CHARACTERISTIC /end GROUP
/begin GROUP S1_VLC "PubIfControlLONC_MDL/Subsystem/VLC" /begin SUB_GROUP S3_Vlc /end SUB_GROUP /end GROUP
/begin GROUP S201_Subsystem "PubIfDecisionPLAN_MDL/PLAN/Subsystem Reference1/ALC/LcDrv/Subsystem"
 /begin REF_CHARACTERISTIC P_PLAN_ALC_DPCthresholdLcDrvLv1 P_PLAN_ALC_DPCthresholdLcDrvLv2 P_PLAN_ALC_DPCthresholdLcDrvLv3 P_PLAN_ALC_LCDeltaTmeGap /end REF_CHARACTERISTIC
/end GROUP
/begin GROUP S201_Subsystem1 "PubIfDecisionPLAN_MDL/PLAN/Subsystem Reference1/ALC/LcDrv/Subsystem1" /begin REF_MEASUREMENT PLAN_ALC_LcDrvRi_DPCHoldCnt /end REF_MEASUREMENT /end GROUP
/begin GROUP S201_Subsystem2 "PubIfDecisionPLAN_MDL/PLAN/Subsystem Reference1/ALC/LcDrv/Subsystem2" /begin REF_MEASUREMENT PLAN_ALC_LcDrvLe_DPCHoldCnt /end REF_MEASUREMENT /end GROUP
/begin GROUP S202_Subsystem2 "PubIfDecisionPLAN_MDL/PLAN/Subsystem Reference1/ALC/LcMrc/Subsystem2" /begin REF_CHARACTERISTIC P_PLAN_ALC_DPCConfimrTimeTableLcMrc /end REF_CHARACTERISTIC /end GROUP
/begin GROUP S204_DrvCancelSup "PubIfDecisionPLAN_MDL/PLAN/Subsystem Reference1/ALC/LcOverTk/DrvCancelSup" /begin REF_CHARACTERISTIC P_PLAN_ALC_OveTkrSupDist /end REF_CHARACTERISTIC /begin REF_MEASUREMENT PLAN_ALC_OveTkrSupDist /end REF_MEASUREMENT /end GROUP
/begin GROUP S204_Subsystem "PubIfDecisionPLAN_MDL/PLAN/Subsystem Reference1/ALC/LcOverTk/Subsystem"
 /begin REF_CHARACTERISTIC P_PLAN_ALC_LCDeltaTmeGap P_PLAN_ALC_LciOverTkDeltaSpdLv1 P_PLAN_ALC_LciOverTkDeltaSpdLv2 P_PLAN_ALC_LciOverTkDeltaSpdLv3 P_PLAN_ALC_LciOverTkSpdSupTimeLv1 P_PLAN_ALC_LciOverTkSpdSupTimeLv2 P_PLAN_ALC_LciOverTkSpdSupTimeLv3 /end REF_CHARACTERISTIC
/end GROUP
/begin GROUP S204_Subsystem1 "PubIfDecisionPLAN_MDL/PLAN/Subsystem Reference1/ALC/LcOverTk/Subsystem1"
 /begin REF_CHARACTERISTIC P_PLAN_ALC_LcOverTkManualTrigger P_PLAN_ALC_LcOverTkManualTriggerTimeCnt /end REF_CHARACTERISTIC
 /begin REF_MEASUREMENT PLAN_ALC_LcOverTkLe_OverTkTrigger PLAN_ALC_LcOverTkRi_OverTkTrigger /end REF_MEASUREMENT
/end GROUP
/begin GROUP S204_Subsystem4 "PubIfDecisionPLAN_MDL/PLAN/Subsystem Reference1/ALC/LcOverTk/Subsystem4" /begin REF_CHARACTERISTIC P_PLAN_ALC_OverTkCutOutDyRWFactor /end REF_CHARACTERISTIC /begin REF_MEASUREMENT PLAN_ALC_PreP0Dy /end REF_MEASUREMENT /end GROUP
/begin GROUP S205_LcCancelDisp "PubIfDecisionPLAN_MDL/PLAN/Subsystem Reference1/ALC/PLAN_IPHMI/LcCancelDisp" /begin SUB_GROUP S429_RisingEdgeTimer1 S429_RisingEdgeTimer2 /end SUB_GROUP /begin REF_CHARACTERISTIC P_PLAN_ALC_LcCancelLaneChangeReqDspTimeCnt /end REF_CHARACTERISTIC /end GROUP
/begin GROUP S205_Subsystem "PubIfDecisionPLAN_MDL/PLAN/Subsystem Reference1/ALC/PLAN_IPHMI/Subsystem"
 /begin REF_CHARACTERISTIC P_PLAN_ALC_DynamicDPCthreshold P_PLAN_ALC_LcDrvHMILineValidFtime P_PLAN_ALC_LciDrvExistDefaultDisp /end REF_CHARACTERISTIC
/end GROUP
/begin GROUP S205_Subsystem1 "PubIfDecisionPLAN_MDL/PLAN/Subsystem Reference1/ALC/PLAN_IPHMI/Subsystem1"
 /begin REF_CHARACTERISTIC P_PLAN_ALC_DynamicDPCthreshold P_PLAN_ALC_LcDrvHMILineValidFtime P_PLAN_ALC_LciDrvExistDefaultDisp /end REF_CHARACTERISTIC
/end GROUP
/begin GROUP S205_Subsystem2 "PubIfDecisionPLAN_MDL/PLAN/Subsystem Reference1/ALC/PLAN_IPHMI/Subsystem2"
 /begin REF_CHARACTERISTIC P_PLAN_ALC_DynamicDPCthreshold P_PLAN_ALC_LcDrvHMILineValidFtime P_PLAN_ALC_LciDrvExistDefaultDisp /end REF_CHARACTERISTIC
/end GROUP
/begin GROUP S205_Subsystem3 "PubIfDecisionPLAN_MDL/PLAN/Subsystem Reference1/ALC/PLAN_IPHMI/Subsystem3"
 /begin REF_CHARACTERISTIC P_PLAN_ALC_DynamicDPCthreshold P_PLAN_ALC_LcDrvHMILineValidFtime P_PLAN_ALC_LciDrvExistDefaultDisp /end REF_CHARACTERISTIC
/end GROUP
/begin GROUP S205_Subsystem4 "PubIfDecisionPLAN_MDL/PLAN/Subsystem Reference1/ALC/PLAN_IPHMI/Subsystem4"
 /begin REF_CHARACTERISTIC P_PLAN_ALC_DynamicDPCthreshold P_PLAN_ALC_LcDrvHMILineValidFtime P_PLAN_ALC_LciDrvExistDefaultDisp /end REF_CHARACTERISTIC
/end GROUP
/begin GROUP S21_ESS "PubIfStateVSM_MDL/Subsystem Reference/Subsystem/StateManage/ESS/ESS" /begin SUB_GROUP S581_Subsystem1 /end SUB_GROUP /end GROUP
/begin GROUP S227_HWA_Condotion "PubIfStateVSM_MDL/Subsystem Reference/Subsystem/StateManage/Cruise/Cruise/HWA/Subsystem/HWA_Condotion"
 /begin REF_CHARACTERISTIC P_VSM_HWAActivation_NOAMOd_Spd P_VSM_HWAActivation_Spd_Low P_VSM_HWAActivation_Spd_Up P_VSM_HWA_EHR_Enable P_VSM_TJA_MRCTrigger /end REF_CHARACTERISTIC
 /begin REF_MEASUREMENT VSM_HWAFastExit_b VSM_HWANOA_Mode VSM_HWASafeStopEn VSM_HWASlowExitConditions_b VSM_HWASlowExitCons_ACCError VSM_HWASlowExitCons_NotHighWayArterialRoad5s VSM_HWASlowExit_b VSM_HWAWarningLevel VSM_SomeHWASafeStop2ExitConditions_b /end REF_MEASUREMENT
/end GROUP
/begin GROUP S227_HWA_SM "PubIfStateVSM_MDL/Subsystem Reference/Subsystem/StateManage/Cruise/Cruise/HWA/Subsystem/HWA_SM"
 /begin REF_CHARACTERISTIC P_VSM_NOH_PilotSelc_SW P_VSM_NOH_Swt_Req_SW P_VSM_TJA_ActiveWaitNum /end REF_CHARACTERISTIC
 /begin REF_MEASUREMENT VSM_HWAActive VSM_HWASts VSM_TJASts /end REF_MEASUREMENT
/end GROUP
/begin GROUP S23_HOD "PubIfStateVSM_MDL/Subsystem Reference/Subsystem/StateManage/HOD/HOD" /begin SUB_GROUP S701_LP_filter /end SUB_GROUP
 /begin REF_CHARACTERISTIC P_VSM_HOD_HWA_HandsOffLev1TimeCnt P_VSM_HOD_HWA_HandsOffLev2TimeCnt P_VSM_HOD_HWA_HandsOffLev3TimeCnt P_VSM_HOD_HWA_HandsOffLev4TimeCnt P_VSM_HOD_HandsOff_Tr P_VSM_HOD_HandsOn_Tr P_VSM_HOD_Handson_TimeInsertPoint P_VSM_HOD_Handson_TrqInsertPoint P_VSM_HOD_LCKTJA_HandsOffLev1TimeCnt P_VSM_HOD_LCKTJA_HandsOffLev2TimeCnt P_VSM_HOD_LCKTJA_HandsOffLev3TimeCnt P_VSM_HOD_LCKTJA_HandsOffLev4TimeCnt /end REF_CHARACTERISTIC
 /begin REF_MEASUREMENT VSM_HOD_SubModel_Number VSM_HOD_SubModel_VERSION VSM_HandsOff VSM_HandsOffDetd VSM_HandsOffWarningLevel /end REF_MEASUREMENT
/end GROUP
/begin GROUP S23_Subsystem1 "Noa_Nofusion/TOS/Subsystem1" /begin SUB_GROUP S167_ACCOSM /end SUB_GROUP /end GROUP
/begin GROUP S24_CCAcceleNeg "PubIfDecisionPLAN_MDL/PLAN/Subsystem Reference/AP/AP/CCCtrl/AccelCCCalc/CCAcceleNeg"
 /begin REF_CHARACTERISTIC P_LongCtrl_CCtAcceleTimeNeg P_LongCtrl_CCtAcceleTimeNegCorrXAxis P_LongCtrl_CCtAcceleTimeNegCorrYAxis /end REF_CHARACTERISTIC
/end GROUP
/begin GROUP S24_CCAccelePos "PubIfDecisionPLAN_MDL/PLAN/Subsystem Reference/AP/AP/CCCtrl/AccelCCCalc/CCAccelePos"
 /begin REF_CHARACTERISTIC P_LongCtrl_CCtAcceleTimePos P_LongCtrl_CCtAcceleTimePosCorrXAxis P_LongCtrl_CCtAcceleTimePosCorrYAxis /end REF_CHARACTERISTIC
/end GROUP
/begin GROUP S24_FF "PubIfControlLATC_MDL/Subsystem Reference/Subsystem/LateralControl/LCS_Angle/Subsystem4/FF" /begin REF_CHARACTERISTIC P_LCS_FFW_Torq_AngleBp P_LCS_FFW_Torq_SpdBp /end REF_CHARACTERISTIC /end GROUP
/begin GROUP S24_LCK_LKA_LDW_ELKStateMachine3 "PubIfStateVSM_MDL/Subsystem Reference/Subsystem/StateManage/LSS/LCK_LKA_LDW_ELKStateMachine3"
 /begin SUB_GROUP S722_ELKState_Machine S722_LCK S722_LCKIE S722_LDW S722_LKA S722_Signal_calculate /end SUB_GROUP
/end GROUP
/begin GROUP S24_LP_filter "PubIfControlLATC_MDL/Subsystem Reference/Subsystem/LateralControl/LCS_Angle/Subsystem4/LP filter" /begin REF_MEASUREMENT LCS_Torq_PID /end REF_MEASUREMENT /end GROUP
/begin GROUP S24_Mph2KphCalc "PubIfDecisionPLAN_MDL/PLAN/Subsystem Reference/AP/AP/CCCtrl/AccelCCCalc/Mph2KphCalc" /begin REF_CHARACTERISTIC C_LongCtrl_Mph2Kph /end REF_CHARACTERISTIC /end GROUP
/begin GROUP S24_PID "PubIfControlLATC_MDL/Subsystem Reference/Subsystem/LateralControl/LCS_Angle/Subsystem4/PID" /begin SUB_GROUP S61_AngleControlTest /end SUB_GROUP /begin REF_CHARACTERISTIC P_LCS_PID_DisableKi_CurveVal /end REF_CHARACTERISTIC /end GROUP
/begin GROUP S24_Subsystem1 "PubIfControlLATC_MDL/Subsystem Reference/Subsystem/LateralControl/LCS_Angle/Subsystem4/Subsystem1" /begin REF_MEASUREMENT LCS_Torq_FFAdd /end REF_MEASUREMENT /end GROUP
/begin GROUP S24_TLS "PubIfStateVSM_MDL/Subsystem Reference/Subsystem/StateManage/LSS/TLS" /begin SUB_GROUP S723_TargetLineSelect /end SUB_GROUP /end GROUP
/begin GROUP S25_LP_filter "PubIfControlLATC_MDL/Subsystem Reference/Subsystem/LateralControl/LCS_Angle/TargetSteerAngleCalc/LP filter" /begin REF_MEASUREMENT LCS_TarSteerAngle_Filter /end REF_MEASUREMENT /end GROUP
/begin GROUP S26_CCNegAcceleBandCalc "PubIfDecisionPLAN_MDL/PLAN/Subsystem Reference/AP/AP/CCCtrl/AcceleBandCC/CCNegAcceleBandCalc"
 /begin REF_CHARACTERISTIC P_LongCtrl_CCaMinNegAcceleLowerBand P_LongCtrl_CCaMinNegAcceleUpperBand P_LongCtrl_CCfacNegAcceleLowerBand P_LongCtrl_CCfacNegAcceleUpperBand /end REF_CHARACTERISTIC
/end GROUP
/begin GROUP S26_CCPosAcceleBandCalc "PubIfDecisionPLAN_MDL/PLAN/Subsystem Reference/AP/AP/CCCtrl/AcceleBandCC/CCPosAcceleBandCalc"
 /begin REF_CHARACTERISTIC P_LongCtrl_CCaMinPosAcceleLowerBand P_LongCtrl_CCaMinPosAcceleUpperBand P_LongCtrl_CCfacPosAcceleLowerBand P_LongCtrl_CCfacPosAcceleUpperBand /end REF_CHARACTERISTIC
/end GROUP
/begin GROUP S27_TSR "PubIfStateVSM_MDL/Subsystem Reference/Subsystem/StateManage/Subsystem/TSR" /begin SUB_GROUP S1689_TSRv3_6 /end SUB_GROUP /end GROUP
/begin GROUP S28_GW_V71 "PubIfStateVSM_MDL/Subsystem Reference/Subsystem/StateManage/UOM/GW_V71" /begin SUB_GROUP S1726_UOM /end SUB_GROUP /end GROUP
/begin GROUP S29_ACC "PubIfStateVSM_MDL/Subsystem Reference/Subsystem/StateManage/Cruise/Cruise/ACC" /begin SUB_GROUP S30_Subsystem /end SUB_GROUP /end GROUP
/begin GROUP S29_HWA "PubIfStateVSM_MDL/Subsystem Reference/Subsystem/StateManage/Cruise/Cruise/HWA" /begin SUB_GROUP S31_Subsystem /end SUB_GROUP /end GROUP
/begin GROUP S29_ISL "PubIfStateVSM_MDL/Subsystem Reference/Subsystem/StateManage/Cruise/Cruise/ISL" /begin SUB_GROUP S32_SM_Conds S32_Subsystem /end SUB_GROUP /begin REF_MEASUREMENT VSM_ISL_SubModel_Number VSM_ISL_SubModel_VERSION /end REF_MEASUREMENT /end GROUP
/begin GROUP S29_LngHMI "PubIfStateVSM_MDL/Subsystem Reference/Subsystem/StateManage/Cruise/Cruise/LngHMI" /begin SUB_GROUP S33_Subsystem1 /end SUB_GROUP /end GROUP
/begin GROUP S29_SetSpd "PubIfStateVSM_MDL/Subsystem Reference/Subsystem/StateManage/Cruise/Cruise/SetSpd" /begin SUB_GROUP S34_Subsystem /end SUB_GROUP /end GROUP
/begin GROUP S2_AxRef "PubIfCommonVIE_MDL/VIE/VIE/AxRef" /begin SUB_GROUP S3_axvRoadSlope_calc /end SUB_GROUP /end GROUP
/begin GROUP S2_LateralControl "PubIfControlLATC_MDL/Subsystem Reference/Subsystem/LateralControl" /begin SUB_GROUP S4_EPSFaultCheck S4_LCS_Angle S4_Understeer_Offset_Calc /end SUB_GROUP /begin REF_CHARACTERISTIC LCS_IN_Offset_Test_Value P_LCS_IN_Offset_Test_SW /end REF_CHARACTERISTIC
 /begin REF_MEASUREMENT LCS_AngCmdReqValVld LCS_IN_CurrentLaneWidth LCS_IN_EPS_DrvInpTrqVal LCS_IN_EPS_LKATorqOvrlDlvd LCS_IN_EPS_LKATorqOvrlDlvdVld LCS_IN_SteerAngOffset_deg LCS_IN_SteerWheelAng LCS_IN_SteerWheelAngleSign LCS_IN_SteerWheelSpd LCS_IN_SteerWheelSpdSign LCS_IN_alpSideSlipAngle LCS_IN_axvRefMs2 LCS_IN_ayvRefMs2 LCS_IN_desLaneA0 LCS_IN_desLaneA1 LCS_IN_desLaneA2 LCS_IN_desLaneA3 LCS_IN_desLaneValid LCS_IN_kapTraj LCS_IN_psiDtOpt LCS_IN_vxvRefMs /end REF_MEASUREMENT
/end GROUP
/begin GROUP S2_StateManage "PubIfStateVSM_MDL/Subsystem Reference/Subsystem/StateManage"
 /begin SUB_GROUP S6_Cruise S6_ESS S6_Enlong2s1 S6_HOD S6_LSS S6_Subsystem S6_UOM /end SUB_GROUP
 /begin REF_CHARACTERISTIC P_VSM_ACCSOS_SW P_VSM_AESSwtReq P_VSM_ELKSwtReq P_VSM_ESS_VehSwtReq P_VSM_ICA_HandsOffSwtReq P_VSM_ISLSwtReq P_VSM_IntelligentEvaSwtReq P_VSM_LCKSwtReq P_VSM_LDWSwtReq P_VSM_LKASwtReq P_VSM_LSSSwtReq P_VSM_NOH_Act_Req P_VSM_NOH_Swt_Req P_VSM_TSRSwtReq P_VSM_TSRWarnSwtReq /end REF_CHARACTERISTIC
/end GROUP
/begin GROUP S2_VxvRef_Calc "PubIfCommonVIE_MDL/VIE/VIE/VxvRef_Calc" /begin SUB_GROUP S7_VxvRef_Calc /end SUB_GROUP
 /begin REF_CHARACTERISTIC P_Global_FrontAxleToCenter_m P_Global_RearAxleToCenter_m P_Global_WheelTrack_m /end REF_CHARACTERISTIC
/end GROUP
/begin GROUP S30_Subsystem "PubIfStateVSM_MDL/Subsystem Reference/Subsystem/StateManage/Cruise/Cruise/ACC/Subsystem" /begin SUB_GROUP S36_ACCTJA_SM S36_ACC_Condotion S36_Subsystem /end SUB_GROUP /begin REF_MEASUREMENT VSM_ACC_SubModel_Number VSM_ACC_SubModel_VERSION /end REF_MEASUREMENT /end GROUP
/begin GROUP S31_Subsystem "PubIfStateVSM_MDL/Subsystem Reference/Subsystem/StateManage/Cruise/Cruise/HWA/Subsystem" /begin SUB_GROUP S227_HWA_Condotion S227_HWA_SM /end SUB_GROUP /begin REF_CHARACTERISTIC P_VSM_HWA_ALCStsSW /end REF_CHARACTERISTIC
 /begin REF_MEASUREMENT VSM_HWA_LaneChangeReq VSM_HWA_TJA_SubModel_Number VSM_HWA_TJA_SubModel_VERSION /end REF_MEASUREMENT
/end GROUP
/begin GROUP S32_SM_Conds "PubIfStateVSM_MDL/Subsystem Reference/Subsystem/StateManage/Cruise/Cruise/ISL/SM_Conds" /begin REF_CHARACTERISTIC P_VSM_ISL_TimeInformDis P_VSM_ISL_TimeTakeOver /end REF_CHARACTERISTIC /end GROUP
/begin GROUP S32_Subsystem "PubIfStateVSM_MDL/Subsystem Reference/Subsystem/StateManage/Cruise/Cruise/ISL/Subsystem" /begin REF_MEASUREMENT VSM_ISLPilotStage /end REF_MEASUREMENT /end GROUP
/begin GROUP S33_Subsystem1 "PubIfStateVSM_MDL/Subsystem Reference/Subsystem/StateManage/Cruise/Cruise/LngHMI/Subsystem1" /begin SUB_GROUP S407_Enlong3s S407_Enlong3s1 S407_Enlong3s2 S407_Enlong3s3 /end SUB_GROUP
 /begin REF_MEASUREMENT VSM_ACC_HazActv VSM_ACC_ModeDisp VSM_HWA_ModeDisp VSM_TJA_ModeDisp /end REF_MEASUREMENT
/end GROUP
/begin GROUP S34_Subsystem "PubIfStateVSM_MDL/Subsystem Reference/Subsystem/StateManage/Cruise/Cruise/SetSpd/Subsystem" /begin REF_MEASUREMENT VSM_ACC_SpdSetValue VSM_ACC_VsetBelowMin /end REF_MEASUREMENT /end GROUP
/begin GROUP S36_ACC_Condotion "PubIfStateVSM_MDL/Subsystem Reference/Subsystem/StateManage/Cruise/Cruise/ACC/Subsystem/ACC_Condotion" /begin SUB_GROUP S38_StandstillNoBrakeForce /end SUB_GROUP
 /begin REF_CHARACTERISTIC P_VSM_ACCExit_AccOverride P_VSM_ACCExit_StandWaitTime P_VSM_ACC_BOMEntry_ACCDecReqValue P_VSM_ACC_BOMEntry_AxvRefMs2 P_VSM_ACC_BOMExit_ACCDecReqValue /end REF_CHARACTERISTIC
 /begin REF_MEASUREMENT VSM_ACCActCondF VSM_ACCFastExit VSM_ACCFastExitCons_ACCError_Inhibit VSM_ACCFastExitCons_ACCOverride VSM_ACCFastExitCons_AEBTrigger VSM_ACCFastExitCons_APSGuidance VSM_ACCFastExitCons_BrakeDiskOverHeat VSM_ACCFastExitCons_Cancel VSM_ACCFastExitCons_DriveBrakeExit VSM_ACCFastExitCons_DriverDoorOpen VSM_ACCFastExitCons_DriverSBR VSM_ACCFastExitCons_DrivingModExit VSM_ACCFastExitCons_EPBClosed VSM_ACCFastExitCons_EngLimpHome VSM_ACCFastExitCons_EngineOff VSM_ACCFastExitCons_EspOff VSM_ACCFastExitCons_NoForwardGear VSM_ACCFastExitCons_RollingBack VSM_ACCFastExitCons_Standstill3min VSM_ACCFastExitCons_VehSpdExit VSM_ACCSlowExit VSM_ACCSlowExitCons_ABSactive400ms VSM_ACCSlowExitCons_EspActive400ms VSM_ACCSlowExitCons_HDCactive40ms VSM_ACCSlowExitCons_MSRactive800ms VSM_ACCSlowExitCons_TCS1active3000ms VSM_ACCSlowExitCons_TCS2active3000ms VSM_ACC_BOMExit VSM_ACC_DecReqValue VSM_AccOverride VSM_ActiveEnable VSM_DriveBrake VSM_VehicleStandStill /end REF_MEASUREMENT
/end GROUP
/begin GROUP S36_ACCTJA_SM "PubIfStateVSM_MDL/Subsystem Reference/Subsystem/StateManage/Cruise/Cruise/ACC/Subsystem/ACCTJA_SM" /begin SUB_GROUP S37_Subsystem /end SUB_GROUP /begin REF_CHARACTERISTIC P_VSM_ACC_BrakeOnlyNum /end REF_CHARACTERISTIC /begin REF_MEASUREMENT VSM_ACCSts /end REF_MEASUREMENT /end GROUP
/begin GROUP S36_Subsystem "PubIfStateVSM_MDL/Subsystem Reference/Subsystem/StateManage/Cruise/Cruise/ACC/Subsystem/Subsystem"
 /begin REF_CHARACTERISTIC P_VSM_ACC_AutoGoSW P_VSM_ACC_RadarOffset P_VSM_ACC_StandActiveNumACCMode P_VSM_ACC_StandActiveNumHWAMode /end REF_CHARACTERISTIC
 /begin REF_MEASUREMENT VSM_ACCStandActive2Active_DrvrSts VSM_ACCStandActive2Wait_DrvrSts VSM_ACCStandActive2Wait_USS VSM_ACCStandActiveTime /end REF_MEASUREMENT
/end GROUP
/begin GROUP S37_Subsystem "PubIfStateVSM_MDL/Subsystem Reference/Subsystem/StateManage/Cruise/Cruise/ACC/Subsystem/ACCTJA_SM/Subsystem" /begin REF_MEASUREMENT VSM_ACC_DrvOffReq /end REF_MEASUREMENT /end GROUP
/begin GROUP S38_StandstillNoBrakeForce "PubIfStateVSM_MDL/Subsystem Reference/Subsystem/StateManage/Cruise/Cruise/ACC/Subsystem/ACC_Condotion/StandstillNoBrakeForce" /begin REF_MEASUREMENT VSM_ACCFastExitCons_StandstillNoBrakeForce /end REF_MEASUREMENT /end GROUP
/begin GROUP S38_Subsystem2 "PubIfDecisionLSM_MDL/Subsystem1/TargetLineCalc_20ms/TargetLineCalc/Subsystem/Subsystem2" /begin REF_CHARACTERISTIC P_LSM_DOP2Line_Limit P_LSM_DOP2Line_Reliable /end REF_CHARACTERISTIC /end GROUP
/begin GROUP S3_AP "PubIfDecisionPLAN_MDL/PLAN/Subsystem Reference/AP" /begin SUB_GROUP S7_AP /end SUB_GROUP /end GROUP
/begin GROUP S3_axvRoadSlope_calc "PubIfCommonVIE_MDL/VIE/VIE/AxRef/axvRoadSlope_calc" /begin REF_CHARACTERISTIC P_Global_SideSlipAnglefactor /end REF_CHARACTERISTIC /end GROUP
/begin GROUP S3_HWA__ACC__TJA_Signal1 "PubIfChassisHMI_MDL/Subsystem/HMI2.12/HWA//ACC//TJA_Signal1"
 /begin SUB_GROUP S7_Subsystem S7_Subsystem1 S7_Subsystem2 S7_Subsystem3 S7_Subsystem4 S7_Subsystem5 /end SUB_GROUP
/end GROUP
/begin GROUP S3_IFC_Signal1 "PubIfChassisHMI_MDL/Subsystem/HMI2.12/IFC_Signal1" /begin REF_CHARACTERISTIC P_HMI_LDW_LKAWarnTime /end REF_CHARACTERISTIC /end GROUP
/begin GROUP S3_Vlc "PubIfControlLONC_MDL/Subsystem/VLC/Vlc"
 /begin SUB_GROUP S6_DC S6_EC S6_FF_Control S6_PI_Control S6_SwitchToBrakeMode S6_SwitchToDriveMode S6_UpdateFlagCalc S6_axvClosedLoopControlCalc S6_axvModelResidualCalc S6_axvTracActMean_calc S6_axvTracMin_calc /end SUB_GROUP
 /begin REF_CHARACTERISTIC P_Global_TireRadius_m P_LongCtrl_VLCTrTatioMax P_LongCtrl_VLCTrTatioMin P_LongCtrl_VLCaXCDeadZoneProp_Y P_LongCtrl_VLCaXCKiCtrlDevChar_Y P_LongCtrl_VLCaxCtrlDevDeadZoneChar_Y P_LongCtrl_VLCaxCtrlDevEC2DCMax P_LongCtrl_VLCaxCtrlDevFastQuitDCMode P_LongCtrl_VLCaxCtrlDevThresAddEC2DC P_LongCtrl_VLCaxCtrlDevTresAddDC2EC P_LongCtrl_VLCdaxTarEC2DCMax P_LongCtrl_VLCdriveOffAxUpLimXAxix P_LongCtrl_VLCdriveOffAxUpLimYAxix P_LongCtrl_VLCki P_LongCtrl_VLCkp P_LongCtrl_VLCks /end REF_CHARACTERISTIC
 /begin REF_MEASUREMENT LongCtrl_DCEnable LongCtrl_ECEnable LongCtrl_FF_NetEngTorq LongCtrl_OverrideToDC LongCtrl_PI_NetEngTorq LongCtrl_Sw2DC LongCtrl_Sw2EC LongCtrl_Tr_Ratio /end REF_MEASUREMENT
/end GROUP
/begin GROUP S407_Enlong3s "PubIfStateVSM_MDL/Subsystem Reference/Subsystem/StateManage/Cruise/Cruise/LngHMI/Subsystem1/Enlong3s" /begin REF_MEASUREMENT VSM_TJATextDisp /end REF_MEASUREMENT /end GROUP
/begin GROUP S407_Enlong3s1 "PubIfStateVSM_MDL/Subsystem Reference/Subsystem/StateManage/Cruise/Cruise/LngHMI/Subsystem1/Enlong3s1" /begin REF_MEASUREMENT VSM_ACCTextDisp /end REF_MEASUREMENT /end GROUP
/begin GROUP S407_Enlong3s2 "PubIfStateVSM_MDL/Subsystem Reference/Subsystem/StateManage/Cruise/Cruise/LngHMI/Subsystem1/Enlong3s2" /begin REF_MEASUREMENT VSM_HWATextDisp /end REF_MEASUREMENT /end GROUP
/begin GROUP S407_Enlong3s3 "PubIfStateVSM_MDL/Subsystem Reference/Subsystem/StateManage/Cruise/Cruise/LngHMI/Subsystem1/Enlong3s3" /begin REF_MEASUREMENT VSM_NOHTextDisp /end REF_MEASUREMENT /end GROUP
/begin GROUP S429_RisingEdgeTimer1 "PubIfDecisionPLAN_MDL/PLAN/Subsystem Reference1/ALC/PLAN_IPHMI/LcCancelDisp/RisingEdgeTimer1" /begin REF_CHARACTERISTIC P_PLAN_ALC_LcCancelLaneChangeReqDspTimeCnt /end REF_CHARACTERISTIC /end GROUP
/begin GROUP S429_RisingEdgeTimer2 "PubIfDecisionPLAN_MDL/PLAN/Subsystem Reference1/ALC/PLAN_IPHMI/LcCancelDisp/RisingEdgeTimer2" /begin REF_CHARACTERISTIC P_PLAN_ALC_LcCancelLaneChangeReqDspTimeCnt /end REF_CHARACTERISTIC /end GROUP
/begin GROUP S478_HWALineETACalc "PubIfDecisionPLAN_MDL/PLAN/Subsystem Reference1/DangerPlausCalc/DangerPlausCalc1/HWALineETACalc" /begin REF_CHARACTERISTIC P_PLAN_ALC_tTimeLC /end REF_CHARACTERISTIC /end GROUP
/begin GROUP S478_Subsystem1 "PubIfDecisionPLAN_MDL/PLAN/Subsystem Reference1/DangerPlausCalc/DangerPlausCalc1/Subsystem1"
 /begin REF_CHARACTERISTIC P_PLAN_DPC_ObjAxLPalpha P_PLAN_DPC_ObjDxLPalpha P_PLAN_DPC_ObjDyLPalpha P_PLAN_DPC_ObjVxLPalpha /end REF_CHARACTERISTIC
/end GROUP
/begin GROUP S479_HWALineETACalc "PubIfDecisionPLAN_MDL/PLAN/Subsystem Reference1/DangerPlausCalc/DangerPlausCalc2/HWALineETACalc" /begin REF_CHARACTERISTIC P_PLAN_ALC_tTimeLC /end REF_CHARACTERISTIC /end GROUP
/begin GROUP S479_Subsystem1 "PubIfDecisionPLAN_MDL/PLAN/Subsystem Reference1/DangerPlausCalc/DangerPlausCalc2/Subsystem1"
 /begin REF_CHARACTERISTIC P_PLAN_DPC_ObjAxLPalpha P_PLAN_DPC_ObjDxLPalpha P_PLAN_DPC_ObjDyLPalpha P_PLAN_DPC_ObjVxLPalpha /end REF_CHARACTERISTIC
/end GROUP
/begin GROUP S49_Subsystem "PubIfDecisionPLAN_MDL/PLAN/Subsystem Reference/AP/AP/IC/CurvatureOfMapCalc/Subsystem" /begin SUB_GROUP S56_LP /end SUB_GROUP /end GROUP
/begin GROUP S4_ALC "PubIfDecisionPLAN_MDL/PLAN/Subsystem Reference1/ALC"
 /begin SUB_GROUP S193_LC2APadapter S193_LcCancelFinishCalc S193_LcDrv S193_LcMrc S193_LcNoh S193_LcOverTk S193_PLAN_IPHMI /end SUB_GROUP
 /begin REF_CHARACTERISTIC P_PLAN_ALC_LcDelayCntSetNoh P_PLAN_ALC_LcDelayCntSetOverTk /end REF_CHARACTERISTIC
 /begin REF_MEASUREMENT PLAN_ALC_LcReason PLAN_ALC_sts /end REF_MEASUREMENT
/end GROUP
/begin GROUP S4_DangerPlausCalc "PubIfDecisionPLAN_MDL/PLAN/Subsystem Reference1/DangerPlausCalc"
 /begin SUB_GROUP S195_DangerPlausCalc S195_DangerPlausCalc1 S195_DangerPlausCalc2 /end SUB_GROUP
 /begin REF_CHARACTERISTIC P_PLAN_DPCswt /end REF_CHARACTERISTIC
/end GROUP
/begin GROUP S4_EPSFaultCheck "PubIfControlLATC_MDL/Subsystem Reference/Subsystem/LateralControl/EPSFaultCheck" /begin REF_MEASUREMENT LCS_EPSFault /end REF_MEASUREMENT /end GROUP
/begin GROUP S4_LCS_Angle "PubIfControlLATC_MDL/Subsystem Reference/Subsystem/LateralControl/LCS_Angle"
 /begin SUB_GROUP S9_AngSlopeCalc S9_LP_filter2 S9_LP_filter3 S9_OverRideDetect S9_Subsystem1 S9_Subsystem4 S9_TargetSteerAngleCalc /end SUB_GROUP
 /begin REF_CHARACTERISTIC P_LCS_A0_Dis_BP P_LCS_A2_LatAcc_BP P_LCS_CurAngleFiltEnable P_LCS_CurAngleFilterFC P_LCS_DangerLevel_ManualSW P_LCS_DangerLevel_ManualValue P_LCS_ESS_preDis_Nomal P_LCS_LCK_preDis_Nomal P_LCS_Offset_Switch P_LCS_PID_DrvTorqFacBp P_LCS_PID_DrvTorqFacVal P_LCS_TarAngleAddOffset_enable P_LCS_TarAngleFilterEnable P_LCS_TarAngleFilterFC_spdBp P_LCS_TarAngleFilterFC_spdVal P_LCS_TestAngleSwitch P_LCS_TestTarAngle P_LCS_preDis_ELK_Fac P_LCS_preDis_ESS_Fac P_LCS_preDis_LCK_A2Curve_Fac P_LCS_preDis_LCK_Fac P_LCS_preDis_LC_Eco_Fac P_LCS_preDis_LC_Nomal_Fac P_LCS_preDis_LC_Sport_Fac P_LCS_preDis_spd /end REF_CHARACTERISTIC
 /begin REF_MEASUREMENT LCS_ControlAngleError LCS_DangerLevelisNotESS LCS_DisplaySpd_kph LCS_ESS_TarAngle LCS_ESS_TarTorq LCS_EqA0 LCS_IN_CurSteerAngle_deg LCS_IN_SteerAngleSpd_degs LCS_IN_TarDangerLevel LCS_LCKPredis LCS_LCKPredisFac LCS_LCType LCS_LC_ELKPredis LCS_LC_ELKPredisFac LCS_LC_ESSAESPredisFac LCS_LC_ESSPredis LCS_LC_EcoPredis LCS_LC_EcoPredisFac LCS_LC_NomalPredis LCS_LC_NomalPredisFac LCS_LC_SportPredis LCS_LC_SportPredisFac LCS_Predis_BaseDis LCS_ReqEPSTrgAngle LCS_Torq_OUT LCS_finalPredis /end REF_MEASUREMENT
/end GROUP
/begin GROUP S4_Simulink_Function "PubIfDecisionLSM_MDL/Subsystem1/TargetLineCalc_20ms/Simulink Function" /begin REF_CHARACTERISTIC P_LSM_IFV2CenterAxis P_LSM_IFV2RearAxis /end REF_CHARACTERISTIC /end GROUP
/begin GROUP S4_TargetLineCalc "PubIfDecisionLSM_MDL/Subsystem1/TargetLineCalc_20ms/TargetLineCalc" /begin SUB_GROUP S15_CenLineCal1 S15_Subsystem /end SUB_GROUP
 /begin REF_CHARACTERISTIC P_LSM_ALC_Enable P_LSM_Error_Limit P_LSM_LineSTD_Limit P_LSM_NOH_Switch P_LSM_OTL_C0_Factor P_LSM_OTL_C1_Factor P_LSM_OTL_C2_Factor P_LSM_Pre_t /end REF_CHARACTERISTIC
 /begin REF_MEASUREMENT LSM_EN_C0 LSM_EN_C1 LSM_EN_C2 LSM_EN_C3 LSM_EN_Front LSM_EN_Start LSM_EN_Valid LSM_Exit_C0 LSM_Exit_C1 LSM_Exit_C2 LSM_Exit_C3 LSM_Exit_Front LSM_Exit_Start LSM_Exit_Valid LSM_L1_A0 LSM_L1_AvaliDis LSM_L1_AvaliTime LSM_L2_A0 LSM_L2_AvaliDis LSM_L2_AvaliTime LSM_L3_A0 LSM_L3_AvaliDis LSM_L3_AvaliTime LSM_L4_A0 LSM_L4_AvaliDis LSM_L4_AvaliTime LSM_LeftMostLane LSM_LockCounter LSM_LockID LSM_MoveID /end REF_MEASUREMENT
/end GROUP
/begin GROUP S4_Understeer_Offset_Calc "PubIfControlLATC_MDL/Subsystem Reference/Subsystem/LateralControl/Understeer&Offset_Calc" /begin SUB_GROUP S10_Enabled_Subsystem /end SUB_GROUP /begin REF_CHARACTERISTIC P_Global_CharSpd_ms P_Global_WheelBase_m /end REF_CHARACTERISTIC /begin REF_MEASUREMENT LCS_OffSetUpdate_Flg /end REF_MEASUREMENT /end GROUP
/begin GROUP S50_If_Action_Subsystem "PubIfDecisionPLAN_MDL/PLAN/Subsystem Reference/AP/AP/IC/CurvatureOfRoadCalc/If Action Subsystem" /begin SUB_GROUP S60_CurvatureMix /end SUB_GROUP /end GROUP
/begin GROUP S50_LP2 "PubIfDecisionPLAN_MDL/PLAN/Subsystem Reference/AP/AP/IC/CurvatureOfRoadCalc/LP2" /begin REF_MEASUREMENT LongCtrl_CurvatureOfRoad /end REF_MEASUREMENT /end GROUP
/begin GROUP S56_LP "PubIfDecisionPLAN_MDL/PLAN/Subsystem Reference/AP/AP/IC/CurvatureOfMapCalc/Subsystem/LP" /begin REF_MEASUREMENT LongCtrl_CurvatureOfMap /end REF_MEASUREMENT /end GROUP
/begin GROUP S581_Subsystem1 "PubIfStateVSM_MDL/Subsystem Reference/Subsystem/StateManage/ESS/ESS/Subsystem1" /begin SUB_GROUP S582_ESS_StateMachine /end SUB_GROUP /begin REF_MEASUREMENT VSM_ESS_SubModel_Number VSM_ESS_SubModel_VERSION /end REF_MEASUREMENT /end GROUP
/begin GROUP S582_ESS_StateMachine "PubIfStateVSM_MDL/Subsystem Reference/Subsystem/StateManage/ESS/ESS/Subsystem1/ESS_StateMachine" /begin SUB_GROUP S583_ESS_Condition /end SUB_GROUP
 /begin REF_CHARACTERISTIC P_Global_WheelBase_m P_VSM_ESS_ACtiveTime P_VSM_ESS_AngleSpdTable_deg P_VSM_ESS_SafeDistance_m P_VSM_ESS_SpdPoint_kmh P_VSM_ESS_SpdTime_s /end REF_CHARACTERISTIC
 /begin REF_MEASUREMENT VSM_ESSState VSM_ESS_LastPoint VSM_ESS_PedSwtReq VSM_ESS_Sensor_idle2error VSM_ESS_VehCnfgESS VSM_ESS_VehSwtReq /end REF_MEASUREMENT
/end GROUP
/begin GROUP S6_axvTracActMean_calc "PubIfControlLONC_MDL/Subsystem/VLC/Vlc/axvTracActMean_calc" /begin REF_CHARACTERISTIC P_Global_TireRadius_m /end REF_CHARACTERISTIC /end GROUP
/begin GROUP S6_axvTracMin_calc "PubIfControlLONC_MDL/Subsystem/VLC/Vlc/axvTracMin_calc" /begin REF_CHARACTERISTIC P_Global_TireRadius_m /end REF_CHARACTERISTIC /end GROUP
/begin GROUP S6_EC "PubIfControlLONC_MDL/Subsystem/VLC/Vlc/EC" /begin REF_CHARACTERISTIC P_Global_TireRadius_m /end REF_CHARACTERISTIC /end GROUP
/begin GROUP S6_FF_Control "PubIfControlLONC_MDL/Subsystem/VLC/Vlc/FF_Control" /begin REF_CHARACTERISTIC P_Global_TireRadius_m /end REF_CHARACTERISTIC /end GROUP
/begin GROUP S6_PI_Control "PubIfControlLONC_MDL/Subsystem/VLC/Vlc/PI_Control" /begin REF_CHARACTERISTIC P_Global_TireRadius_m /end REF_CHARACTERISTIC /end GROUP
/begin GROUP S735_OverTaking "PubIfStateVSM_MDL/Subsystem Reference/Subsystem/StateManage/LSS/LCK_LKA_LDW_ELKStateMachine3/ELKState_Machine/ELK/ELK_OnComing_OverTaking/OverTaking" /begin REF_CHARACTERISTIC P_Global_DxvRearBumper_m /end REF_CHARACTERISTIC /end GROUP
/begin GROUP S7_VxvRef_Calc "PubIfCommonVIE_MDL/VIE/VIE/VxvRef_Calc/VxvRef_Calc" /begin REF_CHARACTERISTIC P_Global_CharSpd_ms P_Global_WheelBase_m /end REF_CHARACTERISTIC /end GROUP
/begin GROUP S80_Virtual_target_and_desired_distance "PubIfDecisionPLAN_MDL/PLAN/Subsystem Reference/AP/AP/LCObjChoose+FollowCtrl/LaneChangeObjectChoose/Virtual target and desired distance"
 /begin REF_CHARACTERISTIC P_Global_DxvRearBumper_m P_PLAN_DPC_BrkPointDxFactorF3 P_PLAN_DPC_BrkPointDxFactorR3 P_PLAN_DPC_MaxObjNum /end REF_CHARACTERISTIC
/end GROUP
/begin GROUP S9_AngSlopeCalc "PubIfControlLATC_MDL/Subsystem Reference/Subsystem/LateralControl/LCS_Angle/AngSlopeCalc" /begin REF_CHARACTERISTIC P_LCS_A0_Dis_BP /end REF_CHARACTERISTIC /end GROUP
/begin GROUP S9_TargetSteerAngleCalc "PubIfControlLATC_MDL/Subsystem Reference/Subsystem/LateralControl/LCS_Angle/TargetSteerAngleCalc" /begin REF_CHARACTERISTIC P_Global_CharSpd_ms P_Global_WheelBase_m /end REF_CHARACTERISTIC /end GROUP
/begin RECORD_LAYOUT Lookup1D_FLOAT32_IEEE FNC_VALUES 1 FLOAT32_IEEE ROW_DIR DIRECT /end RECORD_LAYOUT
/begin RECORD_LAYOUT Lookup1D_X_FLOAT32_IEEE AXIS_PTS_X 1 FLOAT32_IEEE INDEX_INCR DIRECT /end RECORD_LAYOUT
/begin RECORD_LAYOUT Lookup2D_BYTE FNC_VALUES 1 SBYTE ROW_DIR DIRECT /end RECORD_LAYOUT
/begin RECORD_LAYOUT Lookup2D_FLOAT32_IEEE FNC_VALUES 1 FLOAT32_IEEE ROW_DIR DIRECT /end RECORD_LAYOUT
/begin RECORD_LAYOUT Lookup2D_FLOAT64_IEEE FNC_VALUES 1 FLOAT64_IEEE ROW_DIR DIRECT /end RECORD_LAYOUT
/begin RECORD_LAYOUT Lookup2D_LONG FNC_VALUES 1 SLONG ROW_DIR DIRECT /end RECORD_LAYOUT
/begin RECORD_LAYOUT Lookup2D_UBYTE FNC_VALUES 1 UBYTE ROW_DIR DIRECT /end RECORD_LAYOUT
/begin RECORD_LAYOUT Lookup2D_ULONG FNC_VALUES 1 ULONG ROW_DIR DIRECT /end RECORD_LAYOUT
/begin RECORD_LAYOUT Lookup2D_UWORD FNC_VALUES 1 UWORD ROW_DIR DIRECT /end RECORD_LAYOUT
/begin RECORD_LAYOUT Lookup2D_WORD FNC_VALUES 1 SWORD ROW_DIR DIRECT /end RECORD_LAYOUT
/begin RECORD_LAYOUT Lookup2D_X_BOOLEAN AXIS_PTS_X 1 UBYTE INDEX_INCR DIRECT /end RECORD_LAYOUT
/begin RECORD_LAYOUT Lookup2D_X_BYTE AXIS_PTS_X 1 SBYTE INDEX_INCR DIRECT /end RECORD_LAYOUT
/begin RECORD_LAYOUT Lookup2D_X_FLOAT32_IEEE AXIS_PTS_X 1 FLOAT32_IEEE INDEX_INCR DIRECT /end RECORD_LAYOUT
/begin RECORD_LAYOUT Lookup2D_X_LONG AXIS_PTS_X 1 SLONG INDEX_INCR DIRECT /end RECORD_LAYOUT
/begin RECORD_LAYOUT Lookup2D_X_ULONG AXIS_PTS_X 1 ULONG INDEX_INCR DIRECT /end RECORD_LAYOUT
/begin RECORD_LAYOUT Lookup2D_X_UWORD AXIS_PTS_X 1 UWORD INDEX_INCR DIRECT /end RECORD_LAYOUT
/begin RECORD_LAYOUT Lookup2D_X_WORD AXIS_PTS_X 1 SWORD INDEX_INCR DIRECT /end RECORD_LAYOUT
/begin RECORD_LAYOUT Scalar_BOOLEAN FNC_VALUES 1 UBYTE ROW_DIR DIRECT /end RECORD_LAYOUT
/begin RECORD_LAYOUT Scalar_BYTE FNC_VALUES 1 SBYTE ROW_DIR DIRECT /end RECORD_LAYOUT
/begin RECORD_LAYOUT Scalar_FLOAT32_IEEE FNC_VALUES 1 FLOAT32_IEEE ROW_DIR DIRECT /end RECORD_LAYOUT
/begin RECORD_LAYOUT Scalar_FLOAT64_IEEE FNC_VALUES 1 FLOAT64_IEEE ROW_DIR DIRECT /end RECORD_LAYOUT
/begin RECORD_LAYOUT Scalar_LONG FNC_VALUES 1 SLONG ROW_DIR DIRECT /end RECORD_LAYOUT
/begin RECORD_LAYOUT Scalar_UBYTE FNC_VALUES 1 UBYTE ROW_DIR DIRECT /end RECORD_LAYOUT
/begin RECORD_LAYOUT Scalar_ULONG FNC_VALUES 1 ULONG ROW_DIR DIRECT /end RECORD_LAYOUT
/begin RECORD_LAYOUT Scalar_UWORD FNC_VALUES 1 UWORD ROW_DIR DIRECT /end RECORD_LAYOUT
/begin RECORD_LAYOUT __UBYTE_Z FNC_VALUES 1 UBYTE ROW_DIR DIRECT /end RECORD_LAYOUT
/begin RECORD_LAYOUT __UWORD_Z FNC_VALUES 1 UWORD ROW_DIR DIRECT /end RECORD_LAYOUT
/begin RECORD_LAYOUT __ULONG_Z FNC_VALUES 1 ULONG ROW_DIR DIRECT /end RECORD_LAYOUT
/begin RECORD_LAYOUT __SBYTE_Z FNC_VALUES 1 SBYTE ROW_DIR DIRECT /end RECORD_LAYOUT
/begin RECORD_LAYOUT __SWORD_Z FNC_VALUES 1 SWORD ROW_DIR DIRECT /end RECORD_LAYOUT
/begin RECORD_LAYOUT __SLONG_Z FNC_VALUES 1 SLONG ROW_DIR DIRECT /end RECORD_LAYOUT
/begin RECORD_LAYOUT __FLOAT32_IEEE_Z FNC_VALUES 1 FLOAT32_IEEE ROW_DIR DIRECT /end RECORD_LAYOUT
/begin RECORD_LAYOUT __FLOAT64_IEEE_Z FNC_VALUES 1 FLOAT64_IEEE ROW_DIR DIRECT /end RECORD_LAYOUT
/end MODULE
/end PROJECT
