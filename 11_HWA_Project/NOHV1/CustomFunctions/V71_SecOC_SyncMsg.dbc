VERSION ""

NS_ :

BS_:

BU_: DSPACE

BO_ 1121 SecOC_SyncMsg: 16 Vector__XXX
 SG_ resetCnt : 31|16@0+ (1,0) [0|0] ""  DSPACE
 SG_ tripCnt : 7|24@0+ (1,0) [0|0] ""  DSPACE

BA_DEF_ BO_  "CANFD_BRS" ENUM  "0","1";
BA_DEF_  "DBName" STRING ;
BA_DEF_  "BusType" STRING ;
BA_DEF_ BO_  "VFrameFormat" ENUM  "StandardCAN","ExtendedCAN","reserved","reserved","reserved","reserved","reserved","reserved","reserved","reserved","reserved","reserved","reserved","reserved","StandardCAN_FD","ExtendedCAN_FD";
BA_DEF_DEF_  "CANFD_BRS" "1";
BA_DEF_DEF_  "DBName" "";
BA_DEF_DEF_  "BusType" "";
BA_DEF_DEF_  "VFrameFormat" "StandardCAN";
BA_ "BusType" "CAN FD";
BA_ "DBName" "V71_SecOC_SyncMsg";
BA_ "VFrameFormat" BO_ 1121 14;
