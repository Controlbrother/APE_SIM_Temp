/*
* ASAP2 file: PubIfControlLATC_MDL.a2l
* Copyright 2022, dSPACE GmbH. All rights reserved.
*/ ASAP2_VERSION 1 61
/* Version 1.61 */
/begin PROJECT PubIfControlLATC_MDL ""
/begin HEADER "" VERSION "3.732" PROJECT_NO PubIfControlLATC_MDL /end HEADER
/begin MODULE PubIfControlLATC_MDL ""
/begin RECORD_LAYOUT Scalar_BOOLEAN FNC_VALUES 1 UBYTE ROW_DIR DIRECT /end RECORD_LAYOUT
/begin RECORD_LAYOUT Scalar_UBYTE FNC_VALUES 1 UBYTE ROW_DIR DIRECT /end RECORD_LAYOUT
/begin RECORD_LAYOUT Scalar_BYTE FNC_VALUES 1 SBYTE ROW_DIR DIRECT /end RECORD_LAYOUT
/begin RECORD_LAYOUT Scalar_UWORD FNC_VALUES 1 UWORD ROW_DIR DIRECT /end RECORD_LAYOUT
/begin RECORD_LAYOUT Scalar_SWORD FNC_VALUES 1 SWORD ROW_DIR DIRECT /end RECORD_LAYOUT
/begin RECORD_LAYOUT Scalar_ULONG FNC_VALUES 1 ULONG ROW_DIR DIRECT /end RECORD_LAYOUT
/begin RECORD_LAYOUT Scalar_LONG FNC_VALUES 1 SLONG ROW_DIR DIRECT /end RECORD_LAYOUT
/begin RECORD_LAYOUT Scalar_FLOAT32_IEEE FNC_VALUES 1 FLOAT32_IEEE ROW_DIR DIRECT /end RECORD_LAYOUT
/begin RECORD_LAYOUT Scalar_FLOAT64_IEEE FNC_VALUES 1 FLOAT64_IEEE ROW_DIR DIRECT /end RECORD_LAYOUT
/begin RECORD_LAYOUT Lookup1D_BOOLEAN FNC_VALUES 1 UBYTE ROW_DIR DIRECT /end RECORD_LAYOUT
/begin RECORD_LAYOUT Lookup1D_BYTE FNC_VALUES 1 SBYTE ROW_DIR DIRECT /end RECORD_LAYOUT
/begin RECORD_LAYOUT Lookup1D_UBYTE FNC_VALUES 1 UBYTE ROW_DIR DIRECT /end RECORD_LAYOUT
/begin RECORD_LAYOUT Lookup1D_UWORD FNC_VALUES 1 UWORD ROW_DIR DIRECT /end RECORD_LAYOUT
/begin RECORD_LAYOUT Lookup1D_WORD FNC_VALUES 1 SWORD ROW_DIR DIRECT /end RECORD_LAYOUT
/begin RECORD_LAYOUT Lookup1D_ULONG FNC_VALUES 1 ULONG ROW_DIR DIRECT /end RECORD_LAYOUT
/begin RECORD_LAYOUT Lookup1D_LONG FNC_VALUES 1 SLONG ROW_DIR DIRECT /end RECORD_LAYOUT
/begin RECORD_LAYOUT Lookup1D_FLOAT32_IEEE FNC_VALUES 1 FLOAT32_IEEE ROW_DIR DIRECT /end RECORD_LAYOUT
/begin RECORD_LAYOUT Lookup1D_FLOAT64_IEEE FNC_VALUES 1 FLOAT64_IEEE ROW_DIR DIRECT /end RECORD_LAYOUT
/begin RECORD_LAYOUT Lookup1D_X_BOOLEAN AXIS_PTS_X 1 UBYTE INDEX_INCR DIRECT /end RECORD_LAYOUT
/begin RECORD_LAYOUT Lookup1D_X_BYTE AXIS_PTS_X 1 SBYTE INDEX_INCR DIRECT /end RECORD_LAYOUT
/begin RECORD_LAYOUT Lookup1D_X_UBYTE AXIS_PTS_X 1 UBYTE INDEX_INCR DIRECT /end RECORD_LAYOUT
/begin RECORD_LAYOUT Lookup1D_X_UWORD AXIS_PTS_X 1 UWORD INDEX_INCR DIRECT /end RECORD_LAYOUT
/begin RECORD_LAYOUT Lookup1D_X_WORD AXIS_PTS_X 1 SWORD INDEX_INCR DIRECT /end RECORD_LAYOUT
/begin RECORD_LAYOUT Lookup1D_X_ULONG AXIS_PTS_X 1 ULONG INDEX_INCR DIRECT /end RECORD_LAYOUT
/begin RECORD_LAYOUT Lookup1D_X_LONG AXIS_PTS_X 1 SLONG INDEX_INCR DIRECT /end RECORD_LAYOUT
/begin RECORD_LAYOUT Lookup1D_X_FLOAT32_IEEE AXIS_PTS_X 1 FLOAT32_IEEE INDEX_INCR DIRECT /end RECORD_LAYOUT
/begin RECORD_LAYOUT Lookup1D_X_FLOAT64_IEEE AXIS_PTS_X 1 FLOAT64_IEEE INDEX_INCR DIRECT /end RECORD_LAYOUT
/begin RECORD_LAYOUT Lookup2D_BOOLEAN FNC_VALUES 1 UBYTE ROW_DIR DIRECT /end RECORD_LAYOUT
/begin RECORD_LAYOUT Lookup2D_UBYTE FNC_VALUES 1 UBYTE ROW_DIR DIRECT /end RECORD_LAYOUT
/begin RECORD_LAYOUT Lookup2D_BYTE FNC_VALUES 1 SBYTE ROW_DIR DIRECT /end RECORD_LAYOUT
/begin RECORD_LAYOUT Lookup2D_UWORD FNC_VALUES 1 UWORD ROW_DIR DIRECT /end RECORD_LAYOUT
/begin RECORD_LAYOUT Lookup2D_WORD FNC_VALUES 1 SWORD ROW_DIR DIRECT /end RECORD_LAYOUT
/begin RECORD_LAYOUT Lookup2D_ULONG FNC_VALUES 1 ULONG ROW_DIR DIRECT /end RECORD_LAYOUT
/begin RECORD_LAYOUT Lookup2D_LONG FNC_VALUES 1 SLONG ROW_DIR DIRECT /end RECORD_LAYOUT
/begin RECORD_LAYOUT Lookup2D_FLOAT32_IEEE FNC_VALUES 1 FLOAT32_IEEE ROW_DIR DIRECT /end RECORD_LAYOUT
/begin RECORD_LAYOUT Lookup2D_FLOAT64_IEEE FNC_VALUES 1 FLOAT64_IEEE ROW_DIR DIRECT /end RECORD_LAYOUT
/begin RECORD_LAYOUT Lookup2D_X_BOOLEAN AXIS_PTS_X 1 UBYTE INDEX_INCR DIRECT /end RECORD_LAYOUT
/begin RECORD_LAYOUT Lookup2D_X_UBYTE AXIS_PTS_X 1 UBYTE INDEX_INCR DIRECT /end RECORD_LAYOUT
/begin RECORD_LAYOUT Lookup2D_X_BYTE AXIS_PTS_X 1 SBYTE INDEX_INCR DIRECT /end RECORD_LAYOUT
/begin RECORD_LAYOUT Lookup2D_X_UWORD AXIS_PTS_X 1 UWORD INDEX_INCR DIRECT /end RECORD_LAYOUT
/begin RECORD_LAYOUT Lookup2D_X_WORD AXIS_PTS_X 1 SWORD INDEX_INCR DIRECT /end RECORD_LAYOUT
/begin RECORD_LAYOUT Lookup2D_X_ULONG AXIS_PTS_X 1 ULONG INDEX_INCR DIRECT /end RECORD_LAYOUT
/begin RECORD_LAYOUT Lookup2D_X_LONG AXIS_PTS_X 1 SLONG INDEX_INCR DIRECT /end RECORD_LAYOUT
/begin RECORD_LAYOUT Lookup2D_X_FLOAT32_IEEE AXIS_PTS_X 1 FLOAT32_IEEE INDEX_INCR DIRECT /end RECORD_LAYOUT
/begin RECORD_LAYOUT Lookup2D_X_FLOAT64_IEEE AXIS_PTS_X 1 FLOAT64_IEEE INDEX_INCR DIRECT /end RECORD_LAYOUT
/begin CHARACTERISTIC P_LCS_ESS_SteerAngleErr "" CURVE 0x0 /* @MemoryAddress@P_LCS_ESS_SteerAngleErr@ */ Lookup1D_FLOAT32_IEEE 0 PubIfControlLATC_MDL_CM_single -3.4E+38 3.4E+38
 /begin AXIS_DESCR COM_AXIS NO_INPUT_QUANTITY PubIfControlLATC_MDL_CM_single 12 -3.4E+38 3.4E+38 AXIS_PTS_REF P_LCS_LATC_VehicleSpd_TabX_Kph /end AXIS_DESCR
/end CHARACTERISTIC
/begin AXIS_PTS P_LCS_LATC_VehicleSpd_TabX_Kph "" 0x0 /* @MemoryAddress@P_LCS_LATC_VehicleSpd_TabX_Kph@ */ NO_INPUT_QUANTITY Lookup1D_X_FLOAT32_IEEE 0 PubIfControlLATC_MDL_CM_single 12 -3.4E+38 3.4E+38 /end AXIS_PTS
/begin CHARACTERISTIC P_LCS_LATC_MPCMatrixQ1_st "" CURVE 0x0 /* @MemoryAddress@P_LCS_LATC_MPCMatrixQ1_st@ */ Lookup1D_FLOAT32_IEEE 0 PubIfControlLATC_MDL_CM_single -3.4E+38 3.4E+38
 /begin AXIS_DESCR COM_AXIS LCS_IN_Spd_Kph PubIfControlLATC_MDL_CM_single 16 -3.4E+38 3.4E+38 AXIS_PTS_REF P_LCS_VehicleSpd_TabX_Kph /end AXIS_DESCR
/end CHARACTERISTIC
/begin AXIS_PTS P_LCS_VehicleSpd_TabX_Kph "" 0x0 /* @MemoryAddress@P_LCS_VehicleSpd_TabX_Kph@ */ LCS_IN_Spd_Kph Lookup1D_X_FLOAT32_IEEE 0 PubIfControlLATC_MDL_CM_single 16 -3.4E+38 3.4E+38 /end AXIS_PTS
/begin CHARACTERISTIC P_LCS_LATC_MPCMatrixQ2_st "" CURVE 0x0 /* @MemoryAddress@P_LCS_LATC_MPCMatrixQ2_st@ */ Lookup1D_FLOAT32_IEEE 0 PubIfControlLATC_MDL_CM_single -3.4E+38 3.4E+38
 /begin AXIS_DESCR COM_AXIS LCS_IN_Spd_Kph PubIfControlLATC_MDL_CM_single 16 -3.4E+38 3.4E+38 AXIS_PTS_REF P_LCS_VehicleSpd_TabX_Kph /end AXIS_DESCR
/end CHARACTERISTIC
/begin CHARACTERISTIC P_LCS_LATC_MPCMatrixR_st "" CURVE 0x0 /* @MemoryAddress@P_LCS_LATC_MPCMatrixR_st@ */ Lookup1D_FLOAT32_IEEE 0 PubIfControlLATC_MDL_CM_single -3.4E+38 3.4E+38
 /begin AXIS_DESCR COM_AXIS LCS_IN_Spd_Kph PubIfControlLATC_MDL_CM_single 16 -3.4E+38 3.4E+38 AXIS_PTS_REF P_LCS_VehicleSpd_TabX_Kph /end AXIS_DESCR
/end CHARACTERISTIC
/begin CHARACTERISTIC P_LCS_LATC_ELKAngleSlope_ratio "" CURVE 0x0 /* @MemoryAddress@P_LCS_LATC_ELKAngleSlope_ratio@ */ Lookup1D_FLOAT32_IEEE 0 PubIfControlLATC_MDL_CM_single -3.4E+38 3.4E+38
 /begin AXIS_DESCR COM_AXIS LCS_IN_Spd_Kph PubIfControlLATC_MDL_CM_single 16 -3.4E+38 3.4E+38 AXIS_PTS_REF P_LCS_VehicleSpd_TabX_Kph /end AXIS_DESCR
/end CHARACTERISTIC
/begin CHARACTERISTIC P_LCS_LATC_ELKMaxLatAcc_ms2 "" CURVE 0x0 /* @MemoryAddress@P_LCS_LATC_ELKMaxLatAcc_ms2@ */ Lookup1D_FLOAT32_IEEE 0 PubIfControlLATC_MDL_CM_single -3.4E+38 3.4E+38
 /begin AXIS_DESCR COM_AXIS LCS_IN_Spd_Kph PubIfControlLATC_MDL_CM_single 16 -3.4E+38 3.4E+38 AXIS_PTS_REF P_LCS_VehicleSpd_TabX_Kph /end AXIS_DESCR
/end CHARACTERISTIC
/begin CHARACTERISTIC P_LCS_LATC_ESSAngleSlope_ratio "" CURVE 0x0 /* @MemoryAddress@P_LCS_LATC_ESSAngleSlope_ratio@ */ Lookup1D_FLOAT32_IEEE 0 PubIfControlLATC_MDL_CM_single -3.4E+38 3.4E+38
 /begin AXIS_DESCR COM_AXIS LCS_IN_Spd_Kph PubIfControlLATC_MDL_CM_single 16 -3.4E+38 3.4E+38 AXIS_PTS_REF P_LCS_VehicleSpd_TabX_Kph /end AXIS_DESCR
/end CHARACTERISTIC
/begin CHARACTERISTIC P_LCS_LATC_ESSMaxLatAcc_ms2 "" CURVE 0x0 /* @MemoryAddress@P_LCS_LATC_ESSMaxLatAcc_ms2@ */ Lookup1D_FLOAT32_IEEE 0 PubIfControlLATC_MDL_CM_single -3.4E+38 3.4E+38
 /begin AXIS_DESCR COM_AXIS LCS_IN_Spd_Kph PubIfControlLATC_MDL_CM_single 16 -3.4E+38 3.4E+38 AXIS_PTS_REF P_LCS_VehicleSpd_TabX_Kph /end AXIS_DESCR
/end CHARACTERISTIC
/begin CHARACTERISTIC P_LCS_LATC_LCAngleSlope_ratio "" CURVE 0x0 /* @MemoryAddress@P_LCS_LATC_LCAngleSlope_ratio@ */ Lookup1D_FLOAT32_IEEE 0 PubIfControlLATC_MDL_CM_single -3.4E+38 3.4E+38
 /begin AXIS_DESCR COM_AXIS LCS_IN_Spd_Kph PubIfControlLATC_MDL_CM_single 16 -3.4E+38 3.4E+38 AXIS_PTS_REF P_LCS_VehicleSpd_TabX_Kph /end AXIS_DESCR
/end CHARACTERISTIC
/begin CHARACTERISTIC P_LCS_LATC_LCEcoAngleSlope_ratio "" CURVE 0x0 /* @MemoryAddress@P_LCS_LATC_LCEcoAngleSlope_ratio@ */ Lookup1D_FLOAT32_IEEE 0 PubIfControlLATC_MDL_CM_single -3.4E+38 3.4E+38
 /begin AXIS_DESCR COM_AXIS LCS_IN_Spd_Kph PubIfControlLATC_MDL_CM_single 16 -3.4E+38 3.4E+38 AXIS_PTS_REF P_LCS_VehicleSpd_TabX_Kph /end AXIS_DESCR
/end CHARACTERISTIC
/begin CHARACTERISTIC P_LCS_LATC_LCNormalAngleSlope_ratio "" CURVE 0x0 /* @MemoryAddress@P_LCS_LATC_LCNormalAngleSlope_ratio@ */ Lookup1D_FLOAT32_IEEE 0 PubIfControlLATC_MDL_CM_single -3.4E+38 3.4E+38
 /begin AXIS_DESCR COM_AXIS LCS_IN_Spd_Kph PubIfControlLATC_MDL_CM_single 16 -3.4E+38 3.4E+38 AXIS_PTS_REF P_LCS_VehicleSpd_TabX_Kph /end AXIS_DESCR
/end CHARACTERISTIC
/begin CHARACTERISTIC P_LCS_LATC_LCSportAngleSlope_ratio "" CURVE 0x0 /* @MemoryAddress@P_LCS_LATC_LCSportAngleSlope_ratio@ */ Lookup1D_FLOAT32_IEEE 0 PubIfControlLATC_MDL_CM_single -3.4E+38 3.4E+38
 /begin AXIS_DESCR COM_AXIS LCS_IN_Spd_Kph PubIfControlLATC_MDL_CM_single 16 -3.4E+38 3.4E+38 AXIS_PTS_REF P_LCS_VehicleSpd_TabX_Kph /end AXIS_DESCR
/end CHARACTERISTIC
/begin CHARACTERISTIC P_LCS_LATC_LCKIEMaxLatAcc_ms2 "" CURVE 0x0 /* @MemoryAddress@P_LCS_LATC_LCKIEMaxLatAcc_ms2@ */ Lookup1D_FLOAT32_IEEE 0 PubIfControlLATC_MDL_CM_single -3.4E+38 3.4E+38
 /begin AXIS_DESCR COM_AXIS LCS_IN_Spd_Kph PubIfControlLATC_MDL_CM_single 16 -3.4E+38 3.4E+38 AXIS_PTS_REF P_LCS_VehicleSpd_TabX_Kph /end AXIS_DESCR
/end CHARACTERISTIC
/begin CHARACTERISTIC P_LCS_LATC_LCKIEAngleSlope_ratio "" CURVE 0x0 /* @MemoryAddress@P_LCS_LATC_LCKIEAngleSlope_ratio@ */ Lookup1D_FLOAT32_IEEE 0 PubIfControlLATC_MDL_CM_single -3.4E+38 3.4E+38
 /begin AXIS_DESCR COM_AXIS LCS_IN_Spd_Kph PubIfControlLATC_MDL_CM_single 16 -3.4E+38 3.4E+38 AXIS_PTS_REF P_LCS_VehicleSpd_TabX_Kph /end AXIS_DESCR
/end CHARACTERISTIC
/begin CHARACTERISTIC P_LCS_LATC_LCKMaxLatAcc_ms2 "" CURVE 0x0 /* @MemoryAddress@P_LCS_LATC_LCKMaxLatAcc_ms2@ */ Lookup1D_FLOAT32_IEEE 0 PubIfControlLATC_MDL_CM_single -3.4E+38 3.4E+38
 /begin AXIS_DESCR COM_AXIS LCS_IN_Spd_Kph PubIfControlLATC_MDL_CM_single 16 -3.4E+38 3.4E+38 AXIS_PTS_REF P_LCS_VehicleSpd_TabX_Kph /end AXIS_DESCR
/end CHARACTERISTIC
/begin CHARACTERISTIC P_LCS_LATC_LCNormalMaxLatAcc_ms2 "" CURVE 0x0 /* @MemoryAddress@P_LCS_LATC_LCNormalMaxLatAcc_ms2@ */ Lookup1D_FLOAT32_IEEE 0 PubIfControlLATC_MDL_CM_single -3.4E+38 3.4E+38
 /begin AXIS_DESCR COM_AXIS LCS_IN_Spd_Kph PubIfControlLATC_MDL_CM_single 16 -3.4E+38 3.4E+38 AXIS_PTS_REF P_LCS_VehicleSpd_TabX_Kph /end AXIS_DESCR
/end CHARACTERISTIC
/begin CHARACTERISTIC P_LCS_LATC_LCCancleMaxLatAcc_ms2 "" CURVE 0x0 /* @MemoryAddress@P_LCS_LATC_LCCancleMaxLatAcc_ms2@ */ Lookup1D_FLOAT32_IEEE 0 PubIfControlLATC_MDL_CM_single -3.4E+38 3.4E+38
 /begin AXIS_DESCR COM_AXIS LCS_IN_Spd_Kph PubIfControlLATC_MDL_CM_single 16 -3.4E+38 3.4E+38 AXIS_PTS_REF P_LCS_VehicleSpd_TabX_Kph /end AXIS_DESCR
/end CHARACTERISTIC
/begin CHARACTERISTIC P_LCS_LATC_LCEcoMaxLatAcc_ms2 "" CURVE 0x0 /* @MemoryAddress@P_LCS_LATC_LCEcoMaxLatAcc_ms2@ */ Lookup1D_FLOAT32_IEEE 0 PubIfControlLATC_MDL_CM_single -3.4E+38 3.4E+38
 /begin AXIS_DESCR COM_AXIS LCS_IN_Spd_Kph PubIfControlLATC_MDL_CM_single 16 -3.4E+38 3.4E+38 AXIS_PTS_REF P_LCS_VehicleSpd_TabX_Kph /end AXIS_DESCR
/end CHARACTERISTIC
/begin CHARACTERISTIC P_LCS_LATC_LCSportMaxLatAcc_ms2 "" CURVE 0x0 /* @MemoryAddress@P_LCS_LATC_LCSportMaxLatAcc_ms2@ */ Lookup1D_FLOAT32_IEEE 0 PubIfControlLATC_MDL_CM_single -3.4E+38 3.4E+38
 /begin AXIS_DESCR COM_AXIS LCS_IN_Spd_Kph PubIfControlLATC_MDL_CM_single 16 -3.4E+38 3.4E+38 AXIS_PTS_REF P_LCS_VehicleSpd_TabX_Kph /end AXIS_DESCR
/end CHARACTERISTIC
/begin CHARACTERISTIC P_LCS_LATC_LKAAngleSlope_ratio "" CURVE 0x0 /* @MemoryAddress@P_LCS_LATC_LKAAngleSlope_ratio@ */ Lookup1D_FLOAT32_IEEE 0 PubIfControlLATC_MDL_CM_single -3.4E+38 3.4E+38
 /begin AXIS_DESCR COM_AXIS LCS_IN_Spd_Kph PubIfControlLATC_MDL_CM_single 16 -3.4E+38 3.4E+38 AXIS_PTS_REF P_LCS_VehicleSpd_TabX_Kph /end AXIS_DESCR
/end CHARACTERISTIC
/begin CHARACTERISTIC P_LCS_LATC_LKAMaxLatAcc_ms2 "" CURVE 0x0 /* @MemoryAddress@P_LCS_LATC_LKAMaxLatAcc_ms2@ */ Lookup1D_FLOAT32_IEEE 0 PubIfControlLATC_MDL_CM_single -3.4E+38 3.4E+38
 /begin AXIS_DESCR COM_AXIS LCS_IN_Spd_Kph PubIfControlLATC_MDL_CM_single 16 -3.4E+38 3.4E+38 AXIS_PTS_REF P_LCS_VehicleSpd_TabX_Kph /end AXIS_DESCR
/end CHARACTERISTIC
/begin CHARACTERISTIC P_LCS_LATC_LCKAngleSlope_ratio "" CURVE 0x0 /* @MemoryAddress@P_LCS_LATC_LCKAngleSlope_ratio@ */ Lookup1D_FLOAT32_IEEE 0 PubIfControlLATC_MDL_CM_single -3.4E+38 3.4E+38
 /begin AXIS_DESCR COM_AXIS LCS_IN_Spd_Kph PubIfControlLATC_MDL_CM_single 16 -3.4E+38 3.4E+38 AXIS_PTS_REF P_LCS_VehicleSpd_TabX_Kph /end AXIS_DESCR
/end CHARACTERISTIC
/begin CHARACTERISTIC P_LCS_PLAN_LCPreDisFac_ratio "" MAP 0x0 /* @MemoryAddress@P_LCS_PLAN_LCPreDisFac_ratio@ */ Lookup2D_FLOAT32_IEEE 0 PubIfControlLATC_MDL_CM_single -3.4E+38 3.4E+38
 /begin AXIS_DESCR COM_AXIS NO_INPUT_QUANTITY PubIfControlLATC_MDL_CM_single 3 -3.4E+38 3.4E+38 AXIS_PTS_REF P_LCS_PLAN_TarDangerlLevel_Tabx_st /end AXIS_DESCR
 /begin AXIS_DESCR COM_AXIS NO_INPUT_QUANTITY PubIfControlLATC_MDL_CM_single 7 -3.4E+38 3.4E+38 AXIS_PTS_REF P_LCS_PLAN_DesLineA0_TabY_m /end AXIS_DESCR
/end CHARACTERISTIC
/begin AXIS_PTS P_LCS_PLAN_TarDangerlLevel_Tabx_st "" 0x0 /* @MemoryAddress@P_LCS_PLAN_TarDangerlLevel_Tabx_st@ */ NO_INPUT_QUANTITY Lookup2D_X_FLOAT32_IEEE 0 PubIfControlLATC_MDL_CM_single 3 -3.4E+38 3.4E+38 /end AXIS_PTS
/begin AXIS_PTS P_LCS_PLAN_DesLineA0_TabY_m "" 0x0 /* @MemoryAddress@P_LCS_PLAN_DesLineA0_TabY_m@ */ NO_INPUT_QUANTITY Lookup2D_X_FLOAT32_IEEE 0 PubIfControlLATC_MDL_CM_single 7 -3.4E+38 3.4E+38 /end AXIS_PTS
/begin CHARACTERISTIC P_LCS_Plan_LCNomalAyDtLimit_Tab_ms3 "" MAP 0x0 /* @MemoryAddress@P_LCS_Plan_LCNomalAyDtLimit_Tab_ms3@ */ Lookup2D_FLOAT32_IEEE 0 PubIfControlLATC_MDL_CM_single -3.4E+38 3.4E+38
 /begin AXIS_DESCR COM_AXIS LCS_PreDisCurve_m PubIfControlLATC_MDL_CM_single 13 -3.4E+38 3.4E+38 AXIS_PTS_REF P_LCS_PLAN_PreDisCurve_TabX_m /end AXIS_DESCR
 /begin AXIS_DESCR COM_AXIS LCS_IN_Spd_Kph PubIfControlLATC_MDL_CM_single 16 -3.4E+38 3.4E+38 AXIS_PTS_REF P_LCS_PLAN_VehicleSpd_TabY_Kph /end AXIS_DESCR
/end CHARACTERISTIC
/begin AXIS_PTS P_LCS_PLAN_PreDisCurve_TabX_m "" 0x0 /* @MemoryAddress@P_LCS_PLAN_PreDisCurve_TabX_m@ */ LCS_PreDisCurve_m Lookup2D_X_FLOAT32_IEEE 0 PubIfControlLATC_MDL_CM_single 13 -3.4E+38 3.4E+38 /end AXIS_PTS
/begin AXIS_PTS P_LCS_PLAN_VehicleSpd_TabY_Kph "" 0x0 /* @MemoryAddress@P_LCS_PLAN_VehicleSpd_TabY_Kph@ */ LCS_IN_Spd_Kph Lookup2D_X_FLOAT32_IEEE 0 PubIfControlLATC_MDL_CM_single 16 -3.4E+38 3.4E+38 /end AXIS_PTS
/begin CHARACTERISTIC P_LCS_PLAN_LCKAyDtLimit_Tab_ms3 "" MAP 0x0 /* @MemoryAddress@P_LCS_PLAN_LCKAyDtLimit_Tab_ms3@ */ Lookup2D_FLOAT32_IEEE 0 PubIfControlLATC_MDL_CM_single -3.4E+38 3.4E+38
 /begin AXIS_DESCR COM_AXIS LCS_PreDisCurve_m PubIfControlLATC_MDL_CM_single 13 -3.4E+38 3.4E+38 AXIS_PTS_REF P_LCS_PLAN_PreDisCurve_TabX_m /end AXIS_DESCR
 /begin AXIS_DESCR COM_AXIS LCS_IN_Spd_Kph PubIfControlLATC_MDL_CM_single 16 -3.4E+38 3.4E+38 AXIS_PTS_REF P_LCS_PLAN_VehicleSpd_TabY_Kph /end AXIS_DESCR
/end CHARACTERISTIC
/begin CHARACTERISTIC P_LCS_Plan_LKAAyDtLimit_Tab_ms3 "" MAP 0x0 /* @MemoryAddress@P_LCS_Plan_LKAAyDtLimit_Tab_ms3@ */ Lookup2D_FLOAT32_IEEE 0 PubIfControlLATC_MDL_CM_single -3.4E+38 3.4E+38
 /begin AXIS_DESCR COM_AXIS LCS_PreDisCurve_m PubIfControlLATC_MDL_CM_single 13 -3.4E+38 3.4E+38 AXIS_PTS_REF P_LCS_PLAN_PreDisCurve_TabX_m /end AXIS_DESCR
 /begin AXIS_DESCR COM_AXIS LCS_IN_Spd_Kph PubIfControlLATC_MDL_CM_single 16 -3.4E+38 3.4E+38 AXIS_PTS_REF P_LCS_PLAN_VehicleSpd_TabY_Kph /end AXIS_DESCR
/end CHARACTERISTIC
/begin CHARACTERISTIC P_LCS_Plan_ELKAyDtLimit_Tab_ms3 "" MAP 0x0 /* @MemoryAddress@P_LCS_Plan_ELKAyDtLimit_Tab_ms3@ */ Lookup2D_FLOAT32_IEEE 0 PubIfControlLATC_MDL_CM_single -3.4E+38 3.4E+38
 /begin AXIS_DESCR COM_AXIS LCS_PreDisCurve_m PubIfControlLATC_MDL_CM_single 13 -3.4E+38 3.4E+38 AXIS_PTS_REF P_LCS_PLAN_PreDisCurve_TabX_m /end AXIS_DESCR
 /begin AXIS_DESCR COM_AXIS LCS_IN_Spd_Kph PubIfControlLATC_MDL_CM_single 16 -3.4E+38 3.4E+38 AXIS_PTS_REF P_LCS_PLAN_VehicleSpd_TabY_Kph /end AXIS_DESCR
/end CHARACTERISTIC
/begin CHARACTERISTIC P_LCS_Plan_LCSportAyDtLimit_Tab_ms3 "" MAP 0x0 /* @MemoryAddress@P_LCS_Plan_LCSportAyDtLimit_Tab_ms3@ */ Lookup2D_FLOAT32_IEEE 0 PubIfControlLATC_MDL_CM_single -3.4E+38 3.4E+38
 /begin AXIS_DESCR COM_AXIS LCS_PreDisCurve_m PubIfControlLATC_MDL_CM_single 13 -3.4E+38 3.4E+38 AXIS_PTS_REF P_LCS_PLAN_PreDisCurve_TabX_m /end AXIS_DESCR
 /begin AXIS_DESCR COM_AXIS LCS_IN_Spd_Kph PubIfControlLATC_MDL_CM_single 16 -3.4E+38 3.4E+38 AXIS_PTS_REF P_LCS_PLAN_VehicleSpd_TabY_Kph /end AXIS_DESCR
/end CHARACTERISTIC
/begin CHARACTERISTIC P_LCS_Plan_LCAyDtLimit_Tab_ms3 "" MAP 0x0 /* @MemoryAddress@P_LCS_Plan_LCAyDtLimit_Tab_ms3@ */ Lookup2D_FLOAT32_IEEE 0 PubIfControlLATC_MDL_CM_single -3.4E+38 3.4E+38
 /begin AXIS_DESCR COM_AXIS LCS_PreDisCurve_m PubIfControlLATC_MDL_CM_single 13 -3.4E+38 3.4E+38 AXIS_PTS_REF P_LCS_PLAN_PreDisCurve_TabX_m /end AXIS_DESCR
 /begin AXIS_DESCR COM_AXIS LCS_IN_Spd_Kph PubIfControlLATC_MDL_CM_single 16 -3.4E+38 3.4E+38 AXIS_PTS_REF P_LCS_PLAN_VehicleSpd_TabY_Kph /end AXIS_DESCR
/end CHARACTERISTIC
/begin CHARACTERISTIC P_LCS_Plan_LCKIEAyDtLimit_Tab_ms3 "" MAP 0x0 /* @MemoryAddress@P_LCS_Plan_LCKIEAyDtLimit_Tab_ms3@ */ Lookup2D_FLOAT32_IEEE 0 PubIfControlLATC_MDL_CM_single -3.4E+38 3.4E+38
 /begin AXIS_DESCR COM_AXIS LCS_PreDisCurve_m PubIfControlLATC_MDL_CM_single 13 -3.4E+38 3.4E+38 AXIS_PTS_REF P_LCS_PLAN_PreDisCurve_TabX_m /end AXIS_DESCR
 /begin AXIS_DESCR COM_AXIS LCS_IN_Spd_Kph PubIfControlLATC_MDL_CM_single 16 -3.4E+38 3.4E+38 AXIS_PTS_REF P_LCS_PLAN_VehicleSpd_TabY_Kph /end AXIS_DESCR
/end CHARACTERISTIC
/begin CHARACTERISTIC P_LCS_LATC_StateActivAngleSlopeLimit_ratio "" MAP 0x0 /* @MemoryAddress@P_LCS_LATC_StateActivAngleSlopeLimit_ratio@ */ Lookup2D_FLOAT32_IEEE 0 PubIfControlLATC_MDL_CM_single -3.4E+38 3.4E+38
 /begin AXIS_DESCR COM_AXIS LCS_LATC_AngleSlopeFlg_st PubIfControlLATC_MDL_CM_uint8 5 0 255 AXIS_PTS_REF P_LCS_LATC_StateActiveFlg_TabX_st /end AXIS_DESCR
 /begin AXIS_DESCR COM_AXIS LCS_LATC_HoldTime_s PubIfControlLATC_MDL_CM_double 15 -1.7E+308 1.7E+308 AXIS_PTS_REF P_LCS_LATC_StateActiveHoldTime_TabY_st /end AXIS_DESCR
/end CHARACTERISTIC
/begin AXIS_PTS P_LCS_LATC_StateActiveFlg_TabX_st "" 0x0 /* @MemoryAddress@P_LCS_LATC_StateActiveFlg_TabX_st@ */ LCS_LATC_AngleSlopeFlg_st Lookup2D_X_UBYTE 0 PubIfControlLATC_MDL_CM_uint8 5 0 255 /end AXIS_PTS
/begin AXIS_PTS P_LCS_LATC_StateActiveHoldTime_TabY_st "" 0x0 /* @MemoryAddress@P_LCS_LATC_StateActiveHoldTime_TabY_st@ */ LCS_LATC_HoldTime_s Lookup2D_X_FLOAT64_IEEE 0 PubIfControlLATC_MDL_CM_double 15 -1.7E+308 1.7E+308 /end AXIS_PTS
/begin CHARACTERISTIC P_LCS_LATC_CurOffsetCurveFliterTime_Tab_s "" CURVE 0x0 /* @MemoryAddress@P_LCS_LATC_CurOffsetCurveFliterTime_Tab_s@ */ Lookup1D_FLOAT32_IEEE 0 PubIfControlLATC_MDL_CM_single -3.4E+38 3.4E+38
 /begin AXIS_DESCR COM_AXIS NO_INPUT_QUANTITY PubIfControlLATC_MDL_CM_single 10 -3.4E+38 3.4E+38 AXIS_PTS_REF P_LCS_LATC_CurOffsetCurve_TabX_m /end AXIS_DESCR
/end CHARACTERISTIC
/begin AXIS_PTS P_LCS_LATC_CurOffsetCurve_TabX_m "" 0x0 /* @MemoryAddress@P_LCS_LATC_CurOffsetCurve_TabX_m@ */ NO_INPUT_QUANTITY Lookup1D_X_FLOAT32_IEEE 0 PubIfControlLATC_MDL_CM_single 10 -3.4E+38 3.4E+38 /end AXIS_PTS
/begin CHARACTERISTIC P_LCS_PLAN_StateActivAngleSlope_Tab_ratio "" MAP 0x0 /* @MemoryAddress@P_LCS_PLAN_StateActivAngleSlope_Tab_ratio@ */ Lookup2D_FLOAT32_IEEE 0 PubIfControlLATC_MDL_CM_single -3.4E+38 3.4E+38
 /begin AXIS_DESCR COM_AXIS NO_INPUT_QUANTITY PubIfControlLATC_MDL_CM_uint8 5 0 255 AXIS_PTS_REF P_LCS_PLAN_StateActiveFlg_TabX_st /end AXIS_DESCR
 /begin AXIS_DESCR COM_AXIS NO_INPUT_QUANTITY PubIfControlLATC_MDL_CM_double 15 -1.7E+308 1.7E+308 AXIS_PTS_REF P_LCS_PLAN_StateActiveHoldTime_TabY_s /end AXIS_DESCR
/end CHARACTERISTIC
/begin AXIS_PTS P_LCS_PLAN_StateActiveFlg_TabX_st "" 0x0 /* @MemoryAddress@P_LCS_PLAN_StateActiveFlg_TabX_st@ */ NO_INPUT_QUANTITY Lookup2D_X_UBYTE 0 PubIfControlLATC_MDL_CM_uint8 5 0 255 /end AXIS_PTS
/begin AXIS_PTS P_LCS_PLAN_StateActiveHoldTime_TabY_s "" 0x0 /* @MemoryAddress@P_LCS_PLAN_StateActiveHoldTime_TabY_s@ */ NO_INPUT_QUANTITY Lookup2D_X_FLOAT64_IEEE 0 PubIfControlLATC_MDL_CM_double 15 -1.7E+308 1.7E+308 /end AXIS_PTS
/begin CHARACTERISTIC P_LCS_PLAN_StateCompleteAngleSlope_Tab_ratio "" MAP 0x0 /* @MemoryAddress@P_LCS_PLAN_StateCompleteAngleSlope_Tab_ratio@ */ Lookup2D_FLOAT32_IEEE 0 PubIfControlLATC_MDL_CM_single -3.4E+38 3.4E+38
 /begin AXIS_DESCR COM_AXIS NO_INPUT_QUANTITY PubIfControlLATC_MDL_CM_uint8 3 0 255 AXIS_PTS_REF P_LCS_PLAN_StateCompleteFlg_TabX_st /end AXIS_DESCR
 /begin AXIS_DESCR COM_AXIS NO_INPUT_QUANTITY PubIfControlLATC_MDL_CM_double 15 -1.7E+308 1.7E+308 AXIS_PTS_REF P_LCS_PLAN_StateActiveHoldTime_TabY_s /end AXIS_DESCR
/end CHARACTERISTIC
/begin AXIS_PTS P_LCS_PLAN_StateCompleteFlg_TabX_st "" 0x0 /* @MemoryAddress@P_LCS_PLAN_StateCompleteFlg_TabX_st@ */ NO_INPUT_QUANTITY Lookup2D_X_UBYTE 0 PubIfControlLATC_MDL_CM_uint8 3 0 255 /end AXIS_PTS
/begin CHARACTERISTIC P_LCS_PLAN_LCCompletePreDisFac_Tab_ratio "" MAP 0x0 /* @MemoryAddress@P_LCS_PLAN_LCCompletePreDisFac_Tab_ratio@ */ Lookup2D_FLOAT32_IEEE 0 PubIfControlLATC_MDL_CM_single -3.4E+38 3.4E+38
 /begin AXIS_DESCR COM_AXIS NO_INPUT_QUANTITY PubIfControlLATC_MDL_CM_uint8 3 0 255 AXIS_PTS_REF P_LCS_PLAN_StateCompleteFlg_TabX_st /end AXIS_DESCR
 /begin AXIS_DESCR COM_AXIS NO_INPUT_QUANTITY PubIfControlLATC_MDL_CM_double 15 -1.7E+308 1.7E+308 AXIS_PTS_REF P_LCS_PLAN_StateActiveHoldTime_TabY_s /end AXIS_DESCR
/end CHARACTERISTIC
/begin CHARACTERISTIC P_LCS_ESSOverrideTime1 "" VALUE 0x0 /* @MemoryAddress@P_LCS_ESSOverrideTime1@ */ Scalar_FLOAT64_IEEE 0 PubIfControlLATC_MDL_CM_double -1.7E+308 1.7E+308 /end CHARACTERISTIC
/begin CHARACTERISTIC P_LCS_ESSOverrideTime2 "" VALUE 0x0 /* @MemoryAddress@P_LCS_ESSOverrideTime2@ */ Scalar_FLOAT64_IEEE 0 PubIfControlLATC_MDL_CM_double -1.7E+308 1.7E+308 /end CHARACTERISTIC
/begin CHARACTERISTIC P_LCS_ESSOverrideTime3 "" VALUE 0x0 /* @MemoryAddress@P_LCS_ESSOverrideTime3@ */ Scalar_FLOAT64_IEEE 0 PubIfControlLATC_MDL_CM_double -1.7E+308 1.7E+308 /end CHARACTERISTIC
/begin CHARACTERISTIC P_LCS_LATC_TarAngleFliterWindowSize "" VALUE 0x0 /* @MemoryAddress@P_LCS_LATC_TarAngleFliterWindowSize@ */ Scalar_FLOAT64_IEEE 0 PubIfControlLATC_MDL_CM_double -1.7E+308 1.7E+308 /end CHARACTERISTIC
/begin CHARACTERISTIC P_LCS_NoOverRideTime_TH_s "" VALUE 0x0 /* @MemoryAddress@P_LCS_NoOverRideTime_TH_s@ */ Scalar_FLOAT64_IEEE 0 PubIfControlLATC_MDL_CM_double -1.7E+308 1.7E+308 /end CHARACTERISTIC
/begin CHARACTERISTIC P_LCS_OverRideDetect_b "" VALUE 0x0 /* @MemoryAddress@P_LCS_OverRideDetect_b@ */ Scalar_FLOAT64_IEEE 0 PubIfControlLATC_MDL_CM_double -1.7E+308 1.7E+308 /end CHARACTERISTIC
/begin CHARACTERISTIC P_LCS_OverRideTime_TH_s "" VALUE 0x0 /* @MemoryAddress@P_LCS_OverRideTime_TH_s@ */ Scalar_FLOAT64_IEEE 0 PubIfControlLATC_MDL_CM_double -1.7E+308 1.7E+308 /end CHARACTERISTIC
/begin CHARACTERISTIC P_Global_CharSpd_ms "车辆特征车速（过渡转向和转向不足的临界车速，ESP提供）" VALUE 0x0 /* @MemoryAddress@P_Global_CharSpd_ms@ */ Scalar_FLOAT32_IEEE 0 PubIfControlLATC_MDL_CM_single_m_s -3.4E+38 3.4E+38 /end CHARACTERISTIC
/begin CHARACTERISTIC P_Global_SteeringAngleRatio "方向盘与前轮转角传动比" VALUE 0x0 /* @MemoryAddress@P_Global_SteeringAngleRatio@ */ Scalar_FLOAT32_IEEE 0 PubIfControlLATC_MDL_CM_single -3.4E+38 3.4E+38 /end CHARACTERISTIC
/begin CHARACTERISTIC P_Global_WheelBase_m "轴距" VALUE 0x0 /* @MemoryAddress@P_Global_WheelBase_m@ */ Scalar_FLOAT32_IEEE 0 PubIfControlLATC_MDL_CM_single_m -3.4E+38 3.4E+38 /end CHARACTERISTIC
/begin CHARACTERISTIC P_LCS_DetNoOverRide_DrvTrq_TH "" VALUE 0x0 /* @MemoryAddress@P_LCS_DetNoOverRide_DrvTrq_TH@ */ Scalar_FLOAT32_IEEE 0 PubIfControlLATC_MDL_CM_single -3.4E+38 3.4E+38 /end CHARACTERISTIC
/begin CHARACTERISTIC P_LCS_DetOverRide_DrvTrq_TH "" VALUE 0x0 /* @MemoryAddress@P_LCS_DetOverRide_DrvTrq_TH@ */ Scalar_FLOAT32_IEEE 0 PubIfControlLATC_MDL_CM_single -3.4E+38 3.4E+38 /end CHARACTERISTIC
/begin CHARACTERISTIC P_LCS_ESSOverrideValue1 "" VALUE 0x0 /* @MemoryAddress@P_LCS_ESSOverrideValue1@ */ Scalar_FLOAT32_IEEE 0 PubIfControlLATC_MDL_CM_single -3.4E+38 3.4E+38 /end CHARACTERISTIC
/begin CHARACTERISTIC P_LCS_ESSOverrideValue2 "" VALUE 0x0 /* @MemoryAddress@P_LCS_ESSOverrideValue2@ */ Scalar_FLOAT32_IEEE 0 PubIfControlLATC_MDL_CM_single -3.4E+38 3.4E+38 /end CHARACTERISTIC
/begin CHARACTERISTIC P_LCS_ESS_NotActiveFlgDelayTime "" VALUE 0x0 /* @MemoryAddress@P_LCS_ESS_NotActiveFlgDelayTime@ */ Scalar_FLOAT32_IEEE 0 PubIfControlLATC_MDL_CM_single -3.4E+38 3.4E+38 /end CHARACTERISTIC
/begin CHARACTERISTIC P_LCS_ESS_NotActiveFlgDelayTimeSW "" VALUE 0x0 /* @MemoryAddress@P_LCS_ESS_NotActiveFlgDelayTimeSW@ */ Scalar_FLOAT32_IEEE 0 PubIfControlLATC_MDL_CM_single -3.4E+38 3.4E+38 /end CHARACTERISTIC
/begin CHARACTERISTIC P_LCS_ESS_SteerAngleFilterTime "" VALUE 0x0 /* @MemoryAddress@P_LCS_ESS_SteerAngleFilterTime@ */ Scalar_FLOAT32_IEEE 0 PubIfControlLATC_MDL_CM_single -3.4E+38 3.4E+38 /end CHARACTERISTIC
/begin CHARACTERISTIC P_LCS_ESS_TarAngleFilterTime "" VALUE 0x0 /* @MemoryAddress@P_LCS_ESS_TarAngleFilterTime@ */ Scalar_FLOAT32_IEEE 0 PubIfControlLATC_MDL_CM_single -3.4E+38 3.4E+38 /end CHARACTERISTIC
/begin CHARACTERISTIC P_LCS_IN_Offset_Test_Value "" VALUE 0x0 /* @MemoryAddress@P_LCS_IN_Offset_Test_Value@ */ Scalar_FLOAT32_IEEE 0 PubIfControlLATC_MDL_CM_single -3.4E+38 3.4E+38 /end CHARACTERISTIC
/begin CHARACTERISTIC P_LCS_LATC_CurOffsetA2FliterT_s "" VALUE 0x0 /* @MemoryAddress@P_LCS_LATC_CurOffsetA2FliterT_s@ */ Scalar_FLOAT32_IEEE 0 PubIfControlLATC_MDL_CM_single -3.4E+38 3.4E+38 /end CHARACTERISTIC
/begin CHARACTERISTIC P_LCS_LATC_CurOffsetVehicleSpdLimitValue_degs "" VALUE 0x0 /* @MemoryAddress@P_LCS_LATC_CurOffsetVehicleSpdLimitValue_degs@ */ Scalar_FLOAT32_IEEE 0 PubIfControlLATC_MDL_CM_single -3.4E+38 3.4E+38 /end CHARACTERISTIC
/begin CHARACTERISTIC P_LCS_LATC_MPCDeltaT_s "" VALUE 0x0 /* @MemoryAddress@P_LCS_LATC_MPCDeltaT_s@ */ Scalar_FLOAT32_IEEE 0 PubIfControlLATC_MDL_CM_single -3.4E+38 3.4E+38 /end CHARACTERISTIC
/begin CHARACTERISTIC P_LCS_LATC_MPCMaxSterAngleSpd_degs "" VALUE 0x0 /* @MemoryAddress@P_LCS_LATC_MPCMaxSterAngleSpd_degs@ */ Scalar_FLOAT32_IEEE 0 PubIfControlLATC_MDL_CM_single -3.4E+38 3.4E+38 /end CHARACTERISTIC
/begin CHARACTERISTIC P_LCS_LATC_MPCMaxSterAngle_deg "" VALUE 0x0 /* @MemoryAddress@P_LCS_LATC_MPCMaxSterAngle_deg@ */ Scalar_FLOAT32_IEEE 0 PubIfControlLATC_MDL_CM_single -3.4E+38 3.4E+38 /end CHARACTERISTIC
/begin CHARACTERISTIC P_LCS_LCC_HeadingErRrateTime_s "" VALUE 0x0 /* @MemoryAddress@P_LCS_LCC_HeadingErRrateTime_s@ */ Scalar_FLOAT32_IEEE 0 PubIfControlLATC_MDL_CM_single -3.4E+38 3.4E+38 /end CHARACTERISTIC
/begin CHARACTERISTIC P_LCS_LCC_HeadingErrTime_s "" VALUE 0x0 /* @MemoryAddress@P_LCS_LCC_HeadingErrTime_s@ */ Scalar_FLOAT32_IEEE 0 PubIfControlLATC_MDL_CM_single -3.4E+38 3.4E+38 /end CHARACTERISTIC
/begin CHARACTERISTIC P_LCS_LCC_LaterErrRateTime_s "" VALUE 0x0 /* @MemoryAddress@P_LCS_LCC_LaterErrRateTime_s@ */ Scalar_FLOAT32_IEEE 0 PubIfControlLATC_MDL_CM_single -3.4E+38 3.4E+38 /end CHARACTERISTIC
/begin CHARACTERISTIC P_LCS_LCC_LaterErrTime_s "" VALUE 0x0 /* @MemoryAddress@P_LCS_LCC_LaterErrTime_s@ */ Scalar_FLOAT32_IEEE 0 PubIfControlLATC_MDL_CM_single -3.4E+38 3.4E+38 /end CHARACTERISTIC
/begin CHARACTERISTIC P_LCS_LCC_RefThetaTime_s "" VALUE 0x0 /* @MemoryAddress@P_LCS_LCC_RefThetaTime_s@ */ Scalar_FLOAT32_IEEE 0 PubIfControlLATC_MDL_CM_single -3.4E+38 3.4E+38 /end CHARACTERISTIC
/begin CHARACTERISTIC P_LCS_LCC_RefcurveTime_s "" VALUE 0x0 /* @MemoryAddress@P_LCS_LCC_RefcurveTime_s@ */ Scalar_FLOAT32_IEEE 0 PubIfControlLATC_MDL_CM_single -3.4E+38 3.4E+38 /end CHARACTERISTIC
/begin CHARACTERISTIC P_LCS_PLAN_A2FliterTime_s "" VALUE 0x0 /* @MemoryAddress@P_LCS_PLAN_A2FliterTime_s@ */ Scalar_FLOAT32_IEEE 0 PubIfControlLATC_MDL_CM_single -3.4E+38 3.4E+38 /end CHARACTERISTIC
/begin CHARACTERISTIC P_LCS_PLAN_DisFac_Tab_ratio "" VALUE 0x0 /* @MemoryAddress@P_LCS_PLAN_DisFac_Tab_ratio@ */ Scalar_FLOAT32_IEEE 0 PubIfControlLATC_MDL_CM_single -3.4E+38 3.4E+38 /end CHARACTERISTIC
/begin CHARACTERISTIC P_LCS_PLAN_MinDis_m "" VALUE 0x0 /* @MemoryAddress@P_LCS_PLAN_MinDis_m@ */ Scalar_FLOAT32_IEEE 0 PubIfControlLATC_MDL_CM_single -3.4E+38 3.4E+38 /end CHARACTERISTIC
/begin CHARACTERISTIC P_LCS_PLAN_PreDis_Tab_m "" VAL_BLK 0x0 /* @MemoryAddress@P_LCS_PLAN_PreDis_Tab_m@ */ Scalar_FLOAT32_IEEE 0 PubIfControlLATC_MDL_CM_single -3.4E+38 3.4E+38 /* Array Size */ MATRIX_DIM 1 16 1 /end CHARACTERISTIC
/begin CHARACTERISTIC P_LCS_PlLAN_PreDisFac_Tab_ratio "" VAL_BLK 0x0 /* @MemoryAddress@P_LCS_PlLAN_PreDisFac_Tab_ratio@ */ Scalar_FLOAT32_IEEE 0 PubIfControlLATC_MDL_CM_single -3.4E+38 3.4E+38 /* Array Size */ MATRIX_DIM 7 13 1 /end CHARACTERISTIC
/begin CHARACTERISTIC P_LCS_Plan_A2Pretime_s "" VALUE 0x0 /* @MemoryAddress@P_LCS_Plan_A2Pretime_s@ */ Scalar_FLOAT32_IEEE 0 PubIfControlLATC_MDL_CM_single -3.4E+38 3.4E+38 /end CHARACTERISTIC
/begin CHARACTERISTIC P_LCS_LATC_StateHoldTime_st "" VALUE 0x0 /* @MemoryAddress@P_LCS_LATC_StateHoldTime_st@ */ Scalar_UWORD 0 PubIfControlLATC_MDL_CM_uint16 0 65535 /end CHARACTERISTIC
/begin CHARACTERISTIC P_LCS_PLAN_StateHoldTime_st "" VALUE 0x0 /* @MemoryAddress@P_LCS_PLAN_StateHoldTime_st@ */ Scalar_UWORD 0 PubIfControlLATC_MDL_CM_uint16 0 65535 /end CHARACTERISTIC
/begin CHARACTERISTIC P_LCS_ESS_LogicTest_Enable "" VALUE 0x0 /* @MemoryAddress@P_LCS_ESS_LogicTest_Enable@ */ Scalar_BOOLEAN 0 PubIfControlLATC_MDL_CM_boolean 0 1 BIT_MASK 0x01 /end CHARACTERISTIC
/begin CHARACTERISTIC P_LCS_IN_Offset_Test_SW "" VALUE 0x0 /* @MemoryAddress@P_LCS_IN_Offset_Test_SW@ */ Scalar_UBYTE 0 PubIfControlLATC_MDL_CM_uint8 0 255 /end CHARACTERISTIC
/begin CHARACTERISTIC P_LCS_Trq_Switch "" VALUE 0x0 /* @MemoryAddress@P_LCS_Trq_Switch@ */ Scalar_UBYTE 0 PubIfControlLATC_MDL_CM_uint8 0 255 /end CHARACTERISTIC
/begin MEASUREMENT LCS_LATC_HoldTime_s "" FLOAT64_IEEE PubIfControlLATC_MDL_CM_double 0 0 -1.7E+308 1.7E+308 ECU_ADDRESS 0x0 /* @MemoryAddress@LCS_LATC_HoldTime_s@ */ /end MEASUREMENT
/begin MEASUREMENT LCS_PLAN_Trajectory_NumTraj "" FLOAT64_IEEE PubIfControlLATC_MDL_CM_double 0 0 -1.7E+308 1.7E+308 ECU_ADDRESS 0x0 /* @MemoryAddress@LCS_PLAN_Trajectory_NumTraj@ */ /end MEASUREMENT
/begin MEASUREMENT LCS_SubModel_Number "" ULONG PubIfControlLATC_MDL_CM_uint32 0 0 0 4294967295 ECU_ADDRESS 0x0 /* @MemoryAddress@LCS_SubModel_Number@ */ /end MEASUREMENT
/begin MEASUREMENT LCS_SubModel_VERSION "" ULONG PubIfControlLATC_MDL_CM_uint32 0 0 0 4294967295 ECU_ADDRESS 0x0 /* @MemoryAddress@LCS_SubModel_VERSION@ */ /end MEASUREMENT
/begin MEASUREMENT LCS_IN_EPS_DrvInpTrqVal "" FLOAT32_IEEE PubIfControlLATC_MDL_CM_single 0 0 -3.4E+38 3.4E+38 ECU_ADDRESS 0x0 /* @MemoryAddress@LCS_IN_EPS_DrvInpTrqVal@ */ /end MEASUREMENT
/begin MEASUREMENT LCS_IN_SteerWheelSpd "" FLOAT32_IEEE PubIfControlLATC_MDL_CM_single 0 0 -3.4E+38 3.4E+38 ECU_ADDRESS 0x0 /* @MemoryAddress@LCS_IN_SteerWheelSpd@ */ /end MEASUREMENT
/begin MEASUREMENT LCS_ESS_SteerWheelAngleSpd "" FLOAT32_IEEE PubIfControlLATC_MDL_CM_single 0 0 -3.4E+38 3.4E+38 ECU_ADDRESS 0x0 /* @MemoryAddress@LCS_ESS_SteerWheelAngleSpd@ */ /end MEASUREMENT
/begin MEASUREMENT LCS_ESS_SteerWheelAngleSpdFilter "" FLOAT32_IEEE PubIfControlLATC_MDL_CM_single 0 0 -3.4E+38 3.4E+38 ECU_ADDRESS 0x0 /* @MemoryAddress@LCS_ESS_SteerWheelAngleSpdFilter@ */ /end MEASUREMENT
/begin MEASUREMENT LCS_ESS_TarAngleSpd "" FLOAT32_IEEE PubIfControlLATC_MDL_CM_single 0 0 -3.4E+38 3.4E+38 ECU_ADDRESS 0x0 /* @MemoryAddress@LCS_ESS_TarAngleSpd@ */ /end MEASUREMENT
/begin MEASUREMENT LCS_ESS_TarAngleSpdFilter "" FLOAT32_IEEE PubIfControlLATC_MDL_CM_single 0 0 -3.4E+38 3.4E+38 ECU_ADDRESS 0x0 /* @MemoryAddress@LCS_ESS_TarAngleSpdFilter@ */ /end MEASUREMENT
/begin MEASUREMENT LCS_IN_vxvRefMs "" FLOAT32_IEEE PubIfControlLATC_MDL_CM_single 0 0 -3.4E+38 3.4E+38 ECU_ADDRESS 0x0 /* @MemoryAddress@LCS_IN_vxvRefMs@ */ /end MEASUREMENT
/begin MEASUREMENT LCS_IN_SteerWheelSpdSign "" FLOAT32_IEEE PubIfControlLATC_MDL_CM_single 0 0 -3.4E+38 3.4E+38 ECU_ADDRESS 0x0 /* @MemoryAddress@LCS_IN_SteerWheelSpdSign@ */ /end MEASUREMENT
/begin MEASUREMENT LCS_IN_SteerWheelAngleSign "" FLOAT32_IEEE PubIfControlLATC_MDL_CM_single 0 0 -3.4E+38 3.4E+38 ECU_ADDRESS 0x0 /* @MemoryAddress@LCS_IN_SteerWheelAngleSign@ */ /end MEASUREMENT
/begin MEASUREMENT LCS_IN_SteerWheelAng "" FLOAT32_IEEE PubIfControlLATC_MDL_CM_single 0 0 -3.4E+38 3.4E+38 ECU_ADDRESS 0x0 /* @MemoryAddress@LCS_IN_SteerWheelAng@ */ /end MEASUREMENT
/begin MEASUREMENT LCS_IN_CurrentLaneWidth "" FLOAT32_IEEE PubIfControlLATC_MDL_CM_single 0 0 -3.4E+38 3.4E+38 ECU_ADDRESS 0x0 /* @MemoryAddress@LCS_IN_CurrentLaneWidth@ */ /end MEASUREMENT
/begin MEASUREMENT LCS_IN_EPS_LKATorqOvrlDlvd "" FLOAT32_IEEE PubIfControlLATC_MDL_CM_single 0 0 -3.4E+38 3.4E+38 ECU_ADDRESS 0x0 /* @MemoryAddress@LCS_IN_EPS_LKATorqOvrlDlvd@ */ /end MEASUREMENT
/begin MEASUREMENT LCS_IN_EPS_LKATorqOvrlDlvdVld "" FLOAT32_IEEE PubIfControlLATC_MDL_CM_single 0 0 -3.4E+38 3.4E+38 ECU_ADDRESS 0x0 /* @MemoryAddress@LCS_IN_EPS_LKATorqOvrlDlvdVld@ */ /end MEASUREMENT
/begin MEASUREMENT LCS_IN_CurSteerAngle_deg "" FLOAT32_IEEE PubIfControlLATC_MDL_CM_single 0 0 -3.4E+38 3.4E+38 ECU_ADDRESS 0x0 /* @MemoryAddress@LCS_IN_CurSteerAngle_deg@ */ /end MEASUREMENT
/begin MEASUREMENT LCS_IN_SteerAngOffset_deg "" FLOAT32_IEEE PubIfControlLATC_MDL_CM_single 0 0 -3.4E+38 3.4E+38 ECU_ADDRESS 0x0 /* @MemoryAddress@LCS_IN_SteerAngOffset_deg@ */ /end MEASUREMENT
/begin MEASUREMENT LCS_LATC_CorrectSteerAngle_deg "" FLOAT32_IEEE PubIfControlLATC_MDL_CM_single 0 0 -3.4E+38 3.4E+38 ECU_ADDRESS 0x0 /* @MemoryAddress@LCS_LATC_CorrectSteerAngle_deg@ */ /end MEASUREMENT
/begin MEASUREMENT LCS_IN_Spd_Kph "" FLOAT32_IEEE PubIfControlLATC_MDL_CM_single 0 0 -3.4E+38 3.4E+38 ECU_ADDRESS 0x0 /* @MemoryAddress@LCS_IN_Spd_Kph@ */ /end MEASUREMENT
/begin MEASUREMENT LCS_LATC_MaxAy_ms2 "" FLOAT32_IEEE PubIfControlLATC_MDL_CM_single 0 0 -3.4E+38 3.4E+38 ECU_ADDRESS 0x0 /* @MemoryAddress@LCS_LATC_MaxAy_ms2@ */ /end MEASUREMENT
/begin MEASUREMENT LCS_LATC_StateActAngleSlope_degs "" FLOAT32_IEEE PubIfControlLATC_MDL_CM_single 0 0 -3.4E+38 3.4E+38 ECU_ADDRESS 0x0 /* @MemoryAddress@LCS_LATC_StateActAngleSlope_degs@ */ /end MEASUREMENT
/begin MEASUREMENT LCS_LATC_StateAngleSlope_degs "" FLOAT32_IEEE PubIfControlLATC_MDL_CM_single 0 0 -3.4E+38 3.4E+38 ECU_ADDRESS 0x0 /* @MemoryAddress@LCS_LATC_StateAngleSlope_degs@ */ /end MEASUREMENT
/begin MEASUREMENT LCS_IN_psiDtOpt "" FLOAT32_IEEE PubIfControlLATC_MDL_CM_single 0 0 -3.4E+38 3.4E+38 ECU_ADDRESS 0x0 /* @MemoryAddress@LCS_IN_psiDtOpt@ */ /end MEASUREMENT
/begin MEASUREMENT LCS_IN_desLaneA2 "" FLOAT32_IEEE PubIfControlLATC_MDL_CM_single 0 0 -3.4E+38 3.4E+38 ECU_ADDRESS 0x0 /* @MemoryAddress@LCS_IN_desLaneA2@ */ /end MEASUREMENT
/begin MEASUREMENT LCS_LATC_TarAngleFilter_deg "" FLOAT32_IEEE PubIfControlLATC_MDL_CM_single 0 0 -3.4E+38 3.4E+38 ECU_ADDRESS 0x0 /* @MemoryAddress@LCS_LATC_TarAngleFilter_deg@ */ /end MEASUREMENT
/begin MEASUREMENT LCS_LATC_OutTrgSteerAngle "" FLOAT32_IEEE PubIfControlLATC_MDL_CM_single 0 0 -3.4E+38 3.4E+38 ECU_ADDRESS 0x0 /* @MemoryAddress@LCS_LATC_OutTrgSteerAngle@ */ /end MEASUREMENT
/begin MEASUREMENT LCS_IN_kapTraj "" FLOAT32_IEEE PubIfControlLATC_MDL_CM_single 0 0 -3.4E+38 3.4E+38 ECU_ADDRESS 0x0 /* @MemoryAddress@LCS_IN_kapTraj@ */ /end MEASUREMENT
/begin MEASUREMENT LCS_IN_axvRefMs2 "" FLOAT32_IEEE PubIfControlLATC_MDL_CM_single 0 0 -3.4E+38 3.4E+38 ECU_ADDRESS 0x0 /* @MemoryAddress@LCS_IN_axvRefMs2@ */ /end MEASUREMENT
/begin MEASUREMENT LCS_IN_desLaneA3 "" FLOAT32_IEEE PubIfControlLATC_MDL_CM_single 0 0 -3.4E+38 3.4E+38 ECU_ADDRESS 0x0 /* @MemoryAddress@LCS_IN_desLaneA3@ */ /end MEASUREMENT
/begin MEASUREMENT LCS_IN_desLaneA1 "" FLOAT32_IEEE PubIfControlLATC_MDL_CM_single 0 0 -3.4E+38 3.4E+38 ECU_ADDRESS 0x0 /* @MemoryAddress@LCS_IN_desLaneA1@ */ /end MEASUREMENT
/begin MEASUREMENT LCS_IN_desLaneA0 "" FLOAT32_IEEE PubIfControlLATC_MDL_CM_single 0 0 -3.4E+38 3.4E+38 ECU_ADDRESS 0x0 /* @MemoryAddress@LCS_IN_desLaneA0@ */ /end MEASUREMENT
/begin MEASUREMENT LCS_PreDisCurve_m "" FLOAT32_IEEE PubIfControlLATC_MDL_CM_single 0 0 -3.4E+38 3.4E+38 ECU_ADDRESS 0x0 /* @MemoryAddress@LCS_PreDisCurve_m@ */ /end MEASUREMENT
/begin MEASUREMENT LCS_Plan_AyDtlimit "" FLOAT32_IEEE PubIfControlLATC_MDL_CM_single 0 0 -3.4E+38 3.4E+38 ECU_ADDRESS 0x0 /* @MemoryAddress@LCS_Plan_AyDtlimit@ */ /end MEASUREMENT
/begin MEASUREMENT LCS_Plan_FinalpreDis "" FLOAT32_IEEE PubIfControlLATC_MDL_CM_single 0 0 -3.4E+38 3.4E+38 ECU_ADDRESS 0x0 /* @MemoryAddress@LCS_Plan_FinalpreDis@ */ /end MEASUREMENT
/begin MEASUREMENT LCS_CurSteerAngle_deg "" FLOAT32_IEEE PubIfControlLATC_MDL_CM_single 0 0 -3.4E+38 3.4E+38 ECU_ADDRESS 0x0 /* @MemoryAddress@LCS_CurSteerAngle_deg@ */ /end MEASUREMENT
/begin MEASUREMENT LCS_IN_SteerAngleSpd_degs "" FLOAT32_IEEE PubIfControlLATC_MDL_CM_single 0 0 -3.4E+38 3.4E+38 ECU_ADDRESS 0x0 /* @MemoryAddress@LCS_IN_SteerAngleSpd_degs@ */ /end MEASUREMENT
/begin MEASUREMENT LCS_EqA0 "" FLOAT32_IEEE PubIfControlLATC_MDL_CM_single 0 0 -3.4E+38 3.4E+38 ECU_ADDRESS 0x0 /* @MemoryAddress@LCS_EqA0@ */ /end MEASUREMENT
/begin MEASUREMENT LCS_IN_ayvRefMs2 "" FLOAT32_IEEE PubIfControlLATC_MDL_CM_single 0 0 -3.4E+38 3.4E+38 ECU_ADDRESS 0x0 /* @MemoryAddress@LCS_IN_ayvRefMs2@ */ /end MEASUREMENT
/begin MEASUREMENT LCS_IN_alpSideSlipAngle "" FLOAT32_IEEE PubIfControlLATC_MDL_CM_single 0 0 -3.4E+38 3.4E+38 ECU_ADDRESS 0x0 /* @MemoryAddress@LCS_IN_alpSideSlipAngle@ */ /end MEASUREMENT
/begin MEASUREMENT LCS_PLAN_TrajectoryX "" FLOAT32_IEEE PubIfControlLATC_MDL_CM_single 0 0 -3.4E+38 3.4E+38 LAYOUT ROW_DIR MATRIX_DIM 11 1 1 ECU_ADDRESS 0x0 /* @MemoryAddress@LCS_PLAN_TrajectoryX@ */ /end MEASUREMENT
/begin MEASUREMENT LCS_PLAN_Trajectory_PlanY "" FLOAT32_IEEE PubIfControlLATC_MDL_CM_single 0 0 -3.4E+38 3.4E+38 LAYOUT ROW_DIR MATRIX_DIM 11 1 1 ECU_ADDRESS 0x0 /* @MemoryAddress@LCS_PLAN_Trajectory_PlanY@ */ /end MEASUREMENT
/begin MEASUREMENT LCS_LATC_PlanT "" FLOAT32_IEEE PubIfControlLATC_MDL_CM_single 0 0 -3.4E+38 3.4E+38 ECU_ADDRESS 0x0 /* @MemoryAddress@LCS_LATC_PlanT@ */ /end MEASUREMENT
/begin MEASUREMENT LCS_LATC_PlanLength "" FLOAT32_IEEE PubIfControlLATC_MDL_CM_single 0 0 -3.4E+38 3.4E+38 ECU_ADDRESS 0x0 /* @MemoryAddress@LCS_LATC_PlanLength@ */ /end MEASUREMENT
/begin MEASUREMENT LCS_LATC_PlanAyDt "" FLOAT32_IEEE PubIfControlLATC_MDL_CM_single 0 0 -3.4E+38 3.4E+38 LAYOUT ROW_DIR MATRIX_DIM 11 1 1 ECU_ADDRESS 0x0 /* @MemoryAddress@LCS_LATC_PlanAyDt@ */ /end MEASUREMENT
/begin MEASUREMENT LCS_LATC_CurrentSteerAngleOffset_deg "" FLOAT32_IEEE PubIfControlLATC_MDL_CM_single 0 0 -3.4E+38 3.4E+38 ECU_ADDRESS 0x0 /* @MemoryAddress@LCS_LATC_CurrentSteerAngleOffset_deg@ */ /end MEASUREMENT
/begin MEASUREMENT LCS_LATC_SteerAngleCmd_deg "" FLOAT32_IEEE PubIfControlLATC_MDL_CM_single 0 0 -3.4E+38 3.4E+38 ECU_ADDRESS 0x0 /* @MemoryAddress@LCS_LATC_SteerAngleCmd_deg@ */ /end MEASUREMENT
/begin MEASUREMENT LCS_LATC_Feedforward_deg "" FLOAT32_IEEE PubIfControlLATC_MDL_CM_single 0 0 -3.4E+38 3.4E+38 ECU_ADDRESS 0x0 /* @MemoryAddress@LCS_LATC_Feedforward_deg@ */ /end MEASUREMENT
/begin MEASUREMENT LCS_LATC_Feedback_deg "" FLOAT32_IEEE PubIfControlLATC_MDL_CM_single 0 0 -3.4E+38 3.4E+38 ECU_ADDRESS 0x0 /* @MemoryAddress@LCS_LATC_Feedback_deg@ */ /end MEASUREMENT
/begin MEASUREMENT LCS_LATC_SteerAngleLimit_deg "" FLOAT32_IEEE PubIfControlLATC_MDL_CM_single 0 0 -3.4E+38 3.4E+38 ECU_ADDRESS 0x0 /* @MemoryAddress@LCS_LATC_SteerAngleLimit_deg@ */ /end MEASUREMENT
/begin MEASUREMENT LCS_LATC_MatrixResult_deg "" FLOAT32_IEEE PubIfControlLATC_MDL_CM_single 0 0 -3.4E+38 3.4E+38 LAYOUT ROW_DIR MATRIX_DIM 6 1 1 ECU_ADDRESS 0x0 /* @MemoryAddress@LCS_LATC_MatrixResult_deg@ */ /end MEASUREMENT
/begin MEASUREMENT LCS_LATC_TarAngle_deg "" FLOAT32_IEEE PubIfControlLATC_MDL_CM_single 0 0 -3.4E+38 3.4E+38 ECU_ADDRESS 0x0 /* @MemoryAddress@LCS_LATC_TarAngle_deg@ */ /end MEASUREMENT
/begin MEASUREMENT LCS_LATC_MPCDeltaT_s "" FLOAT32_IEEE PubIfControlLATC_MDL_CM_single 0 0 -3.4E+38 3.4E+38 ECU_ADDRESS 0x0 /* @MemoryAddress@LCS_LATC_MPCDeltaT_s@ */ /end MEASUREMENT
/begin MEASUREMENT LCS_Trq_Switch "" UBYTE PubIfControlLATC_MDL_CM_uint8 0 0 0 255 ECU_ADDRESS 0x0 /* @MemoryAddress@LCS_Trq_Switch@ */ /end MEASUREMENT
/begin MEASUREMENT LCS_IN_EPS_FailSts "" UBYTE PubIfControlLATC_MDL_CM_uint8 0 0 0 255 ECU_ADDRESS 0x0 /* @MemoryAddress@LCS_IN_EPS_FailSts@ */ /end MEASUREMENT
/begin MEASUREMENT LCS_IN_EPS_LKATrqOvlDlvdSts "" UBYTE PubIfControlLATC_MDL_CM_uint8 0 0 0 255 ECU_ADDRESS 0x0 /* @MemoryAddress@LCS_IN_EPS_LKATrqOvlDlvdSts@ */ /end MEASUREMENT
/begin MEASUREMENT LCS_IN_TarDangerlLevel_Delay2Frame "" UBYTE PubIfControlLATC_MDL_CM_uint8 0 0 0 255 ECU_ADDRESS 0x0 /* @MemoryAddress@LCS_IN_TarDangerlLevel_Delay2Frame@ */ /end MEASUREMENT
/begin MEASUREMENT LCS_IN_TarDangerlLevel "" UBYTE PubIfControlLATC_MDL_CM_uint8 0 0 0 255 ECU_ADDRESS 0x0 /* @MemoryAddress@LCS_IN_TarDangerlLevel@ */ /end MEASUREMENT
/begin MEASUREMENT LCS_OUT_AngCmdReqValVld "" UBYTE PubIfControlLATC_MDL_CM_uint8 0 0 0 255 ECU_ADDRESS 0x0 /* @MemoryAddress@LCS_OUT_AngCmdReqValVld@ */ /end MEASUREMENT
/begin MEASUREMENT LCS_Counter "" UBYTE PubIfControlLATC_MDL_CM_uint8 0 0 0 255 ECU_ADDRESS 0x0 /* @MemoryAddress@LCS_Counter@ */ /end MEASUREMENT
/begin MEASUREMENT LCS_IN_EPS_LKAAngDlvdSts "" UBYTE PubIfControlLATC_MDL_CM_uint8 0 0 0 255 ECU_ADDRESS 0x0 /* @MemoryAddress@LCS_IN_EPS_LKAAngDlvdSts@ */ /end MEASUREMENT
/begin MEASUREMENT LCS_LATC_AngleSlopeFlg_st "" UBYTE PubIfControlLATC_MDL_CM_uint8 0 0 0 255 ECU_ADDRESS 0x0 /* @MemoryAddress@LCS_LATC_AngleSlopeFlg_st@ */ /end MEASUREMENT
/begin MEASUREMENT LCS_EPSFault "" UBYTE PubIfControlLATC_MDL_CM_uint8 0 0 0 255 ECU_ADDRESS 0x0 /* @MemoryAddress@LCS_EPSFault@ */ /end MEASUREMENT
/begin MEASUREMENT LCS_ESS_NotActiveFlg1 "" UBYTE PubIfControlLATC_MDL_CM_boolean 0 0 0 1 ECU_ADDRESS 0x0 /* @MemoryAddress@LCS_ESS_NotActiveFlg1@ */ BIT_MASK 0x01 /end MEASUREMENT
/begin MEASUREMENT LCS_ESS_NotActiveFlg2 "" UBYTE PubIfControlLATC_MDL_CM_boolean 0 0 0 1 ECU_ADDRESS 0x0 /* @MemoryAddress@LCS_ESS_NotActiveFlg2@ */ BIT_MASK 0x01 /end MEASUREMENT
/begin MEASUREMENT LCS_ESS_NotActiveFlg3 "" UBYTE PubIfControlLATC_MDL_CM_boolean 0 0 0 1 ECU_ADDRESS 0x0 /* @MemoryAddress@LCS_ESS_NotActiveFlg3@ */ BIT_MASK 0x01 /end MEASUREMENT
/begin MEASUREMENT LCS_ESS_NotActiveFlgOriginal "" UBYTE PubIfControlLATC_MDL_CM_boolean 0 0 0 1 ECU_ADDRESS 0x0 /* @MemoryAddress@LCS_ESS_NotActiveFlgOriginal@ */ BIT_MASK 0x01 /end MEASUREMENT
/begin MEASUREMENT LCS_ESS_NotActiveFlg "" UBYTE PubIfControlLATC_MDL_CM_boolean 0 0 0 1 ECU_ADDRESS 0x0 /* @MemoryAddress@LCS_ESS_NotActiveFlg@ */ BIT_MASK 0x01 /end MEASUREMENT
/begin MEASUREMENT LCS_IN_desLaneValid "" UBYTE PubIfControlLATC_MDL_CM_boolean 0 0 0 1 ECU_ADDRESS 0x0 /* @MemoryAddress@LCS_IN_desLaneValid@ */ BIT_MASK 0x01 /end MEASUREMENT
/begin MEASUREMENT LCS_OffSetUpdate_Flg "" UBYTE PubIfControlLATC_MDL_CM_boolean 0 0 0 1 ECU_ADDRESS 0x0 /* @MemoryAddress@LCS_OffSetUpdate_Flg@ */ BIT_MASK 0x01 /end MEASUREMENT
/begin MEASUREMENT LCS_OverRideDetect_b "" UBYTE PubIfControlLATC_MDL_CM_boolean 0 0 0 1 ECU_ADDRESS 0x0 /* @MemoryAddress@LCS_OverRideDetect_b@ */ BIT_MASK 0x01 /end MEASUREMENT
/begin MEASUREMENT LCS_ESS_NotActiveDelayFlg "" UBYTE PubIfControlLATC_MDL_CM_boolean 0 0 0 1 ECU_ADDRESS 0x0 /* @MemoryAddress@LCS_ESS_NotActiveDelayFlg@ */ BIT_MASK 0x01 /end MEASUREMENT
/begin COMPU_METHOD PubIfControlLATC_MDL_CM_single "Q = V" RAT_FUNC "%8.6" "" COEFFS 0 1 0 0 0 1 /end COMPU_METHOD
/begin COMPU_METHOD PubIfControlLATC_MDL_CM_uint8 "Q = V" RAT_FUNC "%3.0" "" COEFFS 0 1 0 0 0 1 /end COMPU_METHOD
/begin COMPU_METHOD PubIfControlLATC_MDL_CM_double "Q = V" RAT_FUNC "%15.10" "" COEFFS 0 1 0 0 0 1 /end COMPU_METHOD
/begin COMPU_METHOD PubIfControlLATC_MDL_CM_single_m_s "Q = V" RAT_FUNC "%8.6" "m/s" COEFFS 0 1 0 0 0 1 /end COMPU_METHOD
/begin COMPU_METHOD PubIfControlLATC_MDL_CM_single_m "Q = V" RAT_FUNC "%8.6" "m" COEFFS 0 1 0 0 0 1 /end COMPU_METHOD
/begin COMPU_METHOD PubIfControlLATC_MDL_CM_uint16 "Q = V" RAT_FUNC "%5.0" "" COEFFS 0 1 0 0 0 1 /end COMPU_METHOD
/begin COMPU_METHOD PubIfControlLATC_MDL_CM_boolean "Q = V" RAT_FUNC "%1.0" "" COEFFS 0 1 0 0 0 1 /end COMPU_METHOD
/begin COMPU_METHOD PubIfControlLATC_MDL_CM_uint32 "Q = V" RAT_FUNC "%10.0" "" COEFFS 0 1 0 0 0 1 /end COMPU_METHOD
/begin GROUP PubIfControlLATC_MDL "PubIfControlLATC_MDL" /* Root */ ROOT /begin SUB_GROUP Root_Subsystem_Reference /end SUB_GROUP /end GROUP
/begin GROUP Root_Subsystem_Reference "PubIfControlLATC_MDL/Subsystem Reference" /begin SUB_GROUP S1_LATC /end SUB_GROUP /end GROUP
/begin GROUP S1_LATC "PubIfControlLATC_MDL/Subsystem Reference/LATC" /begin SUB_GROUP S2_LateralControl /end SUB_GROUP /begin REF_CHARACTERISTIC P_LCS_Trq_Switch /end REF_CHARACTERISTIC
 /begin REF_MEASUREMENT LCS_Counter LCS_SubModel_Number LCS_SubModel_VERSION LCS_Trq_Switch /end REF_MEASUREMENT
/end GROUP
/begin GROUP S2_LateralControl "PubIfControlLATC_MDL/Subsystem Reference/LATC/LateralControl" /begin SUB_GROUP S4_EPSFaultCheck S4_ESS_SteerSpd_Test S4_LCS_Angle /end SUB_GROUP /begin REF_CHARACTERISTIC P_LCS_IN_Offset_Test_SW P_LCS_IN_Offset_Test_Value /end REF_CHARACTERISTIC
 /begin REF_MEASUREMENT LCS_IN_CurrentLaneWidth LCS_IN_EPS_DrvInpTrqVal LCS_IN_EPS_FailSts LCS_IN_EPS_LKAAngDlvdSts LCS_IN_EPS_LKATorqOvrlDlvd LCS_IN_EPS_LKATorqOvrlDlvdVld LCS_IN_EPS_LKATrqOvlDlvdSts LCS_IN_SteerAngOffset_deg LCS_IN_SteerWheelAng LCS_IN_SteerWheelAngleSign LCS_IN_SteerWheelSpd LCS_IN_SteerWheelSpdSign LCS_IN_alpSideSlipAngle LCS_IN_axvRefMs2 LCS_IN_ayvRefMs2 LCS_IN_desLaneA0 LCS_IN_desLaneA1 LCS_IN_desLaneA2 LCS_IN_desLaneA3 LCS_IN_kapTraj LCS_IN_psiDtOpt LCS_IN_vxvRefMs LCS_OUT_AngCmdReqValVld /end REF_MEASUREMENT
/end GROUP
/begin GROUP S4_EPSFaultCheck "PubIfControlLATC_MDL/Subsystem Reference/LATC/LateralControl/EPSFaultCheck" /begin REF_MEASUREMENT LCS_EPSFault /end REF_MEASUREMENT /end GROUP
/begin GROUP S4_ESS_SteerSpd_Test "PubIfControlLATC_MDL/Subsystem Reference/LATC/LateralControl/ESS_SteerSpd_Test" /begin SUB_GROUP S16_LP_filter S16_LP_filter1 S16_NotActiveFlgDelayTime /end SUB_GROUP
 /begin REF_CHARACTERISTIC P_LCS_ESSOverrideTime1 P_LCS_ESSOverrideTime2 P_LCS_ESSOverrideTime3 P_LCS_ESSOverrideValue1 P_LCS_ESSOverrideValue2 P_LCS_ESS_LogicTest_Enable P_LCS_ESS_NotActiveFlgDelayTime P_LCS_ESS_NotActiveFlgDelayTimeSW P_LCS_ESS_SteerAngleErr P_LCS_ESS_SteerAngleFilterTime P_LCS_ESS_TarAngleFilterTime P_LCS_LATC_VehicleSpd_TabX_Kph /end REF_CHARACTERISTIC
 /begin REF_MEASUREMENT LCS_ESS_NotActiveFlg LCS_ESS_NotActiveFlg1 LCS_ESS_NotActiveFlg2 LCS_ESS_NotActiveFlg3 LCS_ESS_NotActiveFlgOriginal LCS_ESS_SteerWheelAngleSpd LCS_ESS_TarAngleSpd /end REF_MEASUREMENT
/end GROUP
/begin GROUP S4_LCS_Angle "PubIfControlLATC_MDL/Subsystem Reference/LATC/LateralControl/LCS_Angle"
 /begin SUB_GROUP S17_Lateral_Control S17_Motion_Planning S17_OverRideDetect S17_SteerAngleCorrect S17_Subsystem S17_Vehicle_Speed /end SUB_GROUP
 /begin REF_MEASUREMENT LCS_IN_TarDangerlLevel LCS_IN_TarDangerlLevel_Delay2Frame LCS_IN_desLaneValid /end REF_MEASUREMENT
/end GROUP
/begin GROUP S16_LP_filter "PubIfControlLATC_MDL/Subsystem Reference/LATC/LateralControl/ESS_SteerSpd_Test/LP filter" /begin REF_MEASUREMENT LCS_ESS_TarAngleSpdFilter /end REF_MEASUREMENT /end GROUP
/begin GROUP S16_LP_filter1 "PubIfControlLATC_MDL/Subsystem Reference/LATC/LateralControl/ESS_SteerSpd_Test/LP filter1" /begin REF_MEASUREMENT LCS_ESS_SteerWheelAngleSpdFilter /end REF_MEASUREMENT /end GROUP
/begin GROUP S16_NotActiveFlgDelayTime "PubIfControlLATC_MDL/Subsystem Reference/LATC/LateralControl/ESS_SteerSpd_Test/NotActiveFlgDelayTime" /begin REF_MEASUREMENT LCS_ESS_NotActiveDelayFlg /end REF_MEASUREMENT /end GROUP
/begin GROUP S17_Lateral_Control "PubIfControlLATC_MDL/Subsystem Reference/LATC/LateralControl/LCS_Angle/Lateral_Control" /begin SUB_GROUP S36_kinematics_MPC /end SUB_GROUP /end GROUP
/begin GROUP S17_Motion_Planning "PubIfControlLATC_MDL/Subsystem Reference/LATC/LateralControl/LCS_Angle/Motion_Planning" /begin SUB_GROUP S37_CartesianTrajectory_MPC /end SUB_GROUP /end GROUP
/begin GROUP S17_OverRideDetect "PubIfControlLATC_MDL/Subsystem Reference/LATC/LateralControl/LCS_Angle/OverRideDetect"
 /begin REF_CHARACTERISTIC P_LCS_DetNoOverRide_DrvTrq_TH P_LCS_DetOverRide_DrvTrq_TH P_LCS_NoOverRideTime_TH_s P_LCS_OverRideDetect_b P_LCS_OverRideTime_TH_s /end REF_CHARACTERISTIC
 /begin REF_MEASUREMENT LCS_OverRideDetect_b /end REF_MEASUREMENT
/end GROUP
/begin GROUP S17_SteerAngleCorrect "PubIfControlLATC_MDL/Subsystem Reference/LATC/LateralControl/LCS_Angle/SteerAngleCorrect"
 /begin REF_MEASUREMENT LCS_CurSteerAngle_deg LCS_IN_CurSteerAngle_deg LCS_IN_SteerAngleSpd_degs /end REF_MEASUREMENT
/end GROUP
/begin GROUP S17_Subsystem "PubIfControlLATC_MDL/Subsystem Reference/LATC/LateralControl/LCS_Angle/Subsystem" /begin REF_MEASUREMENT LCS_EqA0 /end REF_MEASUREMENT /end GROUP
/begin GROUP S17_Vehicle_Speed "PubIfControlLATC_MDL/Subsystem Reference/LATC/LateralControl/LCS_Angle/Vehicle_Speed" /begin REF_MEASUREMENT LCS_IN_Spd_Kph /end REF_MEASUREMENT /end GROUP
/begin GROUP S36_kinematics_MPC "PubIfControlLATC_MDL/Subsystem Reference/LATC/LateralControl/LCS_Angle/Lateral_Control/kinematics_MPC"
 /begin SUB_GROUP S42_Median_Filter S42_SteerAngSlopeCalc S42_Understeer_Offset_Calc /end SUB_GROUP
 /begin REF_CHARACTERISTIC P_Global_SteeringAngleRatio P_LCS_LATC_MPCDeltaT_s P_LCS_LATC_MPCMatrixQ1_st P_LCS_LATC_MPCMatrixQ2_st P_LCS_LATC_MPCMatrixR_st P_LCS_LATC_MPCMaxSterAngleSpd_degs P_LCS_LATC_MPCMaxSterAngle_deg P_LCS_LCC_HeadingErRrateTime_s P_LCS_LCC_HeadingErrTime_s P_LCS_LCC_LaterErrRateTime_s P_LCS_LCC_LaterErrTime_s P_LCS_LCC_RefThetaTime_s P_LCS_LCC_RefcurveTime_s P_LCS_VehicleSpd_TabX_Kph /end REF_CHARACTERISTIC
 /begin REF_MEASUREMENT LCS_LATC_CorrectSteerAngle_deg LCS_LATC_Feedback_deg LCS_LATC_Feedforward_deg LCS_LATC_MPCDeltaT_s LCS_LATC_MatrixResult_deg LCS_LATC_OutTrgSteerAngle LCS_LATC_SteerAngleCmd_deg LCS_LATC_SteerAngleLimit_deg LCS_LATC_TarAngle_deg /end REF_MEASUREMENT
/end GROUP
/begin GROUP S37_CartesianTrajectory_MPC "PubIfControlLATC_MDL/Subsystem Reference/LATC/LateralControl/LCS_Angle/Motion_Planning/CartesianTrajectory_MPC" /begin SUB_GROUP S62_Subsystem /end SUB_GROUP /begin REF_CHARACTERISTIC P_LCS_PLAN_DisFac_Tab_ratio P_LCS_PLAN_MinDis_m /end REF_CHARACTERISTIC
 /begin REF_MEASUREMENT LCS_LATC_PlanAyDt LCS_LATC_PlanLength LCS_LATC_PlanT LCS_PLAN_TrajectoryX LCS_PLAN_Trajectory_NumTraj LCS_PLAN_Trajectory_PlanY /end REF_MEASUREMENT
/end GROUP
/begin GROUP S42_Median_Filter "PubIfControlLATC_MDL/Subsystem Reference/LATC/LateralControl/LCS_Angle/Lateral_Control/kinematics_MPC/Median_Filter" /begin REF_CHARACTERISTIC P_LCS_LATC_TarAngleFliterWindowSize /end REF_CHARACTERISTIC /begin REF_MEASUREMENT LCS_LATC_TarAngleFilter_deg /end REF_MEASUREMENT /end GROUP
/begin GROUP S42_SteerAngSlopeCalc "PubIfControlLATC_MDL/Subsystem Reference/LATC/LateralControl/LCS_Angle/Lateral_Control/kinematics_MPC/SteerAngSlopeCalc" /begin SUB_GROUP S51_Switch_Case_Action_Subsystem /end SUB_GROUP
 /begin REF_CHARACTERISTIC P_LCS_LATC_ELKAngleSlope_ratio P_LCS_LATC_ELKMaxLatAcc_ms2 P_LCS_LATC_ESSAngleSlope_ratio P_LCS_LATC_ESSMaxLatAcc_ms2 P_LCS_LATC_LCAngleSlope_ratio P_LCS_LATC_LCCancleMaxLatAcc_ms2 P_LCS_LATC_LCEcoAngleSlope_ratio P_LCS_LATC_LCEcoMaxLatAcc_ms2 P_LCS_LATC_LCKAngleSlope_ratio P_LCS_LATC_LCKIEAngleSlope_ratio P_LCS_LATC_LCKIEMaxLatAcc_ms2 P_LCS_LATC_LCKMaxLatAcc_ms2 P_LCS_LATC_LCNormalAngleSlope_ratio P_LCS_LATC_LCNormalMaxLatAcc_ms2 P_LCS_LATC_LCSportAngleSlope_ratio P_LCS_LATC_LCSportMaxLatAcc_ms2 P_LCS_LATC_LKAAngleSlope_ratio P_LCS_LATC_LKAMaxLatAcc_ms2 P_LCS_LATC_StateHoldTime_st P_LCS_VehicleSpd_TabX_Kph /end REF_CHARACTERISTIC
 /begin REF_MEASUREMENT LCS_LATC_AngleSlopeFlg_st LCS_LATC_HoldTime_s LCS_LATC_MaxAy_ms2 LCS_LATC_StateActAngleSlope_degs LCS_LATC_StateAngleSlope_degs /end REF_MEASUREMENT
/end GROUP
/begin GROUP S42_Understeer_Offset_Calc "PubIfControlLATC_MDL/Subsystem Reference/LATC/LateralControl/LCS_Angle/Lateral_Control/kinematics_MPC/Understeer&Offset_Calc" /begin SUB_GROUP S53_Enabled_Subsystem /end SUB_GROUP
 /begin REF_CHARACTERISTIC P_Global_CharSpd_ms P_Global_SteeringAngleRatio P_Global_WheelBase_m P_LCS_LATC_CurOffsetA2FliterT_s P_LCS_LATC_CurOffsetVehicleSpdLimitValue_degs /end REF_CHARACTERISTIC
 /begin REF_MEASUREMENT LCS_OffSetUpdate_Flg /end REF_MEASUREMENT
/end GROUP
/begin GROUP S62_Subsystem "PubIfControlLATC_MDL/Subsystem Reference/LATC/LateralControl/LCS_Angle/Motion_Planning/CartesianTrajectory_MPC/Subsystem" /begin SUB_GROUP S64_LP_filter S64_Subsystem /end SUB_GROUP
 /begin REF_CHARACTERISTIC P_LCS_PLAN_A2FliterTime_s P_LCS_PLAN_DesLineA0_TabY_m P_LCS_PLAN_LCKAyDtLimit_Tab_ms3 P_LCS_PLAN_LCPreDisFac_ratio P_LCS_PLAN_PreDisCurve_TabX_m P_LCS_PLAN_PreDis_Tab_m P_LCS_PLAN_StateHoldTime_st P_LCS_PLAN_TarDangerlLevel_Tabx_st P_LCS_PLAN_VehicleSpd_TabY_Kph P_LCS_PlLAN_PreDisFac_Tab_ratio P_LCS_Plan_A2Pretime_s P_LCS_Plan_ELKAyDtLimit_Tab_ms3 P_LCS_Plan_LCAyDtLimit_Tab_ms3 P_LCS_Plan_LCKIEAyDtLimit_Tab_ms3 P_LCS_Plan_LCNomalAyDtLimit_Tab_ms3 P_LCS_Plan_LCSportAyDtLimit_Tab_ms3 P_LCS_Plan_LKAAyDtLimit_Tab_ms3 /end REF_CHARACTERISTIC
 /begin REF_MEASUREMENT LCS_Plan_AyDtlimit LCS_Plan_FinalpreDis /end REF_MEASUREMENT
/end GROUP
/begin GROUP S51_Switch_Case_Action_Subsystem "PubIfControlLATC_MDL/Subsystem Reference/LATC/LateralControl/LCS_Angle/Lateral_Control/kinematics_MPC/SteerAngSlopeCalc/Switch Case Action Subsystem"
 /begin REF_CHARACTERISTIC P_LCS_LATC_StateActivAngleSlopeLimit_ratio P_LCS_LATC_StateActiveFlg_TabX_st P_LCS_LATC_StateActiveHoldTime_TabY_st /end REF_CHARACTERISTIC
/end GROUP
/begin GROUP S53_Enabled_Subsystem "PubIfControlLATC_MDL/Subsystem Reference/LATC/LateralControl/LCS_Angle/Lateral_Control/kinematics_MPC/Understeer&Offset_Calc/Enabled Subsystem"
 /begin REF_CHARACTERISTIC P_Global_SteeringAngleRatio P_LCS_LATC_CurOffsetCurveFliterTime_Tab_s P_LCS_LATC_CurOffsetCurve_TabX_m /end REF_CHARACTERISTIC
 /begin REF_MEASUREMENT LCS_LATC_CurrentSteerAngleOffset_deg /end REF_MEASUREMENT
/end GROUP
/begin GROUP S64_LP_filter "PubIfControlLATC_MDL/Subsystem Reference/LATC/LateralControl/LCS_Angle/Motion_Planning/CartesianTrajectory_MPC/Subsystem/LP filter" /begin REF_MEASUREMENT LCS_PreDisCurve_m /end REF_MEASUREMENT /end GROUP
/begin GROUP S64_Subsystem "PubIfControlLATC_MDL/Subsystem Reference/LATC/LateralControl/LCS_Angle/Motion_Planning/CartesianTrajectory_MPC/Subsystem/Subsystem"
 /begin SUB_GROUP S68_Switch_Case_Action_Subsystem S68_Switch_Case_Action_Subsystem2 S68_Switch_Case_Action_Subsystem5 /end SUB_GROUP
/end GROUP
/begin GROUP S68_Switch_Case_Action_Subsystem "PubIfControlLATC_MDL/Subsystem Reference/LATC/LateralControl/LCS_Angle/Motion_Planning/CartesianTrajectory_MPC/Subsystem/Subsystem/Switch Case Action Subsystem"
 /begin REF_CHARACTERISTIC P_LCS_PLAN_StateActivAngleSlope_Tab_ratio P_LCS_PLAN_StateActiveFlg_TabX_st P_LCS_PLAN_StateActiveHoldTime_TabY_s /end REF_CHARACTERISTIC
/end GROUP
/begin GROUP S68_Switch_Case_Action_Subsystem2 "PubIfControlLATC_MDL/Subsystem Reference/LATC/LateralControl/LCS_Angle/Motion_Planning/CartesianTrajectory_MPC/Subsystem/Subsystem/Switch Case Action Subsystem2"
 /begin REF_CHARACTERISTIC P_LCS_PLAN_StateActiveHoldTime_TabY_s P_LCS_PLAN_StateCompleteAngleSlope_Tab_ratio P_LCS_PLAN_StateCompleteFlg_TabX_st /end REF_CHARACTERISTIC
/end GROUP
/begin GROUP S68_Switch_Case_Action_Subsystem5 "PubIfControlLATC_MDL/Subsystem Reference/LATC/LateralControl/LCS_Angle/Motion_Planning/CartesianTrajectory_MPC/Subsystem/Subsystem/Switch Case Action Subsystem5"
 /begin REF_CHARACTERISTIC P_LCS_PLAN_LCCompletePreDisFac_Tab_ratio P_LCS_PLAN_StateActiveHoldTime_TabY_s P_LCS_PLAN_StateCompleteFlg_TabX_st /end REF_CHARACTERISTIC
/end GROUP
/end MODULE
/end PROJECT
/* EOF PubIfControlLATC_MDL.a2l*/
