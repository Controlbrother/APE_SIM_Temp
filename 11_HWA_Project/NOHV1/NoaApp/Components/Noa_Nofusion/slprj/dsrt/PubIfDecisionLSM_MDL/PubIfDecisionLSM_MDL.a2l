/*
* ASAP2 file: PubIfDecisionLSM_MDL.a2l
* Copyright 2022, dSPACE GmbH. All rights reserved.
*/ ASAP2_VERSION 1 61
/* Version 1.61 */
/begin PROJECT PubIfDecisionLSM_MDL ""
/begin HEADER "" VERSION "1.1192" PROJECT_NO PubIfDecisionLSM_MDL /end HEADER
/begin MODULE PubIfDecisionLSM_MDL ""
/begin RECORD_LAYOUT Scalar_BOOLEAN FNC_VALUES 1 UBYTE ROW_DIR DIRECT /end RECORD_LAYOUT
/begin RECORD_LAYOUT Scalar_UBYTE FNC_VALUES 1 UBYTE ROW_DIR DIRECT /end RECORD_LAYOUT
/begin RECORD_LAYOUT Scalar_BYTE FNC_VALUES 1 SBYTE ROW_DIR DIRECT /end RECORD_LAYOUT
/begin RECORD_LAYOUT Scalar_UWORD FNC_VALUES 1 UWORD ROW_DIR DIRECT /end RECORD_LAYOUT
/begin RECORD_LAYOUT Scalar_SWORD FNC_VALUES 1 SWORD ROW_DIR DIRECT /end RECORD_LAYOUT
/begin RECORD_LAYOUT Scalar_ULONG FNC_VALUES 1 ULONG ROW_DIR DIRECT /end RECORD_LAYOUT
/begin RECORD_LAYOUT Scalar_LONG FNC_VALUES 1 SLONG ROW_DIR DIRECT /end RECORD_LAYOUT
/begin RECORD_LAYOUT Scalar_FLOAT32_IEEE FNC_VALUES 1 FLOAT32_IEEE ROW_DIR DIRECT /end RECORD_LAYOUT
/begin RECORD_LAYOUT Scalar_FLOAT64_IEEE FNC_VALUES 1 FLOAT64_IEEE ROW_DIR DIRECT /end RECORD_LAYOUT
/begin RECORD_LAYOUT Lookup1D_BOOLEAN FNC_VALUES 1 UBYTE ROW_DIR DIRECT /end RECORD_LAYOUT
/begin RECORD_LAYOUT Lookup1D_BYTE FNC_VALUES 1 SBYTE ROW_DIR DIRECT /end RECORD_LAYOUT
/begin RECORD_LAYOUT Lookup1D_UBYTE FNC_VALUES 1 UBYTE ROW_DIR DIRECT /end RECORD_LAYOUT
/begin RECORD_LAYOUT Lookup1D_UWORD FNC_VALUES 1 UWORD ROW_DIR DIRECT /end RECORD_LAYOUT
/begin RECORD_LAYOUT Lookup1D_WORD FNC_VALUES 1 SWORD ROW_DIR DIRECT /end RECORD_LAYOUT
/begin RECORD_LAYOUT Lookup1D_ULONG FNC_VALUES 1 ULONG ROW_DIR DIRECT /end RECORD_LAYOUT
/begin RECORD_LAYOUT Lookup1D_LONG FNC_VALUES 1 SLONG ROW_DIR DIRECT /end RECORD_LAYOUT
/begin RECORD_LAYOUT Lookup1D_FLOAT32_IEEE FNC_VALUES 1 FLOAT32_IEEE ROW_DIR DIRECT /end RECORD_LAYOUT
/begin RECORD_LAYOUT Lookup1D_FLOAT64_IEEE FNC_VALUES 1 FLOAT64_IEEE ROW_DIR DIRECT /end RECORD_LAYOUT
/begin RECORD_LAYOUT Lookup1D_X_BOOLEAN AXIS_PTS_X 1 UBYTE INDEX_INCR DIRECT /end RECORD_LAYOUT
/begin RECORD_LAYOUT Lookup1D_X_BYTE AXIS_PTS_X 1 SBYTE INDEX_INCR DIRECT /end RECORD_LAYOUT
/begin RECORD_LAYOUT Lookup1D_X_UBYTE AXIS_PTS_X 1 UBYTE INDEX_INCR DIRECT /end RECORD_LAYOUT
/begin RECORD_LAYOUT Lookup1D_X_UWORD AXIS_PTS_X 1 UWORD INDEX_INCR DIRECT /end RECORD_LAYOUT
/begin RECORD_LAYOUT Lookup1D_X_WORD AXIS_PTS_X 1 SWORD INDEX_INCR DIRECT /end RECORD_LAYOUT
/begin RECORD_LAYOUT Lookup1D_X_ULONG AXIS_PTS_X 1 ULONG INDEX_INCR DIRECT /end RECORD_LAYOUT
/begin RECORD_LAYOUT Lookup1D_X_LONG AXIS_PTS_X 1 SLONG INDEX_INCR DIRECT /end RECORD_LAYOUT
/begin RECORD_LAYOUT Lookup1D_X_FLOAT32_IEEE AXIS_PTS_X 1 FLOAT32_IEEE INDEX_INCR DIRECT /end RECORD_LAYOUT
/begin RECORD_LAYOUT Lookup1D_X_FLOAT64_IEEE AXIS_PTS_X 1 FLOAT64_IEEE INDEX_INCR DIRECT /end RECORD_LAYOUT
/begin RECORD_LAYOUT Lookup2D_BOOLEAN FNC_VALUES 1 UBYTE ROW_DIR DIRECT /end RECORD_LAYOUT
/begin RECORD_LAYOUT Lookup2D_UBYTE FNC_VALUES 1 UBYTE ROW_DIR DIRECT /end RECORD_LAYOUT
/begin RECORD_LAYOUT Lookup2D_BYTE FNC_VALUES 1 SBYTE ROW_DIR DIRECT /end RECORD_LAYOUT
/begin RECORD_LAYOUT Lookup2D_UWORD FNC_VALUES 1 UWORD ROW_DIR DIRECT /end RECORD_LAYOUT
/begin RECORD_LAYOUT Lookup2D_WORD FNC_VALUES 1 SWORD ROW_DIR DIRECT /end RECORD_LAYOUT
/begin RECORD_LAYOUT Lookup2D_ULONG FNC_VALUES 1 ULONG ROW_DIR DIRECT /end RECORD_LAYOUT
/begin RECORD_LAYOUT Lookup2D_LONG FNC_VALUES 1 SLONG ROW_DIR DIRECT /end RECORD_LAYOUT
/begin RECORD_LAYOUT Lookup2D_FLOAT32_IEEE FNC_VALUES 1 FLOAT32_IEEE ROW_DIR DIRECT /end RECORD_LAYOUT
/begin RECORD_LAYOUT Lookup2D_FLOAT64_IEEE FNC_VALUES 1 FLOAT64_IEEE ROW_DIR DIRECT /end RECORD_LAYOUT
/begin RECORD_LAYOUT Lookup2D_X_BOOLEAN AXIS_PTS_X 1 UBYTE INDEX_INCR DIRECT /end RECORD_LAYOUT
/begin RECORD_LAYOUT Lookup2D_X_UBYTE AXIS_PTS_X 1 UBYTE INDEX_INCR DIRECT /end RECORD_LAYOUT
/begin RECORD_LAYOUT Lookup2D_X_BYTE AXIS_PTS_X 1 SBYTE INDEX_INCR DIRECT /end RECORD_LAYOUT
/begin RECORD_LAYOUT Lookup2D_X_UWORD AXIS_PTS_X 1 UWORD INDEX_INCR DIRECT /end RECORD_LAYOUT
/begin RECORD_LAYOUT Lookup2D_X_WORD AXIS_PTS_X 1 SWORD INDEX_INCR DIRECT /end RECORD_LAYOUT
/begin RECORD_LAYOUT Lookup2D_X_ULONG AXIS_PTS_X 1 ULONG INDEX_INCR DIRECT /end RECORD_LAYOUT
/begin RECORD_LAYOUT Lookup2D_X_LONG AXIS_PTS_X 1 SLONG INDEX_INCR DIRECT /end RECORD_LAYOUT
/begin RECORD_LAYOUT Lookup2D_X_FLOAT32_IEEE AXIS_PTS_X 1 FLOAT32_IEEE INDEX_INCR DIRECT /end RECORD_LAYOUT
/begin RECORD_LAYOUT Lookup2D_X_FLOAT64_IEEE AXIS_PTS_X 1 FLOAT64_IEEE INDEX_INCR DIRECT /end RECORD_LAYOUT
/begin CHARACTERISTIC P_LSM_DOP_PreDis_Y "" CURVE 0x0 /* @MemoryAddress@P_LSM_DOP_PreDis_Y@ */ Lookup1D_FLOAT32_IEEE 0 PubIfDecisionLSM_MDL_CM_single -3.4E+38 3.4E+38
 /begin AXIS_DESCR COM_AXIS NO_INPUT_QUANTITY PubIfDecisionLSM_MDL_CM_single 16 -3.4E+38 3.4E+38 AXIS_PTS_REF P_LSM_DOP_PreDis_X /end AXIS_DESCR
/end CHARACTERISTIC
/begin AXIS_PTS P_LSM_DOP_PreDis_X "" 0x0 /* @MemoryAddress@P_LSM_DOP_PreDis_X@ */ /* Input Quantity */ NO_INPUT_QUANTITY Lookup1D_X_FLOAT32_IEEE 0 PubIfDecisionLSM_MDL_CM_single 16 -3.4E+38 3.4E+38 /end AXIS_PTS
/begin CHARACTERISTIC P_LSM_DOP_C1_EN_Limit "" CURVE 0x0 /* @MemoryAddress@P_LSM_DOP_C1_EN_Limit@ */ Lookup1D_FLOAT32_IEEE 0 PubIfDecisionLSM_MDL_CM_single -3.4E+38 3.4E+38
 /begin AXIS_DESCR COM_AXIS NO_INPUT_QUANTITY PubIfDecisionLSM_MDL_CM_single 7 -3.4E+38 3.4E+38 AXIS_PTS_REF P_LSM_DOP_C1AndC2_Lim_X /end AXIS_DESCR
/end CHARACTERISTIC
/begin AXIS_PTS P_LSM_DOP_C1AndC2_Lim_X "" 0x0 /* @MemoryAddress@P_LSM_DOP_C1AndC2_Lim_X@ */ /* Input Quantity */ NO_INPUT_QUANTITY Lookup1D_X_FLOAT32_IEEE 0 PubIfDecisionLSM_MDL_CM_single 7 -3.4E+38 3.4E+38 /end AXIS_PTS
/begin CHARACTERISTIC P_LSM_DOP_C2_EN_Limit "" CURVE 0x0 /* @MemoryAddress@P_LSM_DOP_C2_EN_Limit@ */ Lookup1D_FLOAT32_IEEE 0 PubIfDecisionLSM_MDL_CM_single -3.4E+38 3.4E+38
 /begin AXIS_DESCR COM_AXIS NO_INPUT_QUANTITY PubIfDecisionLSM_MDL_CM_single 7 -3.4E+38 3.4E+38 AXIS_PTS_REF P_LSM_DOP_C1AndC2_Lim_X /end AXIS_DESCR
/end CHARACTERISTIC
/begin CHARACTERISTIC P_LSM_DOP_C1_out_Limit "" CURVE 0x0 /* @MemoryAddress@P_LSM_DOP_C1_out_Limit@ */ Lookup1D_FLOAT32_IEEE 0 PubIfDecisionLSM_MDL_CM_single -3.4E+38 3.4E+38
 /begin AXIS_DESCR COM_AXIS NO_INPUT_QUANTITY PubIfDecisionLSM_MDL_CM_single 7 -3.4E+38 3.4E+38 AXIS_PTS_REF P_LSM_DOP_C1AndC2_Lim_X /end AXIS_DESCR
/end CHARACTERISTIC
/begin CHARACTERISTIC P_LSM_DOP_C2_out_Limit "" CURVE 0x0 /* @MemoryAddress@P_LSM_DOP_C2_out_Limit@ */ Lookup1D_FLOAT32_IEEE 0 PubIfDecisionLSM_MDL_CM_single -3.4E+38 3.4E+38
 /begin AXIS_DESCR COM_AXIS NO_INPUT_QUANTITY PubIfDecisionLSM_MDL_CM_single 7 -3.4E+38 3.4E+38 AXIS_PTS_REF P_LSM_DOP_C1AndC2_Lim_X /end AXIS_DESCR
/end CHARACTERISTIC
/begin CHARACTERISTIC P_LSM_DoubleLine_DOPOut_C1 "" CURVE 0x0 /* @MemoryAddress@P_LSM_DoubleLine_DOPOut_C1@ */ Lookup1D_FLOAT32_IEEE 0 PubIfDecisionLSM_MDL_CM_single -3.4E+38 3.4E+38
 /begin AXIS_DESCR COM_AXIS NO_INPUT_QUANTITY PubIfDecisionLSM_MDL_CM_single 7 -3.4E+38 3.4E+38 AXIS_PTS_REF P_LSM_DOP_C1AndC2_Lim_X /end AXIS_DESCR
/end CHARACTERISTIC
/begin CHARACTERISTIC P_LSM_SingleLine_DOPOut_C1 "" CURVE 0x0 /* @MemoryAddress@P_LSM_SingleLine_DOPOut_C1@ */ Lookup1D_FLOAT32_IEEE 0 PubIfDecisionLSM_MDL_CM_single -3.4E+38 3.4E+38
 /begin AXIS_DESCR COM_AXIS NO_INPUT_QUANTITY PubIfDecisionLSM_MDL_CM_single 7 -3.4E+38 3.4E+38 AXIS_PTS_REF P_LSM_DOP_C1AndC2_Lim_X /end AXIS_DESCR
/end CHARACTERISTIC
/begin CHARACTERISTIC P_LSM_DOP_C0_EN_Limit "" VALUE 0x0 /* @MemoryAddress@P_LSM_DOP_C0_EN_Limit@ */ Scalar_FLOAT64_IEEE 0 PubIfDecisionLSM_MDL_CM_double -1.7E+308 1.7E+308 /end CHARACTERISTIC
/begin CHARACTERISTIC P_LSM_DOP_C0_out_Limit "" VALUE 0x0 /* @MemoryAddress@P_LSM_DOP_C0_out_Limit@ */ Scalar_FLOAT64_IEEE 0 PubIfDecisionLSM_MDL_CM_double -1.7E+308 1.7E+308 /end CHARACTERISTIC
/begin CHARACTERISTIC P_LSM_NOH_Switch "" VALUE 0x0 /* @MemoryAddress@P_LSM_NOH_Switch@ */ Scalar_FLOAT64_IEEE 0 PubIfDecisionLSM_MDL_CM_double -1.7E+308 1.7E+308 /end CHARACTERISTIC
/begin CHARACTERISTIC P_LSM_DOPValid_CheckTime "" VALUE 0x0 /* @MemoryAddress@P_LSM_DOPValid_CheckTime@ */ Scalar_FLOAT32_IEEE 0 PubIfDecisionLSM_MDL_CM_single -3.4E+38 3.4E+38 /end CHARACTERISTIC
/begin CHARACTERISTIC P_LSM_DOP_In_Pre2Dop_Dis "" VALUE 0x0 /* @MemoryAddress@P_LSM_DOP_In_Pre2Dop_Dis@ */ Scalar_FLOAT32_IEEE 0 PubIfDecisionLSM_MDL_CM_single -3.4E+38 3.4E+38 /end CHARACTERISTIC
/begin CHARACTERISTIC P_LSM_DOP_Out_Pre2Dop_Dis "" VALUE 0x0 /* @MemoryAddress@P_LSM_DOP_Out_Pre2Dop_Dis@ */ Scalar_FLOAT32_IEEE 0 PubIfDecisionLSM_MDL_CM_single -3.4E+38 3.4E+38 /end CHARACTERISTIC
/begin CHARACTERISTIC P_LSM_DoubleLine_Curr2Cent_Dislimit "" VALUE 0x0 /* @MemoryAddress@P_LSM_DoubleLine_Curr2Cent_Dislimit@ */ Scalar_FLOAT32_IEEE 0 PubIfDecisionLSM_MDL_CM_single -3.4E+38 3.4E+38 /end CHARACTERISTIC
/begin CHARACTERISTIC P_LSM_DoubleLine_Dop2Cent_Dislimit "" VALUE 0x0 /* @MemoryAddress@P_LSM_DoubleLine_Dop2Cent_Dislimit@ */ Scalar_FLOAT32_IEEE 0 PubIfDecisionLSM_MDL_CM_single -3.4E+38 3.4E+38 /end CHARACTERISTIC
/begin CHARACTERISTIC P_LSM_DoubleLine_Pre2Cent_Dislimit "" VALUE 0x0 /* @MemoryAddress@P_LSM_DoubleLine_Pre2Cent_Dislimit@ */ Scalar_FLOAT32_IEEE 0 PubIfDecisionLSM_MDL_CM_single -3.4E+38 3.4E+38 /end CHARACTERISTIC
/begin CHARACTERISTIC P_LSM_IFV2CenterAxis "" VALUE 0x0 /* @MemoryAddress@P_LSM_IFV2CenterAxis@ */ Scalar_FLOAT32_IEEE 0 PubIfDecisionLSM_MDL_CM_single -3.4E+38 3.4E+38 /end CHARACTERISTIC
/begin CHARACTERISTIC P_LSM_IFV2RearAxis "" VALUE 0x0 /* @MemoryAddress@P_LSM_IFV2RearAxis@ */ Scalar_FLOAT32_IEEE 0 PubIfDecisionLSM_MDL_CM_single -3.4E+38 3.4E+38 /end CHARACTERISTIC
/begin CHARACTERISTIC P_LSM_LineSTD_Limit "" VALUE 0x0 /* @MemoryAddress@P_LSM_LineSTD_Limit@ */ Scalar_FLOAT32_IEEE 0 PubIfDecisionLSM_MDL_CM_single -3.4E+38 3.4E+38 /end CHARACTERISTIC
/begin CHARACTERISTIC P_LSM_LineWijCal_C12 "" VALUE 0x0 /* @MemoryAddress@P_LSM_LineWijCal_C12@ */ Scalar_FLOAT32_IEEE 0 PubIfDecisionLSM_MDL_CM_single -3.4E+38 3.4E+38 /end CHARACTERISTIC
/begin CHARACTERISTIC P_LSM_LineWijCal_C13 "" VALUE 0x0 /* @MemoryAddress@P_LSM_LineWijCal_C13@ */ Scalar_FLOAT32_IEEE 0 PubIfDecisionLSM_MDL_CM_single -3.4E+38 3.4E+38 /end CHARACTERISTIC
/begin CHARACTERISTIC P_LSM_PosLineLcFac "" VALUE 0x0 /* @MemoryAddress@P_LSM_PosLineLcFac@ */ Scalar_FLOAT32_IEEE 0 PubIfDecisionLSM_MDL_CM_single -3.4E+38 3.4E+38 /end CHARACTERISTIC
/begin CHARACTERISTIC P_LSM_Pre_t "" VALUE 0x0 /* @MemoryAddress@P_LSM_Pre_t@ */ Scalar_FLOAT32_IEEE 0 PubIfDecisionLSM_MDL_CM_single -3.4E+38 3.4E+38 /end CHARACTERISTIC
/begin CHARACTERISTIC P_LSM_SingleLine_Cent2Edge_Dislimit "" VALUE 0x0 /* @MemoryAddress@P_LSM_SingleLine_Cent2Edge_Dislimit@ */ Scalar_FLOAT32_IEEE 0 PubIfDecisionLSM_MDL_CM_single -3.4E+38 3.4E+38 /end CHARACTERISTIC
/begin CHARACTERISTIC P_LSM_SingleLine_Curr2Cent_Dislimit "" VALUE 0x0 /* @MemoryAddress@P_LSM_SingleLine_Curr2Cent_Dislimit@ */ Scalar_FLOAT32_IEEE 0 PubIfDecisionLSM_MDL_CM_single -3.4E+38 3.4E+38 /end CHARACTERISTIC
/begin CHARACTERISTIC P_LSM_SingleLine_Dop2Cent_Dislimit "" VALUE 0x0 /* @MemoryAddress@P_LSM_SingleLine_Dop2Cent_Dislimit@ */ Scalar_FLOAT32_IEEE 0 PubIfDecisionLSM_MDL_CM_single -3.4E+38 3.4E+38 /end CHARACTERISTIC
/begin CHARACTERISTIC P_LSM_SingleLine_Pre2Cent_Dislimit "" VALUE 0x0 /* @MemoryAddress@P_LSM_SingleLine_Pre2Cent_Dislimit@ */ Scalar_FLOAT32_IEEE 0 PubIfDecisionLSM_MDL_CM_single -3.4E+38 3.4E+38 /end CHARACTERISTIC
/begin CHARACTERISTIC P_LSM_ALC_Enable "" VALUE 0x0 /* @MemoryAddress@P_LSM_ALC_Enable@ */ Scalar_UBYTE 0 PubIfDecisionLSM_MDL_CM_uint8 0 255 /end CHARACTERISTIC
/begin MEASUREMENT LSM_UpdateCnt "" ULONG PubIfDecisionLSM_MDL_CM_uint32 0 0 0 4294967295 ECU_ADDRESS 0x0 /* @MemoryAddress@LSM_UpdateCnt@ */ /end MEASUREMENT
/begin MEASUREMENT LSM_QualityK1 "" FLOAT32_IEEE PubIfDecisionLSM_MDL_CM_single 0 0 -3.4E+38 3.4E+38 ECU_ADDRESS 0x0 /* @MemoryAddress@LSM_QualityK1@ */ /end MEASUREMENT
/begin MEASUREMENT LSM_A3K1 "" FLOAT32_IEEE PubIfDecisionLSM_MDL_CM_single 0 0 -3.4E+38 3.4E+38 ECU_ADDRESS 0x0 /* @MemoryAddress@LSM_A3K1@ */ /end MEASUREMENT
/begin MEASUREMENT LSM_A2K1 "" FLOAT32_IEEE PubIfDecisionLSM_MDL_CM_single 0 0 -3.4E+38 3.4E+38 ECU_ADDRESS 0x0 /* @MemoryAddress@LSM_A2K1@ */ /end MEASUREMENT
/begin MEASUREMENT LSM_A1K1 "" FLOAT32_IEEE PubIfDecisionLSM_MDL_CM_single 0 0 -3.4E+38 3.4E+38 ECU_ADDRESS 0x0 /* @MemoryAddress@LSM_A1K1@ */ /end MEASUREMENT
/begin MEASUREMENT LSM_A0K1 "" FLOAT32_IEEE PubIfDecisionLSM_MDL_CM_single 0 0 -3.4E+38 3.4E+38 ECU_ADDRESS 0x0 /* @MemoryAddress@LSM_A0K1@ */ /end MEASUREMENT
/begin MEASUREMENT LSM_RangeK1 "" FLOAT32_IEEE PubIfDecisionLSM_MDL_CM_single 0 0 -3.4E+38 3.4E+38 ECU_ADDRESS 0x0 /* @MemoryAddress@LSM_RangeK1@ */ /end MEASUREMENT
/begin MEASUREMENT LSM_tLostK1 "" FLOAT32_IEEE PubIfDecisionLSM_MDL_CM_single 0 0 -3.4E+38 3.4E+38 ECU_ADDRESS 0x0 /* @MemoryAddress@LSM_tLostK1@ */ /end MEASUREMENT
/begin MEASUREMENT LSM_HWALineC0K1 "" FLOAT32_IEEE PubIfDecisionLSM_MDL_CM_single 0 0 -3.4E+38 3.4E+38 ECU_ADDRESS 0x0 /* @MemoryAddress@LSM_HWALineC0K1@ */ /end MEASUREMENT
/begin MEASUREMENT LSM_LH21 "" FLOAT32_IEEE PubIfDecisionLSM_MDL_CM_single 0 0 -3.4E+38 3.4E+38 ECU_ADDRESS 0x0 /* @MemoryAddress@LSM_LH21@ */ /end MEASUREMENT
/begin MEASUREMENT LSM_LH22 "" FLOAT32_IEEE PubIfDecisionLSM_MDL_CM_single 0 0 -3.4E+38 3.4E+38 ECU_ADDRESS 0x0 /* @MemoryAddress@LSM_LH22@ */ /end MEASUREMENT
/begin MEASUREMENT LSM_LH23 "" FLOAT32_IEEE PubIfDecisionLSM_MDL_CM_single 0 0 -3.4E+38 3.4E+38 ECU_ADDRESS 0x0 /* @MemoryAddress@LSM_LH23@ */ /end MEASUREMENT
/begin MEASUREMENT LSM_LH1Wij "" FLOAT32_IEEE PubIfDecisionLSM_MDL_CM_single 0 0 -3.4E+38 3.4E+38 ECU_ADDRESS 0x0 /* @MemoryAddress@LSM_LH1Wij@ */ /end MEASUREMENT
/begin MEASUREMENT LSM_LH31 "" FLOAT32_IEEE PubIfDecisionLSM_MDL_CM_single 0 0 -3.4E+38 3.4E+38 ECU_ADDRESS 0x0 /* @MemoryAddress@LSM_LH31@ */ /end MEASUREMENT
/begin MEASUREMENT LSM_LH32 "" FLOAT32_IEEE PubIfDecisionLSM_MDL_CM_single 0 0 -3.4E+38 3.4E+38 ECU_ADDRESS 0x0 /* @MemoryAddress@LSM_LH32@ */ /end MEASUREMENT
/begin MEASUREMENT LSM_LH33 "" FLOAT32_IEEE PubIfDecisionLSM_MDL_CM_single 0 0 -3.4E+38 3.4E+38 ECU_ADDRESS 0x0 /* @MemoryAddress@LSM_LH33@ */ /end MEASUREMENT
/begin MEASUREMENT LSM_LH2Wij "" FLOAT32_IEEE PubIfDecisionLSM_MDL_CM_single 0 0 -3.4E+38 3.4E+38 ECU_ADDRESS 0x0 /* @MemoryAddress@LSM_LH2Wij@ */ /end MEASUREMENT
/begin MEASUREMENT LSM_TJALineC3 "" FLOAT32_IEEE PubIfDecisionLSM_MDL_CM_single 0 0 -3.4E+38 3.4E+38 ECU_ADDRESS 0x0 /* @MemoryAddress@LSM_TJALineC3@ */ /end MEASUREMENT
/begin MEASUREMENT LSM_LCKLineC0 "" FLOAT32_IEEE PubIfDecisionLSM_MDL_CM_single 0 0 -3.4E+38 3.4E+38 ECU_ADDRESS 0x0 /* @MemoryAddress@LSM_LCKLineC0@ */ /end MEASUREMENT
/begin MEASUREMENT LSM_LCKRange "" FLOAT32_IEEE PubIfDecisionLSM_MDL_CM_single 0 0 -3.4E+38 3.4E+38 ECU_ADDRESS 0x0 /* @MemoryAddress@LSM_LCKRange@ */ /end MEASUREMENT
/begin MEASUREMENT LSM_HWALineC3 "" FLOAT32_IEEE PubIfDecisionLSM_MDL_CM_single 0 0 -3.4E+38 3.4E+38 ECU_ADDRESS 0x0 /* @MemoryAddress@LSM_HWALineC3@ */ /end MEASUREMENT
/begin MEASUREMENT LSM_HWALineC2 "" FLOAT32_IEEE PubIfDecisionLSM_MDL_CM_single 0 0 -3.4E+38 3.4E+38 ECU_ADDRESS 0x0 /* @MemoryAddress@LSM_HWALineC2@ */ /end MEASUREMENT
/begin MEASUREMENT LSM_HWALineC1 "" FLOAT32_IEEE PubIfDecisionLSM_MDL_CM_single 0 0 -3.4E+38 3.4E+38 ECU_ADDRESS 0x0 /* @MemoryAddress@LSM_HWALineC1@ */ /end MEASUREMENT
/begin MEASUREMENT LSM_HWALeLineC3 "" FLOAT32_IEEE PubIfDecisionLSM_MDL_CM_single 0 0 -3.4E+38 3.4E+38 ECU_ADDRESS 0x0 /* @MemoryAddress@LSM_HWALeLineC3@ */ /end MEASUREMENT
/begin MEASUREMENT LSM_HWALeLineC2 "" FLOAT32_IEEE PubIfDecisionLSM_MDL_CM_single 0 0 -3.4E+38 3.4E+38 ECU_ADDRESS 0x0 /* @MemoryAddress@LSM_HWALeLineC2@ */ /end MEASUREMENT
/begin MEASUREMENT LSM_HWALeLineC1 "" FLOAT32_IEEE PubIfDecisionLSM_MDL_CM_single 0 0 -3.4E+38 3.4E+38 ECU_ADDRESS 0x0 /* @MemoryAddress@LSM_HWALeLineC1@ */ /end MEASUREMENT
/begin MEASUREMENT LSM_HWALeLineC0 "" FLOAT32_IEEE PubIfDecisionLSM_MDL_CM_single 0 0 -3.4E+38 3.4E+38 ECU_ADDRESS 0x0 /* @MemoryAddress@LSM_HWALeLineC0@ */ /end MEASUREMENT
/begin MEASUREMENT LSM_TJALineC2 "" FLOAT32_IEEE PubIfDecisionLSM_MDL_CM_single 0 0 -3.4E+38 3.4E+38 ECU_ADDRESS 0x0 /* @MemoryAddress@LSM_TJALineC2@ */ /end MEASUREMENT
/begin MEASUREMENT LSM_HWALeRange "" FLOAT32_IEEE PubIfDecisionLSM_MDL_CM_single 0 0 -3.4E+38 3.4E+38 ECU_ADDRESS 0x0 /* @MemoryAddress@LSM_HWALeRange@ */ /end MEASUREMENT
/begin MEASUREMENT LSM_HWALineC0 "" FLOAT32_IEEE PubIfDecisionLSM_MDL_CM_single 0 0 -3.4E+38 3.4E+38 ECU_ADDRESS 0x0 /* @MemoryAddress@LSM_HWALineC0@ */ /end MEASUREMENT
/begin MEASUREMENT LSM_HWARange "" FLOAT32_IEEE PubIfDecisionLSM_MDL_CM_single 0 0 -3.4E+38 3.4E+38 ECU_ADDRESS 0x0 /* @MemoryAddress@LSM_HWARange@ */ /end MEASUREMENT
/begin MEASUREMENT LSM_HWARiLineC1 "" FLOAT32_IEEE PubIfDecisionLSM_MDL_CM_single 0 0 -3.4E+38 3.4E+38 ECU_ADDRESS 0x0 /* @MemoryAddress@LSM_HWARiLineC1@ */ /end MEASUREMENT
/begin MEASUREMENT LSM_HWARiLineC0 "" FLOAT32_IEEE PubIfDecisionLSM_MDL_CM_single 0 0 -3.4E+38 3.4E+38 ECU_ADDRESS 0x0 /* @MemoryAddress@LSM_HWARiLineC0@ */ /end MEASUREMENT
/begin MEASUREMENT LSM_HWARiRange "" FLOAT32_IEEE PubIfDecisionLSM_MDL_CM_single 0 0 -3.4E+38 3.4E+38 ECU_ADDRESS 0x0 /* @MemoryAddress@LSM_HWARiRange@ */ /end MEASUREMENT
/begin MEASUREMENT LSM_TJALineC1 "" FLOAT32_IEEE PubIfDecisionLSM_MDL_CM_single 0 0 -3.4E+38 3.4E+38 ECU_ADDRESS 0x0 /* @MemoryAddress@LSM_TJALineC1@ */ /end MEASUREMENT
/begin MEASUREMENT LSM_HeadAngDiff "" FLOAT32_IEEE PubIfDecisionLSM_MDL_CM_single 0 0 -3.4E+38 3.4E+38 ECU_ADDRESS 0x0 /* @MemoryAddress@LSM_HeadAngDiff@ */ /end MEASUREMENT
/begin MEASUREMENT LSM_HWARiLineC3 "" FLOAT32_IEEE PubIfDecisionLSM_MDL_CM_single 0 0 -3.4E+38 3.4E+38 ECU_ADDRESS 0x0 /* @MemoryAddress@LSM_HWARiLineC3@ */ /end MEASUREMENT
/begin MEASUREMENT LSM_HWARiLineC2 "" FLOAT32_IEEE PubIfDecisionLSM_MDL_CM_single 0 0 -3.4E+38 3.4E+38 ECU_ADDRESS 0x0 /* @MemoryAddress@LSM_HWARiLineC2@ */ /end MEASUREMENT
/begin MEASUREMENT LSM_ESSLineC2 "" FLOAT32_IEEE PubIfDecisionLSM_MDL_CM_single 0 0 -3.4E+38 3.4E+38 ECU_ADDRESS 0x0 /* @MemoryAddress@LSM_ESSLineC2@ */ /end MEASUREMENT
/begin MEASUREMENT LSM_ESSLineC1 "" FLOAT32_IEEE PubIfDecisionLSM_MDL_CM_single 0 0 -3.4E+38 3.4E+38 ECU_ADDRESS 0x0 /* @MemoryAddress@LSM_ESSLineC1@ */ /end MEASUREMENT
/begin MEASUREMENT LSM_ESSLineC0 "" FLOAT32_IEEE PubIfDecisionLSM_MDL_CM_single 0 0 -3.4E+38 3.4E+38 ECU_ADDRESS 0x0 /* @MemoryAddress@LSM_ESSLineC0@ */ /end MEASUREMENT
/begin MEASUREMENT LSM_ESSRange "" FLOAT32_IEEE PubIfDecisionLSM_MDL_CM_single 0 0 -3.4E+38 3.4E+38 ECU_ADDRESS 0x0 /* @MemoryAddress@LSM_ESSRange@ */ /end MEASUREMENT
/begin MEASUREMENT LSM_ESSLeLineC3 "" FLOAT32_IEEE PubIfDecisionLSM_MDL_CM_single 0 0 -3.4E+38 3.4E+38 ECU_ADDRESS 0x0 /* @MemoryAddress@LSM_ESSLeLineC3@ */ /end MEASUREMENT
/begin MEASUREMENT LSM_TJALineC0 "" FLOAT32_IEEE PubIfDecisionLSM_MDL_CM_single 0 0 -3.4E+38 3.4E+38 ECU_ADDRESS 0x0 /* @MemoryAddress@LSM_TJALineC0@ */ /end MEASUREMENT
/begin MEASUREMENT LSM_ESSLineC3 "" FLOAT32_IEEE PubIfDecisionLSM_MDL_CM_single 0 0 -3.4E+38 3.4E+38 ECU_ADDRESS 0x0 /* @MemoryAddress@LSM_ESSLineC3@ */ /end MEASUREMENT
/begin MEASUREMENT LSM_ESSLeLineC0 "" FLOAT32_IEEE PubIfDecisionLSM_MDL_CM_single 0 0 -3.4E+38 3.4E+38 ECU_ADDRESS 0x0 /* @MemoryAddress@LSM_ESSLeLineC0@ */ /end MEASUREMENT
/begin MEASUREMENT LSM_ESSLeRange "" FLOAT32_IEEE PubIfDecisionLSM_MDL_CM_single 0 0 -3.4E+38 3.4E+38 ECU_ADDRESS 0x0 /* @MemoryAddress@LSM_ESSLeRange@ */ /end MEASUREMENT
/begin MEASUREMENT LSM_ESSRiLineC3 "" FLOAT32_IEEE PubIfDecisionLSM_MDL_CM_single 0 0 -3.4E+38 3.4E+38 ECU_ADDRESS 0x0 /* @MemoryAddress@LSM_ESSRiLineC3@ */ /end MEASUREMENT
/begin MEASUREMENT LSM_ESSRiLineC2 "" FLOAT32_IEEE PubIfDecisionLSM_MDL_CM_single 0 0 -3.4E+38 3.4E+38 ECU_ADDRESS 0x0 /* @MemoryAddress@LSM_ESSRiLineC2@ */ /end MEASUREMENT
/begin MEASUREMENT LSM_ESSRiLineC1 "" FLOAT32_IEEE PubIfDecisionLSM_MDL_CM_single 0 0 -3.4E+38 3.4E+38 ECU_ADDRESS 0x0 /* @MemoryAddress@LSM_ESSRiLineC1@ */ /end MEASUREMENT
/begin MEASUREMENT LSM_ESSLeLineC2 "" FLOAT32_IEEE PubIfDecisionLSM_MDL_CM_single 0 0 -3.4E+38 3.4E+38 ECU_ADDRESS 0x0 /* @MemoryAddress@LSM_ESSLeLineC2@ */ /end MEASUREMENT
/begin MEASUREMENT LSM_ESSLeLineC1 "" FLOAT32_IEEE PubIfDecisionLSM_MDL_CM_single 0 0 -3.4E+38 3.4E+38 ECU_ADDRESS 0x0 /* @MemoryAddress@LSM_ESSLeLineC1@ */ /end MEASUREMENT
/begin MEASUREMENT LSM_ESSRiLineC0 "" FLOAT32_IEEE PubIfDecisionLSM_MDL_CM_single 0 0 -3.4E+38 3.4E+38 ECU_ADDRESS 0x0 /* @MemoryAddress@LSM_ESSRiLineC0@ */ /end MEASUREMENT
/begin MEASUREMENT LSM_TJARange "" FLOAT32_IEEE PubIfDecisionLSM_MDL_CM_single 0 0 -3.4E+38 3.4E+38 ECU_ADDRESS 0x0 /* @MemoryAddress@LSM_TJARange@ */ /end MEASUREMENT
/begin MEASUREMENT LSM_ESSRiRange "" FLOAT32_IEEE PubIfDecisionLSM_MDL_CM_single 0 0 -3.4E+38 3.4E+38 ECU_ADDRESS 0x0 /* @MemoryAddress@LSM_ESSRiRange@ */ /end MEASUREMENT
/begin MEASUREMENT LSM_dyDiff "" FLOAT32_IEEE PubIfDecisionLSM_MDL_CM_single 0 0 -3.4E+38 3.4E+38 ECU_ADDRESS 0x0 /* @MemoryAddress@LSM_dyDiff@ */ /end MEASUREMENT
/begin MEASUREMENT LSM_RoadWidth "" FLOAT32_IEEE PubIfDecisionLSM_MDL_CM_single 0 0 -3.4E+38 3.4E+38 ECU_ADDRESS 0x0 /* @MemoryAddress@LSM_RoadWidth@ */ /end MEASUREMENT
/begin MEASUREMENT LSM_LCKLineC3 "" FLOAT32_IEEE PubIfDecisionLSM_MDL_CM_single 0 0 -3.4E+38 3.4E+38 ECU_ADDRESS 0x0 /* @MemoryAddress@LSM_LCKLineC3@ */ /end MEASUREMENT
/begin MEASUREMENT LSM_LCKLineC2 "" FLOAT32_IEEE PubIfDecisionLSM_MDL_CM_single 0 0 -3.4E+38 3.4E+38 ECU_ADDRESS 0x0 /* @MemoryAddress@LSM_LCKLineC2@ */ /end MEASUREMENT
/begin MEASUREMENT LSM_LCKLineC1 "" FLOAT32_IEEE PubIfDecisionLSM_MDL_CM_single 0 0 -3.4E+38 3.4E+38 ECU_ADDRESS 0x0 /* @MemoryAddress@LSM_LCKLineC1@ */ /end MEASUREMENT
/begin MEASUREMENT LSM_OTL_A3 "" FLOAT32_IEEE PubIfDecisionLSM_MDL_CM_single 0 0 -3.4E+38 3.4E+38 ECU_ADDRESS 0x0 /* @MemoryAddress@LSM_OTL_A3@ */ /end MEASUREMENT
/begin MEASUREMENT LSM_OTL_A2 "" FLOAT32_IEEE PubIfDecisionLSM_MDL_CM_single 0 0 -3.4E+38 3.4E+38 ECU_ADDRESS 0x0 /* @MemoryAddress@LSM_OTL_A2@ */ /end MEASUREMENT
/begin MEASUREMENT LSM_OTL_A1 "" FLOAT32_IEEE PubIfDecisionLSM_MDL_CM_single 0 0 -3.4E+38 3.4E+38 ECU_ADDRESS 0x0 /* @MemoryAddress@LSM_OTL_A1@ */ /end MEASUREMENT
/begin MEASUREMENT LSM_OTL_A0 "" FLOAT32_IEEE PubIfDecisionLSM_MDL_CM_single 0 0 -3.4E+38 3.4E+38 ECU_ADDRESS 0x0 /* @MemoryAddress@LSM_OTL_A0@ */ /end MEASUREMENT
/begin MEASUREMENT LSM_OTL_Range "" FLOAT32_IEEE PubIfDecisionLSM_MDL_CM_single 0 0 -3.4E+38 3.4E+38 ECU_ADDRESS 0x0 /* @MemoryAddress@LSM_OTL_Range@ */ /end MEASUREMENT
/begin MEASUREMENT LSM_RFM_LineCenter_C0 "" FLOAT32_IEEE PubIfDecisionLSM_MDL_CM_single 0 0 -3.4E+38 3.4E+38 ECU_ADDRESS 0x0 /* @MemoryAddress@LSM_RFM_LineCenter_C0@ */ /end MEASUREMENT
/begin MEASUREMENT LSM_RFM_LineL1_C2 "" FLOAT32_IEEE PubIfDecisionLSM_MDL_CM_single 0 0 -3.4E+38 3.4E+38 ECU_ADDRESS 0x0 /* @MemoryAddress@LSM_RFM_LineL1_C2@ */ /end MEASUREMENT
/begin MEASUREMENT LSM_RFM_LineL1_C3 "" FLOAT32_IEEE PubIfDecisionLSM_MDL_CM_single 0 0 -3.4E+38 3.4E+38 ECU_ADDRESS 0x0 /* @MemoryAddress@LSM_RFM_LineL1_C3@ */ /end MEASUREMENT
/begin MEASUREMENT LSM_RFM_LineL1_Start "" FLOAT32_IEEE PubIfDecisionLSM_MDL_CM_single 0 0 -3.4E+38 3.4E+38 ECU_ADDRESS 0x0 /* @MemoryAddress@LSM_RFM_LineL1_Start@ */ /end MEASUREMENT
/begin MEASUREMENT LSM_RFM_LineL1_Front "" FLOAT32_IEEE PubIfDecisionLSM_MDL_CM_single 0 0 -3.4E+38 3.4E+38 ECU_ADDRESS 0x0 /* @MemoryAddress@LSM_RFM_LineL1_Front@ */ /end MEASUREMENT
/begin MEASUREMENT LSM_RFM_LineR1_C2 "" FLOAT32_IEEE PubIfDecisionLSM_MDL_CM_single 0 0 -3.4E+38 3.4E+38 ECU_ADDRESS 0x0 /* @MemoryAddress@LSM_RFM_LineR1_C2@ */ /end MEASUREMENT
/begin MEASUREMENT LSM_RFM_LineR1_C3 "" FLOAT32_IEEE PubIfDecisionLSM_MDL_CM_single 0 0 -3.4E+38 3.4E+38 ECU_ADDRESS 0x0 /* @MemoryAddress@LSM_RFM_LineR1_C3@ */ /end MEASUREMENT
/begin MEASUREMENT LSM_RFM_LineR1_Start "" FLOAT32_IEEE PubIfDecisionLSM_MDL_CM_single 0 0 -3.4E+38 3.4E+38 ECU_ADDRESS 0x0 /* @MemoryAddress@LSM_RFM_LineR1_Start@ */ /end MEASUREMENT
/begin MEASUREMENT LSM_RFM_LineR1_Front "" FLOAT32_IEEE PubIfDecisionLSM_MDL_CM_single 0 0 -3.4E+38 3.4E+38 ECU_ADDRESS 0x0 /* @MemoryAddress@LSM_RFM_LineR1_Front@ */ /end MEASUREMENT
/begin MEASUREMENT LSM_RFM_LineR1_C0 "" FLOAT32_IEEE PubIfDecisionLSM_MDL_CM_single 0 0 -3.4E+38 3.4E+38 ECU_ADDRESS 0x0 /* @MemoryAddress@LSM_RFM_LineR1_C0@ */ /end MEASUREMENT
/begin MEASUREMENT LSM_RFM_LineCenter_C1 "" FLOAT32_IEEE PubIfDecisionLSM_MDL_CM_single 0 0 -3.4E+38 3.4E+38 ECU_ADDRESS 0x0 /* @MemoryAddress@LSM_RFM_LineCenter_C1@ */ /end MEASUREMENT
/begin MEASUREMENT LSM_RFM_LineR1_C1 "" FLOAT32_IEEE PubIfDecisionLSM_MDL_CM_single 0 0 -3.4E+38 3.4E+38 ECU_ADDRESS 0x0 /* @MemoryAddress@LSM_RFM_LineR1_C1@ */ /end MEASUREMENT
/begin MEASUREMENT LSM_RFM_LineCenter_C2 "" FLOAT32_IEEE PubIfDecisionLSM_MDL_CM_single 0 0 -3.4E+38 3.4E+38 ECU_ADDRESS 0x0 /* @MemoryAddress@LSM_RFM_LineCenter_C2@ */ /end MEASUREMENT
/begin MEASUREMENT LSM_RFM_LineCenter_C3 "" FLOAT32_IEEE PubIfDecisionLSM_MDL_CM_single 0 0 -3.4E+38 3.4E+38 ECU_ADDRESS 0x0 /* @MemoryAddress@LSM_RFM_LineCenter_C3@ */ /end MEASUREMENT
/begin MEASUREMENT LSM_RFM_LineCenter_Start "" FLOAT32_IEEE PubIfDecisionLSM_MDL_CM_single 0 0 -3.4E+38 3.4E+38 ECU_ADDRESS 0x0 /* @MemoryAddress@LSM_RFM_LineCenter_Start@ */ /end MEASUREMENT
/begin MEASUREMENT LSM_RFM_LineCenter_Front "" FLOAT32_IEEE PubIfDecisionLSM_MDL_CM_single 0 0 -3.4E+38 3.4E+38 ECU_ADDRESS 0x0 /* @MemoryAddress@LSM_RFM_LineCenter_Front@ */ /end MEASUREMENT
/begin MEASUREMENT LSM_RFM_LineL1_C0 "" FLOAT32_IEEE PubIfDecisionLSM_MDL_CM_single 0 0 -3.4E+38 3.4E+38 ECU_ADDRESS 0x0 /* @MemoryAddress@LSM_RFM_LineL1_C0@ */ /end MEASUREMENT
/begin MEASUREMENT LSM_RFM_LineL1_C1 "" FLOAT32_IEEE PubIfDecisionLSM_MDL_CM_single 0 0 -3.4E+38 3.4E+38 ECU_ADDRESS 0x0 /* @MemoryAddress@LSM_RFM_LineL1_C1@ */ /end MEASUREMENT
/begin MEASUREMENT LSM_L1_Range "" FLOAT32_IEEE PubIfDecisionLSM_MDL_CM_single 0 0 -3.4E+38 3.4E+38 ECU_ADDRESS 0x0 /* @MemoryAddress@LSM_L1_Range@ */ /end MEASUREMENT
/begin MEASUREMENT LSM_LA_ELEM_0_C1 "" FLOAT32_IEEE PubIfDecisionLSM_MDL_CM_single 0 0 -3.4E+38 3.4E+38 ECU_ADDRESS 0x0 /* @MemoryAddress@LSM_LA_ELEM_0_C1@ */ /end MEASUREMENT
/begin MEASUREMENT LSM_LRE_ELEM_1_C0 "" FLOAT32_IEEE PubIfDecisionLSM_MDL_CM_single 0 0 -3.4E+38 3.4E+38 ECU_ADDRESS 0x0 /* @MemoryAddress@LSM_LRE_ELEM_1_C0@ */ /end MEASUREMENT
/begin MEASUREMENT LSM_LRE_ELEM_1_Range_Start "" FLOAT32_IEEE PubIfDecisionLSM_MDL_CM_single 0 0 -3.4E+38 3.4E+38 ECU_ADDRESS 0x0 /* @MemoryAddress@LSM_LRE_ELEM_1_Range_Start@ */ /end MEASUREMENT
/begin MEASUREMENT LSM_LA_ELEM_0_C2 "" FLOAT32_IEEE PubIfDecisionLSM_MDL_CM_single 0 0 -3.4E+38 3.4E+38 ECU_ADDRESS 0x0 /* @MemoryAddress@LSM_LA_ELEM_0_C2@ */ /end MEASUREMENT
/begin MEASUREMENT LSM_LA_ELEM_0_C3 "" FLOAT32_IEEE PubIfDecisionLSM_MDL_CM_single 0 0 -3.4E+38 3.4E+38 ECU_ADDRESS 0x0 /* @MemoryAddress@LSM_LA_ELEM_0_C3@ */ /end MEASUREMENT
/begin MEASUREMENT LSM_LA_ELEM_0_Range_Start "" FLOAT32_IEEE PubIfDecisionLSM_MDL_CM_single 0 0 -3.4E+38 3.4E+38 ECU_ADDRESS 0x0 /* @MemoryAddress@LSM_LA_ELEM_0_Range_Start@ */ /end MEASUREMENT
/begin MEASUREMENT LSM_LA_ELEM_0_Range_End "" FLOAT32_IEEE PubIfDecisionLSM_MDL_CM_single 0 0 -3.4E+38 3.4E+38 ECU_ADDRESS 0x0 /* @MemoryAddress@LSM_LA_ELEM_0_Range_End@ */ /end MEASUREMENT
/begin MEASUREMENT LSM_LA_ELEM_0_Marker_Width "" FLOAT32_IEEE PubIfDecisionLSM_MDL_CM_single 0 0 -3.4E+38 3.4E+38 ECU_ADDRESS 0x0 /* @MemoryAddress@LSM_LA_ELEM_0_Marker_Width@ */ /end MEASUREMENT
/begin MEASUREMENT LSM_LA_ELEM_0_Confidence "" FLOAT32_IEEE PubIfDecisionLSM_MDL_CM_single 0 0 -3.4E+38 3.4E+38 ECU_ADDRESS 0x0 /* @MemoryAddress@LSM_LA_ELEM_0_Confidence@ */ /end MEASUREMENT
/begin MEASUREMENT LSM_LA_ELEM_1_C0 "" FLOAT32_IEEE PubIfDecisionLSM_MDL_CM_single 0 0 -3.4E+38 3.4E+38 ECU_ADDRESS 0x0 /* @MemoryAddress@LSM_LA_ELEM_1_C0@ */ /end MEASUREMENT
/begin MEASUREMENT LSM_LA_ELEM_1_C1 "" FLOAT32_IEEE PubIfDecisionLSM_MDL_CM_single 0 0 -3.4E+38 3.4E+38 ECU_ADDRESS 0x0 /* @MemoryAddress@LSM_LA_ELEM_1_C1@ */ /end MEASUREMENT
/begin MEASUREMENT LSM_LA_ELEM_1_C2 "" FLOAT32_IEEE PubIfDecisionLSM_MDL_CM_single 0 0 -3.4E+38 3.4E+38 ECU_ADDRESS 0x0 /* @MemoryAddress@LSM_LA_ELEM_1_C2@ */ /end MEASUREMENT
/begin MEASUREMENT LSM_LA_ELEM_1_C3 "" FLOAT32_IEEE PubIfDecisionLSM_MDL_CM_single 0 0 -3.4E+38 3.4E+38 ECU_ADDRESS 0x0 /* @MemoryAddress@LSM_LA_ELEM_1_C3@ */ /end MEASUREMENT
/begin MEASUREMENT LSM_LA_ELEM_1_Range_Start "" FLOAT32_IEEE PubIfDecisionLSM_MDL_CM_single 0 0 -3.4E+38 3.4E+38 ECU_ADDRESS 0x0 /* @MemoryAddress@LSM_LA_ELEM_1_Range_Start@ */ /end MEASUREMENT
/begin MEASUREMENT LSM_LA_ELEM_1_Range_End "" FLOAT32_IEEE PubIfDecisionLSM_MDL_CM_single 0 0 -3.4E+38 3.4E+38 ECU_ADDRESS 0x0 /* @MemoryAddress@LSM_LA_ELEM_1_Range_End@ */ /end MEASUREMENT
/begin MEASUREMENT LSM_L2_Range "" FLOAT32_IEEE PubIfDecisionLSM_MDL_CM_single 0 0 -3.4E+38 3.4E+38 ECU_ADDRESS 0x0 /* @MemoryAddress@LSM_L2_Range@ */ /end MEASUREMENT
/begin MEASUREMENT LSM_LA_ELEM_1_Confidence "" FLOAT32_IEEE PubIfDecisionLSM_MDL_CM_single 0 0 -3.4E+38 3.4E+38 ECU_ADDRESS 0x0 /* @MemoryAddress@LSM_LA_ELEM_1_Confidence@ */ /end MEASUREMENT
/begin MEASUREMENT LSM_LA_ELEM_1_Marker_Width "" FLOAT32_IEEE PubIfDecisionLSM_MDL_CM_single 0 0 -3.4E+38 3.4E+38 ECU_ADDRESS 0x0 /* @MemoryAddress@LSM_LA_ELEM_1_Marker_Width@ */ /end MEASUREMENT
/begin MEASUREMENT LSM_LA_ELEM_2_C0 "" FLOAT32_IEEE PubIfDecisionLSM_MDL_CM_single 0 0 -3.4E+38 3.4E+38 ECU_ADDRESS 0x0 /* @MemoryAddress@LSM_LA_ELEM_2_C0@ */ /end MEASUREMENT
/begin MEASUREMENT LSM_LA_ELEM_2_C1 "" FLOAT32_IEEE PubIfDecisionLSM_MDL_CM_single 0 0 -3.4E+38 3.4E+38 ECU_ADDRESS 0x0 /* @MemoryAddress@LSM_LA_ELEM_2_C1@ */ /end MEASUREMENT
/begin MEASUREMENT LSM_LA_ELEM_2_C2 "" FLOAT32_IEEE PubIfDecisionLSM_MDL_CM_single 0 0 -3.4E+38 3.4E+38 ECU_ADDRESS 0x0 /* @MemoryAddress@LSM_LA_ELEM_2_C2@ */ /end MEASUREMENT
/begin MEASUREMENT LSM_LA_ELEM_2_C3 "" FLOAT32_IEEE PubIfDecisionLSM_MDL_CM_single 0 0 -3.4E+38 3.4E+38 ECU_ADDRESS 0x0 /* @MemoryAddress@LSM_LA_ELEM_2_C3@ */ /end MEASUREMENT
/begin MEASUREMENT LSM_LA_ELEM_2_Range_Start "" FLOAT32_IEEE PubIfDecisionLSM_MDL_CM_single 0 0 -3.4E+38 3.4E+38 ECU_ADDRESS 0x0 /* @MemoryAddress@LSM_LA_ELEM_2_Range_Start@ */ /end MEASUREMENT
/begin MEASUREMENT LSM_LA_ELEM_2_Range_End "" FLOAT32_IEEE PubIfDecisionLSM_MDL_CM_single 0 0 -3.4E+38 3.4E+38 ECU_ADDRESS 0x0 /* @MemoryAddress@LSM_LA_ELEM_2_Range_End@ */ /end MEASUREMENT
/begin MEASUREMENT LSM_LA_ELEM_2_Confidence "" FLOAT32_IEEE PubIfDecisionLSM_MDL_CM_single 0 0 -3.4E+38 3.4E+38 ECU_ADDRESS 0x0 /* @MemoryAddress@LSM_LA_ELEM_2_Confidence@ */ /end MEASUREMENT
/begin MEASUREMENT LSM_LA_ELEM_2_Marker_Width "" FLOAT32_IEEE PubIfDecisionLSM_MDL_CM_single 0 0 -3.4E+38 3.4E+38 ECU_ADDRESS 0x0 /* @MemoryAddress@LSM_LA_ELEM_2_Marker_Width@ */ /end MEASUREMENT
/begin MEASUREMENT LSM_LA_ELEM_3_C0 "" FLOAT32_IEEE PubIfDecisionLSM_MDL_CM_single 0 0 -3.4E+38 3.4E+38 ECU_ADDRESS 0x0 /* @MemoryAddress@LSM_LA_ELEM_3_C0@ */ /end MEASUREMENT
/begin MEASUREMENT LSM_LA_ELEM_3_C1 "" FLOAT32_IEEE PubIfDecisionLSM_MDL_CM_single 0 0 -3.4E+38 3.4E+38 ECU_ADDRESS 0x0 /* @MemoryAddress@LSM_LA_ELEM_3_C1@ */ /end MEASUREMENT
/begin MEASUREMENT LSM_LA_ELEM_3_C2 "" FLOAT32_IEEE PubIfDecisionLSM_MDL_CM_single 0 0 -3.4E+38 3.4E+38 ECU_ADDRESS 0x0 /* @MemoryAddress@LSM_LA_ELEM_3_C2@ */ /end MEASUREMENT
/begin MEASUREMENT LSM_LA_ELEM_3_C3 "" FLOAT32_IEEE PubIfDecisionLSM_MDL_CM_single 0 0 -3.4E+38 3.4E+38 ECU_ADDRESS 0x0 /* @MemoryAddress@LSM_LA_ELEM_3_C3@ */ /end MEASUREMENT
/begin MEASUREMENT LSM_LA_ELEM_3_Range_Start "" FLOAT32_IEEE PubIfDecisionLSM_MDL_CM_single 0 0 -3.4E+38 3.4E+38 ECU_ADDRESS 0x0 /* @MemoryAddress@LSM_LA_ELEM_3_Range_Start@ */ /end MEASUREMENT
/begin MEASUREMENT LSM_L3_Range "" FLOAT32_IEEE PubIfDecisionLSM_MDL_CM_single 0 0 -3.4E+38 3.4E+38 ECU_ADDRESS 0x0 /* @MemoryAddress@LSM_L3_Range@ */ /end MEASUREMENT
/begin MEASUREMENT LSM_LA_ELEM_3_Range_End "" FLOAT32_IEEE PubIfDecisionLSM_MDL_CM_single 0 0 -3.4E+38 3.4E+38 ECU_ADDRESS 0x0 /* @MemoryAddress@LSM_LA_ELEM_3_Range_End@ */ /end MEASUREMENT
/begin MEASUREMENT LSM_LA_ELEM_3_Confidence "" FLOAT32_IEEE PubIfDecisionLSM_MDL_CM_single 0 0 -3.4E+38 3.4E+38 ECU_ADDRESS 0x0 /* @MemoryAddress@LSM_LA_ELEM_3_Confidence@ */ /end MEASUREMENT
/begin MEASUREMENT LSM_LA_ELEM_3_Marker_Width "" FLOAT32_IEEE PubIfDecisionLSM_MDL_CM_single 0 0 -3.4E+38 3.4E+38 ECU_ADDRESS 0x0 /* @MemoryAddress@LSM_LA_ELEM_3_Marker_Width@ */ /end MEASUREMENT
/begin MEASUREMENT LSM_LH_ELEM_0_C0 "" FLOAT32_IEEE PubIfDecisionLSM_MDL_CM_single 0 0 -3.4E+38 3.4E+38 ECU_ADDRESS 0x0 /* @MemoryAddress@LSM_LH_ELEM_0_C0@ */ /end MEASUREMENT
/begin MEASUREMENT LSM_LH_ELEM_0_C1 "" FLOAT32_IEEE PubIfDecisionLSM_MDL_CM_single 0 0 -3.4E+38 3.4E+38 ECU_ADDRESS 0x0 /* @MemoryAddress@LSM_LH_ELEM_0_C1@ */ /end MEASUREMENT
/begin MEASUREMENT LSM_LH_ELEM_0_C2 "" FLOAT32_IEEE PubIfDecisionLSM_MDL_CM_single 0 0 -3.4E+38 3.4E+38 ECU_ADDRESS 0x0 /* @MemoryAddress@LSM_LH_ELEM_0_C2@ */ /end MEASUREMENT
/begin MEASUREMENT LSM_LH_ELEM_0_Confidence "" FLOAT32_IEEE PubIfDecisionLSM_MDL_CM_single 0 0 -3.4E+38 3.4E+38 ECU_ADDRESS 0x0 /* @MemoryAddress@LSM_LH_ELEM_0_Confidence@ */ /end MEASUREMENT
/begin MEASUREMENT LSM_LH_ELEM_0_C3 "" FLOAT32_IEEE PubIfDecisionLSM_MDL_CM_single 0 0 -3.4E+38 3.4E+38 ECU_ADDRESS 0x0 /* @MemoryAddress@LSM_LH_ELEM_0_C3@ */ /end MEASUREMENT
/begin MEASUREMENT LSM_LH_ELEM_0_VR_End "" FLOAT32_IEEE PubIfDecisionLSM_MDL_CM_single 0 0 -3.4E+38 3.4E+38 ECU_ADDRESS 0x0 /* @MemoryAddress@LSM_LH_ELEM_0_VR_End@ */ /end MEASUREMENT
/begin MEASUREMENT LSM_LH_ELEM_0_Marker_Width "" FLOAT32_IEEE PubIfDecisionLSM_MDL_CM_single 0 0 -3.4E+38 3.4E+38 ECU_ADDRESS 0x0 /* @MemoryAddress@LSM_LH_ELEM_0_Marker_Width@ */ /end MEASUREMENT
/begin MEASUREMENT LSM_L4_Range "" FLOAT32_IEEE PubIfDecisionLSM_MDL_CM_single 0 0 -3.4E+38 3.4E+38 ECU_ADDRESS 0x0 /* @MemoryAddress@LSM_L4_Range@ */ /end MEASUREMENT
/begin MEASUREMENT LSM_LH_ELEM_0_VR_Start "" FLOAT32_IEEE PubIfDecisionLSM_MDL_CM_single 0 0 -3.4E+38 3.4E+38 ECU_ADDRESS 0x0 /* @MemoryAddress@LSM_LH_ELEM_0_VR_Start@ */ /end MEASUREMENT
/begin MEASUREMENT LSM_LH_ELEM_1_C0 "" FLOAT32_IEEE PubIfDecisionLSM_MDL_CM_single 0 0 -3.4E+38 3.4E+38 ECU_ADDRESS 0x0 /* @MemoryAddress@LSM_LH_ELEM_1_C0@ */ /end MEASUREMENT
/begin MEASUREMENT LSM_LH_ELEM_1_C1 "" FLOAT32_IEEE PubIfDecisionLSM_MDL_CM_single 0 0 -3.4E+38 3.4E+38 ECU_ADDRESS 0x0 /* @MemoryAddress@LSM_LH_ELEM_1_C1@ */ /end MEASUREMENT
/begin MEASUREMENT LSM_LH_ELEM_1_C2 "" FLOAT32_IEEE PubIfDecisionLSM_MDL_CM_single 0 0 -3.4E+38 3.4E+38 ECU_ADDRESS 0x0 /* @MemoryAddress@LSM_LH_ELEM_1_C2@ */ /end MEASUREMENT
/begin MEASUREMENT LSM_LH_ELEM_1_Confidence "" FLOAT32_IEEE PubIfDecisionLSM_MDL_CM_single 0 0 -3.4E+38 3.4E+38 ECU_ADDRESS 0x0 /* @MemoryAddress@LSM_LH_ELEM_1_Confidence@ */ /end MEASUREMENT
/begin MEASUREMENT LSM_LH_ELEM_1_C3 "" FLOAT32_IEEE PubIfDecisionLSM_MDL_CM_single 0 0 -3.4E+38 3.4E+38 ECU_ADDRESS 0x0 /* @MemoryAddress@LSM_LH_ELEM_1_C3@ */ /end MEASUREMENT
/begin MEASUREMENT LSM_LH_ELEM_1_VR_Start "" FLOAT32_IEEE PubIfDecisionLSM_MDL_CM_single 0 0 -3.4E+38 3.4E+38 ECU_ADDRESS 0x0 /* @MemoryAddress@LSM_LH_ELEM_1_VR_Start@ */ /end MEASUREMENT
/begin MEASUREMENT LSM_LH_ELEM_1_Marker_Width "" FLOAT32_IEEE PubIfDecisionLSM_MDL_CM_single 0 0 -3.4E+38 3.4E+38 ECU_ADDRESS 0x0 /* @MemoryAddress@LSM_LH_ELEM_1_Marker_Width@ */ /end MEASUREMENT
/begin MEASUREMENT LSM_LH_ELEM_1_VR_End "" FLOAT32_IEEE PubIfDecisionLSM_MDL_CM_single 0 0 -3.4E+38 3.4E+38 ECU_ADDRESS 0x0 /* @MemoryAddress@LSM_LH_ELEM_1_VR_End@ */ /end MEASUREMENT
/begin MEASUREMENT LSM_LRE_ELEM_0_C1 "" FLOAT32_IEEE PubIfDecisionLSM_MDL_CM_single 0 0 -3.4E+38 3.4E+38 ECU_ADDRESS 0x0 /* @MemoryAddress@LSM_LRE_ELEM_0_C1@ */ /end MEASUREMENT
/begin MEASUREMENT LSM_LRE_ELEM_0_C2 "" FLOAT32_IEEE PubIfDecisionLSM_MDL_CM_single 0 0 -3.4E+38 3.4E+38 ECU_ADDRESS 0x0 /* @MemoryAddress@LSM_LRE_ELEM_0_C2@ */ /end MEASUREMENT
/begin MEASUREMENT LSM_LRE_ELEM_0_C3 "" FLOAT32_IEEE PubIfDecisionLSM_MDL_CM_single 0 0 -3.4E+38 3.4E+38 ECU_ADDRESS 0x0 /* @MemoryAddress@LSM_LRE_ELEM_0_C3@ */ /end MEASUREMENT
/begin MEASUREMENT LSM_LRE_ELEM_0_Range_End "" FLOAT32_IEEE PubIfDecisionLSM_MDL_CM_single 0 0 -3.4E+38 3.4E+38 ECU_ADDRESS 0x0 /* @MemoryAddress@LSM_LRE_ELEM_0_Range_End@ */ /end MEASUREMENT
/begin MEASUREMENT LSM_LA_ELEM_0_C0 "" FLOAT32_IEEE PubIfDecisionLSM_MDL_CM_single 0 0 -3.4E+38 3.4E+38 ECU_ADDRESS 0x0 /* @MemoryAddress@LSM_LA_ELEM_0_C0@ */ /end MEASUREMENT
/begin MEASUREMENT LSM_LRE_ELEM_0_Range_Start "" FLOAT32_IEEE PubIfDecisionLSM_MDL_CM_single 0 0 -3.4E+38 3.4E+38 ECU_ADDRESS 0x0 /* @MemoryAddress@LSM_LRE_ELEM_0_Range_Start@ */ /end MEASUREMENT
/begin MEASUREMENT LSM_LRE_ELEM_0_C0 "" FLOAT32_IEEE PubIfDecisionLSM_MDL_CM_single 0 0 -3.4E+38 3.4E+38 ECU_ADDRESS 0x0 /* @MemoryAddress@LSM_LRE_ELEM_0_C0@ */ /end MEASUREMENT
/begin MEASUREMENT LSM_LRE_ELEM_0_Confidence "" FLOAT32_IEEE PubIfDecisionLSM_MDL_CM_single 0 0 -3.4E+38 3.4E+38 ECU_ADDRESS 0x0 /* @MemoryAddress@LSM_LRE_ELEM_0_Confidence@ */ /end MEASUREMENT
/begin MEASUREMENT LSM_LRE_ELEM_1_Confidence "" FLOAT32_IEEE PubIfDecisionLSM_MDL_CM_single 0 0 -3.4E+38 3.4E+38 ECU_ADDRESS 0x0 /* @MemoryAddress@LSM_LRE_ELEM_1_Confidence@ */ /end MEASUREMENT
/begin MEASUREMENT LSM_LRE_ELEM_1_C1 "" FLOAT32_IEEE PubIfDecisionLSM_MDL_CM_single 0 0 -3.4E+38 3.4E+38 ECU_ADDRESS 0x0 /* @MemoryAddress@LSM_LRE_ELEM_1_C1@ */ /end MEASUREMENT
/begin MEASUREMENT LSM_LRE_ELEM_1_C2 "" FLOAT32_IEEE PubIfDecisionLSM_MDL_CM_single 0 0 -3.4E+38 3.4E+38 ECU_ADDRESS 0x0 /* @MemoryAddress@LSM_LRE_ELEM_1_C2@ */ /end MEASUREMENT
/begin MEASUREMENT LSM_LRE_ELEM_1_C3 "" FLOAT32_IEEE PubIfDecisionLSM_MDL_CM_single 0 0 -3.4E+38 3.4E+38 ECU_ADDRESS 0x0 /* @MemoryAddress@LSM_LRE_ELEM_1_C3@ */ /end MEASUREMENT
/begin MEASUREMENT LSM_LRE_ELEM_1_Range_End "" FLOAT32_IEEE PubIfDecisionLSM_MDL_CM_single 0 0 -3.4E+38 3.4E+38 ECU_ADDRESS 0x0 /* @MemoryAddress@LSM_LRE_ELEM_1_Range_End@ */ /end MEASUREMENT
/begin MEASUREMENT LSM_EN_C0 "" FLOAT32_IEEE PubIfDecisionLSM_MDL_CM_single 0 0 -3.4E+38 3.4E+38 ECU_ADDRESS 0x0 /* @MemoryAddress@LSM_EN_C0@ */ /end MEASUREMENT
/begin MEASUREMENT LSM_EN_C1 "" FLOAT32_IEEE PubIfDecisionLSM_MDL_CM_single 0 0 -3.4E+38 3.4E+38 ECU_ADDRESS 0x0 /* @MemoryAddress@LSM_EN_C1@ */ /end MEASUREMENT
/begin MEASUREMENT LSM_EN_C2 "" FLOAT32_IEEE PubIfDecisionLSM_MDL_CM_single 0 0 -3.4E+38 3.4E+38 ECU_ADDRESS 0x0 /* @MemoryAddress@LSM_EN_C2@ */ /end MEASUREMENT
/begin MEASUREMENT LSM_EN_C3 "" FLOAT32_IEEE PubIfDecisionLSM_MDL_CM_single 0 0 -3.4E+38 3.4E+38 ECU_ADDRESS 0x0 /* @MemoryAddress@LSM_EN_C3@ */ /end MEASUREMENT
/begin MEASUREMENT LSM_EN_Start "" FLOAT32_IEEE PubIfDecisionLSM_MDL_CM_single 0 0 -3.4E+38 3.4E+38 ECU_ADDRESS 0x0 /* @MemoryAddress@LSM_EN_Start@ */ /end MEASUREMENT
/begin MEASUREMENT LSM_EN_Front "" FLOAT32_IEEE PubIfDecisionLSM_MDL_CM_single 0 0 -3.4E+38 3.4E+38 ECU_ADDRESS 0x0 /* @MemoryAddress@LSM_EN_Front@ */ /end MEASUREMENT
/begin MEASUREMENT LSM_Exit_C0 "" FLOAT32_IEEE PubIfDecisionLSM_MDL_CM_single 0 0 -3.4E+38 3.4E+38 ECU_ADDRESS 0x0 /* @MemoryAddress@LSM_Exit_C0@ */ /end MEASUREMENT
/begin MEASUREMENT LSM_Exit_C1 "" FLOAT32_IEEE PubIfDecisionLSM_MDL_CM_single 0 0 -3.4E+38 3.4E+38 ECU_ADDRESS 0x0 /* @MemoryAddress@LSM_Exit_C1@ */ /end MEASUREMENT
/begin MEASUREMENT LSM_Exit_C2 "" FLOAT32_IEEE PubIfDecisionLSM_MDL_CM_single 0 0 -3.4E+38 3.4E+38 ECU_ADDRESS 0x0 /* @MemoryAddress@LSM_Exit_C2@ */ /end MEASUREMENT
/begin MEASUREMENT LSM_Exit_C3 "" FLOAT32_IEEE PubIfDecisionLSM_MDL_CM_single 0 0 -3.4E+38 3.4E+38 ECU_ADDRESS 0x0 /* @MemoryAddress@LSM_Exit_C3@ */ /end MEASUREMENT
/begin MEASUREMENT LSM_Exit_Start "" FLOAT32_IEEE PubIfDecisionLSM_MDL_CM_single 0 0 -3.4E+38 3.4E+38 ECU_ADDRESS 0x0 /* @MemoryAddress@LSM_Exit_Start@ */ /end MEASUREMENT
/begin MEASUREMENT LSM_Exit_Front "" FLOAT32_IEEE PubIfDecisionLSM_MDL_CM_single 0 0 -3.4E+38 3.4E+38 ECU_ADDRESS 0x0 /* @MemoryAddress@LSM_Exit_Front@ */ /end MEASUREMENT
/begin MEASUREMENT LSM_L3_AvaliTime "" FLOAT32_IEEE PubIfDecisionLSM_MDL_CM_single 0 0 -3.4E+38 3.4E+38 ECU_ADDRESS 0x0 /* @MemoryAddress@LSM_L3_AvaliTime@ */ /end MEASUREMENT
/begin MEASUREMENT LSM_L2_AvaliTime "" FLOAT32_IEEE PubIfDecisionLSM_MDL_CM_single 0 0 -3.4E+38 3.4E+38 ECU_ADDRESS 0x0 /* @MemoryAddress@LSM_L2_AvaliTime@ */ /end MEASUREMENT
/begin MEASUREMENT LSM_L1_AvaliDis "" FLOAT32_IEEE PubIfDecisionLSM_MDL_CM_single 0 0 -3.4E+38 3.4E+38 ECU_ADDRESS 0x0 /* @MemoryAddress@LSM_L1_AvaliDis@ */ /end MEASUREMENT
/begin MEASUREMENT LSM_L2_AvaliDis "" FLOAT32_IEEE PubIfDecisionLSM_MDL_CM_single 0 0 -3.4E+38 3.4E+38 ECU_ADDRESS 0x0 /* @MemoryAddress@LSM_L2_AvaliDis@ */ /end MEASUREMENT
/begin MEASUREMENT LSM_L1_AvaliTime "" FLOAT32_IEEE PubIfDecisionLSM_MDL_CM_single 0 0 -3.4E+38 3.4E+38 ECU_ADDRESS 0x0 /* @MemoryAddress@LSM_L1_AvaliTime@ */ /end MEASUREMENT
/begin MEASUREMENT LSM_L4_AvaliTime "" FLOAT32_IEEE PubIfDecisionLSM_MDL_CM_single 0 0 -3.4E+38 3.4E+38 ECU_ADDRESS 0x0 /* @MemoryAddress@LSM_L4_AvaliTime@ */ /end MEASUREMENT
/begin MEASUREMENT LSM_L3_AvaliDis "" FLOAT32_IEEE PubIfDecisionLSM_MDL_CM_single 0 0 -3.4E+38 3.4E+38 ECU_ADDRESS 0x0 /* @MemoryAddress@LSM_L3_AvaliDis@ */ /end MEASUREMENT
/begin MEASUREMENT LSM_L4_AvaliDis "" FLOAT32_IEEE PubIfDecisionLSM_MDL_CM_single 0 0 -3.4E+38 3.4E+38 ECU_ADDRESS 0x0 /* @MemoryAddress@LSM_L4_AvaliDis@ */ /end MEASUREMENT
/begin MEASUREMENT LSM_L1_A0 "" FLOAT32_IEEE PubIfDecisionLSM_MDL_CM_single 0 0 -3.4E+38 3.4E+38 ECU_ADDRESS 0x0 /* @MemoryAddress@LSM_L1_A0@ */ /end MEASUREMENT
/begin MEASUREMENT LSM_L2_A0 "" FLOAT32_IEEE PubIfDecisionLSM_MDL_CM_single 0 0 -3.4E+38 3.4E+38 ECU_ADDRESS 0x0 /* @MemoryAddress@LSM_L2_A0@ */ /end MEASUREMENT
/begin MEASUREMENT LSM_L3_A0 "" FLOAT32_IEEE PubIfDecisionLSM_MDL_CM_single 0 0 -3.4E+38 3.4E+38 ECU_ADDRESS 0x0 /* @MemoryAddress@LSM_L3_A0@ */ /end MEASUREMENT
/begin MEASUREMENT LSM_L4_A0 "" FLOAT32_IEEE PubIfDecisionLSM_MDL_CM_single 0 0 -3.4E+38 3.4E+38 ECU_ADDRESS 0x0 /* @MemoryAddress@LSM_L4_A0@ */ /end MEASUREMENT
/begin MEASUREMENT LSM_CurDis2 "" FLOAT32_IEEE PubIfDecisionLSM_MDL_CM_single 0 0 -3.4E+38 3.4E+38 ECU_ADDRESS 0x0 /* @MemoryAddress@LSM_CurDis2@ */ /end MEASUREMENT
/begin MEASUREMENT LSM_DeltaDis2 "" FLOAT32_IEEE PubIfDecisionLSM_MDL_CM_single 0 0 -3.4E+38 3.4E+38 ECU_ADDRESS 0x0 /* @MemoryAddress@LSM_DeltaDis2@ */ /end MEASUREMENT
/begin MEASUREMENT LSM_CurDis3 "" FLOAT32_IEEE PubIfDecisionLSM_MDL_CM_single 0 0 -3.4E+38 3.4E+38 ECU_ADDRESS 0x0 /* @MemoryAddress@LSM_CurDis3@ */ /end MEASUREMENT
/begin MEASUREMENT LSM_DeltaDis3 "" FLOAT32_IEEE PubIfDecisionLSM_MDL_CM_single 0 0 -3.4E+38 3.4E+38 ECU_ADDRESS 0x0 /* @MemoryAddress@LSM_DeltaDis3@ */ /end MEASUREMENT
/begin MEASUREMENT LSM_RoadWidth1 "" FLOAT32_IEEE PubIfDecisionLSM_MDL_CM_single 0 0 -3.4E+38 3.4E+38 ECU_ADDRESS 0x0 /* @MemoryAddress@LSM_RoadWidth1@ */ /end MEASUREMENT
/begin MEASUREMENT LSM_CentLineA3 "" FLOAT32_IEEE PubIfDecisionLSM_MDL_CM_single 0 0 -3.4E+38 3.4E+38 ECU_ADDRESS 0x0 /* @MemoryAddress@LSM_CentLineA3@ */ /end MEASUREMENT
/begin MEASUREMENT LSM_CentLineA2 "" FLOAT32_IEEE PubIfDecisionLSM_MDL_CM_single 0 0 -3.4E+38 3.4E+38 ECU_ADDRESS 0x0 /* @MemoryAddress@LSM_CentLineA2@ */ /end MEASUREMENT
/begin MEASUREMENT LSM_CentLineA1 "" FLOAT32_IEEE PubIfDecisionLSM_MDL_CM_single 0 0 -3.4E+38 3.4E+38 ECU_ADDRESS 0x0 /* @MemoryAddress@LSM_CentLineA1@ */ /end MEASUREMENT
/begin MEASUREMENT LSM_CentLineA0 "" FLOAT32_IEEE PubIfDecisionLSM_MDL_CM_single 0 0 -3.4E+38 3.4E+38 ECU_ADDRESS 0x0 /* @MemoryAddress@LSM_CentLineA0@ */ /end MEASUREMENT
/begin MEASUREMENT LSM_CentLineRange "" FLOAT32_IEEE PubIfDecisionLSM_MDL_CM_single 0 0 -3.4E+38 3.4E+38 ECU_ADDRESS 0x0 /* @MemoryAddress@LSM_CentLineRange@ */ /end MEASUREMENT
/begin MEASUREMENT LSM_CentQ "" FLOAT32_IEEE PubIfDecisionLSM_MDL_CM_single 0 0 -3.4E+38 3.4E+38 ECU_ADDRESS 0x0 /* @MemoryAddress@LSM_CentQ@ */ /end MEASUREMENT
/begin MEASUREMENT LSM_dDeltaX "" FLOAT32_IEEE PubIfDecisionLSM_MDL_CM_single 0 0 -3.4E+38 3.4E+38 ECU_ADDRESS 0x0 /* @MemoryAddress@LSM_dDeltaX@ */ /end MEASUREMENT
/begin MEASUREMENT LSM_dDeltaY "" FLOAT32_IEEE PubIfDecisionLSM_MDL_CM_single 0 0 -3.4E+38 3.4E+38 ECU_ADDRESS 0x0 /* @MemoryAddress@LSM_dDeltaY@ */ /end MEASUREMENT
/begin MEASUREMENT LSM_CosOfPsi "" FLOAT32_IEEE PubIfDecisionLSM_MDL_CM_single 0 0 -3.4E+38 3.4E+38 ECU_ADDRESS 0x0 /* @MemoryAddress@LSM_CosOfPsi@ */ /end MEASUREMENT
/begin MEASUREMENT LSM_SinOfsi "" FLOAT32_IEEE PubIfDecisionLSM_MDL_CM_single 0 0 -3.4E+38 3.4E+38 ECU_ADDRESS 0x0 /* @MemoryAddress@LSM_SinOfsi@ */ /end MEASUREMENT
/begin MEASUREMENT LSM_TJA_Line_State1 "" UBYTE PubIfDecisionLSM_MDL_CM_uint8 0 0 0 255 ECU_ADDRESS 0x0 /* @MemoryAddress@LSM_TJA_Line_State1@ */ /end MEASUREMENT
/begin MEASUREMENT LSM_HWASts "" UBYTE PubIfDecisionLSM_MDL_CM_uint8 0 0 0 255 ECU_ADDRESS 0x0 /* @MemoryAddress@LSM_HWASts@ */ /end MEASUREMENT
/begin MEASUREMENT LSM_OTL_Count "" UBYTE PubIfDecisionLSM_MDL_CM_uint8 0 0 0 255 ECU_ADDRESS 0x0 /* @MemoryAddress@LSM_OTL_Count@ */ /end MEASUREMENT
/begin MEASUREMENT LSM_RFM_LineCenter_Valid "" UBYTE PubIfDecisionLSM_MDL_CM_uint8 0 0 0 255 ECU_ADDRESS 0x0 /* @MemoryAddress@LSM_RFM_LineCenter_Valid@ */ /end MEASUREMENT
/begin MEASUREMENT LSM_RFM_LineR1_Valid "" UBYTE PubIfDecisionLSM_MDL_CM_uint8 0 0 0 255 ECU_ADDRESS 0x0 /* @MemoryAddress@LSM_RFM_LineR1_Valid@ */ /end MEASUREMENT
/begin MEASUREMENT LSM_RFM_LineL1_Valid "" UBYTE PubIfDecisionLSM_MDL_CM_uint8 0 0 0 255 ECU_ADDRESS 0x0 /* @MemoryAddress@LSM_RFM_LineL1_Valid@ */ /end MEASUREMENT
/begin MEASUREMENT LSM_L1_Conf "" UBYTE PubIfDecisionLSM_MDL_CM_uint8 0 0 0 255 ECU_ADDRESS 0x0 /* @MemoryAddress@LSM_L1_Conf@ */ /end MEASUREMENT
/begin MEASUREMENT LSM_LRE_ELEM_1_Line_Side "" UBYTE PubIfDecisionLSM_MDL_CM_uint8 0 0 0 255 ECU_ADDRESS 0x0 /* @MemoryAddress@LSM_LRE_ELEM_1_Line_Side@ */ /end MEASUREMENT
/begin MEASUREMENT LSM_LA_ELEM_0_Availability_State "" UBYTE PubIfDecisionLSM_MDL_CM_uint8 0 0 0 255 ECU_ADDRESS 0x0 /* @MemoryAddress@LSM_LA_ELEM_0_Availability_State@ */ /end MEASUREMENT
/begin MEASUREMENT LSM_LA_ELEM_0_Lanemark_Type "" UBYTE PubIfDecisionLSM_MDL_CM_uint8 0 0 0 255 ECU_ADDRESS 0x0 /* @MemoryAddress@LSM_LA_ELEM_0_Lanemark_Type@ */ /end MEASUREMENT
/begin MEASUREMENT LSM_LA_ELEM_0_DLM_Type "" UBYTE PubIfDecisionLSM_MDL_CM_uint8 0 0 0 255 ECU_ADDRESS 0x0 /* @MemoryAddress@LSM_LA_ELEM_0_DLM_Type@ */ /end MEASUREMENT
/begin MEASUREMENT LSM_LA_ELEM_0_Line_Side "" UBYTE PubIfDecisionLSM_MDL_CM_uint8 0 0 0 255 ECU_ADDRESS 0x0 /* @MemoryAddress@LSM_LA_ELEM_0_Line_Side@ */ /end MEASUREMENT
/begin MEASUREMENT LSM_L2_Conf "" UBYTE PubIfDecisionLSM_MDL_CM_uint8 0 0 0 255 ECU_ADDRESS 0x0 /* @MemoryAddress@LSM_L2_Conf@ */ /end MEASUREMENT
/begin MEASUREMENT LSM_LA_ELEM_1_Availability_State "" UBYTE PubIfDecisionLSM_MDL_CM_uint8 0 0 0 255 ECU_ADDRESS 0x0 /* @MemoryAddress@LSM_LA_ELEM_1_Availability_State@ */ /end MEASUREMENT
/begin MEASUREMENT LSM_LA_ELEM_1_Lanemark_Type "" UBYTE PubIfDecisionLSM_MDL_CM_uint8 0 0 0 255 ECU_ADDRESS 0x0 /* @MemoryAddress@LSM_LA_ELEM_1_Lanemark_Type@ */ /end MEASUREMENT
/begin MEASUREMENT LSM_LA_ELEM_1_DLM_Type "" UBYTE PubIfDecisionLSM_MDL_CM_uint8 0 0 0 255 ECU_ADDRESS 0x0 /* @MemoryAddress@LSM_LA_ELEM_1_DLM_Type@ */ /end MEASUREMENT
/begin MEASUREMENT LSM_LA_ELEM_1_Line_Side "" UBYTE PubIfDecisionLSM_MDL_CM_uint8 0 0 0 255 ECU_ADDRESS 0x0 /* @MemoryAddress@LSM_LA_ELEM_1_Line_Side@ */ /end MEASUREMENT
/begin MEASUREMENT LSM_LA_ELEM_2_Availability_State "" UBYTE PubIfDecisionLSM_MDL_CM_uint8 0 0 0 255 ECU_ADDRESS 0x0 /* @MemoryAddress@LSM_LA_ELEM_2_Availability_State@ */ /end MEASUREMENT
/begin MEASUREMENT LSM_L3_Conf "" UBYTE PubIfDecisionLSM_MDL_CM_uint8 0 0 0 255 ECU_ADDRESS 0x0 /* @MemoryAddress@LSM_L3_Conf@ */ /end MEASUREMENT
/begin MEASUREMENT LSM_LA_ELEM_2_Lanemark_Type "" UBYTE PubIfDecisionLSM_MDL_CM_uint8 0 0 0 255 ECU_ADDRESS 0x0 /* @MemoryAddress@LSM_LA_ELEM_2_Lanemark_Type@ */ /end MEASUREMENT
/begin MEASUREMENT LSM_LA_ELEM_2_DLM_Type "" UBYTE PubIfDecisionLSM_MDL_CM_uint8 0 0 0 255 ECU_ADDRESS 0x0 /* @MemoryAddress@LSM_LA_ELEM_2_DLM_Type@ */ /end MEASUREMENT
/begin MEASUREMENT LSM_LA_ELEM_2_Line_Side "" UBYTE PubIfDecisionLSM_MDL_CM_uint8 0 0 0 255 ECU_ADDRESS 0x0 /* @MemoryAddress@LSM_LA_ELEM_2_Line_Side@ */ /end MEASUREMENT
/begin MEASUREMENT LSM_LA_ELEM_3_Availability_State "" UBYTE PubIfDecisionLSM_MDL_CM_uint8 0 0 0 255 ECU_ADDRESS 0x0 /* @MemoryAddress@LSM_LA_ELEM_3_Availability_State@ */ /end MEASUREMENT
/begin MEASUREMENT LSM_LA_ELEM_3_Lanemark_Type "" UBYTE PubIfDecisionLSM_MDL_CM_uint8 0 0 0 255 ECU_ADDRESS 0x0 /* @MemoryAddress@LSM_LA_ELEM_3_Lanemark_Type@ */ /end MEASUREMENT
/begin MEASUREMENT LSM_LA_ELEM_3_DLM_Type "" UBYTE PubIfDecisionLSM_MDL_CM_uint8 0 0 0 255 ECU_ADDRESS 0x0 /* @MemoryAddress@LSM_LA_ELEM_3_DLM_Type@ */ /end MEASUREMENT
/begin MEASUREMENT LSM_LA_ELEM_3_Line_Side "" UBYTE PubIfDecisionLSM_MDL_CM_uint8 0 0 0 255 ECU_ADDRESS 0x0 /* @MemoryAddress@LSM_LA_ELEM_3_Line_Side@ */ /end MEASUREMENT
/begin MEASUREMENT LSM_LH_Count "" UBYTE PubIfDecisionLSM_MDL_CM_uint8 0 0 0 255 ECU_ADDRESS 0x0 /* @MemoryAddress@LSM_LH_Count@ */ /end MEASUREMENT
/begin MEASUREMENT LSM_L4_Conf "" UBYTE PubIfDecisionLSM_MDL_CM_uint8 0 0 0 255 ECU_ADDRESS 0x0 /* @MemoryAddress@LSM_L4_Conf@ */ /end MEASUREMENT
/begin MEASUREMENT LSM_LH_ELEM_0_Availability_State "" UBYTE PubIfDecisionLSM_MDL_CM_uint8 0 0 0 255 ECU_ADDRESS 0x0 /* @MemoryAddress@LSM_LH_ELEM_0_Availability_State@ */ /end MEASUREMENT
/begin MEASUREMENT LSM_LH_ELEM_0_Lanemark_Type "" UBYTE PubIfDecisionLSM_MDL_CM_uint8 0 0 0 255 ECU_ADDRESS 0x0 /* @MemoryAddress@LSM_LH_ELEM_0_Lanemark_Type@ */ /end MEASUREMENT
/begin MEASUREMENT LSM_LH_ELEM_0_DLM_Type "" UBYTE PubIfDecisionLSM_MDL_CM_uint8 0 0 0 255 ECU_ADDRESS 0x0 /* @MemoryAddress@LSM_LH_ELEM_0_DLM_Type@ */ /end MEASUREMENT
/begin MEASUREMENT LSM_LH_ELEM_0_Line_Side "" UBYTE PubIfDecisionLSM_MDL_CM_uint8 0 0 0 255 ECU_ADDRESS 0x0 /* @MemoryAddress@LSM_LH_ELEM_0_Line_Side@ */ /end MEASUREMENT
/begin MEASUREMENT LSM_LH_ELEM_0_Crossing "" UBYTE PubIfDecisionLSM_MDL_CM_uint8 0 0 0 255 ECU_ADDRESS 0x0 /* @MemoryAddress@LSM_LH_ELEM_0_Crossing@ */ /end MEASUREMENT
/begin MEASUREMENT LSM_LH_ELEM_1_Availability_State "" UBYTE PubIfDecisionLSM_MDL_CM_uint8 0 0 0 255 ECU_ADDRESS 0x0 /* @MemoryAddress@LSM_LH_ELEM_1_Availability_State@ */ /end MEASUREMENT
/begin MEASUREMENT LSM_LH_ELEM_1_Lanemark_Type "" UBYTE PubIfDecisionLSM_MDL_CM_uint8 0 0 0 255 ECU_ADDRESS 0x0 /* @MemoryAddress@LSM_LH_ELEM_1_Lanemark_Type@ */ /end MEASUREMENT
/begin MEASUREMENT LSM_LH_ELEM_1_DLM_Type "" UBYTE PubIfDecisionLSM_MDL_CM_uint8 0 0 0 255 ECU_ADDRESS 0x0 /* @MemoryAddress@LSM_LH_ELEM_1_DLM_Type@ */ /end MEASUREMENT
/begin MEASUREMENT LSM_LA_Adjacent_Count "" UBYTE PubIfDecisionLSM_MDL_CM_uint8 0 0 0 255 ECU_ADDRESS 0x0 /* @MemoryAddress@LSM_LA_Adjacent_Count@ */ /end MEASUREMENT
/begin MEASUREMENT LSM_LH_ELEM_1_Line_Side "" UBYTE PubIfDecisionLSM_MDL_CM_uint8 0 0 0 255 ECU_ADDRESS 0x0 /* @MemoryAddress@LSM_LH_ELEM_1_Line_Side@ */ /end MEASUREMENT
/begin MEASUREMENT LSM_LH_ELEM_1_Crossing "" UBYTE PubIfDecisionLSM_MDL_CM_uint8 0 0 0 255 ECU_ADDRESS 0x0 /* @MemoryAddress@LSM_LH_ELEM_1_Crossing@ */ /end MEASUREMENT
/begin MEASUREMENT LSM_LRE_Count "" UBYTE PubIfDecisionLSM_MDL_CM_uint8 0 0 0 255 ECU_ADDRESS 0x0 /* @MemoryAddress@LSM_LRE_Count@ */ /end MEASUREMENT
/begin MEASUREMENT LSM_LRE_ELEM_0_Line_Side "" UBYTE PubIfDecisionLSM_MDL_CM_uint8 0 0 0 255 ECU_ADDRESS 0x0 /* @MemoryAddress@LSM_LRE_ELEM_0_Line_Side@ */ /end MEASUREMENT
/begin MEASUREMENT LSM_LRE_ELEM_0_Availability_State "" UBYTE PubIfDecisionLSM_MDL_CM_uint8 0 0 0 255 ECU_ADDRESS 0x0 /* @MemoryAddress@LSM_LRE_ELEM_0_Availability_State@ */ /end MEASUREMENT
/begin MEASUREMENT LSM_LRE_ELEM_1_Availability_State "" UBYTE PubIfDecisionLSM_MDL_CM_uint8 0 0 0 255 ECU_ADDRESS 0x0 /* @MemoryAddress@LSM_LRE_ELEM_1_Availability_State@ */ /end MEASUREMENT
/begin MEASUREMENT LSM_EN_Valid "" UBYTE PubIfDecisionLSM_MDL_CM_uint8 0 0 0 255 ECU_ADDRESS 0x0 /* @MemoryAddress@LSM_EN_Valid@ */ /end MEASUREMENT
/begin MEASUREMENT LSM_Exit_Valid "" UBYTE PubIfDecisionLSM_MDL_CM_uint8 0 0 0 255 ECU_ADDRESS 0x0 /* @MemoryAddress@LSM_Exit_Valid@ */ /end MEASUREMENT
/begin MEASUREMENT LSM_LeftLineConf "" UBYTE PubIfDecisionLSM_MDL_CM_uint8 0 0 0 255 ECU_ADDRESS 0x0 /* @MemoryAddress@LSM_LeftLineConf@ */ /end MEASUREMENT
/begin MEASUREMENT LSM_RightLineConf "" UBYTE PubIfDecisionLSM_MDL_CM_uint8 0 0 0 255 ECU_ADDRESS 0x0 /* @MemoryAddress@LSM_RightLineConf@ */ /end MEASUREMENT
/begin MEASUREMENT LSM_TJA_Line_State "" UBYTE PubIfDecisionLSM_MDL_CM_uint8 0 0 0 255 ECU_ADDRESS 0x0 /* @MemoryAddress@LSM_TJA_Line_State@ */ /end MEASUREMENT
/begin MEASUREMENT LSM_Wij_State "" UBYTE PubIfDecisionLSM_MDL_CM_uint8 0 0 0 255 ECU_ADDRESS 0x0 /* @MemoryAddress@LSM_Wij_State@ */ /end MEASUREMENT
/begin MEASUREMENT LSM_Line_State "" UBYTE PubIfDecisionLSM_MDL_CM_uint8 0 0 0 255 ECU_ADDRESS 0x0 /* @MemoryAddress@LSM_Line_State@ */ /end MEASUREMENT
/begin MEASUREMENT LSM_LockCounter "" UBYTE PubIfDecisionLSM_MDL_CM_uint8 0 0 0 255 ECU_ADDRESS 0x0 /* @MemoryAddress@LSM_LockCounter@ */ /end MEASUREMENT
/begin MEASUREMENT LSM_MoveID "" SBYTE PubIfDecisionLSM_MDL_CM_int8 0 0 -128 127 ECU_ADDRESS 0x0 /* @MemoryAddress@LSM_MoveID@ */ /end MEASUREMENT
/begin MEASUREMENT LSM_LockID "" SBYTE PubIfDecisionLSM_MDL_CM_int8 0 0 -128 127 ECU_ADDRESS 0x0 /* @MemoryAddress@LSM_LockID@ */ /end MEASUREMENT
/begin MEASUREMENT LSM_LineValidK1 "" UBYTE PubIfDecisionLSM_MDL_CM_boolean 0 0 0 1 ECU_ADDRESS 0x0 /* @MemoryAddress@LSM_LineValidK1@ */ BIT_MASK 0x01 /end MEASUREMENT
/begin MEASUREMENT LSM_LeftMostLane "" UBYTE PubIfDecisionLSM_MDL_CM_boolean 0 0 0 1 ECU_ADDRESS 0x0 /* @MemoryAddress@LSM_LeftMostLane@ */ BIT_MASK 0x01 /end MEASUREMENT
/begin MEASUREMENT LSM_TJALineValid "" UBYTE PubIfDecisionLSM_MDL_CM_boolean 0 0 0 1 ECU_ADDRESS 0x0 /* @MemoryAddress@LSM_TJALineValid@ */ BIT_MASK 0x01 /end MEASUREMENT
/begin MEASUREMENT LSM_HWALineValid "" UBYTE PubIfDecisionLSM_MDL_CM_boolean 0 0 0 1 ECU_ADDRESS 0x0 /* @MemoryAddress@LSM_HWALineValid@ */ BIT_MASK 0x01 /end MEASUREMENT
/begin MEASUREMENT LSM_HWARiLineValid "" UBYTE PubIfDecisionLSM_MDL_CM_boolean 0 0 0 1 ECU_ADDRESS 0x0 /* @MemoryAddress@LSM_HWARiLineValid@ */ BIT_MASK 0x01 /end MEASUREMENT
/begin MEASUREMENT LSM_HWALeLineValid "" UBYTE PubIfDecisionLSM_MDL_CM_boolean 0 0 0 1 ECU_ADDRESS 0x0 /* @MemoryAddress@LSM_HWALeLineValid@ */ BIT_MASK 0x01 /end MEASUREMENT
/begin MEASUREMENT LSM_DoubleLineLost_b "" UBYTE PubIfDecisionLSM_MDL_CM_boolean 0 0 0 1 ECU_ADDRESS 0x0 /* @MemoryAddress@LSM_DoubleLineLost_b@ */ BIT_MASK 0x01 /end MEASUREMENT
/begin MEASUREMENT LSM_ESSLeLineValid "" UBYTE PubIfDecisionLSM_MDL_CM_boolean 0 0 0 1 ECU_ADDRESS 0x0 /* @MemoryAddress@LSM_ESSLeLineValid@ */ BIT_MASK 0x01 /end MEASUREMENT
/begin MEASUREMENT LSM_ESSLineValid "" UBYTE PubIfDecisionLSM_MDL_CM_boolean 0 0 0 1 ECU_ADDRESS 0x0 /* @MemoryAddress@LSM_ESSLineValid@ */ BIT_MASK 0x01 /end MEASUREMENT
/begin MEASUREMENT LSM_ESSRiLineValid "" UBYTE PubIfDecisionLSM_MDL_CM_boolean 0 0 0 1 ECU_ADDRESS 0x0 /* @MemoryAddress@LSM_ESSRiLineValid@ */ BIT_MASK 0x01 /end MEASUREMENT
/begin MEASUREMENT LSM_LCKLineValid "" UBYTE PubIfDecisionLSM_MDL_CM_boolean 0 0 0 1 ECU_ADDRESS 0x0 /* @MemoryAddress@LSM_LCKLineValid@ */ BIT_MASK 0x01 /end MEASUREMENT
/begin MEASUREMENT LSM_MLeLane "" UBYTE PubIfDecisionLSM_MDL_CM_boolean 0 0 0 1 ECU_ADDRESS 0x0 /* @MemoryAddress@LSM_MLeLane@ */ BIT_MASK 0x01 /end MEASUREMENT
/begin MEASUREMENT LSM_LeftLaneChange "" UBYTE PubIfDecisionLSM_MDL_CM_boolean 0 0 0 1 ECU_ADDRESS 0x0 /* @MemoryAddress@LSM_LeftLaneChange@ */ BIT_MASK 0x01 /end MEASUREMENT
/begin MEASUREMENT LSM_RightLaneChange "" UBYTE PubIfDecisionLSM_MDL_CM_boolean 0 0 0 1 ECU_ADDRESS 0x0 /* @MemoryAddress@LSM_RightLaneChange@ */ BIT_MASK 0x01 /end MEASUREMENT
/begin MEASUREMENT LSM_OTLineValid "" UBYTE PubIfDecisionLSM_MDL_CM_boolean 0 0 0 1 ECU_ADDRESS 0x0 /* @MemoryAddress@LSM_OTLineValid@ */ BIT_MASK 0x01 /end MEASUREMENT
/begin MEASUREMENT LSM_SingleLineLost_b "" UBYTE PubIfDecisionLSM_MDL_CM_boolean 0 0 0 1 ECU_ADDRESS 0x0 /* @MemoryAddress@LSM_SingleLineLost_b@ */ BIT_MASK 0x01 /end MEASUREMENT
/begin MEASUREMENT LSM_PathLaneAvail "" UBYTE PubIfDecisionLSM_MDL_CM_boolean 0 0 0 1 /* Layout */ LAYOUT ROW_DIR /* Array size */ MATRIX_DIM 3 1 1 ECU_ADDRESS 0x0 /* @MemoryAddress@LSM_PathLaneAvail@ */ BIT_MASK 0x01 /end MEASUREMENT
/begin MEASUREMENT LSM_LeftOffset_b "" UBYTE PubIfDecisionLSM_MDL_CM_boolean 0 0 0 1 ECU_ADDRESS 0x0 /* @MemoryAddress@LSM_LeftOffset_b@ */ BIT_MASK 0x01 /end MEASUREMENT
/begin MEASUREMENT LSM_RightOffset_b "" UBYTE PubIfDecisionLSM_MDL_CM_boolean 0 0 0 1 ECU_ADDRESS 0x0 /* @MemoryAddress@LSM_RightOffset_b@ */ BIT_MASK 0x01 /end MEASUREMENT
/begin MEASUREMENT LSM_LeftLineTypeEN "" UBYTE PubIfDecisionLSM_MDL_CM_boolean 0 0 0 1 ECU_ADDRESS 0x0 /* @MemoryAddress@LSM_LeftLineTypeEN@ */ BIT_MASK 0x01 /end MEASUREMENT
/begin MEASUREMENT LSM_RightLineTypeEN "" UBYTE PubIfDecisionLSM_MDL_CM_boolean 0 0 0 1 ECU_ADDRESS 0x0 /* @MemoryAddress@LSM_RightLineTypeEN@ */ BIT_MASK 0x01 /end MEASUREMENT
/begin MEASUREMENT LSM_DOP_EN "" UBYTE PubIfDecisionLSM_MDL_CM_boolean 0 0 0 1 ECU_ADDRESS 0x0 /* @MemoryAddress@LSM_DOP_EN@ */ BIT_MASK 0x01 /end MEASUREMENT
/begin MEASUREMENT LSM_DOP_Out "" UBYTE PubIfDecisionLSM_MDL_CM_boolean 0 0 0 1 ECU_ADDRESS 0x0 /* @MemoryAddress@LSM_DOP_Out@ */ BIT_MASK 0x01 /end MEASUREMENT
/begin MEASUREMENT LSM_LH1Valid "" UBYTE PubIfDecisionLSM_MDL_CM_boolean 0 0 0 1 ECU_ADDRESS 0x0 /* @MemoryAddress@LSM_LH1Valid@ */ BIT_MASK 0x01 /end MEASUREMENT
/begin MEASUREMENT LSM_LH2Valid "" UBYTE PubIfDecisionLSM_MDL_CM_boolean 0 0 0 1 ECU_ADDRESS 0x0 /* @MemoryAddress@LSM_LH2Valid@ */ BIT_MASK 0x01 /end MEASUREMENT
/begin MEASUREMENT LSM_CentLineValid "" UBYTE PubIfDecisionLSM_MDL_CM_boolean 0 0 0 1 ECU_ADDRESS 0x0 /* @MemoryAddress@LSM_CentLineValid@ */ BIT_MASK 0x01 /end MEASUREMENT
/begin MEASUREMENT LSM_VisLineUpdate "" UBYTE PubIfDecisionLSM_MDL_CM_boolean 0 0 0 1 ECU_ADDRESS 0x0 /* @MemoryAddress@LSM_VisLineUpdate@ */ BIT_MASK 0x01 /end MEASUREMENT
/begin COMPU_METHOD PubIfDecisionLSM_MDL_CM_single "Q = V" RAT_FUNC "%8.6" "" COEFFS 0 1 0 0 0 1 /end COMPU_METHOD
/begin COMPU_METHOD PubIfDecisionLSM_MDL_CM_double "Q = V" RAT_FUNC "%15.10" "" COEFFS 0 1 0 0 0 1 /end COMPU_METHOD
/begin COMPU_METHOD PubIfDecisionLSM_MDL_CM_uint8 "Q = V" RAT_FUNC "%3.0" "" COEFFS 0 1 0 0 0 1 /end COMPU_METHOD
/begin COMPU_METHOD PubIfDecisionLSM_MDL_CM_uint32 "Q = V" RAT_FUNC "%10.0" "" COEFFS 0 1 0 0 0 1 /end COMPU_METHOD
/begin COMPU_METHOD PubIfDecisionLSM_MDL_CM_int8 "Q = V" RAT_FUNC "%3.0" "" COEFFS 0 1 0 0 0 1 /end COMPU_METHOD
/begin COMPU_METHOD PubIfDecisionLSM_MDL_CM_boolean "Q = V" RAT_FUNC "%1.0" "" COEFFS 0 1 0 0 0 1 /end COMPU_METHOD
/begin GROUP PubIfDecisionLSM_MDL "PubIfDecisionLSM_MDL" /* Root */ ROOT /begin SUB_GROUP Root_Subsystem1 /end SUB_GROUP /end GROUP
/begin GROUP Root_Subsystem1 "PubIfDecisionLSM_MDL/Subsystem1" /begin SUB_GROUP S1_LSM_Signal S1_TargetLineCalc_20ms /end SUB_GROUP
 /begin REF_MEASUREMENT LSM_RFM_LineCenter_C0 LSM_RFM_LineCenter_C1 LSM_RFM_LineCenter_C2 LSM_RFM_LineCenter_C3 LSM_RFM_LineCenter_Front LSM_RFM_LineCenter_Start LSM_RFM_LineCenter_Valid LSM_RFM_LineL1_C0 LSM_RFM_LineL1_C1 LSM_RFM_LineL1_C2 LSM_RFM_LineL1_C3 LSM_RFM_LineL1_Front LSM_RFM_LineL1_Start LSM_RFM_LineL1_Valid LSM_RFM_LineR1_C0 LSM_RFM_LineR1_C1 LSM_RFM_LineR1_C2 LSM_RFM_LineR1_C3 LSM_RFM_LineR1_Front LSM_RFM_LineR1_Start LSM_RFM_LineR1_Valid /end REF_MEASUREMENT
/end GROUP
/begin GROUP S1_LSM_Signal "PubIfDecisionLSM_MDL/Subsystem1/LSM_Signal"
 /begin REF_MEASUREMENT LSM_DoubleLineLost_b LSM_ESSLeLineC0 LSM_ESSLeLineC1 LSM_ESSLeLineC2 LSM_ESSLeLineC3 LSM_ESSLeLineValid LSM_ESSLeRange LSM_ESSLineC0 LSM_ESSLineC1 LSM_ESSLineC2 LSM_ESSLineC3 LSM_ESSLineValid LSM_ESSRange LSM_ESSRiLineC0 LSM_ESSRiLineC1 LSM_ESSRiLineC2 LSM_ESSRiLineC3 LSM_ESSRiLineValid LSM_ESSRiRange LSM_HWALeLineC0 LSM_HWALeLineC1 LSM_HWALeLineC2 LSM_HWALeLineC3 LSM_HWALeLineValid LSM_HWALeRange LSM_HWALineC0 LSM_HWALineC1 LSM_HWALineC2 LSM_HWALineC3 LSM_HWALineValid LSM_HWARange LSM_HWARiLineC0 LSM_HWARiLineC1 LSM_HWARiLineC2 LSM_HWARiLineC3 LSM_HWARiLineValid LSM_HWARiRange LSM_HeadAngDiff LSM_LCKLineC0 LSM_LCKLineC1 LSM_LCKLineC2 LSM_LCKLineC3 LSM_LCKLineValid LSM_LCKRange LSM_LeftLaneChange LSM_MLeLane LSM_OTL_A0 LSM_OTL_A1 LSM_OTL_A2 LSM_OTL_A3 LSM_OTL_Count LSM_OTL_Range LSM_OTLineValid LSM_RightLaneChange LSM_RoadWidth LSM_SingleLineLost_b LSM_TJALineC0 LSM_TJALineC1 LSM_TJALineC2 LSM_TJALineC3 LSM_TJALineValid LSM_TJARange LSM_UpdateCnt LSM_dyDiff /end REF_MEASUREMENT
/end GROUP
/begin GROUP S1_TargetLineCalc_20ms "PubIfDecisionLSM_MDL/Subsystem1/TargetLineCalc_20ms" /begin SUB_GROUP S4_Simulink_Function S4_TargetLineCalc /end SUB_GROUP
 /begin REF_MEASUREMENT LSM_L1_Conf LSM_L1_Range LSM_L2_Conf LSM_L2_Range LSM_L3_Conf LSM_L3_Range LSM_L4_Conf LSM_L4_Range LSM_LA_Adjacent_Count LSM_LA_ELEM_0_Availability_State LSM_LA_ELEM_0_C0 LSM_LA_ELEM_0_C1 LSM_LA_ELEM_0_C2 LSM_LA_ELEM_0_C3 LSM_LA_ELEM_0_Confidence LSM_LA_ELEM_0_DLM_Type LSM_LA_ELEM_0_Lanemark_Type LSM_LA_ELEM_0_Line_Side LSM_LA_ELEM_0_Marker_Width LSM_LA_ELEM_0_Range_End LSM_LA_ELEM_0_Range_Start LSM_LA_ELEM_1_Availability_State LSM_LA_ELEM_1_C0 LSM_LA_ELEM_1_C1 LSM_LA_ELEM_1_C2 LSM_LA_ELEM_1_C3 LSM_LA_ELEM_1_Confidence LSM_LA_ELEM_1_DLM_Type LSM_LA_ELEM_1_Lanemark_Type LSM_LA_ELEM_1_Line_Side LSM_LA_ELEM_1_Marker_Width LSM_LA_ELEM_1_Range_End LSM_LA_ELEM_1_Range_Start LSM_LA_ELEM_2_Availability_State LSM_LA_ELEM_2_C0 LSM_LA_ELEM_2_C1 LSM_LA_ELEM_2_C2 LSM_LA_ELEM_2_C3 LSM_LA_ELEM_2_Confidence LSM_LA_ELEM_2_DLM_Type LSM_LA_ELEM_2_Lanemark_Type LSM_LA_ELEM_2_Line_Side LSM_LA_ELEM_2_Marker_Width LSM_LA_ELEM_2_Range_End LSM_LA_ELEM_2_Range_Start LSM_LA_ELEM_3_Availability_State LSM_LA_ELEM_3_C0 LSM_LA_ELEM_3_C1 LSM_LA_ELEM_3_C2 LSM_LA_ELEM_3_C3 LSM_LA_ELEM_3_Confidence LSM_LA_ELEM_3_DLM_Type LSM_LA_ELEM_3_Lanemark_Type LSM_LA_ELEM_3_Line_Side LSM_LA_ELEM_3_Marker_Width LSM_LA_ELEM_3_Range_End LSM_LA_ELEM_3_Range_Start LSM_LH_Count LSM_LH_ELEM_0_Availability_State LSM_LH_ELEM_0_C0 LSM_LH_ELEM_0_C1 LSM_LH_ELEM_0_C2 LSM_LH_ELEM_0_C3 LSM_LH_ELEM_0_Confidence LSM_LH_ELEM_0_Crossing LSM_LH_ELEM_0_DLM_Type LSM_LH_ELEM_0_Lanemark_Type LSM_LH_ELEM_0_Line_Side LSM_LH_ELEM_0_Marker_Width LSM_LH_ELEM_0_VR_End LSM_LH_ELEM_0_VR_Start LSM_LH_ELEM_1_Availability_State LSM_LH_ELEM_1_C0 LSM_LH_ELEM_1_C1 LSM_LH_ELEM_1_C2 LSM_LH_ELEM_1_C3 LSM_LH_ELEM_1_Confidence LSM_LH_ELEM_1_Crossing LSM_LH_ELEM_1_DLM_Type LSM_LH_ELEM_1_Lanemark_Type LSM_LH_ELEM_1_Line_Side LSM_LH_ELEM_1_Marker_Width LSM_LH_ELEM_1_VR_End LSM_LH_ELEM_1_VR_Start LSM_LRE_Count LSM_LRE_ELEM_0_Availability_State LSM_LRE_ELEM_0_C0 LSM_LRE_ELEM_0_C1 LSM_LRE_ELEM_0_C2 LSM_LRE_ELEM_0_C3 LSM_LRE_ELEM_0_Confidence LSM_LRE_ELEM_0_Line_Side LSM_LRE_ELEM_0_Range_End LSM_LRE_ELEM_0_Range_Start LSM_LRE_ELEM_1_Availability_State LSM_LRE_ELEM_1_C0 LSM_LRE_ELEM_1_C1 LSM_LRE_ELEM_1_C2 LSM_LRE_ELEM_1_C3 LSM_LRE_ELEM_1_Confidence LSM_LRE_ELEM_1_Line_Side LSM_LRE_ELEM_1_Range_End LSM_LRE_ELEM_1_Range_Start LSM_VisLineUpdate /end REF_MEASUREMENT
/end GROUP
/begin GROUP S4_Simulink_Function "PubIfDecisionLSM_MDL/Subsystem1/TargetLineCalc_20ms/Simulink Function" /begin REF_CHARACTERISTIC P_LSM_IFV2CenterAxis P_LSM_IFV2RearAxis /end REF_CHARACTERISTIC /end GROUP
/begin GROUP S4_TargetLineCalc "PubIfDecisionLSM_MDL/Subsystem1/TargetLineCalc_20ms/TargetLineCalc" /begin SUB_GROUP S17_Subsystem2 S17_Subsystem4 S17_Subsystem5 S17_TypeConf /end SUB_GROUP
 /begin REF_CHARACTERISTIC P_LSM_ALC_Enable P_LSM_LineSTD_Limit P_LSM_NOH_Switch P_LSM_Pre_t /end REF_CHARACTERISTIC
 /begin REF_MEASUREMENT LSM_A0K1 LSM_A1K1 LSM_A2K1 LSM_A3K1 LSM_CentLineA0 LSM_CentLineA1 LSM_CentLineA2 LSM_CentLineA3 LSM_CentLineRange LSM_CentLineValid LSM_CentQ LSM_CosOfPsi LSM_EN_C0 LSM_EN_C1 LSM_EN_C2 LSM_EN_C3 LSM_EN_Front LSM_EN_Start LSM_EN_Valid LSM_Exit_C0 LSM_Exit_C1 LSM_Exit_C2 LSM_Exit_C3 LSM_Exit_Front LSM_Exit_Start LSM_Exit_Valid LSM_HWALineC0K1 LSM_HWASts LSM_L1_A0 LSM_L1_AvaliDis LSM_L1_AvaliTime LSM_L2_A0 LSM_L2_AvaliDis LSM_L2_AvaliTime LSM_L3_A0 LSM_L3_AvaliDis LSM_L3_AvaliTime LSM_L4_A0 LSM_L4_AvaliDis LSM_L4_AvaliTime LSM_LH1Valid LSM_LH2Valid LSM_LeftMostLane LSM_LeftOffset_b LSM_LineValidK1 LSM_Line_State LSM_LockCounter LSM_LockID LSM_MoveID LSM_PathLaneAvail LSM_QualityK1 LSM_RangeK1 LSM_RightOffset_b LSM_RoadWidth1 LSM_SinOfsi LSM_TJA_Line_State1 LSM_Wij_State LSM_dDeltaX LSM_dDeltaY LSM_tLostK1 /end REF_MEASUREMENT
/end GROUP
/begin GROUP S17_Subsystem2 "PubIfDecisionLSM_MDL/Subsystem1/TargetLineCalc_20ms/TargetLineCalc/Subsystem2"
 /begin REF_CHARACTERISTIC P_LSM_DOPValid_CheckTime P_LSM_DOP_C0_EN_Limit P_LSM_DOP_C0_out_Limit P_LSM_DOP_C1AndC2_Lim_X P_LSM_DOP_C1_EN_Limit P_LSM_DOP_C1_out_Limit P_LSM_DOP_C2_EN_Limit P_LSM_DOP_C2_out_Limit P_LSM_DOP_In_Pre2Dop_Dis P_LSM_DOP_Out_Pre2Dop_Dis P_LSM_DOP_PreDis_X P_LSM_DOP_PreDis_Y P_LSM_DoubleLine_Curr2Cent_Dislimit P_LSM_DoubleLine_DOPOut_C1 P_LSM_DoubleLine_Dop2Cent_Dislimit P_LSM_DoubleLine_Pre2Cent_Dislimit P_LSM_SingleLine_Cent2Edge_Dislimit P_LSM_SingleLine_Curr2Cent_Dislimit P_LSM_SingleLine_DOPOut_C1 P_LSM_SingleLine_Dop2Cent_Dislimit P_LSM_SingleLine_Pre2Cent_Dislimit /end REF_CHARACTERISTIC
 /begin REF_MEASUREMENT LSM_DOP_EN LSM_DOP_Out LSM_TJA_Line_State /end REF_MEASUREMENT
/end GROUP
/begin GROUP S17_Subsystem4 "PubIfDecisionLSM_MDL/Subsystem1/TargetLineCalc_20ms/TargetLineCalc/Subsystem4" /begin SUB_GROUP S49_If_Action_Subsystem5 /end SUB_GROUP /begin REF_CHARACTERISTIC P_LSM_LineWijCal_C12 P_LSM_LineWijCal_C13 /end REF_CHARACTERISTIC
 /begin REF_MEASUREMENT LSM_CurDis2 LSM_CurDis3 LSM_DeltaDis2 LSM_DeltaDis3 LSM_LH1Wij LSM_LH21 LSM_LH22 LSM_LH23 LSM_LH2Wij LSM_LH31 LSM_LH32 LSM_LH33 LSM_LeftLineConf LSM_RightLineConf /end REF_MEASUREMENT
/end GROUP
/begin GROUP S17_Subsystem5 "PubIfDecisionLSM_MDL/Subsystem1/TargetLineCalc_20ms/TargetLineCalc/Subsystem5" /begin SUB_GROUP S50_If_Action_Subsystem5 /end SUB_GROUP /begin REF_CHARACTERISTIC P_LSM_LineWijCal_C12 P_LSM_LineWijCal_C13 /end REF_CHARACTERISTIC /end GROUP
/begin GROUP S17_TypeConf "PubIfDecisionLSM_MDL/Subsystem1/TargetLineCalc_20ms/TargetLineCalc/TypeConf" /begin REF_MEASUREMENT LSM_LeftLineTypeEN LSM_RightLineTypeEN /end REF_MEASUREMENT /end GROUP
/begin GROUP S49_If_Action_Subsystem5 "PubIfDecisionLSM_MDL/Subsystem1/TargetLineCalc_20ms/TargetLineCalc/Subsystem4/If Action Subsystem5" /begin REF_CHARACTERISTIC P_LSM_PosLineLcFac /end REF_CHARACTERISTIC /end GROUP
/begin GROUP S50_If_Action_Subsystem5 "PubIfDecisionLSM_MDL/Subsystem1/TargetLineCalc_20ms/TargetLineCalc/Subsystem5/If Action Subsystem5" /begin REF_CHARACTERISTIC P_LSM_PosLineLcFac /end REF_CHARACTERISTIC /end GROUP
/end MODULE
/end PROJECT
/* EOF PubIfDecisionLSM_MDL.a2l*/
