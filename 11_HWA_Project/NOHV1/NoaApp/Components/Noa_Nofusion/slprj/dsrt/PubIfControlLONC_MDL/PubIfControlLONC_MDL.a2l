/*
* ASAP2 file: PubIfControlLONC_MDL.a2l
* Copyright 2022, dSPACE GmbH. All rights reserved.
*/ ASAP2_VERSION 1 61
/* Version 1.61 */
/begin PROJECT PubIfControlLONC_MDL ""
/begin HEADER "" VERSION "3.55" PROJECT_NO PubIfControlLONC_MDL /end HEADER
/begin MODULE PubIfControlLONC_MDL ""
/begin RECORD_LAYOUT Scalar_BOOLEAN FNC_VALUES 1 UBYTE ROW_DIR DIRECT /end RECORD_LAYOUT
/begin RECORD_LAYOUT Scalar_UBYTE FNC_VALUES 1 UBYTE ROW_DIR DIRECT /end RECORD_LAYOUT
/begin RECORD_LAYOUT Scalar_BYTE FNC_VALUES 1 SBYTE ROW_DIR DIRECT /end RECORD_LAYOUT
/begin RECORD_LAYOUT Scalar_UWORD FNC_VALUES 1 UWORD ROW_DIR DIRECT /end RECORD_LAYOUT
/begin RECORD_LAYOUT Scalar_SWORD FNC_VALUES 1 SWORD ROW_DIR DIRECT /end RECORD_LAYOUT
/begin RECORD_LAYOUT Scalar_ULONG FNC_VALUES 1 ULONG ROW_DIR DIRECT /end RECORD_LAYOUT
/begin RECORD_LAYOUT Scalar_LONG FNC_VALUES 1 SLONG ROW_DIR DIRECT /end RECORD_LAYOUT
/begin RECORD_LAYOUT Scalar_FLOAT32_IEEE FNC_VALUES 1 FLOAT32_IEEE ROW_DIR DIRECT /end RECORD_LAYOUT
/begin RECORD_LAYOUT Scalar_FLOAT64_IEEE FNC_VALUES 1 FLOAT64_IEEE ROW_DIR DIRECT /end RECORD_LAYOUT
/begin RECORD_LAYOUT Lookup1D_BOOLEAN FNC_VALUES 1 UBYTE ROW_DIR DIRECT /end RECORD_LAYOUT
/begin RECORD_LAYOUT Lookup1D_BYTE FNC_VALUES 1 SBYTE ROW_DIR DIRECT /end RECORD_LAYOUT
/begin RECORD_LAYOUT Lookup1D_UBYTE FNC_VALUES 1 UBYTE ROW_DIR DIRECT /end RECORD_LAYOUT
/begin RECORD_LAYOUT Lookup1D_UWORD FNC_VALUES 1 UWORD ROW_DIR DIRECT /end RECORD_LAYOUT
/begin RECORD_LAYOUT Lookup1D_WORD FNC_VALUES 1 SWORD ROW_DIR DIRECT /end RECORD_LAYOUT
/begin RECORD_LAYOUT Lookup1D_ULONG FNC_VALUES 1 ULONG ROW_DIR DIRECT /end RECORD_LAYOUT
/begin RECORD_LAYOUT Lookup1D_LONG FNC_VALUES 1 SLONG ROW_DIR DIRECT /end RECORD_LAYOUT
/begin RECORD_LAYOUT Lookup1D_FLOAT32_IEEE FNC_VALUES 1 FLOAT32_IEEE ROW_DIR DIRECT /end RECORD_LAYOUT
/begin RECORD_LAYOUT Lookup1D_FLOAT64_IEEE FNC_VALUES 1 FLOAT64_IEEE ROW_DIR DIRECT /end RECORD_LAYOUT
/begin RECORD_LAYOUT Lookup1D_X_BOOLEAN AXIS_PTS_X 1 UBYTE INDEX_INCR DIRECT /end RECORD_LAYOUT
/begin RECORD_LAYOUT Lookup1D_X_BYTE AXIS_PTS_X 1 SBYTE INDEX_INCR DIRECT /end RECORD_LAYOUT
/begin RECORD_LAYOUT Lookup1D_X_UBYTE AXIS_PTS_X 1 UBYTE INDEX_INCR DIRECT /end RECORD_LAYOUT
/begin RECORD_LAYOUT Lookup1D_X_UWORD AXIS_PTS_X 1 UWORD INDEX_INCR DIRECT /end RECORD_LAYOUT
/begin RECORD_LAYOUT Lookup1D_X_WORD AXIS_PTS_X 1 SWORD INDEX_INCR DIRECT /end RECORD_LAYOUT
/begin RECORD_LAYOUT Lookup1D_X_ULONG AXIS_PTS_X 1 ULONG INDEX_INCR DIRECT /end RECORD_LAYOUT
/begin RECORD_LAYOUT Lookup1D_X_LONG AXIS_PTS_X 1 SLONG INDEX_INCR DIRECT /end RECORD_LAYOUT
/begin RECORD_LAYOUT Lookup1D_X_FLOAT32_IEEE AXIS_PTS_X 1 FLOAT32_IEEE INDEX_INCR DIRECT /end RECORD_LAYOUT
/begin RECORD_LAYOUT Lookup1D_X_FLOAT64_IEEE AXIS_PTS_X 1 FLOAT64_IEEE INDEX_INCR DIRECT /end RECORD_LAYOUT
/begin RECORD_LAYOUT Lookup2D_BOOLEAN FNC_VALUES 1 UBYTE ROW_DIR DIRECT /end RECORD_LAYOUT
/begin RECORD_LAYOUT Lookup2D_UBYTE FNC_VALUES 1 UBYTE ROW_DIR DIRECT /end RECORD_LAYOUT
/begin RECORD_LAYOUT Lookup2D_BYTE FNC_VALUES 1 SBYTE ROW_DIR DIRECT /end RECORD_LAYOUT
/begin RECORD_LAYOUT Lookup2D_UWORD FNC_VALUES 1 UWORD ROW_DIR DIRECT /end RECORD_LAYOUT
/begin RECORD_LAYOUT Lookup2D_WORD FNC_VALUES 1 SWORD ROW_DIR DIRECT /end RECORD_LAYOUT
/begin RECORD_LAYOUT Lookup2D_ULONG FNC_VALUES 1 ULONG ROW_DIR DIRECT /end RECORD_LAYOUT
/begin RECORD_LAYOUT Lookup2D_LONG FNC_VALUES 1 SLONG ROW_DIR DIRECT /end RECORD_LAYOUT
/begin RECORD_LAYOUT Lookup2D_FLOAT32_IEEE FNC_VALUES 1 FLOAT32_IEEE ROW_DIR DIRECT /end RECORD_LAYOUT
/begin RECORD_LAYOUT Lookup2D_FLOAT64_IEEE FNC_VALUES 1 FLOAT64_IEEE ROW_DIR DIRECT /end RECORD_LAYOUT
/begin RECORD_LAYOUT Lookup2D_X_BOOLEAN AXIS_PTS_X 1 UBYTE INDEX_INCR DIRECT /end RECORD_LAYOUT
/begin RECORD_LAYOUT Lookup2D_X_UBYTE AXIS_PTS_X 1 UBYTE INDEX_INCR DIRECT /end RECORD_LAYOUT
/begin RECORD_LAYOUT Lookup2D_X_BYTE AXIS_PTS_X 1 SBYTE INDEX_INCR DIRECT /end RECORD_LAYOUT
/begin RECORD_LAYOUT Lookup2D_X_UWORD AXIS_PTS_X 1 UWORD INDEX_INCR DIRECT /end RECORD_LAYOUT
/begin RECORD_LAYOUT Lookup2D_X_WORD AXIS_PTS_X 1 SWORD INDEX_INCR DIRECT /end RECORD_LAYOUT
/begin RECORD_LAYOUT Lookup2D_X_ULONG AXIS_PTS_X 1 ULONG INDEX_INCR DIRECT /end RECORD_LAYOUT
/begin RECORD_LAYOUT Lookup2D_X_LONG AXIS_PTS_X 1 SLONG INDEX_INCR DIRECT /end RECORD_LAYOUT
/begin RECORD_LAYOUT Lookup2D_X_FLOAT32_IEEE AXIS_PTS_X 1 FLOAT32_IEEE INDEX_INCR DIRECT /end RECORD_LAYOUT
/begin RECORD_LAYOUT Lookup2D_X_FLOAT64_IEEE AXIS_PTS_X 1 FLOAT64_IEEE INDEX_INCR DIRECT /end RECORD_LAYOUT
/begin CHARACTERISTIC P_LongCtrl_VLCMaRatioCharMaYAxis "" CURVE 0x0 /* @MemoryAddress@P_LongCtrl_VLCMaRatioCharMaYAxis@ */ Lookup1D_FLOAT32_IEEE 0 PubIfControlLONC_MDL_CM_single 0.0 3.0
 /begin AXIS_DESCR COM_AXIS LongCtrl_Tr_Ratio PubIfControlLONC_MDL_CM_single 18 1.0 30.0 AXIS_PTS_REF P_LongCtrl_VLCTrRatioCharMaXAxis /end AXIS_DESCR
/end CHARACTERISTIC
/begin AXIS_PTS P_LongCtrl_VLCTrRatioCharMaXAxis "" 0x0 /* @MemoryAddress@P_LongCtrl_VLCTrRatioCharMaXAxis@ */ LongCtrl_Tr_Ratio Lookup1D_X_FLOAT32_IEEE 0 PubIfControlLONC_MDL_CM_single 18 1.0 30.0 /end AXIS_PTS
/begin CHARACTERISTIC P_LongCtrl_VLCaccelMinHoldYAxis "" CURVE 0x0 /* @MemoryAddress@P_LongCtrl_VLCaccelMinHoldYAxis@ */ Lookup1D_FLOAT32_IEEE 0 PubIfControlLONC_MDL_CM_single_m_s_2 -6.0 0.0
 /begin AXIS_DESCR COM_AXIS LongCtrl_axvRoadSlopeMs2 PubIfControlLONC_MDL_CM_single_m_s_2 2 0.0 5.0 AXIS_PTS_REF P_LongCtrl_VLCaccelMinHoldXAxis /end AXIS_DESCR
/end CHARACTERISTIC
/begin AXIS_PTS P_LongCtrl_VLCaccelMinHoldXAxis "" 0x0 /* @MemoryAddress@P_LongCtrl_VLCaccelMinHoldXAxis@ */ LongCtrl_axvRoadSlopeMs2 Lookup1D_X_FLOAT32_IEEE 0 PubIfControlLONC_MDL_CM_single_m_s_2 2 0.0 5.0 /end AXIS_PTS
/begin CHARACTERISTIC P_LongCtrl_VLCjerkHoldYAxis "" CURVE 0x0 /* @MemoryAddress@P_LongCtrl_VLCjerkHoldYAxis@ */ Lookup1D_FLOAT32_IEEE 0 PubIfControlLONC_MDL_CM_single_m_s_3 -50.0 0.0
 /begin AXIS_DESCR COM_AXIS LongCtrl_axvRoadSlopeMs2 PubIfControlLONC_MDL_CM_single_m_s_2 2 0.0 4.0 AXIS_PTS_REF P_LongCtrl_VLCjerkHoldXAxis /end AXIS_DESCR
/end CHARACTERISTIC
/begin AXIS_PTS P_LongCtrl_VLCjerkHoldXAxis "" 0x0 /* @MemoryAddress@P_LongCtrl_VLCjerkHoldXAxis@ */ LongCtrl_axvRoadSlopeMs2 Lookup1D_X_FLOAT32_IEEE 0 PubIfControlLONC_MDL_CM_single_m_s_2 2 0.0 4.0 /end AXIS_PTS
/begin CHARACTERISTIC P_LongCtrl_VLCaccelMinSlidHoldYAxis "m/s^2" CURVE 0x0 /* @MemoryAddress@P_LongCtrl_VLCaccelMinSlidHoldYAxis@ */ Lookup1D_FLOAT32_IEEE 0 PubIfControlLONC_MDL_CM_single -3.4E+38 3.4E+38
 /begin AXIS_DESCR COM_AXIS LongCtrl_axvRoadSlopeMs2 PubIfControlLONC_MDL_CM_single 7 -3.4E+38 3.4E+38 AXIS_PTS_REF P_LongCtrl_VLCaccelMinSlidHoldXAxis /end AXIS_DESCR
/end CHARACTERISTIC
/begin AXIS_PTS P_LongCtrl_VLCaccelMinSlidHoldXAxis "m/s^2" 0x0 /* @MemoryAddress@P_LongCtrl_VLCaccelMinSlidHoldXAxis@ */ LongCtrl_axvRoadSlopeMs2 Lookup1D_X_FLOAT32_IEEE 0 PubIfControlLONC_MDL_CM_single 7 -3.4E+38 3.4E+38 /end AXIS_PTS
/begin CHARACTERISTIC P_LongCtrl_VLCjerkSlidHoldYAxis "m/s^3" CURVE 0x0 /* @MemoryAddress@P_LongCtrl_VLCjerkSlidHoldYAxis@ */ Lookup1D_FLOAT32_IEEE 0 PubIfControlLONC_MDL_CM_single -3.4E+38 3.4E+38
 /begin AXIS_DESCR COM_AXIS LongCtrl_axvRoadSlopeMs2 PubIfControlLONC_MDL_CM_single 7 -3.4E+38 3.4E+38 AXIS_PTS_REF P_LongCtrl_VLCjerkSlidHoldXAxis /end AXIS_DESCR
/end CHARACTERISTIC
/begin AXIS_PTS P_LongCtrl_VLCjerkSlidHoldXAxis "m/s^2" 0x0 /* @MemoryAddress@P_LongCtrl_VLCjerkSlidHoldXAxis@ */ LongCtrl_axvRoadSlopeMs2 Lookup1D_X_FLOAT32_IEEE 0 PubIfControlLONC_MDL_CM_single 7 -3.4E+38 3.4E+38 /end AXIS_PTS
/begin CHARACTERISTIC P_LongCtrl_VLCcoefPIYAxis "" CURVE 0x0 /* @MemoryAddress@P_LongCtrl_VLCcoefPIYAxis@ */ Lookup1D_FLOAT32_IEEE 0 PubIfControlLONC_MDL_CM_single 0.0 2.0
 /begin AXIS_DESCR COM_AXIS NO_INPUT_QUANTITY PubIfControlLONC_MDL_CM_single_km_h 4 0.0 30.0 AXIS_PTS_REF P_LongCtrl_VLCvelCharCoefPIXAxis /end AXIS_DESCR
/end CHARACTERISTIC
/begin AXIS_PTS P_LongCtrl_VLCvelCharCoefPIXAxis "" 0x0 /* @MemoryAddress@P_LongCtrl_VLCvelCharCoefPIXAxis@ */ NO_INPUT_QUANTITY Lookup1D_X_FLOAT32_IEEE 0 PubIfControlLONC_MDL_CM_single_km_h 4 0.0 30.0 /end AXIS_PTS
/begin CHARACTERISTIC P_LongCtrl_VLCengInverseEfficientYAxis "" CURVE 0x0 /* @MemoryAddress@P_LongCtrl_VLCengInverseEfficientYAxis@ */ Lookup1D_FLOAT32_IEEE 0 PubIfControlLONC_MDL_CM_single__ -120.0 120.0
 /begin AXIS_DESCR COM_AXIS NO_INPUT_QUANTITY PubIfControlLONC_MDL_CM_single__ 5 -150.0 110.0 AXIS_PTS_REF P_LongCtrl_VLCtorqCharEngInverseEfficientXAxis /end AXIS_DESCR
/end CHARACTERISTIC
/begin AXIS_PTS P_LongCtrl_VLCtorqCharEngInverseEfficientXAxis "" 0x0 /* @MemoryAddress@P_LongCtrl_VLCtorqCharEngInverseEfficientXAxis@ */ NO_INPUT_QUANTITY Lookup1D_X_FLOAT32_IEEE 0 PubIfControlLONC_MDL_CM_single__ 5 -150.0 110.0 /end AXIS_PTS
/begin CHARACTERISTIC P_LongCtrl_VLCcoefKiDiffDtEnlargeYAxis "" CURVE 0x0 /* @MemoryAddress@P_LongCtrl_VLCcoefKiDiffDtEnlargeYAxis@ */ Lookup1D_FLOAT32_IEEE 0 PubIfControlLONC_MDL_CM_single 0.0 3.0
 /begin AXIS_DESCR COM_AXIS NO_INPUT_QUANTITY PubIfControlLONC_MDL_CM_single_m_s_3 6 -10.0 20.0 AXIS_PTS_REF P_LongCtrl_VLCdiffDtCharCoefKiEnlargeXAxis /end AXIS_DESCR
/end CHARACTERISTIC
/begin AXIS_PTS P_LongCtrl_VLCdiffDtCharCoefKiEnlargeXAxis "" 0x0 /* @MemoryAddress@P_LongCtrl_VLCdiffDtCharCoefKiEnlargeXAxis@ */ NO_INPUT_QUANTITY Lookup1D_X_FLOAT32_IEEE 0 PubIfControlLONC_MDL_CM_single_m_s_3 6 -10.0 20.0 /end AXIS_PTS
/begin CHARACTERISTIC P_LongCtrl_VLCcoefKiEnableYAxis "" CURVE 0x0 /* @MemoryAddress@P_LongCtrl_VLCcoefKiEnableYAxis@ */ Lookup1D_FLOAT32_IEEE 0 PubIfControlLONC_MDL_CM_single 0.0 2.0
 /begin AXIS_DESCR COM_AXIS LongCtrl_axvDiff PubIfControlLONC_MDL_CM_single_m_s_2 6 -10.0 20.0 AXIS_PTS_REF P_LongCtrl_VLCaDiffCharCoefKiEnableXAxis /end AXIS_DESCR
/end CHARACTERISTIC
/begin AXIS_PTS P_LongCtrl_VLCaDiffCharCoefKiEnableXAxis "" 0x0 /* @MemoryAddress@P_LongCtrl_VLCaDiffCharCoefKiEnableXAxis@ */ LongCtrl_axvDiff Lookup1D_X_FLOAT32_IEEE 0 PubIfControlLONC_MDL_CM_single_m_s_2 6 -10.0 20.0 /end AXIS_PTS
/begin CHARACTERISTIC P_LongCtrl_VLCAxvTracMinDC1FullFillYAxis "" CURVE 0x0 /* @MemoryAddress@P_LongCtrl_VLCAxvTracMinDC1FullFillYAxis@ */ Lookup1D_FLOAT32_IEEE 0 PubIfControlLONC_MDL_CM_single_m_s_2 -1.0 1.0
 /begin AXIS_DESCR COM_AXIS LongCtrl_vxvRefMs PubIfControlLONC_MDL_CM_single_m_s 4 0.0 60.0 AXIS_PTS_REF P_LongCtrl_VLCAxvTracMinDC1FullFillXAxis /end AXIS_DESCR
/end CHARACTERISTIC
/begin AXIS_PTS P_LongCtrl_VLCAxvTracMinDC1FullFillXAxis "" 0x0 /* @MemoryAddress@P_LongCtrl_VLCAxvTracMinDC1FullFillXAxis@ */ LongCtrl_vxvRefMs Lookup1D_X_FLOAT32_IEEE 0 PubIfControlLONC_MDL_CM_single_m_s 4 0.0 60.0 /end AXIS_PTS
/begin CHARACTERISTIC P_LongCtrl_VLCengEfficientCharYAxis "" CURVE 0x0 /* @MemoryAddress@P_LongCtrl_VLCengEfficientCharYAxis@ */ Lookup1D_FLOAT32_IEEE 0 PubIfControlLONC_MDL_CM_single 0.5 2.0
 /begin AXIS_DESCR COM_AXIS NO_INPUT_QUANTITY PubIfControlLONC_MDL_CM_single__ 5 -100.0 100.0 AXIS_PTS_REF P_LongCtrl_VLCtorqCharEngEfficientXAxis /end AXIS_DESCR
/end CHARACTERISTIC
/begin AXIS_PTS P_LongCtrl_VLCtorqCharEngEfficientXAxis "" 0x0 /* @MemoryAddress@P_LongCtrl_VLCtorqCharEngEfficientXAxis@ */ NO_INPUT_QUANTITY Lookup1D_X_FLOAT32_IEEE 0 PubIfControlLONC_MDL_CM_single__ 5 -100.0 100.0 /end AXIS_PTS
/begin CHARACTERISTIC P_LongCtrl_VLCcoefFYAxis "" CURVE 0x0 /* @MemoryAddress@P_LongCtrl_VLCcoefFYAxis@ */ Lookup1D_FLOAT32_IEEE 0 PubIfControlLONC_MDL_CM_single 0.0 1.0
 /begin AXIS_DESCR COM_AXIS NO_INPUT_QUANTITY PubIfControlLONC_MDL_CM_single_km_h 10 0.0 250.0 AXIS_PTS_REF P_LongCtrl_VLCcoefFXAxis /end AXIS_DESCR
/end CHARACTERISTIC
/begin AXIS_PTS P_LongCtrl_VLCcoefFXAxis "" 0x0 /* @MemoryAddress@P_LongCtrl_VLCcoefFXAxis@ */ NO_INPUT_QUANTITY Lookup1D_X_FLOAT32_IEEE 0 PubIfControlLONC_MDL_CM_single_km_h 10 0.0 250.0 /end AXIS_PTS
/begin CHARACTERISTIC P_Global_TireRadius_m "ÂÖÌ¥°ë¾¶" VALUE 0x0 /* @MemoryAddress@P_Global_TireRadius_m@ */ Scalar_FLOAT32_IEEE 0 PubIfControlLONC_MDL_CM_single_m -3.4E+38 3.4E+38 /end CHARACTERISTIC
/begin CHARACTERISTIC P_Global_Weight_N "³µÖØ" VALUE 0x0 /* @MemoryAddress@P_Global_Weight_N@ */ Scalar_FLOAT32_IEEE 0 PubIfControlLONC_MDL_CM_single_N -3.4E+38 3.4E+38 /end CHARACTERISTIC
/begin CHARACTERISTIC P_LongCtrl_AxvRoadSlopeThrd "m/s^2" VALUE 0x0 /* @MemoryAddress@P_LongCtrl_AxvRoadSlopeThrd@ */ Scalar_FLOAT32_IEEE 0 PubIfControlLONC_MDL_CM_single -3.4E+38 3.4E+38 /end CHARACTERISTIC
/begin CHARACTERISTIC P_LongCtrl_TotWheelTrqRatio "" VALUE 0x0 /* @MemoryAddress@P_LongCtrl_TotWheelTrqRatio@ */ Scalar_FLOAT32_IEEE 0 PubIfControlLONC_MDL_CM_single -3.4E+38 3.4E+38 /end CHARACTERISTIC
/begin CHARACTERISTIC P_LongCtrl_VLCAxTarDtThreEnableI "" VALUE 0x0 /* @MemoryAddress@P_LongCtrl_VLCAxTarDtThreEnableI@ */ Scalar_FLOAT32_IEEE 0 PubIfControlLONC_MDL_CM_single_m_s_3 0.0 5.0 /end CHARACTERISTIC
/begin CHARACTERISTIC P_LongCtrl_VLCCounterAxvTracMinTimeout "" VALUE 0x0 /* @MemoryAddress@P_LongCtrl_VLCCounterAxvTracMinTimeout@ */ Scalar_FLOAT32_IEEE 0 PubIfControlLONC_MDL_CM_single 0.0 100.0 /end CHARACTERISTIC
/begin CHARACTERISTIC P_LongCtrl_VLCCounterDC2ECTorqDelay "" VALUE 0x0 /* @MemoryAddress@P_LongCtrl_VLCCounterDC2ECTorqDelay@ */ Scalar_FLOAT32_IEEE 0 PubIfControlLONC_MDL_CM_single 0.0 100.0 /end CHARACTERISTIC
/begin CHARACTERISTIC P_LongCtrl_VLCCounterDrvOff2EC "" VALUE 0x0 /* @MemoryAddress@P_LongCtrl_VLCCounterDrvOff2EC@ */ Scalar_FLOAT32_IEEE 0 PubIfControlLONC_MDL_CM_single 0.0 100.0 /end CHARACTERISTIC
/begin CHARACTERISTIC P_LongCtrl_VLCDtAxvRef2UpperBandDC5 "" VALUE 0x0 /* @MemoryAddress@P_LongCtrl_VLCDtAxvRef2UpperBandDC5@ */ Scalar_FLOAT32_IEEE 0 PubIfControlLONC_MDL_CM_single -1.0 1.0 /end CHARACTERISTIC
/begin CHARACTERISTIC P_LongCtrl_VLCIACompensionNeg "" VALUE 0x0 /* @MemoryAddress@P_LongCtrl_VLCIACompensionNeg@ */ Scalar_FLOAT32_IEEE 0 PubIfControlLONC_MDL_CM_single_m_s_2 -3.0 0.0 /end CHARACTERISTIC
/begin CHARACTERISTIC P_LongCtrl_VLCIACompensionPos "" VALUE 0x0 /* @MemoryAddress@P_LongCtrl_VLCIACompensionPos@ */ Scalar_FLOAT32_IEEE 0 PubIfControlLONC_MDL_CM_single_m_s_2 0.0 3.0 /end CHARACTERISTIC
/begin CHARACTERISTIC P_LongCtrl_VLCLowerJerkCounterDrvOff2EC "" VALUE 0x0 /* @MemoryAddress@P_LongCtrl_VLCLowerJerkCounterDrvOff2EC@ */ Scalar_FLOAT32_IEEE 0 PubIfControlLONC_MDL_CM_single_m_s_3 -4.0 4.0 /end CHARACTERISTIC
/begin CHARACTERISTIC P_LongCtrl_VLCTorqDiffThreAxvTracMinTimeout "" VALUE 0x0 /* @MemoryAddress@P_LongCtrl_VLCTorqDiffThreAxvTracMinTimeout@ */ Scalar_FLOAT32_IEEE 0 PubIfControlLONC_MDL_CM_single 0.0 20.0 /end CHARACTERISTIC
/begin CHARACTERISTIC P_LongCtrl_VLCTrTatioMax "" VALUE 0x0 /* @MemoryAddress@P_LongCtrl_VLCTrTatioMax@ */ Scalar_FLOAT32_IEEE 0 PubIfControlLONC_MDL_CM_single 10.0 30.0 /end CHARACTERISTIC
/begin CHARACTERISTIC P_LongCtrl_VLCTrTatioMin "" VALUE 0x0 /* @MemoryAddress@P_LongCtrl_VLCTrTatioMin@ */ Scalar_FLOAT32_IEEE 0 PubIfControlLONC_MDL_CM_single 0.1 1.0 /end CHARACTERISTIC
/begin CHARACTERISTIC P_LongCtrl_VLCUpperJerkCounterDrvOff2EC "" VALUE 0x0 /* @MemoryAddress@P_LongCtrl_VLCUpperJerkCounterDrvOff2EC@ */ Scalar_FLOAT32_IEEE 0 PubIfControlLONC_MDL_CM_single_m_s_3 -4.0 4.0 /end CHARACTERISTIC
/begin CHARACTERISTIC P_LongCtrl_VLCVlcAccThresAxvTracMinTimeout "" VALUE 0x0 /* @MemoryAddress@P_LongCtrl_VLCVlcAccThresAxvTracMinTimeout@ */ Scalar_FLOAT32_IEEE 0 PubIfControlLONC_MDL_CM_single_m_s_2 -5.0 2.0 /end CHARACTERISTIC
/begin CHARACTERISTIC P_LongCtrl_VLC_WindArea "" VALUE 0x0 /* @MemoryAddress@P_LongCtrl_VLC_WindArea@ */ Scalar_FLOAT32_IEEE 0 PubIfControlLONC_MDL_CM_single_m_2 -3.4E+38 3.4E+38 /end CHARACTERISTIC
/begin CHARACTERISTIC P_LongCtrl_VLC_fRollCoef "" VALUE 0x0 /* @MemoryAddress@P_LongCtrl_VLC_fRollCoef@ */ Scalar_FLOAT32_IEEE 0 PubIfControlLONC_MDL_CM_single -3.4E+38 3.4E+38 /end CHARACTERISTIC
/begin CHARACTERISTIC P_LongCtrl_VLCaDiffCharCoefKiXAxis "" VAL_BLK 0x0 /* @MemoryAddress@P_LongCtrl_VLCaDiffCharCoefKiXAxis@ */ Scalar_FLOAT32_IEEE 0 PubIfControlLONC_MDL_CM_single_m_s_2 -5.0 5.0 MATRIX_DIM 1 11 1 /end CHARACTERISTIC
/begin CHARACTERISTIC P_LongCtrl_VLCaDtThresUpdateTorq "" VALUE 0x0 /* @MemoryAddress@P_LongCtrl_VLCaDtThresUpdateTorq@ */ Scalar_FLOAT32_IEEE 0 PubIfControlLONC_MDL_CM_single_m_s_3 0.0 10.0 /end CHARACTERISTIC
/begin CHARACTERISTIC P_LongCtrl_VLCaXCDeadZoneProp_Y "" VAL_BLK 0x0 /* @MemoryAddress@P_LongCtrl_VLCaXCDeadZoneProp_Y@ */ Scalar_FLOAT32_IEEE 0 PubIfControlLONC_MDL_CM_single -3.4E+38 3.4E+38 MATRIX_DIM 1 7 1 /end CHARACTERISTIC
/begin CHARACTERISTIC P_LongCtrl_VLCaxCtrlDevDeadZoneChar_Y "" VAL_BLK 0x0 /* @MemoryAddress@P_LongCtrl_VLCaxCtrlDevDeadZoneChar_Y@ */ Scalar_FLOAT32_IEEE 0 PubIfControlLONC_MDL_CM_single -3.4E+38 3.4E+38 MATRIX_DIM 1 5 1 /end CHARACTERISTIC
/begin CHARACTERISTIC P_LongCtrl_VLCaxCtrlDevEC2DCMax "" VALUE 0x0 /* @MemoryAddress@P_LongCtrl_VLCaxCtrlDevEC2DCMax@ */ Scalar_FLOAT32_IEEE 0 PubIfControlLONC_MDL_CM_single -3.4E+38 3.4E+38 /end CHARACTERISTIC
/begin CHARACTERISTIC P_LongCtrl_VLCaxCtrlDevFastQuitDCMode "" VALUE 0x0 /* @MemoryAddress@P_LongCtrl_VLCaxCtrlDevFastQuitDCMode@ */ Scalar_FLOAT32_IEEE 0 PubIfControlLONC_MDL_CM_single -3.4E+38 3.4E+38 /end CHARACTERISTIC
/begin CHARACTERISTIC P_LongCtrl_VLCaxCtrlDevThresAddEC2DCCharYAxis "" VAL_BLK 0x0 /* @MemoryAddress@P_LongCtrl_VLCaxCtrlDevThresAddEC2DCCharYAxis@ */ Scalar_FLOAT32_IEEE 0 PubIfControlLONC_MDL_CM_single -3.4E+38 3.4E+38 MATRIX_DIM 1 5 1 /end CHARACTERISTIC
/begin CHARACTERISTIC P_LongCtrl_VLCaxCtrlDevTresAddDC2ECYAxis "" VAL_BLK 0x0 /* @MemoryAddress@P_LongCtrl_VLCaxCtrlDevTresAddDC2ECYAxis@ */ Scalar_FLOAT32_IEEE 0 PubIfControlLONC_MDL_CM_single -3.4E+38 3.4E+38 MATRIX_DIM 1 5 1 /end CHARACTERISTIC
/begin CHARACTERISTIC P_LongCtrl_VLCaxDtCharAxCtrlDevTresAddDC2ECXAxis "" VAL_BLK 0x0 /* @MemoryAddress@P_LongCtrl_VLCaxDtCharAxCtrlDevTresAddDC2ECXAxis@ */ Scalar_FLOAT32_IEEE 0 PubIfControlLONC_MDL_CM_single_m_s_3 0.0 2.0 MATRIX_DIM 1 5 1 /end CHARACTERISTIC
/begin CHARACTERISTIC P_LongCtrl_VLCaxDtCharAxCtrlDevTresAddEC2DCXAxis "" VAL_BLK 0x0 /* @MemoryAddress@P_LongCtrl_VLCaxDtCharAxCtrlDevTresAddEC2DCXAxis@ */ Scalar_FLOAT32_IEEE 0 PubIfControlLONC_MDL_CM_single_m_s_2 -2.0 1.0 MATRIX_DIM 1 5 1 /end CHARACTERISTIC
/begin CHARACTERISTIC P_LongCtrl_VLCaxvRoadSlopeDC4CharXAxis "" VAL_BLK 0x0 /* @MemoryAddress@P_LongCtrl_VLCaxvRoadSlopeDC4CharXAxis@ */ Scalar_FLOAT32_IEEE 0 PubIfControlLONC_MDL_CM_single_m_s_2 -4.0 1.0 MATRIX_DIM 1 5 1 /end CHARACTERISTIC
/begin CHARACTERISTIC P_LongCtrl_VLCaxvRoadSlopeDC4CharYAxis "" VAL_BLK 0x0 /* @MemoryAddress@P_LongCtrl_VLCaxvRoadSlopeDC4CharYAxis@ */ Scalar_FLOAT32_IEEE 0 PubIfControlLONC_MDL_CM_single 0.0 1.0 MATRIX_DIM 1 5 1 /end CHARACTERISTIC
/begin CHARACTERISTIC P_LongCtrl_VLCcoefIFadeOut1Calc "" VALUE 0x0 /* @MemoryAddress@P_LongCtrl_VLCcoefIFadeOut1Calc@ */ Scalar_FLOAT32_IEEE 0 PubIfControlLONC_MDL_CM_single 1.0 10.0 /end CHARACTERISTIC
/begin CHARACTERISTIC P_LongCtrl_VLCcoefIFadeOut1Condition "" VALUE 0x0 /* @MemoryAddress@P_LongCtrl_VLCcoefIFadeOut1Condition@ */ Scalar_FLOAT32_IEEE 0 PubIfControlLONC_MDL_CM_single 0.0 1.0 /end CHARACTERISTIC
/begin CHARACTERISTIC P_LongCtrl_VLCcoefIFadeOut2Calc "" VALUE 0x0 /* @MemoryAddress@P_LongCtrl_VLCcoefIFadeOut2Calc@ */ Scalar_FLOAT32_IEEE 0 PubIfControlLONC_MDL_CM_single 1.0 10.0 /end CHARACTERISTIC
/begin CHARACTERISTIC P_LongCtrl_VLCcoefIFadeOut2Condition "" VALUE 0x0 /* @MemoryAddress@P_LongCtrl_VLCcoefIFadeOut2Condition@ */ Scalar_FLOAT32_IEEE 0 PubIfControlLONC_MDL_CM_single 0.0 1.0 /end CHARACTERISTIC
/begin CHARACTERISTIC P_LongCtrl_VLCcoefIFadeOut3Calc "" VALUE 0x0 /* @MemoryAddress@P_LongCtrl_VLCcoefIFadeOut3Calc@ */ Scalar_FLOAT32_IEEE 0 PubIfControlLONC_MDL_CM_single 1.0 10.0 /end CHARACTERISTIC
/begin CHARACTERISTIC P_LongCtrl_VLCcoefIFadeOut3Condition "" VALUE 0x0 /* @MemoryAddress@P_LongCtrl_VLCcoefIFadeOut3Condition@ */ Scalar_FLOAT32_IEEE 0 PubIfControlLONC_MDL_CM_single 0.0 1.0 /end CHARACTERISTIC
/begin CHARACTERISTIC P_LongCtrl_VLCcoefKiEnlargeADiffYAxis "" VAL_BLK 0x0 /* @MemoryAddress@P_LongCtrl_VLCcoefKiEnlargeADiffYAxis@ */ Scalar_FLOAT32_IEEE 0 PubIfControlLONC_MDL_CM_single -3.4E+38 3.4E+38 MATRIX_DIM 1 11 1 /end CHARACTERISTIC
/begin CHARACTERISTIC P_LongCtrl_VLCdaxTarEC2DCMax "" VALUE 0x0 /* @MemoryAddress@P_LongCtrl_VLCdaxTarEC2DCMax@ */ Scalar_FLOAT32_IEEE 0 PubIfControlLONC_MDL_CM_single -3.4E+38 3.4E+38 /end CHARACTERISTIC
/begin CHARACTERISTIC P_LongCtrl_VLCdriveOffAxUpLimXAxix "" VAL_BLK 0x0 /* @MemoryAddress@P_LongCtrl_VLCdriveOffAxUpLimXAxix@ */ Scalar_FLOAT32_IEEE 0 PubIfControlLONC_MDL_CM_single -3.4E+38 3.4E+38 MATRIX_DIM 1 5 1 /end CHARACTERISTIC
/begin CHARACTERISTIC P_LongCtrl_VLCdriveOffAxUpLimYAxix "" VAL_BLK 0x0 /* @MemoryAddress@P_LongCtrl_VLCdriveOffAxUpLimYAxix@ */ Scalar_FLOAT32_IEEE 0 PubIfControlLONC_MDL_CM_single -3.4E+38 3.4E+38 MATRIX_DIM 1 5 1 /end CHARACTERISTIC
/begin CHARACTERISTIC P_LongCtrl_VLCki "" VALUE 0x0 /* @MemoryAddress@P_LongCtrl_VLCki@ */ Scalar_FLOAT32_IEEE 0 PubIfControlLONC_MDL_CM_single -3.4E+38 3.4E+38 /end CHARACTERISTIC
/begin CHARACTERISTIC P_LongCtrl_VLCkp "" VALUE 0x0 /* @MemoryAddress@P_LongCtrl_VLCkp@ */ Scalar_FLOAT32_IEEE 0 PubIfControlLONC_MDL_CM_single -3.4E+38 3.4E+38 /end CHARACTERISTIC
/begin CHARACTERISTIC P_LongCtrl_VLCks "" VALUE 0x0 /* @MemoryAddress@P_LongCtrl_VLCks@ */ Scalar_FLOAT32_IEEE 0 PubIfControlLONC_MDL_CM_single -3.4E+38 3.4E+38 /end CHARACTERISTIC
/begin CHARACTERISTIC P_LongCtrl_VLCvelCharAxCtrlDevDeadZoneXAxis "" VAL_BLK 0x0 /* @MemoryAddress@P_LongCtrl_VLCvelCharAxCtrlDevDeadZoneXAxis@ */ Scalar_FLOAT32_IEEE 0 PubIfControlLONC_MDL_CM_single_km_h 0.0 250.0 MATRIX_DIM 1 5 1 /end CHARACTERISTIC
/begin CHARACTERISTIC P_LongCtrl_VLCvelThresUpdateTorq "" VALUE 0x0 /* @MemoryAddress@P_LongCtrl_VLCvelThresUpdateTorq@ */ Scalar_FLOAT32_IEEE 0 PubIfControlLONC_MDL_CM_single_km_h 0.0 30.0 /end CHARACTERISTIC
/begin CHARACTERISTIC P_LongCtrl_VxvRefThrd "m/s" VALUE 0x0 /* @MemoryAddress@P_LongCtrl_VxvRefThrd@ */ Scalar_FLOAT32_IEEE 0 PubIfControlLONC_MDL_CM_single -3.4E+38 3.4E+38 /end CHARACTERISTIC
/begin CHARACTERISTIC P_LongCtrl_SlideFlagEnable "" VALUE 0x0 /* @MemoryAddress@P_LongCtrl_SlideFlagEnable@ */ Scalar_BOOLEAN 0 PubIfControlLONC_MDL_CM_boolean 0 1 BIT_MASK 0x01 /end CHARACTERISTIC
/begin MEASUREMENT LongCtrl_ICEActWheelTrq "" FLOAT64_IEEE PubIfControlLONC_MDL_CM_double 0 0 -1.7E+308 1.7E+308 ECU_ADDRESS 0x0 /* @MemoryAddress@LongCtrl_ICEActWheelTrq@ */ /end MEASUREMENT
/begin MEASUREMENT LongCtrl_VLCState "" FLOAT64_IEEE PubIfControlLONC_MDL_CM_double 0 0 -1.7E+308 1.7E+308 ECU_ADDRESS 0x0 /* @MemoryAddress@LongCtrl_VLCState@ */ /end MEASUREMENT
/begin MEASUREMENT LongCtrl_tECDC "" FLOAT64_IEEE PubIfControlLONC_MDL_CM_double 0 0 -1.7E+308 1.7E+308 ECU_ADDRESS 0x0 /* @MemoryAddress@LongCtrl_tECDC@ */ /end MEASUREMENT
/begin MEASUREMENT LongCtrl_SubModel_VERSION "" ULONG PubIfControlLONC_MDL_CM_uint32 0 0 0 4294967295 ECU_ADDRESS 0x0 /* @MemoryAddress@LongCtrl_SubModel_VERSION@ */ /end MEASUREMENT
/begin MEASUREMENT LongCtrl_SubModel_Number "" ULONG PubIfControlLONC_MDL_CM_uint32 0 0 0 4294967295 ECU_ADDRESS 0x0 /* @MemoryAddress@LongCtrl_SubModel_Number@ */ /end MEASUREMENT
/begin MEASUREMENT LongCtrl_vxvRefMs "" FLOAT32_IEEE PubIfControlLONC_MDL_CM_single 0 0 -3.4E+38 3.4E+38 ECU_ADDRESS 0x0 /* @MemoryAddress@LongCtrl_vxvRefMs@ */ /end MEASUREMENT
/begin MEASUREMENT LongCtrl_axvRoadSlopeMs2 "" FLOAT32_IEEE PubIfControlLONC_MDL_CM_single 0 0 -3.4E+38 3.4E+38 ECU_ADDRESS 0x0 /* @MemoryAddress@LongCtrl_axvRoadSlopeMs2@ */ /end MEASUREMENT
/begin MEASUREMENT LongCtrl_accelHoldMin "" FLOAT32_IEEE PubIfControlLONC_MDL_CM_single 0 0 -3.4E+38 3.4E+38 ECU_ADDRESS 0x0 /* @MemoryAddress@LongCtrl_accelHoldMin@ */ /end MEASUREMENT
/begin MEASUREMENT LongCtrl_jerkHold "" FLOAT32_IEEE PubIfControlLONC_MDL_CM_single 0 0 -3.4E+38 3.4E+38 ECU_ADDRESS 0x0 /* @MemoryAddress@LongCtrl_jerkHold@ */ /end MEASUREMENT
/begin MEASUREMENT LongCtrl_accelSlidHold "" FLOAT32_IEEE PubIfControlLONC_MDL_CM_single 0 0 -3.4E+38 3.4E+38 ECU_ADDRESS 0x0 /* @MemoryAddress@LongCtrl_accelSlidHold@ */ /end MEASUREMENT
/begin MEASUREMENT LongCtrl_jerkSlidHold "" FLOAT32_IEEE PubIfControlLONC_MDL_CM_single 0 0 -3.4E+38 3.4E+38 ECU_ADDRESS 0x0 /* @MemoryAddress@LongCtrl_jerkSlidHold@ */ /end MEASUREMENT
/begin MEASUREMENT LongCtrl_OverrideToDC "" FLOAT32_IEEE PubIfControlLONC_MDL_CM_single 0 0 -3.4E+38 3.4E+38 ECU_ADDRESS 0x0 /* @MemoryAddress@LongCtrl_OverrideToDC@ */ /end MEASUREMENT
/begin MEASUREMENT Longctrl_NetEngTrq "" FLOAT32_IEEE PubIfControlLONC_MDL_CM_single 0 0 -3.4E+38 3.4E+38 ECU_ADDRESS 0x0 /* @MemoryAddress@Longctrl_NetEngTrq@ */ /end MEASUREMENT
/begin MEASUREMENT Longctrl_NetEngTorqNorm "" FLOAT32_IEEE PubIfControlLONC_MDL_CM_single 0 0 -3.4E+38 3.4E+38 ECU_ADDRESS 0x0 /* @MemoryAddress@Longctrl_NetEngTorqNorm@ */ /end MEASUREMENT
/begin MEASUREMENT Longctrl_EngSpd "" FLOAT32_IEEE PubIfControlLONC_MDL_CM_single 0 0 -3.4E+38 3.4E+38 ECU_ADDRESS 0x0 /* @MemoryAddress@Longctrl_EngSpd@ */ /end MEASUREMENT
/begin MEASUREMENT LongCtrl_Tr_Ratio "" FLOAT32_IEEE PubIfControlLONC_MDL_CM_single 0 0 -3.4E+38 3.4E+38 ECU_ADDRESS 0x0 /* @MemoryAddress@LongCtrl_Tr_Ratio@ */ /end MEASUREMENT
/begin MEASUREMENT LongCtrl_Fz "" FLOAT32_IEEE PubIfControlLONC_MDL_CM_single 0 0 -3.4E+38 3.4E+38 ECU_ADDRESS 0x0 /* @MemoryAddress@LongCtrl_Fz@ */ /end MEASUREMENT
/begin MEASUREMENT LongCtrl_ICEFzNm "" FLOAT32_IEEE PubIfControlLONC_MDL_CM_single 0 0 -3.4E+38 3.4E+38 ECU_ADDRESS 0x0 /* @MemoryAddress@LongCtrl_ICEFzNm@ */ /end MEASUREMENT
/begin MEASUREMENT Longctrl_VIE_axRefMs2 "" FLOAT32_IEEE PubIfControlLONC_MDL_CM_single 0 0 -3.4E+38 3.4E+38 ECU_ADDRESS 0x0 /* @MemoryAddress@Longctrl_VIE_axRefMs2@ */ /end MEASUREMENT
/begin MEASUREMENT Longctrl_ACC_axvCvAim "" FLOAT32_IEEE PubIfControlLONC_MDL_CM_single 0 0 -3.4E+38 3.4E+38 ECU_ADDRESS 0x0 /* @MemoryAddress@Longctrl_ACC_axvCvAim@ */ /end MEASUREMENT
/begin MEASUREMENT Longctrl_ACC_AccelerateJerk "" FLOAT32_IEEE PubIfControlLONC_MDL_CM_single 0 0 -3.4E+38 3.4E+38 ECU_ADDRESS 0x0 /* @MemoryAddress@Longctrl_ACC_AccelerateJerk@ */ /end MEASUREMENT
/begin MEASUREMENT Longctrl_ACC_DecelerateJerk "" FLOAT32_IEEE PubIfControlLONC_MDL_CM_single 0 0 -3.4E+38 3.4E+38 ECU_ADDRESS 0x0 /* @MemoryAddress@Longctrl_ACC_DecelerateJerk@ */ /end MEASUREMENT
/begin MEASUREMENT LongCtrl_axvDiff "" FLOAT32_IEEE PubIfControlLONC_MDL_CM_single 0 0 -3.4E+38 3.4E+38 ECU_ADDRESS 0x0 /* @MemoryAddress@LongCtrl_axvDiff@ */ /end MEASUREMENT
/begin MEASUREMENT LongCtrl_PI_NetEngTorqInc "" FLOAT32_IEEE PubIfControlLONC_MDL_CM_single 0 0 -3.4E+38 3.4E+38 ECU_ADDRESS 0x0 /* @MemoryAddress@LongCtrl_PI_NetEngTorqInc@ */ /end MEASUREMENT
/begin MEASUREMENT LongCtrl_axvTracActMean "" FLOAT32_IEEE PubIfControlLONC_MDL_CM_single 0 0 -3.4E+38 3.4E+38 ECU_ADDRESS 0x0 /* @MemoryAddress@LongCtrl_axvTracActMean@ */ /end MEASUREMENT
/begin MEASUREMENT LongCtrl_axvModelDiff "" FLOAT32_IEEE PubIfControlLONC_MDL_CM_single 0 0 -3.4E+38 3.4E+38 ECU_ADDRESS 0x0 /* @MemoryAddress@LongCtrl_axvModelDiff@ */ /end MEASUREMENT
/begin MEASUREMENT Longctrl_VIE_AxRefDt "" FLOAT32_IEEE PubIfControlLONC_MDL_CM_single 0 0 -3.4E+38 3.4E+38 ECU_ADDRESS 0x0 /* @MemoryAddress@Longctrl_VIE_AxRefDt@ */ /end MEASUREMENT
/begin MEASUREMENT LongCtrl_axvModelResidual "" FLOAT32_IEEE PubIfControlLONC_MDL_CM_single 0 0 -3.4E+38 3.4E+38 ECU_ADDRESS 0x0 /* @MemoryAddress@LongCtrl_axvModelResidual@ */ /end MEASUREMENT
/begin MEASUREMENT LongCtrl_axvClosedLoopControl "" FLOAT32_IEEE PubIfControlLONC_MDL_CM_single 0 0 -3.4E+38 3.4E+38 ECU_ADDRESS 0x0 /* @MemoryAddress@LongCtrl_axvClosedLoopControl@ */ /end MEASUREMENT
/begin MEASUREMENT LongCtrl_FF_NetEngTorqMax "" FLOAT32_IEEE PubIfControlLONC_MDL_CM_single__ 0 0 -3.4E+38 3.4E+38 ECU_ADDRESS 0x0 /* @MemoryAddress@LongCtrl_FF_NetEngTorqMax@ */ /end MEASUREMENT
/begin MEASUREMENT LongCtrl_FF_NetEngTorqInc "" FLOAT32_IEEE PubIfControlLONC_MDL_CM_single 0 0 -3.4E+38 3.4E+38 ECU_ADDRESS 0x0 /* @MemoryAddress@LongCtrl_FF_NetEngTorqInc@ */ /end MEASUREMENT
/begin MEASUREMENT LongCtrl_UpdateLowerValue "" FLOAT32_IEEE PubIfControlLONC_MDL_CM_single 0 0 -3.4E+38 3.4E+38 ECU_ADDRESS 0x0 /* @MemoryAddress@LongCtrl_UpdateLowerValue@ */ /end MEASUREMENT
/begin MEASUREMENT LongCtrl_UpdateUpperValue "" FLOAT32_IEEE PubIfControlLONC_MDL_CM_single 0 0 -3.4E+38 3.4E+38 ECU_ADDRESS 0x0 /* @MemoryAddress@LongCtrl_UpdateUpperValue@ */ /end MEASUREMENT
/begin MEASUREMENT LongCtrl_ACC_EngTrqReq "" FLOAT32_IEEE PubIfControlLONC_MDL_CM_single 0 0 -3.4E+38 3.4E+38 ECU_ADDRESS 0x0 /* @MemoryAddress@LongCtrl_ACC_EngTrqReq@ */ /end MEASUREMENT
/begin MEASUREMENT Longctrl_EngTqMinAct "" FLOAT32_IEEE PubIfControlLONC_MDL_CM_single 0 0 -3.4E+38 3.4E+38 ECU_ADDRESS 0x0 /* @MemoryAddress@Longctrl_EngTqMinAct@ */ /end MEASUREMENT
/begin MEASUREMENT Longctrl_ACC_axv_ComfortBandLowerValue "" FLOAT32_IEEE PubIfControlLONC_MDL_CM_single 0 0 -3.4E+38 3.4E+38 ECU_ADDRESS 0x0 /* @MemoryAddress@Longctrl_ACC_axv_ComfortBandLowerValue@ */ /end MEASUREMENT
/begin MEASUREMENT Longctrl_ACC_axv_ComfortBandUpperValue "" FLOAT32_IEEE PubIfControlLONC_MDL_CM_single 0 0 -3.4E+38 3.4E+38 ECU_ADDRESS 0x0 /* @MemoryAddress@Longctrl_ACC_axv_ComfortBandUpperValue@ */ /end MEASUREMENT
/begin MEASUREMENT LongCtrl_PI_NetEngTorq "" FLOAT32_IEEE PubIfControlLONC_MDL_CM_single 0 0 -3.4E+38 3.4E+38 ECU_ADDRESS 0x0 /* @MemoryAddress@LongCtrl_PI_NetEngTorq@ */ /end MEASUREMENT
/begin MEASUREMENT LongCtrl_FF_NetEngTorq "" FLOAT32_IEEE PubIfControlLONC_MDL_CM_single 0 0 -3.4E+38 3.4E+38 ECU_ADDRESS 0x0 /* @MemoryAddress@LongCtrl_FF_NetEngTorq@ */ /end MEASUREMENT
/begin MEASUREMENT LongCtrl_axvTracMin "" FLOAT32_IEEE PubIfControlLONC_MDL_CM_single 0 0 -3.4E+38 3.4E+38 ECU_ADDRESS 0x0 /* @MemoryAddress@LongCtrl_axvTracMin@ */ /end MEASUREMENT
/begin MEASUREMENT LongCtrl_axvModelRef "" FLOAT32_IEEE PubIfControlLONC_MDL_CM_single 0 0 -3.4E+38 3.4E+38 ECU_ADDRESS 0x0 /* @MemoryAddress@LongCtrl_axvModelRef@ */ /end MEASUREMENT
/begin MEASUREMENT Longctrl_VIE_alpSideSlipAngle "" FLOAT32_IEEE PubIfControlLONC_MDL_CM_single 0 0 -3.4E+38 3.4E+38 ECU_ADDRESS 0x0 /* @MemoryAddress@Longctrl_VIE_alpSideSlipAngle@ */ /end MEASUREMENT
/begin MEASUREMENT Longctrl_EngTqMaxActSpd "" FLOAT32_IEEE PubIfControlLONC_MDL_CM_single 0 0 -3.4E+38 3.4E+38 ECU_ADDRESS 0x0 /* @MemoryAddress@Longctrl_EngTqMaxActSpd@ */ /end MEASUREMENT
/begin MEASUREMENT Longctrl_tCycleVLC "" FLOAT32_IEEE PubIfControlLONC_MDL_CM_single 0 0 -3.4E+38 3.4E+38 ECU_ADDRESS 0x0 /* @MemoryAddress@Longctrl_tCycleVLC@ */ /end MEASUREMENT
/begin MEASUREMENT LongCtrl_tEC "" FLOAT32_IEEE PubIfControlLONC_MDL_CM_single 0 0 -3.4E+38 3.4E+38 ECU_ADDRESS 0x0 /* @MemoryAddress@LongCtrl_tEC@ */ /end MEASUREMENT
/begin MEASUREMENT LongCtrl_ACC_Decel_ReqValue "" FLOAT32_IEEE PubIfControlLONC_MDL_CM_single 0 0 -3.4E+38 3.4E+38 ECU_ADDRESS 0x0 /* @MemoryAddress@LongCtrl_ACC_Decel_ReqValue@ */ /end MEASUREMENT
/begin MEASUREMENT LongCtrl_Counter "" UBYTE PubIfControlLONC_MDL_CM_uint8 0 0 0 255 ECU_ADDRESS 0x0 /* @MemoryAddress@LongCtrl_Counter@ */ /end MEASUREMENT
/begin MEASUREMENT Longctrl_ACCSts "" UBYTE PubIfControlLONC_MDL_CM_uint8 0 0 0 255 ECU_ADDRESS 0x0 /* @MemoryAddress@Longctrl_ACCSts@ */ /end MEASUREMENT
/begin MEASUREMENT LongCtrl_RRWheelDriveDirection "" UBYTE PubIfControlLONC_MDL_CM_uint8 0 0 0 255 ECU_ADDRESS 0x0 /* @MemoryAddress@LongCtrl_RRWheelDriveDirection@ */ /end MEASUREMENT
/begin MEASUREMENT LongCtrl_RLWheelDriveDirection "" UBYTE PubIfControlLONC_MDL_CM_uint8 0 0 0 255 ECU_ADDRESS 0x0 /* @MemoryAddress@LongCtrl_RLWheelDriveDirection@ */ /end MEASUREMENT
/begin MEASUREMENT LongCtrl_FRWheelDriveDirection "" UBYTE PubIfControlLONC_MDL_CM_uint8 0 0 0 255 ECU_ADDRESS 0x0 /* @MemoryAddress@LongCtrl_FRWheelDriveDirection@ */ /end MEASUREMENT
/begin MEASUREMENT LongCtrl_FLWheelDriveDirection "" UBYTE PubIfControlLONC_MDL_CM_uint8 0 0 0 255 ECU_ADDRESS 0x0 /* @MemoryAddress@LongCtrl_FLWheelDriveDirection@ */ /end MEASUREMENT
/begin MEASUREMENT Longctrl_CurrentGear "" UBYTE PubIfControlLONC_MDL_CM_uint8 0 0 0 255 ECU_ADDRESS 0x0 /* @MemoryAddress@Longctrl_CurrentGear@ */ /end MEASUREMENT
/begin MEASUREMENT Longctrl_VehicleStandStill "" UBYTE PubIfControlLONC_MDL_CM_boolean 0 0 0 1 ECU_ADDRESS 0x0 /* @MemoryAddress@Longctrl_VehicleStandStill@ */ BIT_MASK 0x01 /end MEASUREMENT
/begin MEASUREMENT LongCtrl_Sw2EC "" UBYTE PubIfControlLONC_MDL_CM_boolean 0 0 0 1 ECU_ADDRESS 0x0 /* @MemoryAddress@LongCtrl_Sw2EC@ */ BIT_MASK 0x01 /end MEASUREMENT
/begin MEASUREMENT LongCtrl_Sw2DC "" UBYTE PubIfControlLONC_MDL_CM_boolean 0 0 0 1 ECU_ADDRESS 0x0 /* @MemoryAddress@LongCtrl_Sw2DC@ */ BIT_MASK 0x01 /end MEASUREMENT
/begin MEASUREMENT LongCtrl_ForwardFlagVxv "" UBYTE PubIfControlLONC_MDL_CM_boolean 0 0 0 1 ECU_ADDRESS 0x0 /* @MemoryAddress@LongCtrl_ForwardFlagVxv@ */ BIT_MASK 0x01 /end MEASUREMENT
/begin MEASUREMENT LongCtrl_ForwardFlagTrq "" UBYTE PubIfControlLONC_MDL_CM_boolean 0 0 0 1 ECU_ADDRESS 0x0 /* @MemoryAddress@LongCtrl_ForwardFlagTrq@ */ BIT_MASK 0x01 /end MEASUREMENT
/begin MEASUREMENT LongCtrl_SlideFlag "" UBYTE PubIfControlLONC_MDL_CM_boolean 0 0 0 1 ECU_ADDRESS 0x0 /* @MemoryAddress@LongCtrl_SlideFlag@ */ BIT_MASK 0x01 /end MEASUREMENT
/begin MEASUREMENT LongCtrl_VLC_DriveOffConditonFulfilled "" UBYTE PubIfControlLONC_MDL_CM_boolean 0 0 0 1 ECU_ADDRESS 0x0 /* @MemoryAddress@LongCtrl_VLC_DriveOffConditonFulfilled@ */ BIT_MASK 0x01 /end MEASUREMENT
/begin MEASUREMENT Longctrl_ACC_DrvOFF_Req "" UBYTE PubIfControlLONC_MDL_CM_boolean 0 0 0 1 ECU_ADDRESS 0x0 /* @MemoryAddress@Longctrl_ACC_DrvOFF_Req@ */ BIT_MASK 0x01 /end MEASUREMENT
/begin MEASUREMENT Longctrl_ShiftinProgress "" UBYTE PubIfControlLONC_MDL_CM_boolean 0 0 0 1 ECU_ADDRESS 0x0 /* @MemoryAddress@Longctrl_ShiftinProgress@ */ BIT_MASK 0x01 /end MEASUREMENT
/begin MEASUREMENT Longctrl_NoBrakeForce "" UBYTE PubIfControlLONC_MDL_CM_boolean 0 0 0 1 ECU_ADDRESS 0x0 /* @MemoryAddress@Longctrl_NoBrakeForce@ */ BIT_MASK 0x01 /end MEASUREMENT
/begin MEASUREMENT LongCtrl_UpdateEnable_axvModeldiff "" UBYTE PubIfControlLONC_MDL_CM_boolean 0 0 0 1 ECU_ADDRESS 0x0 /* @MemoryAddress@LongCtrl_UpdateEnable_axvModeldiff@ */ BIT_MASK 0x01 /end MEASUREMENT
/begin MEASUREMENT Longctrl_ACC_BrakePrefer "" UBYTE PubIfControlLONC_MDL_CM_boolean 0 0 0 1 ECU_ADDRESS 0x0 /* @MemoryAddress@Longctrl_ACC_BrakePrefer@ */ BIT_MASK 0x01 /end MEASUREMENT
/begin MEASUREMENT Longctrl_ACC_DecelToStopReq "" UBYTE PubIfControlLONC_MDL_CM_boolean 0 0 0 1 ECU_ADDRESS 0x0 /* @MemoryAddress@Longctrl_ACC_DecelToStopReq@ */ BIT_MASK 0x01 /end MEASUREMENT
/begin MEASUREMENT LongCtrl_Sw2DC6 "" UBYTE PubIfControlLONC_MDL_CM_boolean 0 0 0 1 ECU_ADDRESS 0x0 /* @MemoryAddress@LongCtrl_Sw2DC6@ */ BIT_MASK 0x01 /end MEASUREMENT
/begin MEASUREMENT LongCtrl_Sw2DC1 "" UBYTE PubIfControlLONC_MDL_CM_boolean 0 0 0 1 ECU_ADDRESS 0x0 /* @MemoryAddress@LongCtrl_Sw2DC1@ */ BIT_MASK 0x01 /end MEASUREMENT
/begin MEASUREMENT LongCtrl_Sw2DC3 "" UBYTE PubIfControlLONC_MDL_CM_boolean 0 0 0 1 ECU_ADDRESS 0x0 /* @MemoryAddress@LongCtrl_Sw2DC3@ */ BIT_MASK 0x01 /end MEASUREMENT
/begin MEASUREMENT LongCtrl_Sw2DC5 "" UBYTE PubIfControlLONC_MDL_CM_boolean 0 0 0 1 ECU_ADDRESS 0x0 /* @MemoryAddress@LongCtrl_Sw2DC5@ */ BIT_MASK 0x01 /end MEASUREMENT
/begin MEASUREMENT LongCtrl_Sw2DC7 "" UBYTE PubIfControlLONC_MDL_CM_boolean 0 0 0 1 ECU_ADDRESS 0x0 /* @MemoryAddress@LongCtrl_Sw2DC7@ */ BIT_MASK 0x01 /end MEASUREMENT
/begin MEASUREMENT LongCtrl_Sw2DC2 "" UBYTE PubIfControlLONC_MDL_CM_boolean 0 0 0 1 ECU_ADDRESS 0x0 /* @MemoryAddress@LongCtrl_Sw2DC2@ */ BIT_MASK 0x01 /end MEASUREMENT
/begin MEASUREMENT LongCtrl_Sw2DC4 "" UBYTE PubIfControlLONC_MDL_CM_boolean 0 0 0 1 ECU_ADDRESS 0x0 /* @MemoryAddress@LongCtrl_Sw2DC4@ */ BIT_MASK 0x01 /end MEASUREMENT
/begin MEASUREMENT LongCtrl_Sw2EC1 "" UBYTE PubIfControlLONC_MDL_CM_boolean 0 0 0 1 ECU_ADDRESS 0x0 /* @MemoryAddress@LongCtrl_Sw2EC1@ */ BIT_MASK 0x01 /end MEASUREMENT
/begin MEASUREMENT LongCtrl_Sw2EC3 "" UBYTE PubIfControlLONC_MDL_CM_boolean 0 0 0 1 ECU_ADDRESS 0x0 /* @MemoryAddress@LongCtrl_Sw2EC3@ */ BIT_MASK 0x01 /end MEASUREMENT
/begin MEASUREMENT LongCtrl_Sw2EC2 "" UBYTE PubIfControlLONC_MDL_CM_boolean 0 0 0 1 ECU_ADDRESS 0x0 /* @MemoryAddress@LongCtrl_Sw2EC2@ */ BIT_MASK 0x01 /end MEASUREMENT
/begin MEASUREMENT LongCtrl_Sw2EC5 "" UBYTE PubIfControlLONC_MDL_CM_boolean 0 0 0 1 ECU_ADDRESS 0x0 /* @MemoryAddress@LongCtrl_Sw2EC5@ */ BIT_MASK 0x01 /end MEASUREMENT
/begin MEASUREMENT LongCtrl_Sw2EC4 "" UBYTE PubIfControlLONC_MDL_CM_boolean 0 0 0 1 ECU_ADDRESS 0x0 /* @MemoryAddress@LongCtrl_Sw2EC4@ */ BIT_MASK 0x01 /end MEASUREMENT
/begin MEASUREMENT LongCtrl_ECEnable "" UBYTE PubIfControlLONC_MDL_CM_boolean 0 0 0 1 ECU_ADDRESS 0x0 /* @MemoryAddress@LongCtrl_ECEnable@ */ BIT_MASK 0x01 /end MEASUREMENT
/begin MEASUREMENT LongCtrl_DCEnable "" UBYTE PubIfControlLONC_MDL_CM_boolean 0 0 0 1 ECU_ADDRESS 0x0 /* @MemoryAddress@LongCtrl_DCEnable@ */ BIT_MASK 0x01 /end MEASUREMENT
/begin COMPU_METHOD PubIfControlLONC_MDL_CM_single "Q = V" RAT_FUNC "%8.6" "" COEFFS 0 1 0 0 0 1 /end COMPU_METHOD
/begin COMPU_METHOD PubIfControlLONC_MDL_CM_single_m_s_2 "Q = V" RAT_FUNC "%8.6" "m/s^2" COEFFS 0 1 0 0 0 1 /end COMPU_METHOD
/begin COMPU_METHOD PubIfControlLONC_MDL_CM_single_m_s_3 "Q = V" RAT_FUNC "%8.6" "m/s^3" COEFFS 0 1 0 0 0 1 /end COMPU_METHOD
/begin COMPU_METHOD PubIfControlLONC_MDL_CM_single_km_h "Q = V" RAT_FUNC "%8.6" "km/h" COEFFS 0 1 0 0 0 1 /end COMPU_METHOD
/begin COMPU_METHOD PubIfControlLONC_MDL_CM_single__ "Q = V" RAT_FUNC "%8.6" "%" COEFFS 0 1 0 0 0 1 /end COMPU_METHOD
/begin COMPU_METHOD PubIfControlLONC_MDL_CM_single_m_s "Q = V" RAT_FUNC "%8.6" "m/s" COEFFS 0 1 0 0 0 1 /end COMPU_METHOD
/begin COMPU_METHOD PubIfControlLONC_MDL_CM_single_m "Q = V" RAT_FUNC "%8.6" "m" COEFFS 0 1 0 0 0 1 /end COMPU_METHOD
/begin COMPU_METHOD PubIfControlLONC_MDL_CM_single_N "Q = V" RAT_FUNC "%8.6" "N" COEFFS 0 1 0 0 0 1 /end COMPU_METHOD
/begin COMPU_METHOD PubIfControlLONC_MDL_CM_single_m_2 "Q = V" RAT_FUNC "%8.6" "m^2" COEFFS 0 1 0 0 0 1 /end COMPU_METHOD
/begin COMPU_METHOD PubIfControlLONC_MDL_CM_boolean "Q = V" RAT_FUNC "%1.0" "" COEFFS 0 1 0 0 0 1 /end COMPU_METHOD
/begin COMPU_METHOD PubIfControlLONC_MDL_CM_double "Q = V" RAT_FUNC "%15.10" "" COEFFS 0 1 0 0 0 1 /end COMPU_METHOD
/begin COMPU_METHOD PubIfControlLONC_MDL_CM_uint32 "Q = V" RAT_FUNC "%10.0" "" COEFFS 0 1 0 0 0 1 /end COMPU_METHOD
/begin COMPU_METHOD PubIfControlLONC_MDL_CM_uint8 "Q = V" RAT_FUNC "%3.0" "" COEFFS 0 1 0 0 0 1 /end COMPU_METHOD
/begin GROUP PubIfControlLONC_MDL "PubIfControlLONC_MDL" /* Root */ ROOT /begin SUB_GROUP Root_Subsystem /end SUB_GROUP /end GROUP
/begin GROUP Root_Subsystem "PubIfControlLONC_MDL/Subsystem" /begin SUB_GROUP S1_VLC /end SUB_GROUP
 /begin REF_MEASUREMENT LongCtrl_Counter LongCtrl_SubModel_Number LongCtrl_SubModel_VERSION /end REF_MEASUREMENT
/end GROUP
/begin GROUP S1_VLC "PubIfControlLONC_MDL/Subsystem/VLC" /begin SUB_GROUP S3_Vlc /end SUB_GROUP /end GROUP
/begin GROUP S3_Vlc "PubIfControlLONC_MDL/Subsystem/VLC/Vlc"
 /begin SUB_GROUP S6_DC S6_EC S6_FF_Control S6_PI_Control S6_SlidJudge S6_SwitchToBrakeMode S6_SwitchToDriveMode S6_UpdateFlagCalc S6_axvClosedLoopControlCalc S6_axvModelResidualCalc S6_axvTracActMean_calc S6_axvTracMin_calc /end SUB_GROUP
 /begin REF_CHARACTERISTIC P_Global_TireRadius_m P_LongCtrl_VLCMaRatioCharMaYAxis P_LongCtrl_VLCTrRatioCharMaXAxis P_LongCtrl_VLCTrTatioMax P_LongCtrl_VLCTrTatioMin P_LongCtrl_VLCaXCDeadZoneProp_Y P_LongCtrl_VLCaxCtrlDevDeadZoneChar_Y P_LongCtrl_VLCaxCtrlDevEC2DCMax P_LongCtrl_VLCaxCtrlDevFastQuitDCMode P_LongCtrl_VLCaxCtrlDevThresAddEC2DCCharYAxis P_LongCtrl_VLCaxCtrlDevTresAddDC2ECYAxis P_LongCtrl_VLCcoefKiEnlargeADiffYAxis P_LongCtrl_VLCdaxTarEC2DCMax P_LongCtrl_VLCdriveOffAxUpLimXAxix P_LongCtrl_VLCdriveOffAxUpLimYAxix P_LongCtrl_VLCki P_LongCtrl_VLCkp P_LongCtrl_VLCks /end REF_CHARACTERISTIC
 /begin REF_MEASUREMENT LongCtrl_DCEnable LongCtrl_ECEnable LongCtrl_FF_NetEngTorq LongCtrl_FLWheelDriveDirection LongCtrl_FRWheelDriveDirection LongCtrl_OverrideToDC LongCtrl_PI_NetEngTorq LongCtrl_RLWheelDriveDirection LongCtrl_RRWheelDriveDirection LongCtrl_Sw2DC LongCtrl_Sw2EC LongCtrl_Tr_Ratio LongCtrl_VLCState LongCtrl_VLC_DriveOffConditonFulfilled LongCtrl_axvRoadSlopeMs2 LongCtrl_tEC LongCtrl_tECDC LongCtrl_vxvRefMs Longctrl_ACCSts Longctrl_ACC_AccelerateJerk Longctrl_ACC_BrakePrefer Longctrl_ACC_DecelToStopReq Longctrl_ACC_DecelerateJerk Longctrl_ACC_DrvOFF_Req Longctrl_ACC_axvCvAim Longctrl_ACC_axv_ComfortBandLowerValue Longctrl_ACC_axv_ComfortBandUpperValue Longctrl_CurrentGear Longctrl_EngSpd Longctrl_EngTqMaxActSpd Longctrl_EngTqMinAct Longctrl_NetEngTorqNorm Longctrl_NetEngTrq Longctrl_NoBrakeForce Longctrl_ShiftinProgress Longctrl_VIE_AxRefDt Longctrl_VIE_alpSideSlipAngle Longctrl_VIE_axRefMs2 Longctrl_VehicleStandStill Longctrl_tCycleVLC /end REF_MEASUREMENT
/end GROUP
/begin GROUP S6_DC "PubIfControlLONC_MDL/Subsystem/VLC/Vlc/DC"
 /begin REF_CHARACTERISTIC P_LongCtrl_VLCaccelMinHoldXAxis P_LongCtrl_VLCaccelMinHoldYAxis P_LongCtrl_VLCaccelMinSlidHoldXAxis P_LongCtrl_VLCaccelMinSlidHoldYAxis P_LongCtrl_VLCjerkHoldXAxis P_LongCtrl_VLCjerkHoldYAxis P_LongCtrl_VLCjerkSlidHoldXAxis P_LongCtrl_VLCjerkSlidHoldYAxis /end REF_CHARACTERISTIC
 /begin REF_MEASUREMENT LongCtrl_ACC_Decel_ReqValue LongCtrl_accelHoldMin LongCtrl_accelSlidHold LongCtrl_jerkHold LongCtrl_jerkSlidHold /end REF_MEASUREMENT
/end GROUP
/begin GROUP S6_EC "PubIfControlLONC_MDL/Subsystem/VLC/Vlc/EC"
 /begin REF_CHARACTERISTIC P_Global_TireRadius_m P_Global_Weight_N P_LongCtrl_VLCCounterDC2ECTorqDelay P_LongCtrl_VLCCounterDrvOff2EC P_LongCtrl_VLCLowerJerkCounterDrvOff2EC P_LongCtrl_VLCUpperJerkCounterDrvOff2EC P_LongCtrl_VLCcoefPIYAxis P_LongCtrl_VLCvelCharCoefPIXAxis /end REF_CHARACTERISTIC
 /begin REF_MEASUREMENT LongCtrl_ACC_EngTrqReq LongCtrl_UpdateLowerValue LongCtrl_UpdateUpperValue /end REF_MEASUREMENT
/end GROUP
/begin GROUP S6_FF_Control "PubIfControlLONC_MDL/Subsystem/VLC/Vlc/FF_Control"
 /begin REF_CHARACTERISTIC P_Global_TireRadius_m P_Global_Weight_N P_LongCtrl_VLCengInverseEfficientYAxis P_LongCtrl_VLCtorqCharEngInverseEfficientXAxis /end REF_CHARACTERISTIC
 /begin REF_MEASUREMENT LongCtrl_FF_NetEngTorqInc LongCtrl_FF_NetEngTorqMax /end REF_MEASUREMENT
/end GROUP
/begin GROUP S6_PI_Control "PubIfControlLONC_MDL/Subsystem/VLC/Vlc/PI_Control"
 /begin REF_CHARACTERISTIC P_Global_TireRadius_m P_LongCtrl_VLCAxTarDtThreEnableI P_LongCtrl_VLCIACompensionNeg P_LongCtrl_VLCIACompensionPos P_LongCtrl_VLCaDiffCharCoefKiEnableXAxis P_LongCtrl_VLCaDiffCharCoefKiXAxis P_LongCtrl_VLCcoefIFadeOut1Calc P_LongCtrl_VLCcoefIFadeOut1Condition P_LongCtrl_VLCcoefIFadeOut2Calc P_LongCtrl_VLCcoefIFadeOut2Condition P_LongCtrl_VLCcoefIFadeOut3Calc P_LongCtrl_VLCcoefIFadeOut3Condition P_LongCtrl_VLCcoefKiDiffDtEnlargeYAxis P_LongCtrl_VLCcoefKiEnableYAxis P_LongCtrl_VLCdiffDtCharCoefKiEnlargeXAxis P_LongCtrl_VLCvelCharAxCtrlDevDeadZoneXAxis /end REF_CHARACTERISTIC
 /begin REF_MEASUREMENT LongCtrl_PI_NetEngTorqInc /end REF_MEASUREMENT
/end GROUP
/begin GROUP S6_SlidJudge "PubIfControlLONC_MDL/Subsystem/VLC/Vlc/SlidJudge"
 /begin REF_CHARACTERISTIC P_Global_TireRadius_m P_LongCtrl_AxvRoadSlopeThrd P_LongCtrl_SlideFlagEnable P_LongCtrl_TotWheelTrqRatio P_LongCtrl_VxvRefThrd /end REF_CHARACTERISTIC
 /begin REF_MEASUREMENT LongCtrl_ForwardFlagTrq LongCtrl_ForwardFlagVxv LongCtrl_ICEActWheelTrq LongCtrl_ICEFzNm LongCtrl_SlideFlag /end REF_MEASUREMENT
/end GROUP
/begin GROUP S6_SwitchToBrakeMode "PubIfControlLONC_MDL/Subsystem/VLC/Vlc/SwitchToBrakeMode"
 /begin REF_CHARACTERISTIC P_LongCtrl_VLCAxvTracMinDC1FullFillXAxis P_LongCtrl_VLCAxvTracMinDC1FullFillYAxis P_LongCtrl_VLCCounterAxvTracMinTimeout P_LongCtrl_VLCDtAxvRef2UpperBandDC5 P_LongCtrl_VLCTorqDiffThreAxvTracMinTimeout P_LongCtrl_VLCVlcAccThresAxvTracMinTimeout P_LongCtrl_VLCaxDtCharAxCtrlDevTresAddEC2DCXAxis P_LongCtrl_VLCaxvRoadSlopeDC4CharXAxis P_LongCtrl_VLCaxvRoadSlopeDC4CharYAxis /end REF_CHARACTERISTIC
 /begin REF_MEASUREMENT LongCtrl_Sw2DC1 LongCtrl_Sw2DC2 LongCtrl_Sw2DC3 LongCtrl_Sw2DC4 LongCtrl_Sw2DC5 LongCtrl_Sw2DC6 LongCtrl_Sw2DC7 /end REF_MEASUREMENT
/end GROUP
/begin GROUP S6_SwitchToDriveMode "PubIfControlLONC_MDL/Subsystem/VLC/Vlc/SwitchToDriveMode" /begin REF_CHARACTERISTIC P_LongCtrl_VLCaxDtCharAxCtrlDevTresAddDC2ECXAxis /end REF_CHARACTERISTIC
 /begin REF_MEASUREMENT LongCtrl_Sw2EC1 LongCtrl_Sw2EC2 LongCtrl_Sw2EC3 LongCtrl_Sw2EC4 LongCtrl_Sw2EC5 /end REF_MEASUREMENT
/end GROUP
/begin GROUP S6_UpdateFlagCalc "PubIfControlLONC_MDL/Subsystem/VLC/Vlc/UpdateFlagCalc"
 /begin REF_CHARACTERISTIC P_LongCtrl_VLCaDtThresUpdateTorq P_LongCtrl_VLCvelThresUpdateTorq /end REF_CHARACTERISTIC
 /begin REF_MEASUREMENT LongCtrl_UpdateEnable_axvModeldiff /end REF_MEASUREMENT
/end GROUP
/begin GROUP S6_axvClosedLoopControlCalc "PubIfControlLONC_MDL/Subsystem/VLC/Vlc/axvClosedLoopControlCalc" /begin REF_MEASUREMENT LongCtrl_axvClosedLoopControl LongCtrl_axvDiff /end REF_MEASUREMENT /end GROUP
/begin GROUP S6_axvModelResidualCalc "PubIfControlLONC_MDL/Subsystem/VLC/Vlc/axvModelResidualCalc"
 /begin REF_MEASUREMENT LongCtrl_axvModelDiff LongCtrl_axvModelRef LongCtrl_axvModelResidual /end REF_MEASUREMENT
/end GROUP
/begin GROUP S6_axvTracActMean_calc "PubIfControlLONC_MDL/Subsystem/VLC/Vlc/axvTracActMean_calc"
 /begin REF_CHARACTERISTIC P_Global_TireRadius_m P_Global_Weight_N P_LongCtrl_VLC_WindArea P_LongCtrl_VLC_fRollCoef P_LongCtrl_VLCcoefFXAxis P_LongCtrl_VLCcoefFYAxis P_LongCtrl_VLCengEfficientCharYAxis P_LongCtrl_VLCtorqCharEngEfficientXAxis /end REF_CHARACTERISTIC
 /begin REF_MEASUREMENT LongCtrl_Fz LongCtrl_axvTracActMean /end REF_MEASUREMENT
/end GROUP
/begin GROUP S6_axvTracMin_calc "PubIfControlLONC_MDL/Subsystem/VLC/Vlc/axvTracMin_calc"
 /begin REF_CHARACTERISTIC P_Global_TireRadius_m P_Global_Weight_N P_LongCtrl_VLC_WindArea P_LongCtrl_VLC_fRollCoef P_LongCtrl_VLCcoefFXAxis P_LongCtrl_VLCcoefFYAxis P_LongCtrl_VLCengEfficientCharYAxis P_LongCtrl_VLCtorqCharEngEfficientXAxis /end REF_CHARACTERISTIC
 /begin REF_MEASUREMENT LongCtrl_axvTracMin /end REF_MEASUREMENT
/end GROUP
/end MODULE
/end PROJECT
/* EOF PubIfControlLONC_MDL.a2l*/
