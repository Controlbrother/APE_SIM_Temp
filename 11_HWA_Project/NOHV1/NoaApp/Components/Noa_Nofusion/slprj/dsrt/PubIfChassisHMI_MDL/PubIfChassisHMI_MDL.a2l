/*
* ASAP2 file: PubIfChassisHMI_MDL.a2l
* Copyright 2022, dSPACE GmbH. All rights reserved.
*/ ASAP2_VERSION 1 61
/* Version 1.61 */
/begin PROJECT PubIfChassisHMI_MDL ""
/begin HEADER "" VERSION "3.97" PROJECT_NO PubIfChassisHMI_MDL /end HEADER
/begin MODULE PubIfChassisHMI_MDL ""
/begin RECORD_LAYOUT Scalar_BOOLEAN FNC_VALUES 1 UBYTE ROW_DIR DIRECT /end RECORD_LAYOUT
/begin RECORD_LAYOUT Scalar_UBYTE FNC_VALUES 1 UBYTE ROW_DIR DIRECT /end RECORD_LAYOUT
/begin RECORD_LAYOUT Scalar_BYTE FNC_VALUES 1 SBYTE ROW_DIR DIRECT /end RECORD_LAYOUT
/begin RECORD_LAYOUT Scalar_UWORD FNC_VALUES 1 UWORD ROW_DIR DIRECT /end RECORD_LAYOUT
/begin RECORD_LAYOUT Scalar_SWORD FNC_VALUES 1 SWORD ROW_DIR DIRECT /end RECORD_LAYOUT
/begin RECORD_LAYOUT Scalar_ULONG FNC_VALUES 1 ULONG ROW_DIR DIRECT /end RECORD_LAYOUT
/begin RECORD_LAYOUT Scalar_LONG FNC_VALUES 1 SLONG ROW_DIR DIRECT /end RECORD_LAYOUT
/begin RECORD_LAYOUT Scalar_FLOAT32_IEEE FNC_VALUES 1 FLOAT32_IEEE ROW_DIR DIRECT /end RECORD_LAYOUT
/begin RECORD_LAYOUT Scalar_FLOAT64_IEEE FNC_VALUES 1 FLOAT64_IEEE ROW_DIR DIRECT /end RECORD_LAYOUT
/begin RECORD_LAYOUT Lookup1D_BOOLEAN FNC_VALUES 1 UBYTE ROW_DIR DIRECT /end RECORD_LAYOUT
/begin RECORD_LAYOUT Lookup1D_BYTE FNC_VALUES 1 SBYTE ROW_DIR DIRECT /end RECORD_LAYOUT
/begin RECORD_LAYOUT Lookup1D_UBYTE FNC_VALUES 1 UBYTE ROW_DIR DIRECT /end RECORD_LAYOUT
/begin RECORD_LAYOUT Lookup1D_UWORD FNC_VALUES 1 UWORD ROW_DIR DIRECT /end RECORD_LAYOUT
/begin RECORD_LAYOUT Lookup1D_WORD FNC_VALUES 1 SWORD ROW_DIR DIRECT /end RECORD_LAYOUT
/begin RECORD_LAYOUT Lookup1D_ULONG FNC_VALUES 1 ULONG ROW_DIR DIRECT /end RECORD_LAYOUT
/begin RECORD_LAYOUT Lookup1D_LONG FNC_VALUES 1 SLONG ROW_DIR DIRECT /end RECORD_LAYOUT
/begin RECORD_LAYOUT Lookup1D_FLOAT32_IEEE FNC_VALUES 1 FLOAT32_IEEE ROW_DIR DIRECT /end RECORD_LAYOUT
/begin RECORD_LAYOUT Lookup1D_FLOAT64_IEEE FNC_VALUES 1 FLOAT64_IEEE ROW_DIR DIRECT /end RECORD_LAYOUT
/begin RECORD_LAYOUT Lookup1D_X_BOOLEAN AXIS_PTS_X 1 UBYTE INDEX_INCR DIRECT /end RECORD_LAYOUT
/begin RECORD_LAYOUT Lookup1D_X_BYTE AXIS_PTS_X 1 SBYTE INDEX_INCR DIRECT /end RECORD_LAYOUT
/begin RECORD_LAYOUT Lookup1D_X_UBYTE AXIS_PTS_X 1 UBYTE INDEX_INCR DIRECT /end RECORD_LAYOUT
/begin RECORD_LAYOUT Lookup1D_X_UWORD AXIS_PTS_X 1 UWORD INDEX_INCR DIRECT /end RECORD_LAYOUT
/begin RECORD_LAYOUT Lookup1D_X_WORD AXIS_PTS_X 1 SWORD INDEX_INCR DIRECT /end RECORD_LAYOUT
/begin RECORD_LAYOUT Lookup1D_X_ULONG AXIS_PTS_X 1 ULONG INDEX_INCR DIRECT /end RECORD_LAYOUT
/begin RECORD_LAYOUT Lookup1D_X_LONG AXIS_PTS_X 1 SLONG INDEX_INCR DIRECT /end RECORD_LAYOUT
/begin RECORD_LAYOUT Lookup1D_X_FLOAT32_IEEE AXIS_PTS_X 1 FLOAT32_IEEE INDEX_INCR DIRECT /end RECORD_LAYOUT
/begin RECORD_LAYOUT Lookup1D_X_FLOAT64_IEEE AXIS_PTS_X 1 FLOAT64_IEEE INDEX_INCR DIRECT /end RECORD_LAYOUT
/begin RECORD_LAYOUT Lookup2D_BOOLEAN FNC_VALUES 1 UBYTE ROW_DIR DIRECT /end RECORD_LAYOUT
/begin RECORD_LAYOUT Lookup2D_UBYTE FNC_VALUES 1 UBYTE ROW_DIR DIRECT /end RECORD_LAYOUT
/begin RECORD_LAYOUT Lookup2D_BYTE FNC_VALUES 1 SBYTE ROW_DIR DIRECT /end RECORD_LAYOUT
/begin RECORD_LAYOUT Lookup2D_UWORD FNC_VALUES 1 UWORD ROW_DIR DIRECT /end RECORD_LAYOUT
/begin RECORD_LAYOUT Lookup2D_WORD FNC_VALUES 1 SWORD ROW_DIR DIRECT /end RECORD_LAYOUT
/begin RECORD_LAYOUT Lookup2D_ULONG FNC_VALUES 1 ULONG ROW_DIR DIRECT /end RECORD_LAYOUT
/begin RECORD_LAYOUT Lookup2D_LONG FNC_VALUES 1 SLONG ROW_DIR DIRECT /end RECORD_LAYOUT
/begin RECORD_LAYOUT Lookup2D_FLOAT32_IEEE FNC_VALUES 1 FLOAT32_IEEE ROW_DIR DIRECT /end RECORD_LAYOUT
/begin RECORD_LAYOUT Lookup2D_FLOAT64_IEEE FNC_VALUES 1 FLOAT64_IEEE ROW_DIR DIRECT /end RECORD_LAYOUT
/begin RECORD_LAYOUT Lookup2D_X_BOOLEAN AXIS_PTS_X 1 UBYTE INDEX_INCR DIRECT /end RECORD_LAYOUT
/begin RECORD_LAYOUT Lookup2D_X_UBYTE AXIS_PTS_X 1 UBYTE INDEX_INCR DIRECT /end RECORD_LAYOUT
/begin RECORD_LAYOUT Lookup2D_X_BYTE AXIS_PTS_X 1 SBYTE INDEX_INCR DIRECT /end RECORD_LAYOUT
/begin RECORD_LAYOUT Lookup2D_X_UWORD AXIS_PTS_X 1 UWORD INDEX_INCR DIRECT /end RECORD_LAYOUT
/begin RECORD_LAYOUT Lookup2D_X_WORD AXIS_PTS_X 1 SWORD INDEX_INCR DIRECT /end RECORD_LAYOUT
/begin RECORD_LAYOUT Lookup2D_X_ULONG AXIS_PTS_X 1 ULONG INDEX_INCR DIRECT /end RECORD_LAYOUT
/begin RECORD_LAYOUT Lookup2D_X_LONG AXIS_PTS_X 1 SLONG INDEX_INCR DIRECT /end RECORD_LAYOUT
/begin RECORD_LAYOUT Lookup2D_X_FLOAT32_IEEE AXIS_PTS_X 1 FLOAT32_IEEE INDEX_INCR DIRECT /end RECORD_LAYOUT
/begin RECORD_LAYOUT Lookup2D_X_FLOAT64_IEEE AXIS_PTS_X 1 FLOAT64_IEEE INDEX_INCR DIRECT /end RECORD_LAYOUT
/begin CHARACTERISTIC P_HMI_LDW_LKAWarnTime /* Long Identifier */ "" /* Type */ VALUE /* ECU Address */ 0x0 /* @MemoryAddress@P_HMI_LDW_LKAWarnTime@ */ /* Record Layout */ Scalar_FLOAT32_IEEE /* Maximum Difference */ 0 PubIfChassisHMI_MDL_CM_single -3.4E+38 3.4E+38 /end CHARACTERISTIC
/begin CHARACTERISTIC P_HMI_ObjectTypeFilter /* Long Identifier */ "" /* Type */ VALUE /* ECU Address */ 0x0 /* @MemoryAddress@P_HMI_ObjectTypeFilter@ */ /* Record Layout */ Scalar_FLOAT32_IEEE /* Maximum Difference */ 0 PubIfChassisHMI_MDL_CM_single -3.4E+38 3.4E+38 /end CHARACTERISTIC
/begin MEASUREMENT HMI_Counter "" /* Data type */ UBYTE PubIfChassisHMI_MDL_CM_uint8 /* Resolution (Not used) */ 0 /* Accuracy (Not used) */ 0 0 255 /* Address */ ECU_ADDRESS 0x0 /* @MemoryAddress@HMI_Counter@ */ /end MEASUREMENT
/begin COMPU_METHOD /* Name of CompuMethod */ PubIfChassisHMI_MDL_CM_single "Q = V" /* Conversion Type */ RAT_FUNC /* Format */ "%8.6" /* Units */ "" /* Coefficients */ COEFFS 0 1 0 0 0 1 /end COMPU_METHOD
/begin COMPU_METHOD /* Name of CompuMethod */ PubIfChassisHMI_MDL_CM_uint8 "Q = V" /* Conversion Type */ RAT_FUNC /* Format */ "%3.0" /* Units */ "" /* Coefficients */ COEFFS 0 1 0 0 0 1 /end COMPU_METHOD
/begin GROUP PubIfChassisHMI_MDL "PubIfChassisHMI_MDL" /* Root */ ROOT /begin SUB_GROUP Root_Subsystem /end SUB_GROUP /end GROUP
/begin GROUP Root_Subsystem "PubIfChassisHMI_MDL/Subsystem" /begin SUB_GROUP S1_HMI2_12 /end SUB_GROUP /begin REF_MEASUREMENT HMI_Counter /end REF_MEASUREMENT /end GROUP
/begin GROUP S1_HMI2_12 "PubIfChassisHMI_MDL/Subsystem/HMI2.12" /begin SUB_GROUP S3_HWA__ACC__TJA_Signal1 S3_IFC_Signal1 /end SUB_GROUP /end GROUP
/begin GROUP S3_HWA__ACC__TJA_Signal1 "PubIfChassisHMI_MDL/Subsystem/HMI2.12/HWA//ACC//TJA_Signal1"
 /begin SUB_GROUP S7_Subsystem S7_Subsystem1 S7_Subsystem2 S7_Subsystem3 S7_Subsystem4 S7_Subsystem5 /end SUB_GROUP
/end GROUP
/begin GROUP S3_IFC_Signal1 "PubIfChassisHMI_MDL/Subsystem/HMI2.12/IFC_Signal1" /begin REF_CHARACTERISTIC P_HMI_LDW_LKAWarnTime /end REF_CHARACTERISTIC /end GROUP
/begin GROUP S7_Subsystem "PubIfChassisHMI_MDL/Subsystem/HMI2.12/HWA//ACC//TJA_Signal1/Subsystem" /begin REF_CHARACTERISTIC P_HMI_ObjectTypeFilter /end REF_CHARACTERISTIC /end GROUP
/begin GROUP S7_Subsystem1 "PubIfChassisHMI_MDL/Subsystem/HMI2.12/HWA//ACC//TJA_Signal1/Subsystem1" /begin REF_CHARACTERISTIC P_HMI_ObjectTypeFilter /end REF_CHARACTERISTIC /end GROUP
/begin GROUP S7_Subsystem2 "PubIfChassisHMI_MDL/Subsystem/HMI2.12/HWA//ACC//TJA_Signal1/Subsystem2" /begin REF_CHARACTERISTIC P_HMI_ObjectTypeFilter /end REF_CHARACTERISTIC /end GROUP
/begin GROUP S7_Subsystem3 "PubIfChassisHMI_MDL/Subsystem/HMI2.12/HWA//ACC//TJA_Signal1/Subsystem3" /begin REF_CHARACTERISTIC P_HMI_ObjectTypeFilter /end REF_CHARACTERISTIC /end GROUP
/begin GROUP S7_Subsystem4 "PubIfChassisHMI_MDL/Subsystem/HMI2.12/HWA//ACC//TJA_Signal1/Subsystem4" /begin REF_CHARACTERISTIC P_HMI_ObjectTypeFilter /end REF_CHARACTERISTIC /end GROUP
/begin GROUP S7_Subsystem5 "PubIfChassisHMI_MDL/Subsystem/HMI2.12/HWA//ACC//TJA_Signal1/Subsystem5" /begin REF_CHARACTERISTIC P_HMI_ObjectTypeFilter /end REF_CHARACTERISTIC /end GROUP
/end MODULE
/end PROJECT
/* EOF PubIfChassisHMI_MDL.a2l*/
