/*
* ASAP2 file: Noa_Nofusion.a2l
* Copyright 2022, dSPACE GmbH. All rights reserved.
*/ ASAP2_VERSION 1 61
/* Version 1.61 */
/begin PROJECT Noa_Nofusion ""
/begin HEADER "" VERSION "1.579" PROJECT_NO Noa_Nofusion /end HEADER
/begin MODULE Noa_Nofusion ""
/begin RECORD_LAYOUT Scalar_BOOLEAN FNC_VALUES 1 UBYTE ROW_DIR DIRECT /end RECORD_LAYOUT
/begin RECORD_LAYOUT Scalar_UBYTE FNC_VALUES 1 UBYTE ROW_DIR DIRECT /end RECORD_LAYOUT
/begin RECORD_LAYOUT Scalar_BYTE FNC_VALUES 1 SBYTE ROW_DIR DIRECT /end RECORD_LAYOUT
/begin RECORD_LAYOUT Scalar_UWORD FNC_VALUES 1 UWORD ROW_DIR DIRECT /end RECORD_LAYOUT
/begin RECORD_LAYOUT Scalar_SWORD FNC_VALUES 1 SWORD ROW_DIR DIRECT /end RECORD_LAYOUT
/begin RECORD_LAYOUT Scalar_ULONG FNC_VALUES 1 ULONG ROW_DIR DIRECT /end RECORD_LAYOUT
/begin RECORD_LAYOUT Scalar_LONG FNC_VALUES 1 SLONG ROW_DIR DIRECT /end RECORD_LAYOUT
/begin RECORD_LAYOUT Scalar_FLOAT32_IEEE FNC_VALUES 1 FLOAT32_IEEE ROW_DIR DIRECT /end RECORD_LAYOUT
/begin RECORD_LAYOUT Scalar_FLOAT64_IEEE FNC_VALUES 1 FLOAT64_IEEE ROW_DIR DIRECT /end RECORD_LAYOUT
/begin RECORD_LAYOUT Lookup1D_BOOLEAN FNC_VALUES 1 UBYTE ROW_DIR DIRECT /end RECORD_LAYOUT
/begin RECORD_LAYOUT Lookup1D_BYTE FNC_VALUES 1 SBYTE ROW_DIR DIRECT /end RECORD_LAYOUT
/begin RECORD_LAYOUT Lookup1D_UBYTE FNC_VALUES 1 UBYTE ROW_DIR DIRECT /end RECORD_LAYOUT
/begin RECORD_LAYOUT Lookup1D_UWORD FNC_VALUES 1 UWORD ROW_DIR DIRECT /end RECORD_LAYOUT
/begin RECORD_LAYOUT Lookup1D_WORD FNC_VALUES 1 SWORD ROW_DIR DIRECT /end RECORD_LAYOUT
/begin RECORD_LAYOUT Lookup1D_ULONG FNC_VALUES 1 ULONG ROW_DIR DIRECT /end RECORD_LAYOUT
/begin RECORD_LAYOUT Lookup1D_LONG FNC_VALUES 1 SLONG ROW_DIR DIRECT /end RECORD_LAYOUT
/begin RECORD_LAYOUT Lookup1D_FLOAT32_IEEE FNC_VALUES 1 FLOAT32_IEEE ROW_DIR DIRECT /end RECORD_LAYOUT
/begin RECORD_LAYOUT Lookup1D_FLOAT64_IEEE FNC_VALUES 1 FLOAT64_IEEE ROW_DIR DIRECT /end RECORD_LAYOUT
/begin RECORD_LAYOUT Lookup1D_X_BOOLEAN AXIS_PTS_X 1 UBYTE INDEX_INCR DIRECT /end RECORD_LAYOUT
/begin RECORD_LAYOUT Lookup1D_X_BYTE AXIS_PTS_X 1 SBYTE INDEX_INCR DIRECT /end RECORD_LAYOUT
/begin RECORD_LAYOUT Lookup1D_X_UBYTE AXIS_PTS_X 1 UBYTE INDEX_INCR DIRECT /end RECORD_LAYOUT
/begin RECORD_LAYOUT Lookup1D_X_UWORD AXIS_PTS_X 1 UWORD INDEX_INCR DIRECT /end RECORD_LAYOUT
/begin RECORD_LAYOUT Lookup1D_X_WORD AXIS_PTS_X 1 SWORD INDEX_INCR DIRECT /end RECORD_LAYOUT
/begin RECORD_LAYOUT Lookup1D_X_ULONG AXIS_PTS_X 1 ULONG INDEX_INCR DIRECT /end RECORD_LAYOUT
/begin RECORD_LAYOUT Lookup1D_X_LONG AXIS_PTS_X 1 SLONG INDEX_INCR DIRECT /end RECORD_LAYOUT
/begin RECORD_LAYOUT Lookup1D_X_FLOAT32_IEEE AXIS_PTS_X 1 FLOAT32_IEEE INDEX_INCR DIRECT /end RECORD_LAYOUT
/begin RECORD_LAYOUT Lookup1D_X_FLOAT64_IEEE AXIS_PTS_X 1 FLOAT64_IEEE INDEX_INCR DIRECT /end RECORD_LAYOUT
/begin RECORD_LAYOUT Lookup2D_BOOLEAN FNC_VALUES 1 UBYTE ROW_DIR DIRECT /end RECORD_LAYOUT
/begin RECORD_LAYOUT Lookup2D_UBYTE FNC_VALUES 1 UBYTE ROW_DIR DIRECT /end RECORD_LAYOUT
/begin RECORD_LAYOUT Lookup2D_BYTE FNC_VALUES 1 SBYTE ROW_DIR DIRECT /end RECORD_LAYOUT
/begin RECORD_LAYOUT Lookup2D_UWORD FNC_VALUES 1 UWORD ROW_DIR DIRECT /end RECORD_LAYOUT
/begin RECORD_LAYOUT Lookup2D_WORD FNC_VALUES 1 SWORD ROW_DIR DIRECT /end RECORD_LAYOUT
/begin RECORD_LAYOUT Lookup2D_ULONG FNC_VALUES 1 ULONG ROW_DIR DIRECT /end RECORD_LAYOUT
/begin RECORD_LAYOUT Lookup2D_LONG FNC_VALUES 1 SLONG ROW_DIR DIRECT /end RECORD_LAYOUT
/begin RECORD_LAYOUT Lookup2D_FLOAT32_IEEE FNC_VALUES 1 FLOAT32_IEEE ROW_DIR DIRECT /end RECORD_LAYOUT
/begin RECORD_LAYOUT Lookup2D_FLOAT64_IEEE FNC_VALUES 1 FLOAT64_IEEE ROW_DIR DIRECT /end RECORD_LAYOUT
/begin RECORD_LAYOUT Lookup2D_X_BOOLEAN AXIS_PTS_X 1 UBYTE INDEX_INCR DIRECT /end RECORD_LAYOUT
/begin RECORD_LAYOUT Lookup2D_X_UBYTE AXIS_PTS_X 1 UBYTE INDEX_INCR DIRECT /end RECORD_LAYOUT
/begin RECORD_LAYOUT Lookup2D_X_BYTE AXIS_PTS_X 1 SBYTE INDEX_INCR DIRECT /end RECORD_LAYOUT
/begin RECORD_LAYOUT Lookup2D_X_UWORD AXIS_PTS_X 1 UWORD INDEX_INCR DIRECT /end RECORD_LAYOUT
/begin RECORD_LAYOUT Lookup2D_X_WORD AXIS_PTS_X 1 SWORD INDEX_INCR DIRECT /end RECORD_LAYOUT
/begin RECORD_LAYOUT Lookup2D_X_ULONG AXIS_PTS_X 1 ULONG INDEX_INCR DIRECT /end RECORD_LAYOUT
/begin RECORD_LAYOUT Lookup2D_X_LONG AXIS_PTS_X 1 SLONG INDEX_INCR DIRECT /end RECORD_LAYOUT
/begin RECORD_LAYOUT Lookup2D_X_FLOAT32_IEEE AXIS_PTS_X 1 FLOAT32_IEEE INDEX_INCR DIRECT /end RECORD_LAYOUT
/begin RECORD_LAYOUT Lookup2D_X_FLOAT64_IEEE AXIS_PTS_X 1 FLOAT64_IEEE INDEX_INCR DIRECT /end RECORD_LAYOUT
/begin CHARACTERISTIC P_EQ4_BC0Gain "" VALUE 0x0 /* @MemoryAddress@P_EQ4_BC0Gain@ */ Scalar_FLOAT64_IEEE 0 Noa_Nofusion_CM_double -1.7E+308 1.7E+308 /end CHARACTERISTIC
/begin CHARACTERISTIC P_HWA_TOS_P0HeadingAngle "" VALUE 0x0 /* @MemoryAddress@P_HWA_TOS_P0HeadingAngle@ */ Scalar_FLOAT64_IEEE 0 Noa_Nofusion_CM_double -1.7E+308 1.7E+308 /end CHARACTERISTIC
/begin CHARACTERISTIC P_Global_DxvFrontBumper_m "后轴到前杠前边缘的X向位置" VALUE 0x0 /* @MemoryAddress@P_Global_DxvFrontBumper_m@ */ Scalar_FLOAT32_IEEE 0 Noa_Nofusion_CM_single_m -3.4E+38 3.4E+38 /end CHARACTERISTIC
/begin CHARACTERISTIC P_Global_EQ2RearAxisX_m "后轴中心点到摄像头光心的X向位置" VALUE 0x0 /* @MemoryAddress@P_Global_EQ2RearAxisX_m@ */ Scalar_FLOAT32_IEEE 0 Noa_Nofusion_CM_single_m -3.4E+38 3.4E+38 /end CHARACTERISTIC
/begin CHARACTERISTIC P_Global_EQ2RearAxisY_m "摄像头光心到后轴中心点的Y向位置" VALUE 0x0 /* @MemoryAddress@P_Global_EQ2RearAxisY_m@ */ Scalar_FLOAT32_IEEE 0 Noa_Nofusion_CM_single_m -3.4E+38 3.4E+38 /end CHARACTERISTIC
/begin CHARACTERISTIC P_Global_SteeringAngleRatio "方向盘与前轮转角传动比" VALUE 0x0 /* @MemoryAddress@P_Global_SteeringAngleRatio@ */ Scalar_FLOAT32_IEEE 0 Noa_Nofusion_CM_single -3.4E+38 3.4E+38 /end CHARACTERISTIC
/begin CHARACTERISTIC P_TOSS_DxOffset "" VALUE 0x0 /* @MemoryAddress@P_TOSS_DxOffset@ */ Scalar_FLOAT32_IEEE 0 Noa_Nofusion_CM_single -3.4E+38 3.4E+38 /end CHARACTERISTIC
/begin CHARACTERISTIC P_RFM_RoadType "" VALUE 0x0 /* @MemoryAddress@P_RFM_RoadType@ */ Scalar_UBYTE 0 Noa_Nofusion_CM_uint8 0 255 /end CHARACTERISTIC
/begin CHARACTERISTIC P_RFM_mapvalid "" VALUE 0x0 /* @MemoryAddress@P_RFM_mapvalid@ */ Scalar_UBYTE 0 Noa_Nofusion_CM_uint8 0 255 /end CHARACTERISTIC
/begin MEASUREMENT RFM_R1_dDisFront "" FLOAT32_IEEE Noa_Nofusion_CM_single 0 0 0.0 200.0 ECU_ADDRESS 0x0 /* @MemoryAddress@RFM_R1_dDisFront@ */ /end MEASUREMENT
/begin MEASUREMENT RFM_R1_dDisStart "" FLOAT32_IEEE Noa_Nofusion_CM_single 0 0 0.0 200.0 ECU_ADDRESS 0x0 /* @MemoryAddress@RFM_R1_dDisStart@ */ /end MEASUREMENT
/begin MEASUREMENT RFM_R1_dC3V "" FLOAT32_IEEE Noa_Nofusion_CM_single 0 0 -0.004 0.004 ECU_ADDRESS 0x0 /* @MemoryAddress@RFM_R1_dC3V@ */ /end MEASUREMENT
/begin MEASUREMENT RFM_R1_dC2V "" FLOAT32_IEEE Noa_Nofusion_CM_single 0 0 -0.125 0.125 ECU_ADDRESS 0x0 /* @MemoryAddress@RFM_R1_dC2V@ */ /end MEASUREMENT
/begin MEASUREMENT RFM_R1_dC1V "" FLOAT32_IEEE Noa_Nofusion_CM_single 0 0 -2.0 2.0 ECU_ADDRESS 0x0 /* @MemoryAddress@RFM_R1_dC1V@ */ /end MEASUREMENT
/begin MEASUREMENT RFM_R1_dC0V "" FLOAT32_IEEE Noa_Nofusion_CM_single 0 0 -30.0 30.0 ECU_ADDRESS 0x0 /* @MemoryAddress@RFM_R1_dC0V@ */ /end MEASUREMENT
/begin MEASUREMENT RFM_L1_dDisFront "" FLOAT32_IEEE Noa_Nofusion_CM_single 0 0 0.0 200.0 ECU_ADDRESS 0x0 /* @MemoryAddress@RFM_L1_dDisFront@ */ /end MEASUREMENT
/begin MEASUREMENT RFM_L1_dDisStart "" FLOAT32_IEEE Noa_Nofusion_CM_single 0 0 0.0 200.0 ECU_ADDRESS 0x0 /* @MemoryAddress@RFM_L1_dDisStart@ */ /end MEASUREMENT
/begin MEASUREMENT RFM_L1_dC3V "" FLOAT32_IEEE Noa_Nofusion_CM_single 0 0 -0.004 0.004 ECU_ADDRESS 0x0 /* @MemoryAddress@RFM_L1_dC3V@ */ /end MEASUREMENT
/begin MEASUREMENT RFM_L1_dC1V "" FLOAT32_IEEE Noa_Nofusion_CM_single 0 0 -2.0 2.0 ECU_ADDRESS 0x0 /* @MemoryAddress@RFM_L1_dC1V@ */ /end MEASUREMENT
/begin MEASUREMENT RFM_L1_dC0V "" FLOAT32_IEEE Noa_Nofusion_CM_single 0 0 -30.0 30.0 ECU_ADDRESS 0x0 /* @MemoryAddress@RFM_L1_dC0V@ */ /end MEASUREMENT
/begin MEASUREMENT EQ4_DX "" FLOAT32_IEEE Noa_Nofusion_CM_single 0 0 -3.4E+38 3.4E+38 LAYOUT ROW_DIR MATRIX_DIM 20 1 1 ECU_ADDRESS 0x0 /* @MemoryAddress@EQ4_DX@ */ /end MEASUREMENT
/begin MEASUREMENT LCKIE_DX "" FLOAT32_IEEE Noa_Nofusion_CM_single 0 0 -3.4E+38 3.4E+38 LAYOUT ROW_DIR MATRIX_DIM 9 1 1 ECU_ADDRESS 0x0 /* @MemoryAddress@LCKIE_DX@ */ /end MEASUREMENT
/begin MEASUREMENT LCKIE_DY "" FLOAT32_IEEE Noa_Nofusion_CM_single 0 0 -3.4E+38 3.4E+38 LAYOUT ROW_DIR MATRIX_DIM 9 1 1 ECU_ADDRESS 0x0 /* @MemoryAddress@LCKIE_DY@ */ /end MEASUREMENT
/begin MEASUREMENT LCKIE_VX "" FLOAT32_IEEE Noa_Nofusion_CM_single 0 0 -3.4E+38 3.4E+38 LAYOUT ROW_DIR MATRIX_DIM 9 1 1 ECU_ADDRESS 0x0 /* @MemoryAddress@LCKIE_VX@ */ /end MEASUREMENT
/begin MEASUREMENT dxP0 "" FLOAT32_IEEE Noa_Nofusion_CM_single 0 0 -3.4E+38 3.4E+38 ECU_ADDRESS 0x0 /* @MemoryAddress@dxP0@ */ /end MEASUREMENT
/begin MEASUREMENT LongCtrl_VlcInternalAcc "" FLOAT32_IEEE Noa_Nofusion_CM_single 0 0 -3.4E+38 3.4E+38 ECU_ADDRESS 0x0 /* @MemoryAddress@LongCtrl_VlcInternalAcc@ */ /end MEASUREMENT
/begin MEASUREMENT LCKIE_ID "" UWORD Noa_Nofusion_CM_ufix16_En7 0 0 0 511.9921875 LAYOUT ROW_DIR MATRIX_DIM 9 1 1 ECU_ADDRESS 0x0 /* @MemoryAddress@LCKIE_ID@ */ /end MEASUREMENT
/begin MEASUREMENT RFM_R1_eLineType "" UBYTE Noa_Nofusion_CM_uint8 0 0 0 255 ECU_ADDRESS 0x0 /* @MemoryAddress@RFM_R1_eLineType@ */ /end MEASUREMENT
/begin MEASUREMENT RFM_R1_bIsLineExist "" UBYTE Noa_Nofusion_CM_uint8 0 0 0 255 ECU_ADDRESS 0x0 /* @MemoryAddress@RFM_R1_bIsLineExist@ */ /end MEASUREMENT
/begin MEASUREMENT RFM_L1_eLineType "" UBYTE Noa_Nofusion_CM_uint8 0 0 0 255 ECU_ADDRESS 0x0 /* @MemoryAddress@RFM_L1_eLineType@ */ /end MEASUREMENT
/begin MEASUREMENT RFM_L1_bIsLineExist "" UBYTE Noa_Nofusion_CM_uint8 0 0 0 255 ECU_ADDRESS 0x0 /* @MemoryAddress@RFM_L1_bIsLineExist@ */ /end MEASUREMENT
/begin MEASUREMENT EQ4_Type "" UBYTE Noa_Nofusion_CM_uint8 0 0 0 255 LAYOUT ROW_DIR MATRIX_DIM 20 1 1 ECU_ADDRESS 0x0 /* @MemoryAddress@EQ4_Type@ */ /end MEASUREMENT
/begin MEASUREMENT Object_Type "" UBYTE Noa_Nofusion_CM_uint8 0 0 0 255 LAYOUT ROW_DIR MATRIX_DIM 9 1 1 ECU_ADDRESS 0x0 /* @MemoryAddress@Object_Type@ */ /end MEASUREMENT
/begin MEASUREMENT LSM_Line_source "" UBYTE Noa_Nofusion_CM_uint8 0 0 0 255 ECU_ADDRESS 0x0 /* @MemoryAddress@LSM_Line_source@ */ /end MEASUREMENT
/begin COMPU_METHOD Noa_Nofusion_CM_double "Q = V" RAT_FUNC "%15.10" "" COEFFS 0 1 0 0 0 1 /end COMPU_METHOD
/begin COMPU_METHOD Noa_Nofusion_CM_single_m "Q = V" RAT_FUNC "%8.6" "m" COEFFS 0 1 0 0 0 1 /end COMPU_METHOD
/begin COMPU_METHOD Noa_Nofusion_CM_single "Q = V" RAT_FUNC "%8.6" "" COEFFS 0 1 0 0 0 1 /end COMPU_METHOD
/begin COMPU_METHOD Noa_Nofusion_CM_uint8 "Q = V" RAT_FUNC "%3.0" "" COEFFS 0 1 0 0 0 1 /end COMPU_METHOD
/begin COMPU_METHOD Noa_Nofusion_CM_ufix16_En7 "Q = V*128.000000" RAT_FUNC "%10.7" "" COEFFS 0 128.000000 0.000000 0 0 1.000000 /end COMPU_METHOD
/begin GROUP Noa_Nofusion "Noa_Nofusion" /* Root */ ROOT
 /begin SUB_GROUP Root_Chassis1 Root_Common Root_Control1 Root_LPV Root_Subsystem1 Root_Subsystem4 Root_TOS /end SUB_GROUP
/end GROUP
/begin GROUP Root_Chassis1 "Noa_Nofusion/Chassis1" /begin SUB_GROUP S6_HMI /end SUB_GROUP /end GROUP
/begin GROUP Root_Common "Noa_Nofusion/Common" /begin SUB_GROUP mr_grp2link_PubIfCommonVIE_MDL /end SUB_GROUP /end GROUP
/begin GROUP Root_Control1 "Noa_Nofusion/Control1"
 /begin SUB_GROUP mr_grp2link_PubIfControlLATC_MDL mr_grp2link_PubIfControlLONC_MDL /end SUB_GROUP
 /begin REF_MEASUREMENT LongCtrl_VlcInternalAcc /end REF_MEASUREMENT
/end GROUP
/begin GROUP Root_LPV "Noa_Nofusion/LPV" /begin SUB_GROUP S17_Subsystem5 S17_VSM mr_grp2link_PubIfDecisionPLAN_MDL /end SUB_GROUP /end GROUP
/begin GROUP Root_Subsystem1 "Noa_Nofusion/Subsystem1" /begin REF_CHARACTERISTIC P_RFM_RoadType P_RFM_mapvalid /end REF_CHARACTERISTIC /end GROUP
/begin GROUP Root_Subsystem4 "Noa_Nofusion/Subsystem4" /begin SUB_GROUP S22_Simulink_Function /end SUB_GROUP
 /begin REF_CHARACTERISTIC P_EQ4_BC0Gain P_Global_EQ2RearAxisX_m P_Global_EQ2RearAxisY_m /end REF_CHARACTERISTIC
 /begin REF_MEASUREMENT RFM_L1_bIsLineExist RFM_L1_dC0V RFM_L1_dC1V RFM_L1_dC3V RFM_L1_dDisFront RFM_L1_dDisStart RFM_L1_eLineType RFM_R1_bIsLineExist RFM_R1_dC0V RFM_R1_dC1V RFM_R1_dC2V RFM_R1_dC3V RFM_R1_dDisFront RFM_R1_dDisStart RFM_R1_eLineType /end REF_MEASUREMENT
/end GROUP
/begin GROUP Root_TOS "Noa_Nofusion/TOS" /begin SUB_GROUP S23_Subsystem2 /end SUB_GROUP /end GROUP
/begin GROUP S6_HMI "Noa_Nofusion/Chassis1/HMI" /begin SUB_GROUP mr_grp2link_PubIfChassisHMI_MDL /end SUB_GROUP /end GROUP
/begin GROUP S17_Subsystem5 "Noa_Nofusion/LPV/Subsystem5" /begin SUB_GROUP mr_grp2link_PubIfDecisionLSM_MDL /end SUB_GROUP /begin REF_MEASUREMENT LSM_Line_source /end REF_MEASUREMENT /end GROUP
/begin GROUP S17_VSM "Noa_Nofusion/LPV/VSM" /begin SUB_GROUP mr_grp2link_PubIfStateVSM_MDL /end SUB_GROUP /end GROUP
/begin GROUP S22_Simulink_Function "Noa_Nofusion/Subsystem4/Simulink Function" /begin REF_CHARACTERISTIC P_Global_EQ2RearAxisX_m P_Global_EQ2RearAxisY_m /end REF_CHARACTERISTIC /end GROUP
/begin GROUP S23_Subsystem2 "Noa_Nofusion/TOS/Subsystem2" /begin SUB_GROUP S170_ACCOSM S170_DOP S170_Subsystem /end SUB_GROUP /end GROUP
/begin GROUP S170_ACCOSM "Noa_Nofusion/TOS/Subsystem2/ACCOSM" /begin SUB_GROUP S172_HWA_Task100ms1 /end SUB_GROUP
 /begin REF_CHARACTERISTIC P_Global_SteeringAngleRatio P_HWA_TOS_P0HeadingAngle P_TOSS_DxOffset /end REF_CHARACTERISTIC
 /begin REF_MEASUREMENT dxP0 /end REF_MEASUREMENT
/end GROUP
/begin GROUP S170_DOP "Noa_Nofusion/TOS/Subsystem2/DOP" /begin SUB_GROUP S174_HWA_Task100ms1 /end SUB_GROUP /begin REF_CHARACTERISTIC P_Global_SteeringAngleRatio /end REF_CHARACTERISTIC /end GROUP
/begin GROUP S170_Subsystem "Noa_Nofusion/TOS/Subsystem2/Subsystem"
 /begin REF_MEASUREMENT EQ4_DX EQ4_Type LCKIE_DX LCKIE_DY LCKIE_ID LCKIE_VX Object_Type /end REF_MEASUREMENT
/end GROUP
/begin GROUP S172_HWA_Task100ms1 "Noa_Nofusion/TOS/Subsystem2/ACCOSM/HWA_Task100ms1" /begin SUB_GROUP S179_VxVy /end SUB_GROUP /begin REF_CHARACTERISTIC P_Global_DxvFrontBumper_m /end REF_CHARACTERISTIC /end GROUP
/begin GROUP S174_HWA_Task100ms1 "Noa_Nofusion/TOS/Subsystem2/DOP/HWA_Task100ms1" /begin SUB_GROUP S220_VxVy /end SUB_GROUP /begin REF_CHARACTERISTIC P_Global_DxvFrontBumper_m /end REF_CHARACTERISTIC /end GROUP
/begin GROUP S179_VxVy "Noa_Nofusion/TOS/Subsystem2/ACCOSM/HWA_Task100ms1/VxVy" /begin REF_CHARACTERISTIC P_Global_EQ2RearAxisX_m /end REF_CHARACTERISTIC /end GROUP
/begin GROUP S220_VxVy "Noa_Nofusion/TOS/Subsystem2/DOP/HWA_Task100ms1/VxVy" /begin REF_CHARACTERISTIC P_Global_EQ2RearAxisX_m /end REF_CHARACTERISTIC /end GROUP
/end MODULE
/end PROJECT
/* EOF Noa_Nofusion.a2l*/
