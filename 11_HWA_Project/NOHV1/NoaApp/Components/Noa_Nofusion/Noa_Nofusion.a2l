ASAP2_VERSION 1 61
/begin PROJECT Noa_Nofusion ""
/begin HEADER "" VERSION "1.579" PROJECT_NO Noa_Nofusion /end HEADER
/begin MODULE Noa_Nofusion ""
/begin RECORD_LAYOUT Scalar_BOOLEAN FNC_VALUES 1 UBYTE ROW_DIR DIRECT /end RECORD_LAYOUT
/begin RECORD_LAYOUT Scalar_UBYTE FNC_VALUES 1 UBYTE ROW_DIR DIRECT /end RECORD_LAYOUT
/begin RECORD_LAYOUT Scalar_UWORD FNC_VALUES 1 UWORD ROW_DIR DIRECT /end RECORD_LAYOUT
/begin RECORD_LAYOUT Scalar_FLOAT32_IEEE FNC_VALUES 1 FLOAT32_IEEE ROW_DIR DIRECT /end RECORD_LAYOUT
/begin RECORD_LAYOUT Scalar_FLOAT64_IEEE FNC_VALUES 1 FLOAT64_IEEE ROW_DIR DIRECT /end RECORD_LAYOUT
/begin RECORD_LAYOUT Lookup1D_FLOAT32_IEEE FNC_VALUES 1 FLOAT32_IEEE ROW_DIR DIRECT /end RECORD_LAYOUT
/begin RECORD_LAYOUT Lookup1D_X_UBYTE AXIS_PTS_X 1 UBYTE INDEX_INCR DIRECT /end RECORD_LAYOUT
/begin RECORD_LAYOUT Lookup1D_X_UWORD AXIS_PTS_X 1 UWORD INDEX_INCR DIRECT /end RECORD_LAYOUT
/begin RECORD_LAYOUT Lookup1D_X_WORD AXIS_PTS_X 1 SWORD INDEX_INCR DIRECT /end RECORD_LAYOUT
/begin RECORD_LAYOUT Lookup1D_X_ULONG AXIS_PTS_X 1 ULONG INDEX_INCR DIRECT /end RECORD_LAYOUT
/begin RECORD_LAYOUT Lookup1D_X_LONG AXIS_PTS_X 1 SLONG INDEX_INCR DIRECT /end RECORD_LAYOUT
/begin RECORD_LAYOUT Lookup1D_X_FLOAT32_IEEE AXIS_PTS_X 1 FLOAT32_IEEE INDEX_INCR DIRECT /end RECORD_LAYOUT
/begin RECORD_LAYOUT Lookup1D_X_FLOAT64_IEEE AXIS_PTS_X 1 FLOAT64_IEEE INDEX_INCR DIRECT /end RECORD_LAYOUT
/begin RECORD_LAYOUT Lookup2D_BOOLEAN FNC_VALUES 1 UBYTE ROW_DIR DIRECT /end RECORD_LAYOUT
/begin RECORD_LAYOUT Lookup2D_UBYTE FNC_VALUES 1 UBYTE ROW_DIR DIRECT /end RECORD_LAYOUT
/begin RECORD_LAYOUT Lookup2D_BYTE FNC_VALUES 1 SBYTE ROW_DIR DIRECT /end RECORD_LAYOUT
/begin RECORD_LAYOUT Lookup2D_UWORD FNC_VALUES 1 UWORD ROW_DIR DIRECT /end RECORD_LAYOUT
/begin RECORD_LAYOUT Lookup2D_WORD FNC_VALUES 1 SWORD ROW_DIR DIRECT /end RECORD_LAYOUT
/begin RECORD_LAYOUT Lookup2D_ULONG FNC_VALUES 1 ULONG ROW_DIR DIRECT /end RECORD_LAYOUT
/begin RECORD_LAYOUT Lookup2D_LONG FNC_VALUES 1 SLONG ROW_DIR DIRECT /end RECORD_LAYOUT
/begin RECORD_LAYOUT Lookup2D_FLOAT64_IEEE FNC_VALUES 1 FLOAT64_IEEE ROW_DIR DIRECT /end RECORD_LAYOUT
/begin RECORD_LAYOUT Lookup2D_X_BOOLEAN AXIS_PTS_X 1 UBYTE INDEX_INCR DIRECT /end RECORD_LAYOUT
/begin RECORD_LAYOUT Lookup2D_X_BYTE AXIS_PTS_X 1 SBYTE INDEX_INCR DIRECT /end RECORD_LAYOUT
/begin RECORD_LAYOUT Lookup2D_X_UWORD AXIS_PTS_X 1 UWORD INDEX_INCR DIRECT /end RECORD_LAYOUT
/begin CHARACTERISTIC P_LongCtrl_VLCaccelMinHoldYAxis "" CURVE 0x0 /* @MemoryAddress@P_LongCtrl_VLCaccelMinHoldYAxis@ */ Lookup1D_FLOAT32_IEEE 0 PubIfControlLONC_MDL_CM_single_m_s_2 -6.0 0.0
 /begin AXIS_DESCR COM_AXIS LongCtrl_axvRoadSlopeMs2 PubIfControlLONC_MDL_CM_single_m_s_2 2 0.0 5.0 AXIS_PTS_REF P_LongCtrl_VLCaccelMinHoldXAxis /end AXIS_DESCR
/end CHARACTERISTIC
/begin CHARACTERISTIC P_LongCtrl_VLCjerkHoldYAxis "" CURVE 0x0 /* @MemoryAddress@P_LongCtrl_VLCjerkHoldYAxis@ */ Lookup1D_FLOAT32_IEEE 0 PubIfControlLONC_MDL_CM_single_m_s_3 -50.0 0.0
 /begin AXIS_DESCR COM_AXIS LongCtrl_axvRoadSlopeMs2 PubIfControlLONC_MDL_CM_single_m_s_2 2 0.0 4.0 AXIS_PTS_REF P_LongCtrl_VLCjerkHoldXAxis /end AXIS_DESCR
/end CHARACTERISTIC
/begin CHARACTERISTIC P_LongCtrl_VLCaccelMinSlidHoldYAxis "m/s^2" CURVE 0x0 /* @MemoryAddress@P_LongCtrl_VLCaccelMinSlidHoldYAxis@ */ Lookup1D_FLOAT32_IEEE 0 PubIfControlLONC_MDL_CM_single -3.4E+38 3.4E+38
 /begin AXIS_DESCR COM_AXIS LongCtrl_axvRoadSlopeMs2 PubIfControlLONC_MDL_CM_single 7 -3.4E+38 3.4E+38 AXIS_PTS_REF P_LongCtrl_VLCaccelMinSlidHoldXAxis /end AXIS_DESCR
/end CHARACTERISTIC
/begin CHARACTERISTIC P_LongCtrl_VLCjerkSlidHoldYAxis "m/s^3" CURVE 0x0 /* @MemoryAddress@P_LongCtrl_VLCjerkSlidHoldYAxis@ */ Lookup1D_FLOAT32_IEEE 0 PubIfControlLONC_MDL_CM_single -3.4E+38 3.4E+38
 /begin AXIS_DESCR COM_AXIS LongCtrl_axvRoadSlopeMs2 PubIfControlLONC_MDL_CM_single 7 -3.4E+38 3.4E+38 AXIS_PTS_REF P_LongCtrl_VLCjerkSlidHoldXAxis /end AXIS_DESCR
/end CHARACTERISTIC
/begin CHARACTERISTIC P_LongCtrl_VLCcoefPIYAxis "" CURVE 0x0 /* @MemoryAddress@P_LongCtrl_VLCcoefPIYAxis@ */ Lookup1D_FLOAT32_IEEE 0 PubIfControlLONC_MDL_CM_single 0.0 2.0
 /begin AXIS_DESCR COM_AXIS NO_INPUT_QUANTITY PubIfControlLONC_MDL_CM_single_km_h 4 0.0 30.0 AXIS_PTS_REF P_LongCtrl_VLCvelCharCoefPIXAxis /end AXIS_DESCR
/end CHARACTERISTIC
/begin CHARACTERISTIC P_LongCtrl_VLCengInverseEfficientYAxis "" CURVE 0x0 /* @MemoryAddress@P_LongCtrl_VLCengInverseEfficientYAxis@ */ Lookup1D_FLOAT32_IEEE 0 PubIfControlLONC_MDL_CM_single__ -120.0 120.0
 /begin AXIS_DESCR COM_AXIS NO_INPUT_QUANTITY PubIfControlLONC_MDL_CM_single__ 5 -150.0 110.0 AXIS_PTS_REF P_LongCtrl_VLCtorqCharEngInverseEfficientXAxis /end AXIS_DESCR
/end CHARACTERISTIC
/begin CHARACTERISTIC P_LongCtrl_VLCcoefKiDiffDtEnlargeYAxis "" CURVE 0x0 /* @MemoryAddress@P_LongCtrl_VLCcoefKiDiffDtEnlargeYAxis@ */ Lookup1D_FLOAT32_IEEE 0 PubIfControlLONC_MDL_CM_single 0.0 3.0
 /begin AXIS_DESCR COM_AXIS NO_INPUT_QUANTITY PubIfControlLONC_MDL_CM_single_m_s_3 6 -10.0 20.0 AXIS_PTS_REF P_LongCtrl_VLCdiffDtCharCoefKiEnlargeXAxis /end AXIS_DESCR
/end CHARACTERISTIC
/begin CHARACTERISTIC P_LongCtrl_VLCcoefKiEnableYAxis "" CURVE 0x0 /* @MemoryAddress@P_LongCtrl_VLCcoefKiEnableYAxis@ */ Lookup1D_FLOAT32_IEEE 0 PubIfControlLONC_MDL_CM_single 0.0 2.0
 /begin AXIS_DESCR COM_AXIS LongCtrl_axvDiff PubIfControlLONC_MDL_CM_single_m_s_2 6 -10.0 20.0 AXIS_PTS_REF P_LongCtrl_VLCaDiffCharCoefKiEnableXAxis /end AXIS_DESCR
/end CHARACTERISTIC
/begin CHARACTERISTIC P_LongCtrl_VLCAxvTracMinDC1FullFillYAxis "" CURVE 0x0 /* @MemoryAddress@P_LongCtrl_VLCAxvTracMinDC1FullFillYAxis@ */ Lookup1D_FLOAT32_IEEE 0 PubIfControlLONC_MDL_CM_single_m_s_2 -1.0 1.0
 /begin AXIS_DESCR COM_AXIS LongCtrl_vxvRefMs PubIfControlLONC_MDL_CM_single_m_s 4 0.0 60.0 AXIS_PTS_REF P_LongCtrl_VLCAxvTracMinDC1FullFillXAxis /end AXIS_DESCR
/end CHARACTERISTIC
/begin CHARACTERISTIC P_LongCtrl_VLCengEfficientCharYAxis "" CURVE 0x0 /* @MemoryAddress@P_LongCtrl_VLCengEfficientCharYAxis@ */ Lookup1D_FLOAT32_IEEE 0 PubIfControlLONC_MDL_CM_single 0.5 2.0
 /begin AXIS_DESCR COM_AXIS NO_INPUT_QUANTITY PubIfControlLONC_MDL_CM_single__ 5 -100.0 100.0 AXIS_PTS_REF P_LongCtrl_VLCtorqCharEngEfficientXAxis /end AXIS_DESCR
/end CHARACTERISTIC
/begin CHARACTERISTIC P_LongCtrl_VLCcoefFYAxis "" CURVE 0x0 /* @MemoryAddress@P_LongCtrl_VLCcoefFYAxis@ */ Lookup1D_FLOAT32_IEEE 0 PubIfControlLONC_MDL_CM_single 0.0 1.0
 /begin AXIS_DESCR COM_AXIS NO_INPUT_QUANTITY PubIfControlLONC_MDL_CM_single_km_h 10 0.0 250.0 AXIS_PTS_REF P_LongCtrl_VLCcoefFXAxis /end AXIS_DESCR
/end CHARACTERISTIC
/begin CHARACTERISTIC P_Global_Weight_N "车重" VALUE 0x0 /* @MemoryAddress@P_Global_Weight_N@ */ Scalar_FLOAT32_IEEE 0 PubIfControlLONC_MDL_CM_single_N -3.4E+38 3.4E+38 /end CHARACTERISTIC
/begin CHARACTERISTIC P_LongCtrl_AxvRoadSlopeThrd "m/s^2" VALUE 0x0 /* @MemoryAddress@P_LongCtrl_AxvRoadSlopeThrd@ */ Scalar_FLOAT32_IEEE 0 PubIfControlLONC_MDL_CM_single -3.4E+38 3.4E+38 /end CHARACTERISTIC
/begin CHARACTERISTIC P_LongCtrl_TotWheelTrqRatio "" VALUE 0x0 /* @MemoryAddress@P_LongCtrl_TotWheelTrqRatio@ */ Scalar_FLOAT32_IEEE 0 PubIfControlLONC_MDL_CM_single -3.4E+38 3.4E+38 /end CHARACTERISTIC
/begin CHARACTERISTIC P_LongCtrl_VLCAxTarDtThreEnableI "" VALUE 0x0 /* @MemoryAddress@P_LongCtrl_VLCAxTarDtThreEnableI@ */ Scalar_FLOAT32_IEEE 0 PubIfControlLONC_MDL_CM_single_m_s_3 0.0 5.0 /end CHARACTERISTIC
/begin CHARACTERISTIC P_LongCtrl_VLCCounterAxvTracMinTimeout "" VALUE 0x0 /* @MemoryAddress@P_LongCtrl_VLCCounterAxvTracMinTimeout@ */ Scalar_FLOAT32_IEEE 0 PubIfControlLONC_MDL_CM_single 0.0 100.0 /end CHARACTERISTIC
/begin CHARACTERISTIC P_LongCtrl_VLCCounterDC2ECTorqDelay "" VALUE 0x0 /* @MemoryAddress@P_LongCtrl_VLCCounterDC2ECTorqDelay@ */ Scalar_FLOAT32_IEEE 0 PubIfControlLONC_MDL_CM_single 0.0 100.0 /end CHARACTERISTIC
/begin CHARACTERISTIC P_LongCtrl_VLCCounterDrvOff2EC "" VALUE 0x0 /* @MemoryAddress@P_LongCtrl_VLCCounterDrvOff2EC@ */ Scalar_FLOAT32_IEEE 0 PubIfControlLONC_MDL_CM_single 0.0 100.0 /end CHARACTERISTIC
/begin CHARACTERISTIC P_LongCtrl_VLCDtAxvRef2UpperBandDC5 "" VALUE 0x0 /* @MemoryAddress@P_LongCtrl_VLCDtAxvRef2UpperBandDC5@ */ Scalar_FLOAT32_IEEE 0 PubIfControlLONC_MDL_CM_single -1.0 1.0 /end CHARACTERISTIC
/begin CHARACTERISTIC P_LongCtrl_VLCIACompensionNeg "" VALUE 0x0 /* @MemoryAddress@P_LongCtrl_VLCIACompensionNeg@ */ Scalar_FLOAT32_IEEE 0 PubIfControlLONC_MDL_CM_single_m_s_2 -3.0 0.0 /end CHARACTERISTIC
/begin CHARACTERISTIC P_LongCtrl_VLCIACompensionPos "" VALUE 0x0 /* @MemoryAddress@P_LongCtrl_VLCIACompensionPos@ */ Scalar_FLOAT32_IEEE 0 PubIfControlLONC_MDL_CM_single_m_s_2 0.0 3.0 /end CHARACTERISTIC
/begin CHARACTERISTIC P_LongCtrl_VLCLowerJerkCounterDrvOff2EC "" VALUE 0x0 /* @MemoryAddress@P_LongCtrl_VLCLowerJerkCounterDrvOff2EC@ */ Scalar_FLOAT32_IEEE 0 PubIfControlLONC_MDL_CM_single_m_s_3 -4.0 4.0 /end CHARACTERISTIC
/begin CHARACTERISTIC P_LongCtrl_VLCTorqDiffThreAxvTracMinTimeout "" VALUE 0x0 /* @MemoryAddress@P_LongCtrl_VLCTorqDiffThreAxvTracMinTimeout@ */ Scalar_FLOAT32_IEEE 0 PubIfControlLONC_MDL_CM_single 0.0 20.0 /end CHARACTERISTIC
/begin CHARACTERISTIC P_LongCtrl_VLCUpperJerkCounterDrvOff2EC "" VALUE 0x0 /* @MemoryAddress@P_LongCtrl_VLCUpperJerkCounterDrvOff2EC@ */ Scalar_FLOAT32_IEEE 0 PubIfControlLONC_MDL_CM_single_m_s_3 -4.0 4.0 /end CHARACTERISTIC
/begin CHARACTERISTIC P_LongCtrl_VLCVlcAccThresAxvTracMinTimeout "" VALUE 0x0 /* @MemoryAddress@P_LongCtrl_VLCVlcAccThresAxvTracMinTimeout@ */ Scalar_FLOAT32_IEEE 0 PubIfControlLONC_MDL_CM_single_m_s_2 -5.0 2.0 /end CHARACTERISTIC
/begin CHARACTERISTIC P_LongCtrl_VLC_WindArea "" VALUE 0x0 /* @MemoryAddress@P_LongCtrl_VLC_WindArea@ */ Scalar_FLOAT32_IEEE 0 PubIfControlLONC_MDL_CM_single_m_2 -3.4E+38 3.4E+38 /end CHARACTERISTIC
/begin CHARACTERISTIC P_LongCtrl_VLC_fRollCoef "" VALUE 0x0 /* @MemoryAddress@P_LongCtrl_VLC_fRollCoef@ */ Scalar_FLOAT32_IEEE 0 PubIfControlLONC_MDL_CM_single -3.4E+38 3.4E+38 /end CHARACTERISTIC
/begin CHARACTERISTIC P_LongCtrl_VLCaDiffCharCoefKiXAxis "" VAL_BLK 0x0 /* @MemoryAddress@P_LongCtrl_VLCaDiffCharCoefKiXAxis@ */ Scalar_FLOAT32_IEEE 0 PubIfControlLONC_MDL_CM_single_m_s_2 -5.0 5.0 MATRIX_DIM 1 11 1 /end CHARACTERISTIC
/begin CHARACTERISTIC P_LongCtrl_VLCaDtThresUpdateTorq "" VALUE 0x0 /* @MemoryAddress@P_LongCtrl_VLCaDtThresUpdateTorq@ */ Scalar_FLOAT32_IEEE 0 PubIfControlLONC_MDL_CM_single_m_s_3 0.0 10.0 /end CHARACTERISTIC
/begin CHARACTERISTIC P_LongCtrl_VLCaxDtCharAxCtrlDevTresAddDC2ECXAxis "" VAL_BLK 0x0 /* @MemoryAddress@P_LongCtrl_VLCaxDtCharAxCtrlDevTresAddDC2ECXAxis@ */ Scalar_FLOAT32_IEEE 0 PubIfControlLONC_MDL_CM_single_m_s_3 0.0 2.0 MATRIX_DIM 1 5 1 /end CHARACTERISTIC
/begin CHARACTERISTIC P_LongCtrl_VLCaxDtCharAxCtrlDevTresAddEC2DCXAxis "" VAL_BLK 0x0 /* @MemoryAddress@P_LongCtrl_VLCaxDtCharAxCtrlDevTresAddEC2DCXAxis@ */ Scalar_FLOAT32_IEEE 0 PubIfControlLONC_MDL_CM_single_m_s_2 -2.0 1.0 MATRIX_DIM 1 5 1 /end CHARACTERISTIC
/begin CHARACTERISTIC P_LongCtrl_VLCaxvRoadSlopeDC4CharXAxis "" VAL_BLK 0x0 /* @MemoryAddress@P_LongCtrl_VLCaxvRoadSlopeDC4CharXAxis@ */ Scalar_FLOAT32_IEEE 0 PubIfControlLONC_MDL_CM_single_m_s_2 -4.0 1.0 MATRIX_DIM 1 5 1 /end CHARACTERISTIC
/begin CHARACTERISTIC P_LongCtrl_VLCaxvRoadSlopeDC4CharYAxis "" VAL_BLK 0x0 /* @MemoryAddress@P_LongCtrl_VLCaxvRoadSlopeDC4CharYAxis@ */ Scalar_FLOAT32_IEEE 0 PubIfControlLONC_MDL_CM_single 0.0 1.0 MATRIX_DIM 1 5 1 /end CHARACTERISTIC
/begin CHARACTERISTIC P_LongCtrl_VLCcoefIFadeOut1Calc "" VALUE 0x0 /* @MemoryAddress@P_LongCtrl_VLCcoefIFadeOut1Calc@ */ Scalar_FLOAT32_IEEE 0 PubIfControlLONC_MDL_CM_single 1.0 10.0 /end CHARACTERISTIC
/begin CHARACTERISTIC P_LongCtrl_VLCcoefIFadeOut1Condition "" VALUE 0x0 /* @MemoryAddress@P_LongCtrl_VLCcoefIFadeOut1Condition@ */ Scalar_FLOAT32_IEEE 0 PubIfControlLONC_MDL_CM_single 0.0 1.0 /end CHARACTERISTIC
/begin CHARACTERISTIC P_LongCtrl_VLCcoefIFadeOut2Calc "" VALUE 0x0 /* @MemoryAddress@P_LongCtrl_VLCcoefIFadeOut2Calc@ */ Scalar_FLOAT32_IEEE 0 PubIfControlLONC_MDL_CM_single 1.0 10.0 /end CHARACTERISTIC
/begin CHARACTERISTIC P_LongCtrl_VLCcoefIFadeOut2Condition "" VALUE 0x0 /* @MemoryAddress@P_LongCtrl_VLCcoefIFadeOut2Condition@ */ Scalar_FLOAT32_IEEE 0 PubIfControlLONC_MDL_CM_single 0.0 1.0 /end CHARACTERISTIC
/begin CHARACTERISTIC P_LongCtrl_VLCcoefIFadeOut3Calc "" VALUE 0x0 /* @MemoryAddress@P_LongCtrl_VLCcoefIFadeOut3Calc@ */ Scalar_FLOAT32_IEEE 0 PubIfControlLONC_MDL_CM_single 1.0 10.0 /end CHARACTERISTIC
/begin CHARACTERISTIC P_LongCtrl_VLCcoefIFadeOut3Condition "" VALUE 0x0 /* @MemoryAddress@P_LongCtrl_VLCcoefIFadeOut3Condition@ */ Scalar_FLOAT32_IEEE 0 PubIfControlLONC_MDL_CM_single 0.0 1.0 /end CHARACTERISTIC
/begin CHARACTERISTIC P_LongCtrl_VLCvelCharAxCtrlDevDeadZoneXAxis "" VAL_BLK 0x0 /* @MemoryAddress@P_LongCtrl_VLCvelCharAxCtrlDevDeadZoneXAxis@ */ Scalar_FLOAT32_IEEE 0 PubIfControlLONC_MDL_CM_single_km_h 0.0 250.0 MATRIX_DIM 1 5 1 /end CHARACTERISTIC
/begin CHARACTERISTIC P_LongCtrl_VLCvelThresUpdateTorq "" VALUE 0x0 /* @MemoryAddress@P_LongCtrl_VLCvelThresUpdateTorq@ */ Scalar_FLOAT32_IEEE 0 PubIfControlLONC_MDL_CM_single_km_h 0.0 30.0 /end CHARACTERISTIC
/begin CHARACTERISTIC P_LongCtrl_VxvRefThrd "m/s" VALUE 0x0 /* @MemoryAddress@P_LongCtrl_VxvRefThrd@ */ Scalar_FLOAT32_IEEE 0 PubIfControlLONC_MDL_CM_single -3.4E+38 3.4E+38 /end CHARACTERISTIC
/begin CHARACTERISTIC P_LongCtrl_SlideFlagEnable "" VALUE 0x0 /* @MemoryAddress@P_LongCtrl_SlideFlagEnable@ */ Scalar_BOOLEAN 0 PubIfControlLONC_MDL_CM_boolean 0 1 BIT_MASK 0x01 /end CHARACTERISTIC
/begin AXIS_PTS P_LongCtrl_VLCaccelMinHoldXAxis "" 0x0 /* @MemoryAddress@P_LongCtrl_VLCaccelMinHoldXAxis@ */ LongCtrl_axvRoadSlopeMs2 Lookup1D_X_FLOAT32_IEEE 0 PubIfControlLONC_MDL_CM_single_m_s_2 2 0.0 5.0 /end AXIS_PTS
/begin AXIS_PTS P_LongCtrl_VLCjerkHoldXAxis "" 0x0 /* @MemoryAddress@P_LongCtrl_VLCjerkHoldXAxis@ */ LongCtrl_axvRoadSlopeMs2 Lookup1D_X_FLOAT32_IEEE 0 PubIfControlLONC_MDL_CM_single_m_s_2 2 0.0 4.0 /end AXIS_PTS
/begin AXIS_PTS P_LongCtrl_VLCaccelMinSlidHoldXAxis "m/s^2" 0x0 /* @MemoryAddress@P_LongCtrl_VLCaccelMinSlidHoldXAxis@ */ LongCtrl_axvRoadSlopeMs2 Lookup1D_X_FLOAT32_IEEE 0 PubIfControlLONC_MDL_CM_single 7 -3.4E+38 3.4E+38 /end AXIS_PTS
/begin AXIS_PTS P_LongCtrl_VLCjerkSlidHoldXAxis "m/s^2" 0x0 /* @MemoryAddress@P_LongCtrl_VLCjerkSlidHoldXAxis@ */ LongCtrl_axvRoadSlopeMs2 Lookup1D_X_FLOAT32_IEEE 0 PubIfControlLONC_MDL_CM_single 7 -3.4E+38 3.4E+38 /end AXIS_PTS
/begin AXIS_PTS P_LongCtrl_VLCvelCharCoefPIXAxis "" 0x0 /* @MemoryAddress@P_LongCtrl_VLCvelCharCoefPIXAxis@ */ NO_INPUT_QUANTITY Lookup1D_X_FLOAT32_IEEE 0 PubIfControlLONC_MDL_CM_single_km_h 4 0.0 30.0 /end AXIS_PTS
/begin AXIS_PTS P_LongCtrl_VLCtorqCharEngInverseEfficientXAxis "" 0x0 /* @MemoryAddress@P_LongCtrl_VLCtorqCharEngInverseEfficientXAxis@ */ NO_INPUT_QUANTITY Lookup1D_X_FLOAT32_IEEE 0 PubIfControlLONC_MDL_CM_single__ 5 -150.0 110.0 /end AXIS_PTS
/begin AXIS_PTS P_LongCtrl_VLCdiffDtCharCoefKiEnlargeXAxis "" 0x0 /* @MemoryAddress@P_LongCtrl_VLCdiffDtCharCoefKiEnlargeXAxis@ */ NO_INPUT_QUANTITY Lookup1D_X_FLOAT32_IEEE 0 PubIfControlLONC_MDL_CM_single_m_s_3 6 -10.0 20.0 /end AXIS_PTS
/begin AXIS_PTS P_LongCtrl_VLCaDiffCharCoefKiEnableXAxis "" 0x0 /* @MemoryAddress@P_LongCtrl_VLCaDiffCharCoefKiEnableXAxis@ */ LongCtrl_axvDiff Lookup1D_X_FLOAT32_IEEE 0 PubIfControlLONC_MDL_CM_single_m_s_2 6 -10.0 20.0 /end AXIS_PTS
/begin AXIS_PTS P_LongCtrl_VLCAxvTracMinDC1FullFillXAxis "" 0x0 /* @MemoryAddress@P_LongCtrl_VLCAxvTracMinDC1FullFillXAxis@ */ LongCtrl_vxvRefMs Lookup1D_X_FLOAT32_IEEE 0 PubIfControlLONC_MDL_CM_single_m_s 4 0.0 60.0 /end AXIS_PTS
/begin AXIS_PTS P_LongCtrl_VLCtorqCharEngEfficientXAxis "" 0x0 /* @MemoryAddress@P_LongCtrl_VLCtorqCharEngEfficientXAxis@ */ NO_INPUT_QUANTITY Lookup1D_X_FLOAT32_IEEE 0 PubIfControlLONC_MDL_CM_single__ 5 -100.0 100.0 /end AXIS_PTS
/begin AXIS_PTS P_LongCtrl_VLCcoefFXAxis "" 0x0 /* @MemoryAddress@P_LongCtrl_VLCcoefFXAxis@ */ NO_INPUT_QUANTITY Lookup1D_X_FLOAT32_IEEE 0 PubIfControlLONC_MDL_CM_single_km_h 10 0.0 250.0 /end AXIS_PTS
/begin CHARACTERISTIC P_Global_DxvRearBumper_m "后轴中心到后杠后边缘中心的X向位置" VALUE 0x0 /* @MemoryAddress@P_Global_DxvRearBumper_m@ */ Scalar_FLOAT32_IEEE 0 PubIfDecisionPLAN_MDL_CM_single_m -3.4E+38 3.4E+38 /end CHARACTERISTIC
/begin CHARACTERISTIC P_VSM_HOD_Handson_TimeInsertPoint "" CURVE 0x0 /* @MemoryAddress@P_VSM_HOD_Handson_TimeInsertPoint@ */ Lookup1D_FLOAT32_IEEE 0 PubIfStateVSM_MDL_CM_single -3.4E+38 3.4E+38
 /begin AXIS_DESCR COM_AXIS VSM_HOD_DrvTrqFilted PubIfStateVSM_MDL_CM_single 5 -3.4E+38 3.4E+38 AXIS_PTS_REF P_VSM_HOD_Handson_TrqInsertPoint /end AXIS_DESCR
/end CHARACTERISTIC
/begin CHARACTERISTIC P_VSM_ESS_SpdTime_s "" CURVE 0x0 /* @MemoryAddress@P_VSM_ESS_SpdTime_s@ */ Lookup1D_FLOAT32_IEEE 0 PubIfStateVSM_MDL_CM_single -3.4E+38 3.4E+38
 /begin AXIS_DESCR COM_AXIS NO_INPUT_QUANTITY PubIfStateVSM_MDL_CM_single 6 -3.4E+38 3.4E+38 AXIS_PTS_REF P_VSM_ESS_SpdPoint_kmh /end AXIS_DESCR
/end CHARACTERISTIC
/begin CHARACTERISTIC P_VSM_ESS_AngleSpdTable_deg "" CURVE 0x0 /* @MemoryAddress@P_VSM_ESS_AngleSpdTable_deg@ */ Lookup1D_FLOAT32_IEEE 0 PubIfStateVSM_MDL_CM_single -3.4E+38 3.4E+38
 /begin AXIS_DESCR COM_AXIS NO_INPUT_QUANTITY PubIfStateVSM_MDL_CM_single 6 -3.4E+38 3.4E+38 AXIS_PTS_REF P_VSM_ESS_SpdPoint_kmh /end AXIS_DESCR
/end CHARACTERISTIC
/begin CHARACTERISTIC P_VSM_ESS_MaxLateral_mss "" CURVE 0x0 /* @MemoryAddress@P_VSM_ESS_MaxLateral_mss@ */ Lookup1D_FLOAT32_IEEE 0 PubIfStateVSM_MDL_CM_single -3.4E+38 3.4E+38
 /begin AXIS_DESCR COM_AXIS NO_INPUT_QUANTITY PubIfStateVSM_MDL_CM_single 6 -3.4E+38 3.4E+38 AXIS_PTS_REF P_VSM_ESS_IPSpeed_kmh /end AXIS_DESCR
/end CHARACTERISTIC
/begin CHARACTERISTIC P_VSM_ESS_SteerWheelSpd_Param "" CURVE 0x0 /* @MemoryAddress@P_VSM_ESS_SteerWheelSpd_Param@ */ Lookup1D_FLOAT32_IEEE 0 PubIfStateVSM_MDL_CM_single -3.4E+38 3.4E+38
 /begin AXIS_DESCR COM_AXIS NO_INPUT_QUANTITY PubIfStateVSM_MDL_CM_single 6 -3.4E+38 3.4E+38 AXIS_PTS_REF P_VSM_ESS_SteerWheelSpd_BP /end AXIS_DESCR
/end CHARACTERISTIC
/begin CHARACTERISTIC P_VSM_ESS_DriveIn "" CURVE 0x0 /* @MemoryAddress@P_VSM_ESS_DriveIn@ */ Lookup1D_FLOAT32_IEEE 0 PubIfStateVSM_MDL_CM_single -3.4E+38 3.4E+38
 /begin AXIS_DESCR COM_AXIS NO_INPUT_QUANTITY PubIfStateVSM_MDL_CM_single 6 -3.4E+38 3.4E+38 AXIS_PTS_REF P_VSM_ESS_DriveIn_BP /end AXIS_DESCR
/end CHARACTERISTIC
/begin CHARACTERISTIC P_VSM_ESS_DriverInputTrq_Param "" CURVE 0x0 /* @MemoryAddress@P_VSM_ESS_DriverInputTrq_Param@ */ Lookup1D_FLOAT32_IEEE 0 PubIfStateVSM_MDL_CM_single -3.4E+38 3.4E+38
 /begin AXIS_DESCR COM_AXIS NO_INPUT_QUANTITY PubIfStateVSM_MDL_CM_single 6 -3.4E+38 3.4E+38 AXIS_PTS_REF P_VSM_ESS_DriveIn_BP /end AXIS_DESCR
/end CHARACTERISTIC
/begin CHARACTERISTIC P_VSM_LCKIE_Laneoffset "" CURVE 0x0 /* @MemoryAddress@P_VSM_LCKIE_Laneoffset@ */ Lookup1D_FLOAT32_IEEE 0 PubIfStateVSM_MDL_CM_single -3.4E+38 3.4E+38
 /begin AXIS_DESCR COM_AXIS NO_INPUT_QUANTITY PubIfStateVSM_MDL_CM_single 5 -3.4E+38 3.4E+38 AXIS_PTS_REF P_VSM_LCKIE_Laneoffset_BP /end AXIS_DESCR
/end CHARACTERISTIC
/begin CHARACTERISTIC P_VSM_LKA_State_Param_LaneCurve "" VAL_BLK 0x0 /* @MemoryAddress@P_VSM_LKA_State_Param_LaneCurve@ */ Scalar_FLOAT64_IEEE 0 PubIfStateVSM_MDL_CM_double -1.7E+308 1.7E+308 MATRIX_DIM 1 4 1 /end CHARACTERISTIC
/begin CHARACTERISTIC P_VSM_LKA_State_Param_LaneCurve_Offset "" VAL_BLK 0x0 /* @MemoryAddress@P_VSM_LKA_State_Param_LaneCurve_Offset@ */ Scalar_FLOAT64_IEEE 0 PubIfStateVSM_MDL_CM_double -1.7E+308 1.7E+308 MATRIX_DIM 1 4 1 /end CHARACTERISTIC
/begin CHARACTERISTIC P_VSM_NOH_Swt_Req_SW "" VALUE 0x0 /* @MemoryAddress@P_VSM_NOH_Swt_Req_SW@ */ Scalar_FLOAT64_IEEE 0 PubIfStateVSM_MDL_CM_double -1.7E+308 1.7E+308 /end CHARACTERISTIC
/begin CHARACTERISTIC P_VSM_SOSSpdLimit "" VALUE 0x0 /* @MemoryAddress@P_VSM_SOSSpdLimit@ */ Scalar_FLOAT64_IEEE 0 PubIfStateVSM_MDL_CM_double -1.7E+308 1.7E+308 /end CHARACTERISTIC
/begin CHARACTERISTIC P_Global_VehicleWidthMin_m "最小车宽" VALUE 0x0 /* @MemoryAddress@P_Global_VehicleWidthMin_m@ */ Scalar_FLOAT32_IEEE 0 PubIfStateVSM_MDL_CM_single_m -3.4E+38 3.4E+38 /end CHARACTERISTIC
/begin CHARACTERISTIC P_VSM_ACC_BOMEntry_ACCDecReqValue "" VALUE 0x0 /* @MemoryAddress@P_VSM_ACC_BOMEntry_ACCDecReqValue@ */ Scalar_FLOAT32_IEEE 0 PubIfStateVSM_MDL_CM_single -2.0 0.0 /end CHARACTERISTIC
/begin CHARACTERISTIC P_VSM_ACC_BOMEntry_AxvRefMs2 "" VALUE 0x0 /* @MemoryAddress@P_VSM_ACC_BOMEntry_AxvRefMs2@ */ Scalar_FLOAT32_IEEE 0 PubIfStateVSM_MDL_CM_single -2.0 0.0 /end CHARACTERISTIC
/begin CHARACTERISTIC P_VSM_ACC_BOMExit_ACCDecReqValue "" VALUE 0x0 /* @MemoryAddress@P_VSM_ACC_BOMExit_ACCDecReqValue@ */ Scalar_FLOAT32_IEEE 0 PubIfStateVSM_MDL_CM_single -2.0 0.0 /end CHARACTERISTIC
/begin CHARACTERISTIC P_VSM_ACC_RadarOffset "" VALUE 0x0 /* @MemoryAddress@P_VSM_ACC_RadarOffset@ */ Scalar_FLOAT32_IEEE 0 PubIfStateVSM_MDL_CM_single -3.4E+38 3.4E+38 /end CHARACTERISTIC
/begin CHARACTERISTIC P_VSM_ELK_Lane_Width_Table "" VAL_BLK 0x0 /* @MemoryAddress@P_VSM_ELK_Lane_Width_Table@ */ Scalar_FLOAT32_IEEE 0 PubIfStateVSM_MDL_CM_single -3.4E+38 3.4E+38 MATRIX_DIM 1 7 1 /end CHARACTERISTIC
/begin CHARACTERISTIC P_VSM_ELK_Lane_Width_Table_Calibration "" VAL_BLK 0x0 /* @MemoryAddress@P_VSM_ELK_Lane_Width_Table_Calibration@ */ Scalar_FLOAT32_IEEE 0 PubIfStateVSM_MDL_CM_single -3.4E+38 3.4E+38 MATRIX_DIM 1 7 1 /end CHARACTERISTIC
/begin CHARACTERISTIC P_VSM_ELK_Sensitive_Table "" VAL_BLK 0x0 /* @MemoryAddress@P_VSM_ELK_Sensitive_Table@ */ Scalar_FLOAT32_IEEE 0 PubIfStateVSM_MDL_CM_single -3.4E+38 3.4E+38 MATRIX_DIM 1 3 1 /end CHARACTERISTIC
/begin CHARACTERISTIC P_VSM_ELK_Sensitive_Table_Calibration "" VAL_BLK 0x0 /* @MemoryAddress@P_VSM_ELK_Sensitive_Table_Calibration@ */ Scalar_FLOAT32_IEEE 0 PubIfStateVSM_MDL_CM_single -3.4E+38 3.4E+38 MATRIX_DIM 1 3 1 /end CHARACTERISTIC
/begin CHARACTERISTIC P_VSM_ELK_State_Absesp_enable "" VALUE 0x0 /* @MemoryAddress@P_VSM_ELK_State_Absesp_enable@ */ Scalar_FLOAT32_IEEE 0 PubIfStateVSM_MDL_CM_single -3.4E+38 3.4E+38 /end CHARACTERISTIC
/begin CHARACTERISTIC P_VSM_ELK_State_Accpedalrate_enable "" VALUE 0x0 /* @MemoryAddress@P_VSM_ELK_State_Accpedalrate_enable@ */ Scalar_FLOAT32_IEEE 0 PubIfStateVSM_MDL_CM_single -3.4E+38 3.4E+38 /end CHARACTERISTIC
/begin CHARACTERISTIC P_VSM_ELK_State_Breakpressure_enable "" VALUE 0x0 /* @MemoryAddress@P_VSM_ELK_State_Breakpressure_enable@ */ Scalar_FLOAT32_IEEE 0 PubIfStateVSM_MDL_CM_single -3.4E+38 3.4E+38 /end CHARACTERISTIC
/begin CHARACTERISTIC P_VSM_ELK_State_DriverInputTrqValue_enable "" VALUE 0x0 /* @MemoryAddress@P_VSM_ELK_State_DriverInputTrqValue_enable@ */ Scalar_FLOAT32_IEEE 0 PubIfStateVSM_MDL_CM_single -3.4E+38 3.4E+38 /end CHARACTERISTIC
/begin CHARACTERISTIC P_VSM_ELK_State_ESSSts_enable "" VALUE 0x0 /* @MemoryAddress@P_VSM_ELK_State_ESSSts_enable@ */ Scalar_FLOAT32_IEEE 0 PubIfStateVSM_MDL_CM_single -3.4E+38 3.4E+38 /end CHARACTERISTIC
/begin CHARACTERISTIC P_VSM_ELK_State_Eps_enable "" VALUE 0x0 /* @MemoryAddress@P_VSM_ELK_State_Eps_enable@ */ Scalar_FLOAT32_IEEE 0 PubIfStateVSM_MDL_CM_single -3.4E+38 3.4E+38 /end CHARACTERISTIC
/begin CHARACTERISTIC P_VSM_ELK_State_Failsafe_enable "" VALUE 0x0 /* @MemoryAddress@P_VSM_ELK_State_Failsafe_enable@ */ Scalar_FLOAT32_IEEE 0 PubIfStateVSM_MDL_CM_single -3.4E+38 3.4E+38 /end CHARACTERISTIC
/begin CHARACTERISTIC P_VSM_ELK_State_GEAR_enable "" VALUE 0x0 /* @MemoryAddress@P_VSM_ELK_State_GEAR_enable@ */ Scalar_FLOAT32_IEEE 0 PubIfStateVSM_MDL_CM_single -3.4E+38 3.4E+38 /end CHARACTERISTIC
/begin CHARACTERISTIC P_VSM_ELK_State_Headingangle_enable "" VALUE 0x0 /* @MemoryAddress@P_VSM_ELK_State_Headingangle_enable@ */ Scalar_FLOAT32_IEEE 0 PubIfStateVSM_MDL_CM_single -3.4E+38 3.4E+38 /end CHARACTERISTIC
/begin CHARACTERISTIC P_VSM_ELK_State_LaneChange_enable "" VALUE 0x0 /* @MemoryAddress@P_VSM_ELK_State_LaneChange_enable@ */ Scalar_FLOAT32_IEEE 0 PubIfStateVSM_MDL_CM_single -3.4E+38 3.4E+38 /end CHARACTERISTIC
/begin CHARACTERISTIC P_VSM_ELK_State_Lane_enable "" VALUE 0x0 /* @MemoryAddress@P_VSM_ELK_State_Lane_enable@ */ Scalar_FLOAT32_IEEE 0 PubIfStateVSM_MDL_CM_single -3.4E+38 3.4E+38 /end CHARACTERISTIC
/begin CHARACTERISTIC P_VSM_ELK_State_Lanecurve_enable "" VALUE 0x0 /* @MemoryAddress@P_VSM_ELK_State_Lanecurve_enable@ */ Scalar_FLOAT32_IEEE 0 PubIfStateVSM_MDL_CM_single -3.4E+38 3.4E+38 /end CHARACTERISTIC
/begin CHARACTERISTIC P_VSM_ELK_State_LateralAcce_enable "" VALUE 0x0 /* @MemoryAddress@P_VSM_ELK_State_LateralAcce_enable@ */ Scalar_FLOAT32_IEEE 0 PubIfStateVSM_MDL_CM_single -3.4E+38 3.4E+38 /end CHARACTERISTIC
/begin CHARACTERISTIC P_VSM_ELK_State_LongitudeAcc_enable "" VALUE 0x0 /* @MemoryAddress@P_VSM_ELK_State_LongitudeAcc_enable@ */ Scalar_FLOAT32_IEEE 0 PubIfStateVSM_MDL_CM_single -3.4E+38 3.4E+38 /end CHARACTERISTIC
/begin CHARACTERISTIC P_VSM_ELK_State_Overide_enable "" VALUE 0x0 /* @MemoryAddress@P_VSM_ELK_State_Overide_enable@ */ Scalar_FLOAT32_IEEE 0 PubIfStateVSM_MDL_CM_single -3.4E+38 3.4E+38 /end CHARACTERISTIC
/begin CHARACTERISTIC P_VSM_ELK_State_Param_AngleOffset "" VALUE 0x0 /* @MemoryAddress@P_VSM_ELK_State_Param_AngleOffset@ */ Scalar_FLOAT32_IEEE 0 PubIfStateVSM_MDL_CM_single -3.4E+38 3.4E+38 /end CHARACTERISTIC
/begin CHARACTERISTIC P_VSM_ELK_State_Param_OnTime "" VAL_BLK 0x0 /* @MemoryAddress@P_VSM_ELK_State_Param_OnTime@ */ Scalar_FLOAT32_IEEE 0 PubIfStateVSM_MDL_CM_single -3.4E+38 3.4E+38 MATRIX_DIM 1 16 1 /end CHARACTERISTIC
/begin CHARACTERISTIC P_VSM_ELK_State_Param_Oncoming "" VALUE 0x0 /* @MemoryAddress@P_VSM_ELK_State_Param_Oncoming@ */ Scalar_FLOAT32_IEEE 0 PubIfStateVSM_MDL_CM_single -3.4E+38 3.4E+38 /end CHARACTERISTIC
/begin CHARACTERISTIC P_VSM_ELK_State_Param_OutOffset "" VALUE 0x0 /* @MemoryAddress@P_VSM_ELK_State_Param_OutOffset@ */ Scalar_FLOAT32_IEEE 0 PubIfStateVSM_MDL_CM_single -3.4E+38 3.4E+38 /end CHARACTERISTIC
/begin CHARACTERISTIC P_VSM_ELK_State_Param_OvTime "" VAL_BLK 0x0 /* @MemoryAddress@P_VSM_ELK_State_Param_OvTime@ */ Scalar_FLOAT32_IEEE 0 PubIfStateVSM_MDL_CM_single -3.4E+38 3.4E+38 MATRIX_DIM 1 16 1 /end CHARACTERISTIC
/begin CHARACTERISTIC P_VSM_ELK_State_Param_Over "" VALUE 0x0 /* @MemoryAddress@P_VSM_ELK_State_Param_Over@ */ Scalar_FLOAT32_IEEE 0 PubIfStateVSM_MDL_CM_single -3.4E+38 3.4E+38 /end CHARACTERISTIC
/begin CHARACTERISTIC P_VSM_ELK_State_Param_Speed "" VAL_BLK 0x0 /* @MemoryAddress@P_VSM_ELK_State_Param_Speed@ */ Scalar_FLOAT32_IEEE 0 PubIfStateVSM_MDL_CM_single -3.4E+38 3.4E+38 MATRIX_DIM 1 16 1 /end CHARACTERISTIC
/begin CHARACTERISTIC P_VSM_ELK_State_SteerWheelAngle_enable "" VALUE 0x0 /* @MemoryAddress@P_VSM_ELK_State_SteerWheelAngle_enable@ */ Scalar_FLOAT32_IEEE 0 PubIfStateVSM_MDL_CM_single -3.4E+38 3.4E+38 /end CHARACTERISTIC
/begin CHARACTERISTIC P_VSM_ELK_State_SteerWheelSpd_enable "" VALUE 0x0 /* @MemoryAddress@P_VSM_ELK_State_SteerWheelSpd_enable@ */ Scalar_FLOAT32_IEEE 0 PubIfStateVSM_MDL_CM_single -3.4E+38 3.4E+38 /end CHARACTERISTIC
/begin CHARACTERISTIC P_VSM_ELK_State_Vehspeed_enable "" VALUE 0x0 /* @MemoryAddress@P_VSM_ELK_State_Vehspeed_enable@ */ Scalar_FLOAT32_IEEE 0 PubIfStateVSM_MDL_CM_single -3.4E+38 3.4E+38 /end CHARACTERISTIC
/begin CHARACTERISTIC P_VSM_ELK_State_Yawsup_enable "" VALUE 0x0 /* @MemoryAddress@P_VSM_ELK_State_Yawsup_enable@ */ Scalar_FLOAT32_IEEE 0 PubIfStateVSM_MDL_CM_single -3.4E+38 3.4E+38 /end CHARACTERISTIC
/begin CHARACTERISTIC P_VSM_ESS_ACtiveTime "" VALUE 0x0 /* @MemoryAddress@P_VSM_ESS_ACtiveTime@ */ Scalar_FLOAT32_IEEE 0 PubIfStateVSM_MDL_CM_single -3.4E+38 3.4E+38 /end CHARACTERISTIC
/begin CHARACTERISTIC P_VSM_ESS_AccPedlPosn_Param "" VALUE 0x0 /* @MemoryAddress@P_VSM_ESS_AccPedlPosn_Param@ */ Scalar_FLOAT32_IEEE 0 PubIfStateVSM_MDL_CM_single -3.4E+38 3.4E+38 /end CHARACTERISTIC
/begin CHARACTERISTIC P_VSM_ESS_DangerPlausLeft "" VALUE 0x0 /* @MemoryAddress@P_VSM_ESS_DangerPlausLeft@ */ Scalar_FLOAT32_IEEE 0 PubIfStateVSM_MDL_CM_single -3.4E+38 3.4E+38 /end CHARACTERISTIC
/begin CHARACTERISTIC P_VSM_ESS_DangerPlausRight "" VALUE 0x0 /* @MemoryAddress@P_VSM_ESS_DangerPlausRight@ */ Scalar_FLOAT32_IEEE 0 PubIfStateVSM_MDL_CM_single -3.4E+38 3.4E+38 /end CHARACTERISTIC
/begin CHARACTERISTIC P_VSM_ESS_DelayTime "" VALUE 0x0 /* @MemoryAddress@P_VSM_ESS_DelayTime@ */ Scalar_FLOAT32_IEEE 0 PubIfStateVSM_MDL_CM_single -3.4E+38 3.4E+38 /end CHARACTERISTIC
/begin CHARACTERISTIC P_VSM_ESS_DrvOverTime_Param "" VALUE 0x0 /* @MemoryAddress@P_VSM_ESS_DrvOverTime_Param@ */ Scalar_FLOAT32_IEEE 0 PubIfStateVSM_MDL_CM_single -3.4E+38 3.4E+38 /end CHARACTERISTIC
/begin CHARACTERISTIC P_VSM_ESS_LgtAccelLower_Param "" VALUE 0x0 /* @MemoryAddress@P_VSM_ESS_LgtAccelLower_Param@ */ Scalar_FLOAT32_IEEE 0 PubIfStateVSM_MDL_CM_single -3.4E+38 3.4E+38 /end CHARACTERISTIC
/begin CHARACTERISTIC P_VSM_ESS_LgtAccelUpper_Param "" VALUE 0x0 /* @MemoryAddress@P_VSM_ESS_LgtAccelUpper_Param@ */ Scalar_FLOAT32_IEEE 0 PubIfStateVSM_MDL_CM_single -3.4E+38 3.4E+38 /end CHARACTERISTIC
/begin CHARACTERISTIC P_VSM_ESS_MasterCylindBrake "" VALUE 0x0 /* @MemoryAddress@P_VSM_ESS_MasterCylindBrake@ */ Scalar_FLOAT32_IEEE 0 PubIfStateVSM_MDL_CM_single -3.4E+38 3.4E+38 /end CHARACTERISTIC
/begin CHARACTERISTIC P_VSM_ESS_SafeDistance_m "" VALUE 0x0 /* @MemoryAddress@P_VSM_ESS_SafeDistance_m@ */ Scalar_FLOAT32_IEEE 0 PubIfStateVSM_MDL_CM_single -3.4E+38 3.4E+38 /end CHARACTERISTIC
/begin CHARACTERISTIC P_VSM_ESS_StopA0_Param "" VALUE 0x0 /* @MemoryAddress@P_VSM_ESS_StopA0_Param@ */ Scalar_FLOAT32_IEEE 0 PubIfStateVSM_MDL_CM_single -3.4E+38 3.4E+38 /end CHARACTERISTIC
/begin CHARACTERISTIC P_VSM_ESS_StopA1Time_Param "" VALUE 0x0 /* @MemoryAddress@P_VSM_ESS_StopA1Time_Param@ */ Scalar_FLOAT32_IEEE 0 PubIfStateVSM_MDL_CM_single -3.4E+38 3.4E+38 /end CHARACTERISTIC
/begin CHARACTERISTIC P_VSM_ESS_StopA1_Param "" VALUE 0x0 /* @MemoryAddress@P_VSM_ESS_StopA1_Param@ */ Scalar_FLOAT32_IEEE 0 PubIfStateVSM_MDL_CM_single -3.4E+38 3.4E+38 /end CHARACTERISTIC
/begin CHARACTERISTIC P_VSM_HOD_DrvTrqFlterTIme "" VALUE 0x0 /* @MemoryAddress@P_VSM_HOD_DrvTrqFlterTIme@ */ Scalar_FLOAT32_IEEE 0 PubIfStateVSM_MDL_CM_single -3.4E+38 3.4E+38 /end CHARACTERISTIC
/begin CHARACTERISTIC P_VSM_HOD_HWA_HandsOffLev1TimeCnt "" VALUE 0x0 /* @MemoryAddress@P_VSM_HOD_HWA_HandsOffLev1TimeCnt@ */ Scalar_FLOAT32_IEEE 0 PubIfStateVSM_MDL_CM_single -3.4E+38 3.4E+38 /end CHARACTERISTIC
/begin CHARACTERISTIC P_VSM_HOD_HWA_HandsOffLev2TimeCnt "" VALUE 0x0 /* @MemoryAddress@P_VSM_HOD_HWA_HandsOffLev2TimeCnt@ */ Scalar_FLOAT32_IEEE 0 PubIfStateVSM_MDL_CM_single -3.4E+38 3.4E+38 /end CHARACTERISTIC
/begin CHARACTERISTIC P_VSM_HOD_HWA_HandsOffLev3TimeCnt "" VALUE 0x0 /* @MemoryAddress@P_VSM_HOD_HWA_HandsOffLev3TimeCnt@ */ Scalar_FLOAT32_IEEE 0 PubIfStateVSM_MDL_CM_single -3.4E+38 3.4E+38 /end CHARACTERISTIC
/begin CHARACTERISTIC P_VSM_HOD_HWA_HandsOffLev4TimeCnt "" VALUE 0x0 /* @MemoryAddress@P_VSM_HOD_HWA_HandsOffLev4TimeCnt@ */ Scalar_FLOAT32_IEEE 0 PubIfStateVSM_MDL_CM_single -3.4E+38 3.4E+38 /end CHARACTERISTIC
/begin CHARACTERISTIC P_VSM_HOD_HandsOff_Tr "" VALUE 0x0 /* @MemoryAddress@P_VSM_HOD_HandsOff_Tr@ */ Scalar_FLOAT32_IEEE 0 PubIfStateVSM_MDL_CM_single -3.4E+38 3.4E+38 /end CHARACTERISTIC
/begin CHARACTERISTIC P_VSM_HOD_HandsOn_Tr "" VALUE 0x0 /* @MemoryAddress@P_VSM_HOD_HandsOn_Tr@ */ Scalar_FLOAT32_IEEE 0 PubIfStateVSM_MDL_CM_single -3.4E+38 3.4E+38 /end CHARACTERISTIC
/begin CHARACTERISTIC P_VSM_HOD_LCKTJA_HandsOffLev1TimeCnt "" VALUE 0x0 /* @MemoryAddress@P_VSM_HOD_LCKTJA_HandsOffLev1TimeCnt@ */ Scalar_FLOAT32_IEEE 0 PubIfStateVSM_MDL_CM_single -3.4E+38 3.4E+38 /end CHARACTERISTIC
/begin CHARACTERISTIC P_VSM_HOD_LCKTJA_HandsOffLev2TimeCnt "" VALUE 0x0 /* @MemoryAddress@P_VSM_HOD_LCKTJA_HandsOffLev2TimeCnt@ */ Scalar_FLOAT32_IEEE 0 PubIfStateVSM_MDL_CM_single -3.4E+38 3.4E+38 /end CHARACTERISTIC
/begin CHARACTERISTIC P_VSM_HOD_LCKTJA_HandsOffLev3TimeCnt "" VALUE 0x0 /* @MemoryAddress@P_VSM_HOD_LCKTJA_HandsOffLev3TimeCnt@ */ Scalar_FLOAT32_IEEE 0 PubIfStateVSM_MDL_CM_single -3.4E+38 3.4E+38 /end CHARACTERISTIC
/begin CHARACTERISTIC P_VSM_HOD_LCKTJA_HandsOffLev4TimeCnt "" VALUE 0x0 /* @MemoryAddress@P_VSM_HOD_LCKTJA_HandsOffLev4TimeCnt@ */ Scalar_FLOAT32_IEEE 0 PubIfStateVSM_MDL_CM_single -3.4E+38 3.4E+38 /end CHARACTERISTIC
/begin CHARACTERISTIC P_VSM_HWAActivation_NOAMOd_Spd "" VALUE 0x0 /* @MemoryAddress@P_VSM_HWAActivation_NOAMOd_Spd@ */ Scalar_FLOAT32_IEEE 0 PubIfStateVSM_MDL_CM_single -3.4E+38 3.4E+38 /end CHARACTERISTIC
/begin CHARACTERISTIC P_VSM_HWAActivation_Spd_Low "" VALUE 0x0 /* @MemoryAddress@P_VSM_HWAActivation_Spd_Low@ */ Scalar_FLOAT32_IEEE 0 PubIfStateVSM_MDL_CM_single -3.4E+38 3.4E+38 /end CHARACTERISTIC
/begin CHARACTERISTIC P_VSM_HWAActivation_Spd_Up "" VALUE 0x0 /* @MemoryAddress@P_VSM_HWAActivation_Spd_Up@ */ Scalar_FLOAT32_IEEE 0 PubIfStateVSM_MDL_CM_single -3.4E+38 3.4E+38 /end CHARACTERISTIC
/begin CHARACTERISTIC P_VSM_LDW_State_Param_LaneTime "" VAL_BLK 0x0 /* @MemoryAddress@P_VSM_LDW_State_Param_LaneTime@ */ Scalar_FLOAT32_IEEE 0 PubIfStateVSM_MDL_CM_single -3.4E+38 3.4E+38 MATRIX_DIM 1 16 1 /end CHARACTERISTIC
/begin CHARACTERISTIC P_VSM_LDW_State_Param_LaneWidth_Offset "" VAL_BLK 0x0 /* @MemoryAddress@P_VSM_LDW_State_Param_LaneWidth_Offset@ */ Scalar_FLOAT32_IEEE 0 PubIfStateVSM_MDL_CM_single -3.4E+38 3.4E+38 MATRIX_DIM 1 7 1 /end CHARACTERISTIC
/begin CHARACTERISTIC P_VSM_LDW_State_Param_Sensitive_Offset "" VAL_BLK 0x0 /* @MemoryAddress@P_VSM_LDW_State_Param_Sensitive_Offset@ */ Scalar_FLOAT32_IEEE 0 PubIfStateVSM_MDL_CM_single -3.4E+38 3.4E+38 MATRIX_DIM 1 3 1 /end CHARACTERISTIC
/begin CHARACTERISTIC P_VSM_LDW_State_Param_Speed "" VAL_BLK 0x0 /* @MemoryAddress@P_VSM_LDW_State_Param_Speed@ */ Scalar_FLOAT32_IEEE 0 PubIfStateVSM_MDL_CM_single -3.4E+38 3.4E+38 MATRIX_DIM 1 16 1 /end CHARACTERISTIC
/begin CHARACTERISTIC P_VSM_LKA_State_Param_LaneWidth_Offset "" VAL_BLK 0x0 /* @MemoryAddress@P_VSM_LKA_State_Param_LaneWidth_Offset@ */ Scalar_FLOAT32_IEEE 0 PubIfStateVSM_MDL_CM_single -3.4E+38 3.4E+38 MATRIX_DIM 1 7 1 /end CHARACTERISTIC
/begin CHARACTERISTIC P_VSM_LKA_State_Param_Sensitive_Offset "" VAL_BLK 0x0 /* @MemoryAddress@P_VSM_LKA_State_Param_Sensitive_Offset@ */ Scalar_FLOAT32_IEEE 0 PubIfStateVSM_MDL_CM_single -3.4E+38 3.4E+38 MATRIX_DIM 1 3 1 /end CHARACTERISTIC
/begin CHARACTERISTIC P_VSM_LSMC_SampleTime "" VALUE 0x0 /* @MemoryAddress@P_VSM_LSMC_SampleTime@ */ Scalar_FLOAT32_IEEE 0 PubIfStateVSM_MDL_CM_single -3.4E+38 3.4E+38 /end CHARACTERISTIC
/begin CHARACTERISTIC P_VSM_ACCExit_AccOverride "" VALUE 0x0 /* @MemoryAddress@P_VSM_ACCExit_AccOverride@ */ Scalar_UWORD 0 PubIfStateVSM_MDL_CM_uint16_s 0.0 1000.0 /end CHARACTERISTIC
/begin CHARACTERISTIC P_VSM_ACCExit_StandWaitTime "" VALUE 0x0 /* @MemoryAddress@P_VSM_ACCExit_StandWaitTime@ */ Scalar_UWORD 0 PubIfStateVSM_MDL_CM_uint16__S_ 0.0 1000.0 /end CHARACTERISTIC
/begin CHARACTERISTIC P_VSM_ACC_BrakeOnlyNum "" VALUE 0x0 /* @MemoryAddress@P_VSM_ACC_BrakeOnlyNum@ */ Scalar_UWORD 0 PubIfStateVSM_MDL_CM_uint16_num 0.0 600.0 /end CHARACTERISTIC
/begin CHARACTERISTIC P_VSM_ACC_StandActiveNumACCMode "" VALUE 0x0 /* @MemoryAddress@P_VSM_ACC_StandActiveNumACCMode@ */ Scalar_UWORD 0 PubIfStateVSM_MDL_CM_uint16_num 0.0 9000.0 /end CHARACTERISTIC
/begin CHARACTERISTIC P_VSM_ACC_StandActiveNumHWAMode "" VALUE 0x0 /* @MemoryAddress@P_VSM_ACC_StandActiveNumHWAMode@ */ Scalar_UWORD 0 PubIfStateVSM_MDL_CM_uint16_num 0.0 9000.0 /end CHARACTERISTIC
/begin CHARACTERISTIC P_VSM_SOSContinueTime "" VALUE 0x0 /* @MemoryAddress@P_VSM_SOSContinueTime@ */ Scalar_UWORD 0 PubIfStateVSM_MDL_CM_uint16 0 65535 /end CHARACTERISTIC
/begin CHARACTERISTIC P_VSM_TJA_ActiveWaitNum "" VALUE 0x0 /* @MemoryAddress@P_VSM_TJA_ActiveWaitNum@ */ Scalar_UWORD 0 PubIfStateVSM_MDL_CM_uint16_num 0.0 3000.0 /end CHARACTERISTIC
/begin CHARACTERISTIC P_VSM_TLS_LCCancelTime "" VALUE 0x0 /* @MemoryAddress@P_VSM_TLS_LCCancelTime@ */ Scalar_UWORD 0 PubIfStateVSM_MDL_CM_uint16 0 65535 /end CHARACTERISTIC
/begin CHARACTERISTIC P_VSM_ACCSOS_SW "" VALUE 0x0 /* @MemoryAddress@P_VSM_ACCSOS_SW@ */ Scalar_BOOLEAN 0 PubIfStateVSM_MDL_CM_boolean 0 1 BIT_MASK 0x01 /end CHARACTERISTIC
/begin CHARACTERISTIC P_VSM_ACC_AutoGoSW "" VALUE 0x0 /* @MemoryAddress@P_VSM_ACC_AutoGoSW@ */ Scalar_BOOLEAN 0 PubIfStateVSM_MDL_CM_boolean 0 1 BIT_MASK 0x01 /end CHARACTERISTIC
/begin CHARACTERISTIC P_VSM_AESSwtReq "" VALUE 0x0 /* @MemoryAddress@P_VSM_AESSwtReq@ */ Scalar_BOOLEAN 0 PubIfStateVSM_MDL_CM_boolean 0 1 BIT_MASK 0x01 /end CHARACTERISTIC
/begin CHARACTERISTIC P_VSM_ALCSwtReq "" VALUE 0x0 /* @MemoryAddress@P_VSM_ALCSwtReq@ */ Scalar_BOOLEAN 0 PubIfStateVSM_MDL_CM_boolean 0 1 BIT_MASK 0x01 /end CHARACTERISTIC
/begin CHARACTERISTIC P_VSM_ELKSwtReq "" VALUE 0x0 /* @MemoryAddress@P_VSM_ELKSwtReq@ */ Scalar_BOOLEAN 0 PubIfStateVSM_MDL_CM_boolean 0 1 BIT_MASK 0x01 /end CHARACTERISTIC
/begin CHARACTERISTIC P_VSM_ESS_AEBFlag_enable "" VALUE 0x0 /* @MemoryAddress@P_VSM_ESS_AEBFlag_enable@ */ Scalar_BOOLEAN 0 PubIfStateVSM_MDL_CM_boolean 0 1 BIT_MASK 0x01 /end CHARACTERISTIC
/begin CHARACTERISTIC P_VSM_ESS_AccelPed_enable "" VALUE 0x0 /* @MemoryAddress@P_VSM_ESS_AccelPed_enable@ */ Scalar_BOOLEAN 0 PubIfStateVSM_MDL_CM_boolean 0 1 BIT_MASK 0x01 /end CHARACTERISTIC
/begin CHARACTERISTIC P_VSM_ESS_DoorSts_enable "" VALUE 0x0 /* @MemoryAddress@P_VSM_ESS_DoorSts_enable@ */ Scalar_BOOLEAN 0 PubIfStateVSM_MDL_CM_boolean 0 1 BIT_MASK 0x01 /end CHARACTERISTIC
/begin CHARACTERISTIC P_VSM_ESS_DrvSBR_enable "" VALUE 0x0 /* @MemoryAddress@P_VSM_ESS_DrvSBR_enable@ */ Scalar_BOOLEAN 0 PubIfStateVSM_MDL_CM_boolean 0 1 BIT_MASK 0x01 /end CHARACTERISTIC
/begin CHARACTERISTIC P_VSM_ESS_ESPActive_enable "" VALUE 0x0 /* @MemoryAddress@P_VSM_ESS_ESPActive_enable@ */ Scalar_BOOLEAN 0 PubIfStateVSM_MDL_CM_boolean 0 1 BIT_MASK 0x01 /end CHARACTERISTIC
/begin CHARACTERISTIC P_VSM_ESS_ESPFuncOffSts_enable "" VALUE 0x0 /* @MemoryAddress@P_VSM_ESS_ESPFuncOffSts_enable@ */ Scalar_BOOLEAN 0 PubIfStateVSM_MDL_CM_boolean 0 1 BIT_MASK 0x01 /end CHARACTERISTIC
/begin CHARACTERISTIC P_VSM_ESS_FcwDisFlag_enable "" VALUE 0x0 /* @MemoryAddress@P_VSM_ESS_FcwDisFlag_enable@ */ Scalar_BOOLEAN 0 PubIfStateVSM_MDL_CM_boolean 0 1 BIT_MASK 0x01 /end CHARACTERISTIC
/begin CHARACTERISTIC P_VSM_ESS_FcwSw_enable "" VALUE 0x0 /* @MemoryAddress@P_VSM_ESS_FcwSw_enable@ */ Scalar_BOOLEAN 0 PubIfStateVSM_MDL_CM_boolean 0 1 BIT_MASK 0x01 /end CHARACTERISTIC
/begin CHARACTERISTIC P_VSM_ESS_HiLoBeam_enable "" VALUE 0x0 /* @MemoryAddress@P_VSM_ESS_HiLoBeam_enable@ */ Scalar_BOOLEAN 0 PubIfStateVSM_MDL_CM_boolean 0 1 BIT_MASK 0x01 /end CHARACTERISTIC
/begin CHARACTERISTIC P_VSM_ESS_LateralAccel_enable "" VALUE 0x0 /* @MemoryAddress@P_VSM_ESS_LateralAccel_enable@ */ Scalar_BOOLEAN 0 PubIfStateVSM_MDL_CM_boolean 0 1 BIT_MASK 0x01 /end CHARACTERISTIC
/begin CHARACTERISTIC P_VSM_ESS_OVERRIDE_SW "" VALUE 0x0 /* @MemoryAddress@P_VSM_ESS_OVERRIDE_SW@ */ Scalar_BOOLEAN 0 PubIfStateVSM_MDL_CM_boolean 0 1 BIT_MASK 0x01 /end CHARACTERISTIC
/begin CHARACTERISTIC P_VSM_ESS_SteerWheelSpd_enable "" VALUE 0x0 /* @MemoryAddress@P_VSM_ESS_SteerWheelSpd_enable@ */ Scalar_BOOLEAN 0 PubIfStateVSM_MDL_CM_boolean 0 1 BIT_MASK 0x01 /end CHARACTERISTIC
/begin CHARACTERISTIC P_VSM_ESS_TrailerSts_enable "" VALUE 0x0 /* @MemoryAddress@P_VSM_ESS_TrailerSts_enable@ */ Scalar_BOOLEAN 0 PubIfStateVSM_MDL_CM_boolean 0 1 BIT_MASK 0x01 /end CHARACTERISTIC
/begin CHARACTERISTIC P_VSM_ESS_VehLgtAccel_enable "" VALUE 0x0 /* @MemoryAddress@P_VSM_ESS_VehLgtAccel_enable@ */ Scalar_BOOLEAN 0 PubIfStateVSM_MDL_CM_boolean 0 1 BIT_MASK 0x01 /end CHARACTERISTIC
/begin CHARACTERISTIC P_VSM_ESS_VehSwtReq "" VALUE 0x0 /* @MemoryAddress@P_VSM_ESS_VehSwtReq@ */ Scalar_BOOLEAN 0 PubIfStateVSM_MDL_CM_boolean 0 1 BIT_MASK 0x01 /end CHARACTERISTIC
/begin CHARACTERISTIC P_VSM_ESS_Vehspeed_enable "" VALUE 0x0 /* @MemoryAddress@P_VSM_ESS_Vehspeed_enable@ */ Scalar_BOOLEAN 0 PubIfStateVSM_MDL_CM_boolean 0 1 BIT_MASK 0x01 /end CHARACTERISTIC
/begin CHARACTERISTIC P_VSM_ESS_WiprReq_enable "" VALUE 0x0 /* @MemoryAddress@P_VSM_ESS_WiprReq_enable@ */ Scalar_BOOLEAN 0 PubIfStateVSM_MDL_CM_boolean 0 1 BIT_MASK 0x01 /end CHARACTERISTIC
/begin CHARACTERISTIC P_VSM_HWA_ALCStsSW "" VALUE 0x0 /* @MemoryAddress@P_VSM_HWA_ALCStsSW@ */ Scalar_BOOLEAN 0 PubIfStateVSM_MDL_CM_boolean 0 1 BIT_MASK 0x01 /end CHARACTERISTIC
/begin CHARACTERISTIC P_VSM_HWA_EHR_Enable "EHR使能开关" VALUE 0x0 /* @MemoryAddress@P_VSM_HWA_EHR_Enable@ */ Scalar_BOOLEAN 0 PubIfStateVSM_MDL_CM_boolean 0 1 BIT_MASK 0x01 /end CHARACTERISTIC
/begin CHARACTERISTIC P_VSM_ICA_HandsOffSwtReq "" VALUE 0x0 /* @MemoryAddress@P_VSM_ICA_HandsOffSwtReq@ */ Scalar_BOOLEAN 0 PubIfStateVSM_MDL_CM_boolean 0 1 BIT_MASK 0x01 /end CHARACTERISTIC
/begin CHARACTERISTIC P_VSM_ISLSwtReq "" VALUE 0x0 /* @MemoryAddress@P_VSM_ISLSwtReq@ */ Scalar_BOOLEAN 0 PubIfStateVSM_MDL_CM_boolean 0 1 BIT_MASK 0x01 /end CHARACTERISTIC
/begin CHARACTERISTIC P_VSM_IntelligentEvaSwtReq "" VALUE 0x0 /* @MemoryAddress@P_VSM_IntelligentEvaSwtReq@ */ Scalar_BOOLEAN 0 PubIfStateVSM_MDL_CM_boolean 0 1 BIT_MASK 0x01 /end CHARACTERISTIC
/begin CHARACTERISTIC P_VSM_LCKSwtReq "" VALUE 0x0 /* @MemoryAddress@P_VSM_LCKSwtReq@ */ Scalar_BOOLEAN 0 PubIfStateVSM_MDL_CM_boolean 0 1 BIT_MASK 0x01 /end CHARACTERISTIC
/begin CHARACTERISTIC P_VSM_LDWSwtReq "" VALUE 0x0 /* @MemoryAddress@P_VSM_LDWSwtReq@ */ Scalar_BOOLEAN 0 PubIfStateVSM_MDL_CM_boolean 0 1 BIT_MASK 0x01 /end CHARACTERISTIC
/begin CHARACTERISTIC P_VSM_LKASwtReq "" VALUE 0x0 /* @MemoryAddress@P_VSM_LKASwtReq@ */ Scalar_BOOLEAN 0 PubIfStateVSM_MDL_CM_boolean 0 1 BIT_MASK 0x01 /end CHARACTERISTIC
/begin CHARACTERISTIC P_VSM_LSSSwtReq "" VALUE 0x0 /* @MemoryAddress@P_VSM_LSSSwtReq@ */ Scalar_BOOLEAN 0 PubIfStateVSM_MDL_CM_boolean 0 1 BIT_MASK 0x01 /end CHARACTERISTIC
/begin CHARACTERISTIC P_VSM_NOH_Act_Req "" VALUE 0x0 /* @MemoryAddress@P_VSM_NOH_Act_Req@ */ Scalar_BOOLEAN 0 PubIfStateVSM_MDL_CM_boolean 0 1 BIT_MASK 0x01 /end CHARACTERISTIC
/begin CHARACTERISTIC P_VSM_NOH_Swt_Req "" VALUE 0x0 /* @MemoryAddress@P_VSM_NOH_Swt_Req@ */ Scalar_BOOLEAN 0 PubIfStateVSM_MDL_CM_boolean 0 1 BIT_MASK 0x01 /end CHARACTERISTIC
/begin CHARACTERISTIC P_VSM_TSRSwtReq "" VALUE 0x0 /* @MemoryAddress@P_VSM_TSRSwtReq@ */ Scalar_BOOLEAN 0 PubIfStateVSM_MDL_CM_boolean 0 1 BIT_MASK 0x01 /end CHARACTERISTIC
/begin CHARACTERISTIC P_VSM_TSRWarnSwtReq "" VALUE 0x0 /* @MemoryAddress@P_VSM_TSRWarnSwtReq@ */ Scalar_BOOLEAN 0 PubIfStateVSM_MDL_CM_boolean 0 1 BIT_MASK 0x01 /end CHARACTERISTIC
/begin CHARACTERISTIC P_VSM_TimeGapHMI_SW "" VALUE 0x0 /* @MemoryAddress@P_VSM_TimeGapHMI_SW@ */ Scalar_BOOLEAN 0 PubIfStateVSM_MDL_CM_boolean 0 1 BIT_MASK 0x01 /end CHARACTERISTIC
/begin CHARACTERISTIC P_Global_VehiclePowerType "动力形式，0-V71混动；1-V61混动；" VALUE 0x0 /* @MemoryAddress@P_Global_VehiclePowerType@ */ Scalar_UBYTE 0 PubIfStateVSM_MDL_CM_uint8 0 255 /end CHARACTERISTIC
/begin CHARACTERISTIC P_VSM_CruiseFunUserInputMappingWays "" VALUE 0x0 /* @MemoryAddress@P_VSM_CruiseFunUserInputMappingWays@ */ Scalar_UBYTE 0 PubIfStateVSM_MDL_CM_uint8 0 255 /end CHARACTERISTIC
/begin CHARACTERISTIC P_VSM_ISL_TimeInformDis "" VALUE 0x0 /* @MemoryAddress@P_VSM_ISL_TimeInformDis@ */ Scalar_UBYTE 0 PubIfStateVSM_MDL_CM_uint8_s 1.0 255.0 /end CHARACTERISTIC
/begin CHARACTERISTIC P_VSM_ISL_TimeTakeOver "" VALUE 0x0 /* @MemoryAddress@P_VSM_ISL_TimeTakeOver@ */ Scalar_UBYTE 0 PubIfStateVSM_MDL_CM_uint8_s 0 255 /end CHARACTERISTIC
/begin CHARACTERISTIC P_VSM_NOH_PilotSelc_SW "" VALUE 0x0 /* @MemoryAddress@P_VSM_NOH_PilotSelc_SW@ */ Scalar_UBYTE 0 PubIfStateVSM_MDL_CM_uint8 0 255 /end CHARACTERISTIC
/begin AXIS_PTS P_VSM_HOD_Handson_TrqInsertPoint "" 0x0 /* @MemoryAddress@P_VSM_HOD_Handson_TrqInsertPoint@ */ VSM_HOD_DrvTrqFilted Lookup1D_X_FLOAT32_IEEE 0 PubIfStateVSM_MDL_CM_single 5 -3.4E+38 3.4E+38 /end AXIS_PTS
/begin AXIS_PTS P_VSM_ESS_SpdPoint_kmh "" 0x0 /* @MemoryAddress@P_VSM_ESS_SpdPoint_kmh@ */ NO_INPUT_QUANTITY Lookup1D_X_FLOAT32_IEEE 0 PubIfStateVSM_MDL_CM_single 6 -3.4E+38 3.4E+38 /end AXIS_PTS
/begin AXIS_PTS P_VSM_ESS_IPSpeed_kmh "" 0x0 /* @MemoryAddress@P_VSM_ESS_IPSpeed_kmh@ */ NO_INPUT_QUANTITY Lookup1D_X_FLOAT32_IEEE 0 PubIfStateVSM_MDL_CM_single 6 -3.4E+38 3.4E+38 /end AXIS_PTS
/begin AXIS_PTS P_VSM_ESS_SteerWheelSpd_BP "" 0x0 /* @MemoryAddress@P_VSM_ESS_SteerWheelSpd_BP@ */ NO_INPUT_QUANTITY Lookup1D_X_FLOAT32_IEEE 0 PubIfStateVSM_MDL_CM_single 6 -3.4E+38 3.4E+38 /end AXIS_PTS
/begin AXIS_PTS P_VSM_ESS_DriveIn_BP "" 0x0 /* @MemoryAddress@P_VSM_ESS_DriveIn_BP@ */ NO_INPUT_QUANTITY Lookup1D_X_FLOAT32_IEEE 0 PubIfStateVSM_MDL_CM_single 6 -3.4E+38 3.4E+38 /end AXIS_PTS
/begin AXIS_PTS P_VSM_LCKIE_Laneoffset_BP "" 0x0 /* @MemoryAddress@P_VSM_LCKIE_Laneoffset_BP@ */ NO_INPUT_QUANTITY Lookup1D_X_FLOAT32_IEEE 0 PubIfStateVSM_MDL_CM_single 5 -3.4E+38 3.4E+38 /end AXIS_PTS
/begin MEASUREMENT LongCtrl_ICEActWheelTrq "" FLOAT64_IEEE PubIfControlLONC_MDL_CM_double 0 0 -1.7E+308 1.7E+308 ECU_ADDRESS 0x0 /* @MemoryAddress@LongCtrl_ICEActWheelTrq@ */ /end MEASUREMENT
/begin MEASUREMENT LongCtrl_accelHoldMin "" FLOAT32_IEEE PubIfControlLONC_MDL_CM_single 0 0 -3.4E+38 3.4E+38 ECU_ADDRESS 0x0 /* @MemoryAddress@LongCtrl_accelHoldMin@ */ /end MEASUREMENT
/begin MEASUREMENT LongCtrl_jerkHold "" FLOAT32_IEEE PubIfControlLONC_MDL_CM_single 0 0 -3.4E+38 3.4E+38 ECU_ADDRESS 0x0 /* @MemoryAddress@LongCtrl_jerkHold@ */ /end MEASUREMENT
/begin MEASUREMENT LongCtrl_accelSlidHold "" FLOAT32_IEEE PubIfControlLONC_MDL_CM_single 0 0 -3.4E+38 3.4E+38 ECU_ADDRESS 0x0 /* @MemoryAddress@LongCtrl_accelSlidHold@ */ /end MEASUREMENT
/begin MEASUREMENT LongCtrl_jerkSlidHold "" FLOAT32_IEEE PubIfControlLONC_MDL_CM_single 0 0 -3.4E+38 3.4E+38 ECU_ADDRESS 0x0 /* @MemoryAddress@LongCtrl_jerkSlidHold@ */ /end MEASUREMENT
/begin MEASUREMENT LongCtrl_Fz "" FLOAT32_IEEE PubIfControlLONC_MDL_CM_single 0 0 -3.4E+38 3.4E+38 ECU_ADDRESS 0x0 /* @MemoryAddress@LongCtrl_Fz@ */ /end MEASUREMENT
/begin MEASUREMENT LongCtrl_ICEFzNm "" FLOAT32_IEEE PubIfControlLONC_MDL_CM_single 0 0 -3.4E+38 3.4E+38 ECU_ADDRESS 0x0 /* @MemoryAddress@LongCtrl_ICEFzNm@ */ /end MEASUREMENT
/begin MEASUREMENT LongCtrl_axvDiff "" FLOAT32_IEEE PubIfControlLONC_MDL_CM_single 0 0 -3.4E+38 3.4E+38 ECU_ADDRESS 0x0 /* @MemoryAddress@LongCtrl_axvDiff@ */ /end MEASUREMENT
/begin MEASUREMENT LongCtrl_PI_NetEngTorqInc "" FLOAT32_IEEE PubIfControlLONC_MDL_CM_single 0 0 -3.4E+38 3.4E+38 ECU_ADDRESS 0x0 /* @MemoryAddress@LongCtrl_PI_NetEngTorqInc@ */ /end MEASUREMENT
/begin MEASUREMENT LongCtrl_axvTracActMean "" FLOAT32_IEEE PubIfControlLONC_MDL_CM_single 0 0 -3.4E+38 3.4E+38 ECU_ADDRESS 0x0 /* @MemoryAddress@LongCtrl_axvTracActMean@ */ /end MEASUREMENT
/begin MEASUREMENT LongCtrl_axvModelDiff "" FLOAT32_IEEE PubIfControlLONC_MDL_CM_single 0 0 -3.4E+38 3.4E+38 ECU_ADDRESS 0x0 /* @MemoryAddress@LongCtrl_axvModelDiff@ */ /end MEASUREMENT
/begin MEASUREMENT LongCtrl_axvModelResidual "" FLOAT32_IEEE PubIfControlLONC_MDL_CM_single 0 0 -3.4E+38 3.4E+38 ECU_ADDRESS 0x0 /* @MemoryAddress@LongCtrl_axvModelResidual@ */ /end MEASUREMENT
/begin MEASUREMENT LongCtrl_axvClosedLoopControl "" FLOAT32_IEEE PubIfControlLONC_MDL_CM_single 0 0 -3.4E+38 3.4E+38 ECU_ADDRESS 0x0 /* @MemoryAddress@LongCtrl_axvClosedLoopControl@ */ /end MEASUREMENT
/begin MEASUREMENT LongCtrl_FF_NetEngTorqMax "" FLOAT32_IEEE PubIfControlLONC_MDL_CM_single__ 0 0 -3.4E+38 3.4E+38 ECU_ADDRESS 0x0 /* @MemoryAddress@LongCtrl_FF_NetEngTorqMax@ */ /end MEASUREMENT
/begin MEASUREMENT LongCtrl_FF_NetEngTorqInc "" FLOAT32_IEEE PubIfControlLONC_MDL_CM_single 0 0 -3.4E+38 3.4E+38 ECU_ADDRESS 0x0 /* @MemoryAddress@LongCtrl_FF_NetEngTorqInc@ */ /end MEASUREMENT
/begin MEASUREMENT LongCtrl_UpdateLowerValue "" FLOAT32_IEEE PubIfControlLONC_MDL_CM_single 0 0 -3.4E+38 3.4E+38 ECU_ADDRESS 0x0 /* @MemoryAddress@LongCtrl_UpdateLowerValue@ */ /end MEASUREMENT
/begin MEASUREMENT LongCtrl_UpdateUpperValue "" FLOAT32_IEEE PubIfControlLONC_MDL_CM_single 0 0 -3.4E+38 3.4E+38 ECU_ADDRESS 0x0 /* @MemoryAddress@LongCtrl_UpdateUpperValue@ */ /end MEASUREMENT
/begin MEASUREMENT LongCtrl_ACC_EngTrqReq "" FLOAT32_IEEE PubIfControlLONC_MDL_CM_single 0 0 -3.4E+38 3.4E+38 ECU_ADDRESS 0x0 /* @MemoryAddress@LongCtrl_ACC_EngTrqReq@ */ /end MEASUREMENT
/begin MEASUREMENT LongCtrl_axvTracMin "" FLOAT32_IEEE PubIfControlLONC_MDL_CM_single 0 0 -3.4E+38 3.4E+38 ECU_ADDRESS 0x0 /* @MemoryAddress@LongCtrl_axvTracMin@ */ /end MEASUREMENT
/begin MEASUREMENT LongCtrl_axvModelRef "" FLOAT32_IEEE PubIfControlLONC_MDL_CM_single 0 0 -3.4E+38 3.4E+38 ECU_ADDRESS 0x0 /* @MemoryAddress@LongCtrl_axvModelRef@ */ /end MEASUREMENT
/begin MEASUREMENT LongCtrl_ACC_Decel_ReqValue "" FLOAT32_IEEE PubIfControlLONC_MDL_CM_single 0 0 -3.4E+38 3.4E+38 ECU_ADDRESS 0x0 /* @MemoryAddress@LongCtrl_ACC_Decel_ReqValue@ */ /end MEASUREMENT
/begin MEASUREMENT LongCtrl_ForwardFlagVxv "" UBYTE PubIfControlLONC_MDL_CM_boolean 0 0 0 1 ECU_ADDRESS 0x0 /* @MemoryAddress@LongCtrl_ForwardFlagVxv@ */ BIT_MASK 0x01 /end MEASUREMENT
/begin MEASUREMENT LongCtrl_ForwardFlagTrq "" UBYTE PubIfControlLONC_MDL_CM_boolean 0 0 0 1 ECU_ADDRESS 0x0 /* @MemoryAddress@LongCtrl_ForwardFlagTrq@ */ BIT_MASK 0x01 /end MEASUREMENT
/begin MEASUREMENT LongCtrl_SlideFlag "" UBYTE PubIfControlLONC_MDL_CM_boolean 0 0 0 1 ECU_ADDRESS 0x0 /* @MemoryAddress@LongCtrl_SlideFlag@ */ BIT_MASK 0x01 /end MEASUREMENT
/begin MEASUREMENT LongCtrl_UpdateEnable_axvModeldiff "" UBYTE PubIfControlLONC_MDL_CM_boolean 0 0 0 1 ECU_ADDRESS 0x0 /* @MemoryAddress@LongCtrl_UpdateEnable_axvModeldiff@ */ BIT_MASK 0x01 /end MEASUREMENT
/begin MEASUREMENT LongCtrl_Sw2DC6 "" UBYTE PubIfControlLONC_MDL_CM_boolean 0 0 0 1 ECU_ADDRESS 0x0 /* @MemoryAddress@LongCtrl_Sw2DC6@ */ BIT_MASK 0x01 /end MEASUREMENT
/begin MEASUREMENT LongCtrl_Sw2DC1 "" UBYTE PubIfControlLONC_MDL_CM_boolean 0 0 0 1 ECU_ADDRESS 0x0 /* @MemoryAddress@LongCtrl_Sw2DC1@ */ BIT_MASK 0x01 /end MEASUREMENT
/begin MEASUREMENT LongCtrl_Sw2DC3 "" UBYTE PubIfControlLONC_MDL_CM_boolean 0 0 0 1 ECU_ADDRESS 0x0 /* @MemoryAddress@LongCtrl_Sw2DC3@ */ BIT_MASK 0x01 /end MEASUREMENT
/begin MEASUREMENT LongCtrl_Sw2DC5 "" UBYTE PubIfControlLONC_MDL_CM_boolean 0 0 0 1 ECU_ADDRESS 0x0 /* @MemoryAddress@LongCtrl_Sw2DC5@ */ BIT_MASK 0x01 /end MEASUREMENT
/begin MEASUREMENT LongCtrl_Sw2DC7 "" UBYTE PubIfControlLONC_MDL_CM_boolean 0 0 0 1 ECU_ADDRESS 0x0 /* @MemoryAddress@LongCtrl_Sw2DC7@ */ BIT_MASK 0x01 /end MEASUREMENT
/begin MEASUREMENT LongCtrl_Sw2DC2 "" UBYTE PubIfControlLONC_MDL_CM_boolean 0 0 0 1 ECU_ADDRESS 0x0 /* @MemoryAddress@LongCtrl_Sw2DC2@ */ BIT_MASK 0x01 /end MEASUREMENT
/begin MEASUREMENT LongCtrl_Sw2DC4 "" UBYTE PubIfControlLONC_MDL_CM_boolean 0 0 0 1 ECU_ADDRESS 0x0 /* @MemoryAddress@LongCtrl_Sw2DC4@ */ BIT_MASK 0x01 /end MEASUREMENT
/begin MEASUREMENT LongCtrl_Sw2EC1 "" UBYTE PubIfControlLONC_MDL_CM_boolean 0 0 0 1 ECU_ADDRESS 0x0 /* @MemoryAddress@LongCtrl_Sw2EC1@ */ BIT_MASK 0x01 /end MEASUREMENT
/begin MEASUREMENT LongCtrl_Sw2EC3 "" UBYTE PubIfControlLONC_MDL_CM_boolean 0 0 0 1 ECU_ADDRESS 0x0 /* @MemoryAddress@LongCtrl_Sw2EC3@ */ BIT_MASK 0x01 /end MEASUREMENT
/begin MEASUREMENT LongCtrl_Sw2EC2 "" UBYTE PubIfControlLONC_MDL_CM_boolean 0 0 0 1 ECU_ADDRESS 0x0 /* @MemoryAddress@LongCtrl_Sw2EC2@ */ BIT_MASK 0x01 /end MEASUREMENT
/begin MEASUREMENT LongCtrl_Sw2EC5 "" UBYTE PubIfControlLONC_MDL_CM_boolean 0 0 0 1 ECU_ADDRESS 0x0 /* @MemoryAddress@LongCtrl_Sw2EC5@ */ BIT_MASK 0x01 /end MEASUREMENT
/begin MEASUREMENT LongCtrl_Sw2EC4 "" UBYTE PubIfControlLONC_MDL_CM_boolean 0 0 0 1 ECU_ADDRESS 0x0 /* @MemoryAddress@LongCtrl_Sw2EC4@ */ BIT_MASK 0x01 /end MEASUREMENT
/begin MEASUREMENT PLAN_ALC_LcOverTkLe_ALCSwtOn "" UBYTE PubIfDecisionPLAN_MDL_CM_boolean 0 0 0 1 ECU_ADDRESS 0x0 /* @MemoryAddress@PLAN_ALC_LcOverTkLe_ALCSwtOn@ */ BIT_MASK 0x01 /end MEASUREMENT
/begin MEASUREMENT PLAN_ALC_LcOverTkRi_ALCSwtOn "" UBYTE PubIfDecisionPLAN_MDL_CM_boolean 0 0 0 1 ECU_ADDRESS 0x0 /* @MemoryAddress@PLAN_ALC_LcOverTkRi_ALCSwtOn@ */ BIT_MASK 0x01 /end MEASUREMENT
/begin MEASUREMENT VSM_ACCActCondF "" FLOAT64_IEEE PubIfStateVSM_MDL_CM_double 0 0 -1.7E+308 1.7E+308 ECU_ADDRESS 0x0 /* @MemoryAddress@VSM_ACCActCondF@ */ /end MEASUREMENT
/begin MEASUREMENT VSM_ESS_SubModel_VERSION "" ULONG PubIfStateVSM_MDL_CM_uint32 0 0 0 4294967295 ECU_ADDRESS 0x0 /* @MemoryAddress@VSM_ESS_SubModel_VERSION@ */ /end MEASUREMENT
/begin MEASUREMENT VSM_LCK_VERSION "" ULONG PubIfStateVSM_MDL_CM_uint32 0 0 0 4294967295 ECU_ADDRESS 0x0 /* @MemoryAddress@VSM_LCK_VERSION@ */ /end MEASUREMENT
/begin MEASUREMENT VSM_LCKIE_SubModel_VERSION "" ULONG PubIfStateVSM_MDL_CM_uint32 0 0 0 4294967295 ECU_ADDRESS 0x0 /* @MemoryAddress@VSM_LCKIE_SubModel_VERSION@ */ /end MEASUREMENT
/begin MEASUREMENT VSM_LDW_VERSION "" ULONG PubIfStateVSM_MDL_CM_uint32 0 0 0 4294967295 ECU_ADDRESS 0x0 /* @MemoryAddress@VSM_LDW_VERSION@ */ /end MEASUREMENT
/begin MEASUREMENT VSM_LKA_VERSION "" ULONG PubIfStateVSM_MDL_CM_uint32 0 0 0 4294967295 ECU_ADDRESS 0x0 /* @MemoryAddress@VSM_LKA_VERSION@ */ /end MEASUREMENT
/begin MEASUREMENT VSM_ACC_USSObjDxMin "" FLOAT32_IEEE PubIfStateVSM_MDL_CM_single 0 0 -3.4E+38 3.4E+38 ECU_ADDRESS 0x0 /* @MemoryAddress@VSM_ACC_USSObjDxMin@ */ /end MEASUREMENT
/begin MEASUREMENT VSM_ACC_P0DxThrehod "" FLOAT32_IEEE PubIfStateVSM_MDL_CM_single 0 0 -3.4E+38 3.4E+38 ECU_ADDRESS 0x0 /* @MemoryAddress@VSM_ACC_P0DxThrehod@ */ /end MEASUREMENT
/begin MEASUREMENT VSM_ACC_DecReqValue "" FLOAT32_IEEE PubIfStateVSM_MDL_CM_single 0 0 -3.4E+38 3.4E+38 ECU_ADDRESS 0x0 /* @MemoryAddress@VSM_ACC_DecReqValue@ */ /end MEASUREMENT
/begin MEASUREMENT VSM_HOD_DrvTrqFilted "" FLOAT32_IEEE PubIfStateVSM_MDL_CM_single 0 0 -3.4E+38 3.4E+38 ECU_ADDRESS 0x0 /* @MemoryAddress@VSM_HOD_DrvTrqFilted@ */ /end MEASUREMENT
/begin MEASUREMENT VSM_ACC_SpdSetValue "" FLOAT32_IEEE PubIfStateVSM_MDL_CM_single 0 0 -3.4E+38 3.4E+38 ECU_ADDRESS 0x0 /* @MemoryAddress@VSM_ACC_SpdSetValue@ */ /end MEASUREMENT
/begin MEASUREMENT VSM_ESS_StateR "" FLOAT32_IEEE PubIfStateVSM_MDL_CM_single 0 0 -3.4E+38 3.4E+38 ECU_ADDRESS 0x0 /* @MemoryAddress@VSM_ESS_StateR@ */ /end MEASUREMENT
/begin MEASUREMENT VSM_ESS_StateL "" FLOAT32_IEEE PubIfStateVSM_MDL_CM_single 0 0 -3.4E+38 3.4E+38 ECU_ADDRESS 0x0 /* @MemoryAddress@VSM_ESS_StateL@ */ /end MEASUREMENT
/begin MEASUREMENT VSM_preFLWhelDy "" FLOAT32_IEEE PubIfStateVSM_MDL_CM_single 0 0 -3.4E+38 3.4E+38 ECU_ADDRESS 0x0 /* @MemoryAddress@VSM_preFLWhelDy@ */ /end MEASUREMENT
/begin MEASUREMENT VSM_preFRWhelDy "" FLOAT32_IEEE PubIfStateVSM_MDL_CM_single 0 0 -3.4E+38 3.4E+38 ECU_ADDRESS 0x0 /* @MemoryAddress@VSM_preFRWhelDy@ */ /end MEASUREMENT
/begin MEASUREMENT VSM_FLWhelDy "" FLOAT32_IEEE PubIfStateVSM_MDL_CM_single 0 0 -3.4E+38 3.4E+38 ECU_ADDRESS 0x0 /* @MemoryAddress@VSM_FLWhelDy@ */ /end MEASUREMENT
/begin MEASUREMENT VSM_FRWhelDy "" FLOAT32_IEEE PubIfStateVSM_MDL_CM_single 0 0 -3.4E+38 3.4E+38 ECU_ADDRESS 0x0 /* @MemoryAddress@VSM_FRWhelDy@ */ /end MEASUREMENT
/begin MEASUREMENT VSM_ELK_Warning "" FLOAT32_IEEE PubIfStateVSM_MDL_CM_single 0 0 -3.4E+38 3.4E+38 ECU_ADDRESS 0x0 /* @MemoryAddress@VSM_ELK_Warning@ */ /end MEASUREMENT
/begin MEASUREMENT VSM_ESS_LastPoint "" FLOAT32_IEEE PubIfStateVSM_MDL_CM_single 0 0 -3.4E+38 3.4E+38 ECU_ADDRESS 0x0 /* @MemoryAddress@VSM_ESS_LastPoint@ */ /end MEASUREMENT
/begin MEASUREMENT VSM_ACCSts "" SLONG PubIfStateVSM_MDL_CM_ACC_STATE 0 0 0 9 ECU_ADDRESS 0x0 /* @MemoryAddress@VSM_ACCSts@ */ /end MEASUREMENT
/begin MEASUREMENT VSM_ACCStandActiveTime "" UWORD PubIfStateVSM_MDL_CM_uint16 0 0 0 65535 ECU_ADDRESS 0x0 /* @MemoryAddress@VSM_ACCStandActiveTime@ */ /end MEASUREMENT
/begin MEASUREMENT VSM_ESS_SubModel_Number "" UWORD PubIfStateVSM_MDL_CM_uint16 0 0 0 65535 ECU_ADDRESS 0x0 /* @MemoryAddress@VSM_ESS_SubModel_Number@ */ /end MEASUREMENT
/begin MEASUREMENT VSM_LCKIE_SubModel_Number "" UWORD PubIfStateVSM_MDL_CM_uint16 0 0 0 65535 ECU_ADDRESS 0x0 /* @MemoryAddress@VSM_LCKIE_SubModel_Number@ */ /end MEASUREMENT
/begin MEASUREMENT VSM_Diagnostic_ACCError "" UBYTE PubIfStateVSM_MDL_CM_uint8 0 0 0 255 ECU_ADDRESS 0x0 /* @MemoryAddress@VSM_Diagnostic_ACCError@ */ /end MEASUREMENT
/begin MEASUREMENT VSM_ACC_SWEngState "" UBYTE PubIfStateVSM_MDL_CM_uint8 0 0 0 255 ECU_ADDRESS 0x0 /* @MemoryAddress@VSM_ACC_SWEngState@ */ /end MEASUREMENT
/begin MEASUREMENT VSM_Diagnostic_HWAError "" UBYTE PubIfStateVSM_MDL_CM_uint8 0 0 0 255 ECU_ADDRESS 0x0 /* @MemoryAddress@VSM_Diagnostic_HWAError@ */ /end MEASUREMENT
/begin MEASUREMENT VSM_ESS_VehCnfgESS "" UBYTE PubIfStateVSM_MDL_CM_uint8 0 0 0 255 ECU_ADDRESS 0x0 /* @MemoryAddress@VSM_ESS_VehCnfgESS@ */ /end MEASUREMENT
/begin MEASUREMENT VSM_Diagnostic_TJAError "" UBYTE PubIfStateVSM_MDL_CM_uint8 0 0 0 255 ECU_ADDRESS 0x0 /* @MemoryAddress@VSM_Diagnostic_TJAError@ */ /end MEASUREMENT
/begin MEASUREMENT VSM_ELK_VehConfigELK "" UBYTE PubIfStateVSM_MDL_CM_uint8 0 0 0 255 ECU_ADDRESS 0x0 /* @MemoryAddress@VSM_ELK_VehConfigELK@ */ /end MEASUREMENT
/begin MEASUREMENT VSM_LKAState "" UBYTE PubIfStateVSM_MDL_CM_uint8 0 0 0 255 ECU_ADDRESS 0x0 /* @MemoryAddress@VSM_LKAState@ */ /end MEASUREMENT
/begin MEASUREMENT VSM_TarDangerLevel "" UBYTE PubIfStateVSM_MDL_CM_uint8 0 0 0 255 ECU_ADDRESS 0x0 /* @MemoryAddress@VSM_TarDangerLevel@ */ /end MEASUREMENT
/begin MEASUREMENT VSM_ACC_HazActv "" UBYTE PubIfStateVSM_MDL_CM_uint8 0 0 0 255 ECU_ADDRESS 0x0 /* @MemoryAddress@VSM_ACC_HazActv@ */ /end MEASUREMENT
/begin MEASUREMENT VSM_ACC_ModeDisp "" UBYTE PubIfStateVSM_MDL_CM_uint8 0 0 0 255 ECU_ADDRESS 0x0 /* @MemoryAddress@VSM_ACC_ModeDisp@ */ /end MEASUREMENT
/begin MEASUREMENT VSM_TJA_ModeDisp "" UBYTE PubIfStateVSM_MDL_CM_uint8 0 0 0 255 ECU_ADDRESS 0x0 /* @MemoryAddress@VSM_TJA_ModeDisp@ */ /end MEASUREMENT
/begin MEASUREMENT VSM_HWANOA_Mode "" UBYTE PubIfStateVSM_MDL_CM_uint8 0 0 0 255 ECU_ADDRESS 0x0 /* @MemoryAddress@VSM_HWANOA_Mode@ */ /end MEASUREMENT
/begin MEASUREMENT VSM_TJATextDisp "" UBYTE PubIfStateVSM_MDL_CM_uint8 0 0 0 255 ECU_ADDRESS 0x0 /* @MemoryAddress@VSM_TJATextDisp@ */ /end MEASUREMENT
/begin MEASUREMENT VSM_HWATextDisp "" UBYTE PubIfStateVSM_MDL_CM_uint8 0 0 0 255 ECU_ADDRESS 0x0 /* @MemoryAddress@VSM_HWATextDisp@ */ /end MEASUREMENT
/begin MEASUREMENT VSM_ACCTextDisp "" UBYTE PubIfStateVSM_MDL_CM_uint8 0 0 0 255 ECU_ADDRESS 0x0 /* @MemoryAddress@VSM_ACCTextDisp@ */ /end MEASUREMENT
/begin MEASUREMENT VSM_HWA_LaneChangeReq "" UBYTE PubIfStateVSM_MDL_CM_uint8 0 0 0 255 ECU_ADDRESS 0x0 /* @MemoryAddress@VSM_HWA_LaneChangeReq@ */ /end MEASUREMENT
/begin MEASUREMENT VSM_ACC_DrvrOff_Disp "" UBYTE PubIfStateVSM_MDL_CM_uint8 0 0 0 255 ECU_ADDRESS 0x0 /* @MemoryAddress@VSM_ACC_DrvrOff_Disp@ */ /end MEASUREMENT
/begin MEASUREMENT VSM_HWA_ModeDisp "" UBYTE PubIfStateVSM_MDL_CM_uint8 0 0 0 255 ECU_ADDRESS 0x0 /* @MemoryAddress@VSM_HWA_ModeDisp@ */ /end MEASUREMENT
/begin MEASUREMENT VSM_ELKState "" UBYTE PubIfStateVSM_MDL_CM_uint8 0 0 0 255 ECU_ADDRESS 0x0 /* @MemoryAddress@VSM_ELKState@ */ /end MEASUREMENT
/begin MEASUREMENT VSM_LCKState "" UBYTE PubIfStateVSM_MDL_CM_uint8 0 0 0 255 ECU_ADDRESS 0x0 /* @MemoryAddress@VSM_LCKState@ */ /end MEASUREMENT
/begin MEASUREMENT VSM_LCK_Counter "" UBYTE PubIfStateVSM_MDL_CM_uint8 0 0 0 255 ECU_ADDRESS 0x0 /* @MemoryAddress@VSM_LCK_Counter@ */ /end MEASUREMENT
/begin MEASUREMENT VSM_LCKIE_State "" UBYTE PubIfStateVSM_MDL_CM_uint8 0 0 0 255 ECU_ADDRESS 0x0 /* @MemoryAddress@VSM_LCKIE_State@ */ /end MEASUREMENT
/begin MEASUREMENT VSM_LDWSts "" UBYTE PubIfStateVSM_MDL_CM_uint8 0 0 0 255 ECU_ADDRESS 0x0 /* @MemoryAddress@VSM_LDWSts@ */ /end MEASUREMENT
/begin MEASUREMENT VSM_LDW_Error "" UBYTE PubIfStateVSM_MDL_CM_uint8 0 0 0 255 ECU_ADDRESS 0x0 /* @MemoryAddress@VSM_LDW_Error@ */ /end MEASUREMENT
/begin MEASUREMENT VSM_LDW_Counter "" UBYTE PubIfStateVSM_MDL_CM_uint8 0 0 0 255 ECU_ADDRESS 0x0 /* @MemoryAddress@VSM_LDW_Counter@ */ /end MEASUREMENT
/begin MEASUREMENT VSM_LKA_Counter "" UBYTE PubIfStateVSM_MDL_CM_uint8 0 0 0 255 ECU_ADDRESS 0x0 /* @MemoryAddress@VSM_LKA_Counter@ */ /end MEASUREMENT
/begin MEASUREMENT VSM_Counter "" UBYTE PubIfStateVSM_MDL_CM_uint8 0 0 0 255 ECU_ADDRESS 0x0 /* @MemoryAddress@VSM_Counter@ */ /end MEASUREMENT
/begin MEASUREMENT VSM_TJA_ACC_SelSts "" UBYTE PubIfStateVSM_MDL_CM_uint8 0 0 0 255 ECU_ADDRESS 0x0 /* @MemoryAddress@VSM_TJA_ACC_SelSts@ */ /end MEASUREMENT
/begin MEASUREMENT VSM_HandsOffWarningLevel "" UBYTE PubIfStateVSM_MDL_CM_uint8 0 0 0 255 ECU_ADDRESS 0x0 /* @MemoryAddress@VSM_HandsOffWarningLevel@ */ /end MEASUREMENT
/begin MEASUREMENT VSM_ESSState "" UBYTE PubIfStateVSM_MDL_CM_uint8 0 0 0 255 ECU_ADDRESS 0x0 /* @MemoryAddress@VSM_ESSState@ */ /end MEASUREMENT
/begin MEASUREMENT VSM_ACC_TimeGapSet "" UBYTE PubIfStateVSM_MDL_CM_uint8 0 0 0 255 ECU_ADDRESS 0x0 /* @MemoryAddress@VSM_ACC_TimeGapSet@ */ /end MEASUREMENT
/begin MEASUREMENT VSM_HWAWarningLevel "" UBYTE PubIfStateVSM_MDL_CM_uint8 0 0 0 255 ECU_ADDRESS 0x0 /* @MemoryAddress@VSM_HWAWarningLevel@ */ /end MEASUREMENT
/begin MEASUREMENT VSM_ACCFastExitCons_Standstill3min "" UBYTE PubIfStateVSM_MDL_CM_boolean 0 0 0 1 ECU_ADDRESS 0x0 /* @MemoryAddress@VSM_ACCFastExitCons_Standstill3min@ */ BIT_MASK 0x01 /end MEASUREMENT
/begin MEASUREMENT VSM_VehicleStandStill "" UBYTE PubIfStateVSM_MDL_CM_boolean 0 0 0 1 ECU_ADDRESS 0x0 /* @MemoryAddress@VSM_VehicleStandStill@ */ BIT_MASK 0x01 /end MEASUREMENT
/begin MEASUREMENT VSM_ACCFastExitCons_RollingBack "" UBYTE PubIfStateVSM_MDL_CM_boolean 0 0 0 1 ECU_ADDRESS 0x0 /* @MemoryAddress@VSM_ACCFastExitCons_RollingBack@ */ BIT_MASK 0x01 /end MEASUREMENT
/begin MEASUREMENT VSM_ACCFastExitCons_EngineOff "" UBYTE PubIfStateVSM_MDL_CM_boolean 0 0 0 1 ECU_ADDRESS 0x0 /* @MemoryAddress@VSM_ACCFastExitCons_EngineOff@ */ BIT_MASK 0x01 /end MEASUREMENT
/begin MEASUREMENT VSM_ACCFastExitCons_BrakeDiskOverHeat "" UBYTE PubIfStateVSM_MDL_CM_boolean 0 0 0 1 ECU_ADDRESS 0x0 /* @MemoryAddress@VSM_ACCFastExitCons_BrakeDiskOverHeat@ */ BIT_MASK 0x01 /end MEASUREMENT
/begin MEASUREMENT VSM_ACCFastExitCons_Cancel "" UBYTE PubIfStateVSM_MDL_CM_boolean 0 0 0 1 ECU_ADDRESS 0x0 /* @MemoryAddress@VSM_ACCFastExitCons_Cancel@ */ BIT_MASK 0x01 /end MEASUREMENT
/begin MEASUREMENT VSM_ACCFastExitCons_EspOff "" UBYTE PubIfStateVSM_MDL_CM_boolean 0 0 0 1 ECU_ADDRESS 0x0 /* @MemoryAddress@VSM_ACCFastExitCons_EspOff@ */ BIT_MASK 0x01 /end MEASUREMENT
/begin MEASUREMENT VSM_ACCFastExitCons_NoForwardGear "" UBYTE PubIfStateVSM_MDL_CM_boolean 0 0 0 1 ECU_ADDRESS 0x0 /* @MemoryAddress@VSM_ACCFastExitCons_NoForwardGear@ */ BIT_MASK 0x01 /end MEASUREMENT
/begin MEASUREMENT VSM_ACC_DriverBrake "" UBYTE PubIfStateVSM_MDL_CM_boolean 0 0 0 1 ECU_ADDRESS 0x0 /* @MemoryAddress@VSM_ACC_DriverBrake@ */ BIT_MASK 0x01 /end MEASUREMENT
/begin MEASUREMENT VSM_ACCFastExitCons_DriveBrakeExit "" UBYTE PubIfStateVSM_MDL_CM_boolean 0 0 0 1 ECU_ADDRESS 0x0 /* @MemoryAddress@VSM_ACCFastExitCons_DriveBrakeExit@ */ BIT_MASK 0x01 /end MEASUREMENT
/begin MEASUREMENT VSM_ACCFastExitCons_EPBClosed "" UBYTE PubIfStateVSM_MDL_CM_boolean 0 0 0 1 ECU_ADDRESS 0x0 /* @MemoryAddress@VSM_ACCFastExitCons_EPBClosed@ */ BIT_MASK 0x01 /end MEASUREMENT
/begin MEASUREMENT VSM_ACCFastExitCons_DriverDoorOpen "" UBYTE PubIfStateVSM_MDL_CM_boolean 0 0 0 1 ECU_ADDRESS 0x0 /* @MemoryAddress@VSM_ACCFastExitCons_DriverDoorOpen@ */ BIT_MASK 0x01 /end MEASUREMENT
/begin MEASUREMENT VSM_ACCFastExitCons_AEBTrigger "" UBYTE PubIfStateVSM_MDL_CM_boolean 0 0 0 1 ECU_ADDRESS 0x0 /* @MemoryAddress@VSM_ACCFastExitCons_AEBTrigger@ */ BIT_MASK 0x01 /end MEASUREMENT
/begin MEASUREMENT VSM_ACCFastExitCons_VehSpdExit "" UBYTE PubIfStateVSM_MDL_CM_boolean 0 0 0 1 ECU_ADDRESS 0x0 /* @MemoryAddress@VSM_ACCFastExitCons_VehSpdExit@ */ BIT_MASK 0x01 /end MEASUREMENT
/begin MEASUREMENT VSM_ACCFastExitCons_DrivingModExit "" UBYTE PubIfStateVSM_MDL_CM_boolean 0 0 0 1 ECU_ADDRESS 0x0 /* @MemoryAddress@VSM_ACCFastExitCons_DrivingModExit@ */ BIT_MASK 0x01 /end MEASUREMENT
/begin MEASUREMENT VSM_ACCFastExitCons_APSGuidance "" UBYTE PubIfStateVSM_MDL_CM_boolean 0 0 0 1 ECU_ADDRESS 0x0 /* @MemoryAddress@VSM_ACCFastExitCons_APSGuidance@ */ BIT_MASK 0x01 /end MEASUREMENT
/begin MEASUREMENT VSM_ACCFastExitCons_ACCError_Inhibit "" UBYTE PubIfStateVSM_MDL_CM_boolean 0 0 0 1 ECU_ADDRESS 0x0 /* @MemoryAddress@VSM_ACCFastExitCons_ACCError_Inhibit@ */ BIT_MASK 0x01 /end MEASUREMENT
/begin MEASUREMENT VSM_ACCFastExitCons_ACCOverride "" UBYTE PubIfStateVSM_MDL_CM_boolean 0 0 0 1 ECU_ADDRESS 0x0 /* @MemoryAddress@VSM_ACCFastExitCons_ACCOverride@ */ BIT_MASK 0x01 /end MEASUREMENT
/begin MEASUREMENT VSM_ACC_SWCruise "" UBYTE PubIfStateVSM_MDL_CM_boolean 0 0 0 1 ECU_ADDRESS 0x0 /* @MemoryAddress@VSM_ACC_SWCruise@ */ BIT_MASK 0x01 /end MEASUREMENT
/begin MEASUREMENT VSM_User_ACCSet "" UBYTE PubIfStateVSM_MDL_CM_boolean 0 0 0 1 ECU_ADDRESS 0x0 /* @MemoryAddress@VSM_User_ACCSet@ */ BIT_MASK 0x01 /end MEASUREMENT
/begin MEASUREMENT VSM_DriveBrake "" UBYTE PubIfStateVSM_MDL_CM_boolean 0 0 0 1 ECU_ADDRESS 0x0 /* @MemoryAddress@VSM_DriveBrake@ */ BIT_MASK 0x01 /end MEASUREMENT
/begin MEASUREMENT VSM_ACCSlowExitCons_EspActive400ms "" UBYTE PubIfStateVSM_MDL_CM_boolean 0 0 0 1 ECU_ADDRESS 0x0 /* @MemoryAddress@VSM_ACCSlowExitCons_EspActive400ms@ */ BIT_MASK 0x01 /end MEASUREMENT
/begin MEASUREMENT VSM_ACCSlowExitCons_MSRactive800ms "" UBYTE PubIfStateVSM_MDL_CM_boolean 0 0 0 1 ECU_ADDRESS 0x0 /* @MemoryAddress@VSM_ACCSlowExitCons_MSRactive800ms@ */ BIT_MASK 0x01 /end MEASUREMENT
/begin MEASUREMENT VSM_ACCSlowExitCons_HDCactive40ms "" UBYTE PubIfStateVSM_MDL_CM_boolean 0 0 0 1 ECU_ADDRESS 0x0 /* @MemoryAddress@VSM_ACCSlowExitCons_HDCactive40ms@ */ BIT_MASK 0x01 /end MEASUREMENT
/begin MEASUREMENT VSM_ACCSlowExitCons_ABSactive400ms "" UBYTE PubIfStateVSM_MDL_CM_boolean 0 0 0 1 ECU_ADDRESS 0x0 /* @MemoryAddress@VSM_ACCSlowExitCons_ABSactive400ms@ */ BIT_MASK 0x01 /end MEASUREMENT
/begin MEASUREMENT VSM_ACCSlowExitCons_TCS1active3000ms "" UBYTE PubIfStateVSM_MDL_CM_boolean 0 0 0 1 ECU_ADDRESS 0x0 /* @MemoryAddress@VSM_ACCSlowExitCons_TCS1active3000ms@ */ BIT_MASK 0x01 /end MEASUREMENT
/begin MEASUREMENT VSM_ACCSlowExitCons_TCS2active3000ms "" UBYTE PubIfStateVSM_MDL_CM_boolean 0 0 0 1 ECU_ADDRESS 0x0 /* @MemoryAddress@VSM_ACCSlowExitCons_TCS2active3000ms@ */ BIT_MASK 0x01 /end MEASUREMENT
/begin MEASUREMENT VSM_ACCFastExitCons_DriverSBR "" UBYTE PubIfStateVSM_MDL_CM_boolean 0 0 0 1 ECU_ADDRESS 0x0 /* @MemoryAddress@VSM_ACCFastExitCons_DriverSBR@ */ BIT_MASK 0x01 /end MEASUREMENT
/begin MEASUREMENT VSM_ActiveEnable "" UBYTE PubIfStateVSM_MDL_CM_boolean 0 0 0 1 ECU_ADDRESS 0x0 /* @MemoryAddress@VSM_ActiveEnable@ */ BIT_MASK 0x01 /end MEASUREMENT
/begin MEASUREMENT VSM_ACC_USSObjExist "" UBYTE PubIfStateVSM_MDL_CM_boolean 0 0 0 1 ECU_ADDRESS 0x0 /* @MemoryAddress@VSM_ACC_USSObjExist@ */ BIT_MASK 0x01 /end MEASUREMENT
/begin MEASUREMENT VSM_ACC_DrvOfftoSM "" UBYTE PubIfStateVSM_MDL_CM_boolean 0 0 0 1 ECU_ADDRESS 0x0 /* @MemoryAddress@VSM_ACC_DrvOfftoSM@ */ BIT_MASK 0x01 /end MEASUREMENT
/begin MEASUREMENT VSM_AccOverride "" UBYTE PubIfStateVSM_MDL_CM_boolean 0 0 0 1 ECU_ADDRESS 0x0 /* @MemoryAddress@VSM_AccOverride@ */ BIT_MASK 0x01 /end MEASUREMENT
/begin MEASUREMENT VSM_ACCFastExit "" UBYTE PubIfStateVSM_MDL_CM_boolean 0 0 0 1 ECU_ADDRESS 0x0 /* @MemoryAddress@VSM_ACCFastExit@ */ BIT_MASK 0x01 /end MEASUREMENT
/begin MEASUREMENT VSM_ACCSlowExit "" UBYTE PubIfStateVSM_MDL_CM_boolean 0 0 0 1 ECU_ADDRESS 0x0 /* @MemoryAddress@VSM_ACCSlowExit@ */ BIT_MASK 0x01 /end MEASUREMENT
/begin MEASUREMENT VSM_ACC_AccPedalTouch "" UBYTE PubIfStateVSM_MDL_CM_boolean 0 0 0 1 ECU_ADDRESS 0x0 /* @MemoryAddress@VSM_ACC_AccPedalTouch@ */ BIT_MASK 0x01 /end MEASUREMENT
/begin MEASUREMENT VSM_ACC_VehCnfgACC "" UBYTE PubIfStateVSM_MDL_CM_boolean 0 0 0 1 ECU_ADDRESS 0x0 /* @MemoryAddress@VSM_ACC_VehCnfgACC@ */ BIT_MASK 0x01 /end MEASUREMENT
/begin MEASUREMENT VSM_ACC_BOMExit "" UBYTE PubIfStateVSM_MDL_CM_boolean 0 0 0 1 ECU_ADDRESS 0x0 /* @MemoryAddress@VSM_ACC_BOMExit@ */ BIT_MASK 0x01 /end MEASUREMENT
/begin MEASUREMENT VSM_ACCStandActive2Wait_DrvrSts "" UBYTE PubIfStateVSM_MDL_CM_boolean 0 0 0 1 ECU_ADDRESS 0x0 /* @MemoryAddress@VSM_ACCStandActive2Wait_DrvrSts@ */ BIT_MASK 0x01 /end MEASUREMENT
/begin MEASUREMENT VSM_ACCStandActive2Wait_USS "" UBYTE PubIfStateVSM_MDL_CM_boolean 0 0 0 1 ECU_ADDRESS 0x0 /* @MemoryAddress@VSM_ACCStandActive2Wait_USS@ */ BIT_MASK 0x01 /end MEASUREMENT
/begin MEASUREMENT VSM_ACCStandActive2Active_DrvrSts "" UBYTE PubIfStateVSM_MDL_CM_boolean 0 0 0 1 ECU_ADDRESS 0x0 /* @MemoryAddress@VSM_ACCStandActive2Active_DrvrSts@ */ BIT_MASK 0x01 /end MEASUREMENT
/begin MEASUREMENT VSM_HandsOff "" UBYTE PubIfStateVSM_MDL_CM_boolean 0 0 0 1 ECU_ADDRESS 0x0 /* @MemoryAddress@VSM_HandsOff@ */ BIT_MASK 0x01 /end MEASUREMENT
/begin MEASUREMENT VSM_User_TJASet "" UBYTE PubIfStateVSM_MDL_CM_boolean 0 0 0 1 ECU_ADDRESS 0x0 /* @MemoryAddress@VSM_User_TJASet@ */ BIT_MASK 0x01 /end MEASUREMENT
/begin MEASUREMENT VSM_ESS_PedSwtReq "" UBYTE PubIfStateVSM_MDL_CM_boolean 0 0 0 1 ECU_ADDRESS 0x0 /* @MemoryAddress@VSM_ESS_PedSwtReq@ */ BIT_MASK 0x01 /end MEASUREMENT
/begin MEASUREMENT VSM_ESS_VehSwtReq "" UBYTE PubIfStateVSM_MDL_CM_boolean 0 0 0 1 ECU_ADDRESS 0x0 /* @MemoryAddress@VSM_ESS_VehSwtReq@ */ BIT_MASK 0x01 /end MEASUREMENT
/begin MEASUREMENT VSM_ESS_Sensor_idle2error "" UBYTE PubIfStateVSM_MDL_CM_boolean 0 0 0 1 ECU_ADDRESS 0x0 /* @MemoryAddress@VSM_ESS_Sensor_idle2error@ */ BIT_MASK 0x01 /end MEASUREMENT
/begin MEASUREMENT VSM_ESS_VehicleSpd_IDLE2READY "" UBYTE PubIfStateVSM_MDL_CM_boolean 0 0 0 1 ECU_ADDRESS 0x0 /* @MemoryAddress@VSM_ESS_VehicleSpd_IDLE2READY@ */ BIT_MASK 0x01 /end MEASUREMENT
/begin MEASUREMENT VSM_ESS_ESPFuncOffSts_IDLE2READY "" UBYTE PubIfStateVSM_MDL_CM_boolean 0 0 0 1 ECU_ADDRESS 0x0 /* @MemoryAddress@VSM_ESS_ESPFuncOffSts_IDLE2READY@ */ BIT_MASK 0x01 /end MEASUREMENT
/begin MEASUREMENT VSM_ESS_DoorSts_IDLE2READY "" UBYTE PubIfStateVSM_MDL_CM_boolean 0 0 0 1 ECU_ADDRESS 0x0 /* @MemoryAddress@VSM_ESS_DoorSts_IDLE2READY@ */ BIT_MASK 0x01 /end MEASUREMENT
/begin MEASUREMENT VSM_ESS_DrvSBR_IDLE2READY "" UBYTE PubIfStateVSM_MDL_CM_boolean 0 0 0 1 ECU_ADDRESS 0x0 /* @MemoryAddress@VSM_ESS_DrvSBR_IDLE2READY@ */ BIT_MASK 0x01 /end MEASUREMENT
/begin MEASUREMENT VSM_ESS_TrailerSts_IDLE2READY "" UBYTE PubIfStateVSM_MDL_CM_boolean 0 0 0 1 ECU_ADDRESS 0x0 /* @MemoryAddress@VSM_ESS_TrailerSts_IDLE2READY@ */ BIT_MASK 0x01 /end MEASUREMENT
/begin MEASUREMENT VSM_ESS_WiprReq_IDLE2READY "" UBYTE PubIfStateVSM_MDL_CM_boolean 0 0 0 1 ECU_ADDRESS 0x0 /* @MemoryAddress@VSM_ESS_WiprReq_IDLE2READY@ */ BIT_MASK 0x01 /end MEASUREMENT
/begin MEASUREMENT VSM_ESS_HiLoBeam_IDLE2READY "" UBYTE PubIfStateVSM_MDL_CM_boolean 0 0 0 1 ECU_ADDRESS 0x0 /* @MemoryAddress@VSM_ESS_HiLoBeam_IDLE2READY@ */ BIT_MASK 0x01 /end MEASUREMENT
/begin MEASUREMENT VSM_ESS_ESPActive_IDLE2READY "" UBYTE PubIfStateVSM_MDL_CM_boolean 0 0 0 1 ECU_ADDRESS 0x0 /* @MemoryAddress@VSM_ESS_ESPActive_IDLE2READY@ */ BIT_MASK 0x01 /end MEASUREMENT
/begin MEASUREMENT VSM_ESS_LateralAccel_IDLE2READY "" UBYTE PubIfStateVSM_MDL_CM_boolean 0 0 0 1 ECU_ADDRESS 0x0 /* @MemoryAddress@VSM_ESS_LateralAccel_IDLE2READY@ */ BIT_MASK 0x01 /end MEASUREMENT
/begin MEASUREMENT VSM_ESS_IDLE2READY "" UBYTE PubIfStateVSM_MDL_CM_boolean 0 0 0 1 ECU_ADDRESS 0x0 /* @MemoryAddress@VSM_ESS_IDLE2READY@ */ BIT_MASK 0x01 /end MEASUREMENT
/begin MEASUREMENT VSM_ESS_VehicleSpd_READY2IDLE "" UBYTE PubIfStateVSM_MDL_CM_boolean 0 0 0 1 ECU_ADDRESS 0x0 /* @MemoryAddress@VSM_ESS_VehicleSpd_READY2IDLE@ */ BIT_MASK 0x01 /end MEASUREMENT
/begin MEASUREMENT VSM_ESS_ESPFuncOffSts_READY2IDLE "" UBYTE PubIfStateVSM_MDL_CM_boolean 0 0 0 1 ECU_ADDRESS 0x0 /* @MemoryAddress@VSM_ESS_ESPFuncOffSts_READY2IDLE@ */ BIT_MASK 0x01 /end MEASUREMENT
/begin MEASUREMENT VSM_ESS_DoorSts_READY2IDLE "" UBYTE PubIfStateVSM_MDL_CM_boolean 0 0 0 1 ECU_ADDRESS 0x0 /* @MemoryAddress@VSM_ESS_DoorSts_READY2IDLE@ */ BIT_MASK 0x01 /end MEASUREMENT
/begin MEASUREMENT VSM_ESS_DrvSBR_READY2IDLE "" UBYTE PubIfStateVSM_MDL_CM_boolean 0 0 0 1 ECU_ADDRESS 0x0 /* @MemoryAddress@VSM_ESS_DrvSBR_READY2IDLE@ */ BIT_MASK 0x01 /end MEASUREMENT
/begin MEASUREMENT VSM_ESS_TrailerSts_READY2IDLE "" UBYTE PubIfStateVSM_MDL_CM_boolean 0 0 0 1 ECU_ADDRESS 0x0 /* @MemoryAddress@VSM_ESS_TrailerSts_READY2IDLE@ */ BIT_MASK 0x01 /end MEASUREMENT
/begin MEASUREMENT VSM_ESS_WiprReq_READY2IDLE "" UBYTE PubIfStateVSM_MDL_CM_boolean 0 0 0 1 ECU_ADDRESS 0x0 /* @MemoryAddress@VSM_ESS_WiprReq_READY2IDLE@ */ BIT_MASK 0x01 /end MEASUREMENT
/begin MEASUREMENT VSM_ESS_HiLoBeam_READY2IDLE "" UBYTE PubIfStateVSM_MDL_CM_boolean 0 0 0 1 ECU_ADDRESS 0x0 /* @MemoryAddress@VSM_ESS_HiLoBeam_READY2IDLE@ */ BIT_MASK 0x01 /end MEASUREMENT
/begin MEASUREMENT VSM_ESS_ESPActive_READY2IDLE "" UBYTE PubIfStateVSM_MDL_CM_boolean 0 0 0 1 ECU_ADDRESS 0x0 /* @MemoryAddress@VSM_ESS_ESPActive_READY2IDLE@ */ BIT_MASK 0x01 /end MEASUREMENT
/begin MEASUREMENT VSM_ESS_LateralAccel_READY2IDLE "" UBYTE PubIfStateVSM_MDL_CM_boolean 0 0 0 1 ECU_ADDRESS 0x0 /* @MemoryAddress@VSM_ESS_LateralAccel_READY2IDLE@ */ BIT_MASK 0x01 /end MEASUREMENT
/begin MEASUREMENT VSM_ESS_READY2IDLE "" UBYTE PubIfStateVSM_MDL_CM_boolean 0 0 0 1 ECU_ADDRESS 0x0 /* @MemoryAddress@VSM_ESS_READY2IDLE@ */ BIT_MASK 0x01 /end MEASUREMENT
/begin MEASUREMENT VSM_ESS_FcwWarn_Ready2Active "" UBYTE PubIfStateVSM_MDL_CM_boolean 0 0 0 1 ECU_ADDRESS 0x0 /* @MemoryAddress@VSM_ESS_FcwWarn_Ready2Active@ */ BIT_MASK 0x01 /end MEASUREMENT
/begin MEASUREMENT VSM_ESS_FcwDisFlag_Ready2Active "" UBYTE PubIfStateVSM_MDL_CM_boolean 0 0 0 1 ECU_ADDRESS 0x0 /* @MemoryAddress@VSM_ESS_FcwDisFlag_Ready2Active@ */ BIT_MASK 0x01 /end MEASUREMENT
/begin MEASUREMENT VSM_ESS_FcwFlag_READY2ACTIVE "" UBYTE PubIfStateVSM_MDL_CM_boolean 0 0 0 1 ECU_ADDRESS 0x0 /* @MemoryAddress@VSM_ESS_FcwFlag_READY2ACTIVE@ */ BIT_MASK 0x01 /end MEASUREMENT
/begin MEASUREMENT VSM_ESS_AEBVehFlag_Ready2Active "" UBYTE PubIfStateVSM_MDL_CM_boolean 0 0 0 1 ECU_ADDRESS 0x0 /* @MemoryAddress@VSM_ESS_AEBVehFlag_Ready2Active@ */ BIT_MASK 0x01 /end MEASUREMENT
/begin MEASUREMENT VSM_ESS_AEBVruFlag_Ready2Active "" UBYTE PubIfStateVSM_MDL_CM_boolean 0 0 0 1 ECU_ADDRESS 0x0 /* @MemoryAddress@VSM_ESS_AEBVruFlag_Ready2Active@ */ BIT_MASK 0x01 /end MEASUREMENT
/begin MEASUREMENT VSM_ESS_AEBFlag_READY2ACTIVE "" UBYTE PubIfStateVSM_MDL_CM_boolean 0 0 0 1 ECU_ADDRESS 0x0 /* @MemoryAddress@VSM_ESS_AEBFlag_READY2ACTIVE@ */ BIT_MASK 0x01 /end MEASUREMENT
/begin MEASUREMENT VSM_ESS_AccelPed_READY2ACTIVE "" UBYTE PubIfStateVSM_MDL_CM_boolean 0 0 0 1 ECU_ADDRESS 0x0 /* @MemoryAddress@VSM_ESS_AccelPed_READY2ACTIVE@ */ BIT_MASK 0x01 /end MEASUREMENT
/begin MEASUREMENT VSM_ESS_VehLgtAccel_READY2ACTIVE "" UBYTE PubIfStateVSM_MDL_CM_boolean 0 0 0 1 ECU_ADDRESS 0x0 /* @MemoryAddress@VSM_ESS_VehLgtAccel_READY2ACTIVE@ */ BIT_MASK 0x01 /end MEASUREMENT
/begin MEASUREMENT VSM_ESS_READY2ACTIVE "" UBYTE PubIfStateVSM_MDL_CM_boolean 0 0 0 1 ECU_ADDRESS 0x0 /* @MemoryAddress@VSM_ESS_READY2ACTIVE@ */ BIT_MASK 0x01 /end MEASUREMENT
/begin MEASUREMENT VSM_ESS_ESPActive_ACTIVE2IDLE "" UBYTE PubIfStateVSM_MDL_CM_boolean 0 0 0 1 ECU_ADDRESS 0x0 /* @MemoryAddress@VSM_ESS_ESPActive_ACTIVE2IDLE@ */ BIT_MASK 0x01 /end MEASUREMENT
/begin MEASUREMENT VSM_ESS_LateralAccel_ACTIVE2IDLE "" UBYTE PubIfStateVSM_MDL_CM_boolean 0 0 0 1 ECU_ADDRESS 0x0 /* @MemoryAddress@VSM_ESS_LateralAccel_ACTIVE2IDLE@ */ BIT_MASK 0x01 /end MEASUREMENT
/begin MEASUREMENT VSM_ESS_ESPFuncOffSts_ACTIVE2IDLE "" UBYTE PubIfStateVSM_MDL_CM_boolean 0 0 0 1 ECU_ADDRESS 0x0 /* @MemoryAddress@VSM_ESS_ESPFuncOffSts_ACTIVE2IDLE@ */ BIT_MASK 0x01 /end MEASUREMENT
/begin MEASUREMENT VSM_ESS_DoorSts_ACTIVE2IDLE "" UBYTE PubIfStateVSM_MDL_CM_boolean 0 0 0 1 ECU_ADDRESS 0x0 /* @MemoryAddress@VSM_ESS_DoorSts_ACTIVE2IDLE@ */ BIT_MASK 0x01 /end MEASUREMENT
/begin MEASUREMENT VSM_ESS_DrvSBR_ACTIVE2IDLE "" UBYTE PubIfStateVSM_MDL_CM_boolean 0 0 0 1 ECU_ADDRESS 0x0 /* @MemoryAddress@VSM_ESS_DrvSBR_ACTIVE2IDLE@ */ BIT_MASK 0x01 /end MEASUREMENT
/begin MEASUREMENT VSM_ESS_AEBTrigFlag_ACTIVE2IDLE "" UBYTE PubIfStateVSM_MDL_CM_boolean 0 0 0 1 ECU_ADDRESS 0x0 /* @MemoryAddress@VSM_ESS_AEBTrigFlag_ACTIVE2IDLE@ */ BIT_MASK 0x01 /end MEASUREMENT
/begin MEASUREMENT VSM_ESS_VehicleSpd_ACTIVE2IDLE "" UBYTE PubIfStateVSM_MDL_CM_boolean 0 0 0 1 ECU_ADDRESS 0x0 /* @MemoryAddress@VSM_ESS_VehicleSpd_ACTIVE2IDLE@ */ BIT_MASK 0x01 /end MEASUREMENT
/begin MEASUREMENT VSM_ESS_MasterCylindBrakePress_ACTIVE2IDLE "" UBYTE PubIfStateVSM_MDL_CM_boolean 0 0 0 1 ECU_ADDRESS 0x0 /* @MemoryAddress@VSM_ESS_MasterCylindBrakePress_ACTIVE2IDLE@ */ BIT_MASK 0x01 /end MEASUREMENT
/begin MEASUREMENT VSM_ESS_ACTIVE2IDLE "" UBYTE PubIfStateVSM_MDL_CM_boolean 0 0 0 1 ECU_ADDRESS 0x0 /* @MemoryAddress@VSM_ESS_ACTIVE2IDLE@ */ BIT_MASK 0x01 /end MEASUREMENT
/begin MEASUREMENT VSM_ESS_DPC_L_Active2Ready "" UBYTE PubIfStateVSM_MDL_CM_boolean 0 0 0 1 ECU_ADDRESS 0x0 /* @MemoryAddress@VSM_ESS_DPC_L_Active2Ready@ */ BIT_MASK 0x01 /end MEASUREMENT
/begin MEASUREMENT VSM_ESS_LineA1_Active2Ready "" UBYTE PubIfStateVSM_MDL_CM_boolean 0 0 0 1 ECU_ADDRESS 0x0 /* @MemoryAddress@VSM_ESS_LineA1_Active2Ready@ */ BIT_MASK 0x01 /end MEASUREMENT
/begin MEASUREMENT VSM_ESS_LineA0_Active2Ready "" UBYTE PubIfStateVSM_MDL_CM_boolean 0 0 0 1 ECU_ADDRESS 0x0 /* @MemoryAddress@VSM_ESS_LineA0_Active2Ready@ */ BIT_MASK 0x01 /end MEASUREMENT
/begin MEASUREMENT VSM_ESS_DrvOver_Active2Ready_DiffDirc "" UBYTE PubIfStateVSM_MDL_CM_boolean 0 0 0 1 ECU_ADDRESS 0x0 /* @MemoryAddress@VSM_ESS_DrvOver_Active2Ready_DiffDirc@ */ BIT_MASK 0x01 /end MEASUREMENT
/begin MEASUREMENT VSM_ESS_DrvOver_Active2Ready_SamDirc "" UBYTE PubIfStateVSM_MDL_CM_boolean 0 0 0 1 ECU_ADDRESS 0x0 /* @MemoryAddress@VSM_ESS_DrvOver_Active2Ready_SamDirc@ */ BIT_MASK 0x01 /end MEASUREMENT
/begin MEASUREMENT VSM_ESS_DrvOver_Active2Ready "" UBYTE PubIfStateVSM_MDL_CM_boolean 0 0 0 1 ECU_ADDRESS 0x0 /* @MemoryAddress@VSM_ESS_DrvOver_Active2Ready@ */ BIT_MASK 0x01 /end MEASUREMENT
/begin MEASUREMENT VSM_ESS_L_Oncoming_Active2Ready "" UBYTE PubIfStateVSM_MDL_CM_boolean 0 0 0 1 ECU_ADDRESS 0x0 /* @MemoryAddress@VSM_ESS_L_Oncoming_Active2Ready@ */ BIT_MASK 0x01 /end MEASUREMENT
/begin MEASUREMENT VSM_ESS_LValid_Active2Ready "" UBYTE PubIfStateVSM_MDL_CM_boolean 0 0 0 1 ECU_ADDRESS 0x0 /* @MemoryAddress@VSM_ESS_LValid_Active2Ready@ */ BIT_MASK 0x01 /end MEASUREMENT
/begin MEASUREMENT VSM_ESS_L_ACTIVE2READY "" UBYTE PubIfStateVSM_MDL_CM_boolean 0 0 0 1 ECU_ADDRESS 0x0 /* @MemoryAddress@VSM_ESS_L_ACTIVE2READY@ */ BIT_MASK 0x01 /end MEASUREMENT
/begin MEASUREMENT VSM_ESS_DPC_R_Active2Ready "" UBYTE PubIfStateVSM_MDL_CM_boolean 0 0 0 1 ECU_ADDRESS 0x0 /* @MemoryAddress@VSM_ESS_DPC_R_Active2Ready@ */ BIT_MASK 0x01 /end MEASUREMENT
/begin MEASUREMENT VSM_ESS_R_Oncoming_Active2Ready "" UBYTE PubIfStateVSM_MDL_CM_boolean 0 0 0 1 ECU_ADDRESS 0x0 /* @MemoryAddress@VSM_ESS_R_Oncoming_Active2Ready@ */ BIT_MASK 0x01 /end MEASUREMENT
/begin MEASUREMENT VSM_ESS_RValid_Active2Ready "" UBYTE PubIfStateVSM_MDL_CM_boolean 0 0 0 1 ECU_ADDRESS 0x0 /* @MemoryAddress@VSM_ESS_RValid_Active2Ready@ */ BIT_MASK 0x01 /end MEASUREMENT
/begin MEASUREMENT VSM_ESS_R_ACTIVE2READY "" UBYTE PubIfStateVSM_MDL_CM_boolean 0 0 0 1 ECU_ADDRESS 0x0 /* @MemoryAddress@VSM_ESS_R_ACTIVE2READY@ */ BIT_MASK 0x01 /end MEASUREMENT
/begin MEASUREMENT VSM_ESS_L_SteerWheelSpdSign_Ready2Active "" UBYTE PubIfStateVSM_MDL_CM_boolean 0 0 0 1 ECU_ADDRESS 0x0 /* @MemoryAddress@VSM_ESS_L_SteerWheelSpdSign_Ready2Active@ */ BIT_MASK 0x01 /end MEASUREMENT
/begin MEASUREMENT VSM_ESS_LineLValid_Ready2Active "" UBYTE PubIfStateVSM_MDL_CM_boolean 0 0 0 1 ECU_ADDRESS 0x0 /* @MemoryAddress@VSM_ESS_LineLValid_Ready2Active@ */ BIT_MASK 0x01 /end MEASUREMENT
/begin MEASUREMENT VSM_ESS_LeftOncoming_Ready2Active "" UBYTE PubIfStateVSM_MDL_CM_boolean 0 0 0 1 ECU_ADDRESS 0x0 /* @MemoryAddress@VSM_ESS_LeftOncoming_Ready2Active@ */ BIT_MASK 0x01 /end MEASUREMENT
/begin MEASUREMENT VSM_ESS_DangerPlausLeft_Ready2Active "" UBYTE PubIfStateVSM_MDL_CM_boolean 0 0 0 1 ECU_ADDRESS 0x0 /* @MemoryAddress@VSM_ESS_DangerPlausLeft_Ready2Active@ */ BIT_MASK 0x01 /end MEASUREMENT
/begin MEASUREMENT VSM_ESS_SteerWheelSpd_READY2ACTIVE "" UBYTE PubIfStateVSM_MDL_CM_boolean 0 0 0 1 ECU_ADDRESS 0x0 /* @MemoryAddress@VSM_ESS_SteerWheelSpd_READY2ACTIVE@ */ BIT_MASK 0x01 /end MEASUREMENT
/begin MEASUREMENT VSM_ESS_Left_READY2ACTIVE "" UBYTE PubIfStateVSM_MDL_CM_boolean 0 0 0 1 ECU_ADDRESS 0x0 /* @MemoryAddress@VSM_ESS_Left_READY2ACTIVE@ */ BIT_MASK 0x01 /end MEASUREMENT
/begin MEASUREMENT VSM_ESS_R_SteerWheelSpdSign_Ready2Active "" UBYTE PubIfStateVSM_MDL_CM_boolean 0 0 0 1 ECU_ADDRESS 0x0 /* @MemoryAddress@VSM_ESS_R_SteerWheelSpdSign_Ready2Active@ */ BIT_MASK 0x01 /end MEASUREMENT
/begin MEASUREMENT VSM_ESS_LineRValid_Ready2Active "" UBYTE PubIfStateVSM_MDL_CM_boolean 0 0 0 1 ECU_ADDRESS 0x0 /* @MemoryAddress@VSM_ESS_LineRValid_Ready2Active@ */ BIT_MASK 0x01 /end MEASUREMENT
/begin MEASUREMENT VSM_ESS_RightOncoming_Ready2Active "" UBYTE PubIfStateVSM_MDL_CM_boolean 0 0 0 1 ECU_ADDRESS 0x0 /* @MemoryAddress@VSM_ESS_RightOncoming_Ready2Active@ */ BIT_MASK 0x01 /end MEASUREMENT
/begin MEASUREMENT VSM_ESS_DangerPlausRight_Ready2Active "" UBYTE PubIfStateVSM_MDL_CM_boolean 0 0 0 1 ECU_ADDRESS 0x0 /* @MemoryAddress@VSM_ESS_DangerPlausRight_Ready2Active@ */ BIT_MASK 0x01 /end MEASUREMENT
/begin MEASUREMENT VSM_ESS_Right_READY2ACTIVE "" UBYTE PubIfStateVSM_MDL_CM_boolean 0 0 0 1 ECU_ADDRESS 0x0 /* @MemoryAddress@VSM_ESS_Right_READY2ACTIVE@ */ BIT_MASK 0x01 /end MEASUREMENT
/begin MEASUREMENT VSM_SomeHWASafeStop2ExitConditions_b "" UBYTE PubIfStateVSM_MDL_CM_boolean 0 0 0 1 ECU_ADDRESS 0x0 /* @MemoryAddress@VSM_SomeHWASafeStop2ExitConditions_b@ */ BIT_MASK 0x01 /end MEASUREMENT
/begin MEASUREMENT VSM_HWASlowExitCons_NotHighWayArterialRoad5s "" UBYTE PubIfStateVSM_MDL_CM_boolean 0 0 0 1 ECU_ADDRESS 0x0 /* @MemoryAddress@VSM_HWASlowExitCons_NotHighWayArterialRoad5s@ */ BIT_MASK 0x01 /end MEASUREMENT
/begin MEASUREMENT VSM_HWASlowExitCons_ACCError "" UBYTE PubIfStateVSM_MDL_CM_boolean 0 0 0 1 ECU_ADDRESS 0x0 /* @MemoryAddress@VSM_HWASlowExitCons_ACCError@ */ BIT_MASK 0x01 /end MEASUREMENT
/begin MEASUREMENT VSM_HWASlowExitConditions_b "" UBYTE PubIfStateVSM_MDL_CM_boolean 0 0 0 1 ECU_ADDRESS 0x0 /* @MemoryAddress@VSM_HWASlowExitConditions_b@ */ BIT_MASK 0x01 /end MEASUREMENT
/begin MEASUREMENT VSM_HandsOn "" UBYTE PubIfStateVSM_MDL_CM_boolean 0 0 0 1 ECU_ADDRESS 0x0 /* @MemoryAddress@VSM_HandsOn@ */ BIT_MASK 0x01 /end MEASUREMENT
/begin MEASUREMENT VSM_ELK_Con_AccPedalRate_Active2Ready "" UBYTE PubIfStateVSM_MDL_CM_boolean 0 0 0 1 ECU_ADDRESS 0x0 /* @MemoryAddress@VSM_ELK_Con_AccPedalRate_Active2Ready@ */ BIT_MASK 0x01 /end MEASUREMENT
/begin MEASUREMENT VSM_ELK_Con_BrakePressure_Active2Ready "" UBYTE PubIfStateVSM_MDL_CM_boolean 0 0 0 1 ECU_ADDRESS 0x0 /* @MemoryAddress@VSM_ELK_Con_BrakePressure_Active2Ready@ */ BIT_MASK 0x01 /end MEASUREMENT
/begin MEASUREMENT VSM_ELK_Con_SteerWheelAngle_Active2Ready "" UBYTE PubIfStateVSM_MDL_CM_boolean 0 0 0 1 ECU_ADDRESS 0x0 /* @MemoryAddress@VSM_ELK_Con_SteerWheelAngle_Active2Ready@ */ BIT_MASK 0x01 /end MEASUREMENT
/begin MEASUREMENT VSM_ELK_Con_SteerWheelSpd_Active2Ready "" UBYTE PubIfStateVSM_MDL_CM_boolean 0 0 0 1 ECU_ADDRESS 0x0 /* @MemoryAddress@VSM_ELK_Con_SteerWheelSpd_Active2Ready@ */ BIT_MASK 0x01 /end MEASUREMENT
/begin MEASUREMENT VSM_ACC_SWSet "" UBYTE PubIfStateVSM_MDL_CM_boolean 0 0 0 1 ECU_ADDRESS 0x0 /* @MemoryAddress@VSM_ACC_SWSet@ */ BIT_MASK 0x01 /end MEASUREMENT
/begin MEASUREMENT VSM_ACC_SWRes "" UBYTE PubIfStateVSM_MDL_CM_boolean 0 0 0 1 ECU_ADDRESS 0x0 /* @MemoryAddress@VSM_ACC_SWRes@ */ BIT_MASK 0x01 /end MEASUREMENT
/begin MEASUREMENT VSM_ACC_VsetBelowMin "" UBYTE PubIfStateVSM_MDL_CM_boolean 0 0 0 1 ECU_ADDRESS 0x0 /* @MemoryAddress@VSM_ACC_VsetBelowMin@ */ BIT_MASK 0x01 /end MEASUREMENT
/begin MEASUREMENT VSM_ELK_Con_YawRate_Idle2Ready "" UBYTE PubIfStateVSM_MDL_CM_boolean 0 0 0 1 ECU_ADDRESS 0x0 /* @MemoryAddress@VSM_ELK_Con_YawRate_Idle2Ready@ */ BIT_MASK 0x01 /end MEASUREMENT
/begin MEASUREMENT VSM_ELK_Con_AbsEsp_Idle2Ready "" UBYTE PubIfStateVSM_MDL_CM_boolean 0 0 0 1 ECU_ADDRESS 0x0 /* @MemoryAddress@VSM_ELK_Con_AbsEsp_Idle2Ready@ */ BIT_MASK 0x01 /end MEASUREMENT
/begin MEASUREMENT VSM_ELK_Con_Headingangel_Idle2Ready "" UBYTE PubIfStateVSM_MDL_CM_boolean 0 0 0 1 ECU_ADDRESS 0x0 /* @MemoryAddress@VSM_ELK_Con_Headingangel_Idle2Ready@ */ BIT_MASK 0x01 /end MEASUREMENT
/begin MEASUREMENT VSM_ELK_Con_Failsafe_Idle2Ready "" UBYTE PubIfStateVSM_MDL_CM_boolean 0 0 0 1 ECU_ADDRESS 0x0 /* @MemoryAddress@VSM_ELK_Con_Failsafe_Idle2Ready@ */ BIT_MASK 0x01 /end MEASUREMENT
/begin MEASUREMENT VSM_ELK_Con_LaneCurve_Idle2Ready "" UBYTE PubIfStateVSM_MDL_CM_boolean 0 0 0 1 ECU_ADDRESS 0x0 /* @MemoryAddress@VSM_ELK_Con_LaneCurve_Idle2Ready@ */ BIT_MASK 0x01 /end MEASUREMENT
/begin MEASUREMENT VSM_ELK_Con_VehicleSpeed_Idle2ReadyELK "" UBYTE PubIfStateVSM_MDL_CM_boolean 0 0 0 1 ECU_ADDRESS 0x0 /* @MemoryAddress@VSM_ELK_Con_VehicleSpeed_Idle2ReadyELK@ */ BIT_MASK 0x01 /end MEASUREMENT
/begin MEASUREMENT VSM_ELK_Con_Lane_Idle2Ready "" UBYTE PubIfStateVSM_MDL_CM_boolean 0 0 0 1 ECU_ADDRESS 0x0 /* @MemoryAddress@VSM_ELK_Con_Lane_Idle2Ready@ */ BIT_MASK 0x01 /end MEASUREMENT
/begin MEASUREMENT VSM_ELK_Con_ESSSts_Idle2Ready "" UBYTE PubIfStateVSM_MDL_CM_boolean 0 0 0 1 ECU_ADDRESS 0x0 /* @MemoryAddress@VSM_ELK_Con_ESSSts_Idle2Ready@ */ BIT_MASK 0x01 /end MEASUREMENT
/begin MEASUREMENT VSM_ELK_Idle2Ready "" UBYTE PubIfStateVSM_MDL_CM_boolean 0 0 0 1 ECU_ADDRESS 0x0 /* @MemoryAddress@VSM_ELK_Idle2Ready@ */ BIT_MASK 0x01 /end MEASUREMENT
/begin MEASUREMENT VSM_ELK_Con_YawRate_Ready2Idle "" UBYTE PubIfStateVSM_MDL_CM_boolean 0 0 0 1 ECU_ADDRESS 0x0 /* @MemoryAddress@VSM_ELK_Con_YawRate_Ready2Idle@ */ BIT_MASK 0x01 /end MEASUREMENT
/begin MEASUREMENT VSM_ELK_Con_AbsEsp_Ready2Idle "" UBYTE PubIfStateVSM_MDL_CM_boolean 0 0 0 1 ECU_ADDRESS 0x0 /* @MemoryAddress@VSM_ELK_Con_AbsEsp_Ready2Idle@ */ BIT_MASK 0x01 /end MEASUREMENT
/begin MEASUREMENT VSM_ELK_Con_Failsafe_Ready2Idle "" UBYTE PubIfStateVSM_MDL_CM_boolean 0 0 0 1 ECU_ADDRESS 0x0 /* @MemoryAddress@VSM_ELK_Con_Failsafe_Ready2Idle@ */ BIT_MASK 0x01 /end MEASUREMENT
/begin MEASUREMENT VSM_ELK_Con_LaneCurve_Ready2Idle "" UBYTE PubIfStateVSM_MDL_CM_boolean 0 0 0 1 ECU_ADDRESS 0x0 /* @MemoryAddress@VSM_ELK_Con_LaneCurve_Ready2Idle@ */ BIT_MASK 0x01 /end MEASUREMENT
/begin MEASUREMENT VSM_ELK_Con_Headingangle_Ready2Idle "" UBYTE PubIfStateVSM_MDL_CM_boolean 0 0 0 1 ECU_ADDRESS 0x0 /* @MemoryAddress@VSM_ELK_Con_Headingangle_Ready2Idle@ */ BIT_MASK 0x01 /end MEASUREMENT
/begin MEASUREMENT VSM_ELK_Con_VehicleSpeed_Ready2Idle "" UBYTE PubIfStateVSM_MDL_CM_boolean 0 0 0 1 ECU_ADDRESS 0x0 /* @MemoryAddress@VSM_ELK_Con_VehicleSpeed_Ready2Idle@ */ BIT_MASK 0x01 /end MEASUREMENT
/begin MEASUREMENT VSM_ELK_Con_Lane_Ready2Idle "" UBYTE PubIfStateVSM_MDL_CM_boolean 0 0 0 1 ECU_ADDRESS 0x0 /* @MemoryAddress@VSM_ELK_Con_Lane_Ready2Idle@ */ BIT_MASK 0x01 /end MEASUREMENT
/begin MEASUREMENT VSM_ELK_Con_ESSSts_Ready2Idle "" UBYTE PubIfStateVSM_MDL_CM_boolean 0 0 0 1 ECU_ADDRESS 0x0 /* @MemoryAddress@VSM_ELK_Con_ESSSts_Ready2Idle@ */ BIT_MASK 0x01 /end MEASUREMENT
/begin MEASUREMENT VSM_ELK_Other2Idle "" UBYTE PubIfStateVSM_MDL_CM_boolean 0 0 0 1 ECU_ADDRESS 0x0 /* @MemoryAddress@VSM_ELK_Other2Idle@ */ BIT_MASK 0x01 /end MEASUREMENT
/begin MEASUREMENT VSM_ELK_Con_SteerWheelAngle_Ready2Active "" UBYTE PubIfStateVSM_MDL_CM_boolean 0 0 0 1 ECU_ADDRESS 0x0 /* @MemoryAddress@VSM_ELK_Con_SteerWheelAngle_Ready2Active@ */ BIT_MASK 0x01 /end MEASUREMENT
/begin MEASUREMENT VSM_ELK_Con_DriverInput_Ready2Active "" UBYTE PubIfStateVSM_MDL_CM_boolean 0 0 0 1 ECU_ADDRESS 0x0 /* @MemoryAddress@VSM_ELK_Con_DriverInput_Ready2Active@ */ BIT_MASK 0x01 /end MEASUREMENT
/begin MEASUREMENT VSM_ELK_Con_SteerWheelSpd_Ready2Active "" UBYTE PubIfStateVSM_MDL_CM_boolean 0 0 0 1 ECU_ADDRESS 0x0 /* @MemoryAddress@VSM_ELK_Con_SteerWheelSpd_Ready2Active@ */ BIT_MASK 0x01 /end MEASUREMENT
/begin MEASUREMENT VSM_ELK_Con_LateralAcc_Ready2Active "" UBYTE PubIfStateVSM_MDL_CM_boolean 0 0 0 1 ECU_ADDRESS 0x0 /* @MemoryAddress@VSM_ELK_Con_LateralAcc_Ready2Active@ */ BIT_MASK 0x01 /end MEASUREMENT
/begin MEASUREMENT VSM_ELK_Con_LongitudeAcc_Ready2Active "" UBYTE PubIfStateVSM_MDL_CM_boolean 0 0 0 1 ECU_ADDRESS 0x0 /* @MemoryAddress@VSM_ELK_Con_LongitudeAcc_Ready2Active@ */ BIT_MASK 0x01 /end MEASUREMENT
/begin MEASUREMENT VSM_ELK_Con_BrakePressure_Ready2Active "" UBYTE PubIfStateVSM_MDL_CM_boolean 0 0 0 1 ECU_ADDRESS 0x0 /* @MemoryAddress@VSM_ELK_Con_BrakePressure_Ready2Active@ */ BIT_MASK 0x01 /end MEASUREMENT
/begin MEASUREMENT VSM_ELK_Con_AccPedalRate_Ready2Active "" UBYTE PubIfStateVSM_MDL_CM_boolean 0 0 0 1 ECU_ADDRESS 0x0 /* @MemoryAddress@VSM_ELK_Con_AccPedalRate_Ready2Active@ */ BIT_MASK 0x01 /end MEASUREMENT
/begin MEASUREMENT VSM_ELK_Con_EpsSta_Ready2Active "" UBYTE PubIfStateVSM_MDL_CM_boolean 0 0 0 1 ECU_ADDRESS 0x0 /* @MemoryAddress@VSM_ELK_Con_EpsSta_Ready2Active@ */ BIT_MASK 0x01 /end MEASUREMENT
/begin MEASUREMENT VSM_ELK_Con_CURRENT_GEAR_Ready2Active "" UBYTE PubIfStateVSM_MDL_CM_boolean 0 0 0 1 ECU_ADDRESS 0x0 /* @MemoryAddress@VSM_ELK_Con_CURRENT_GEAR_Ready2Active@ */ BIT_MASK 0x01 /end MEASUREMENT
/begin MEASUREMENT VSM_ELK_Con_Override_Ready2Active "" UBYTE PubIfStateVSM_MDL_CM_boolean 0 0 0 1 ECU_ADDRESS 0x0 /* @MemoryAddress@VSM_ELK_Con_Override_Ready2Active@ */ BIT_MASK 0x01 /end MEASUREMENT
/begin MEASUREMENT VSM_ELK_Con_LaneChange_Ready2Active "" UBYTE PubIfStateVSM_MDL_CM_boolean 0 0 0 1 ECU_ADDRESS 0x0 /* @MemoryAddress@VSM_ELK_Con_LaneChange_Ready2Active@ */ BIT_MASK 0x01 /end MEASUREMENT
/begin MEASUREMENT VSM_ELK_Ready2Active "" UBYTE PubIfStateVSM_MDL_CM_boolean 0 0 0 1 ECU_ADDRESS 0x0 /* @MemoryAddress@VSM_ELK_Ready2Active@ */ BIT_MASK 0x01 /end MEASUREMENT
/begin MEASUREMENT VSM_ELK_Con_DriverInput_Active2Ready "" UBYTE PubIfStateVSM_MDL_CM_boolean 0 0 0 1 ECU_ADDRESS 0x0 /* @MemoryAddress@VSM_ELK_Con_DriverInput_Active2Ready@ */ BIT_MASK 0x01 /end MEASUREMENT
/begin MEASUREMENT VSM_ELK_Con_LateralAcc_Active2Ready "" UBYTE PubIfStateVSM_MDL_CM_boolean 0 0 0 1 ECU_ADDRESS 0x0 /* @MemoryAddress@VSM_ELK_Con_LateralAcc_Active2Ready@ */ BIT_MASK 0x01 /end MEASUREMENT
/begin MEASUREMENT VSM_ELK_Con_LongitudeAcc_Active2Ready "" UBYTE PubIfStateVSM_MDL_CM_boolean 0 0 0 1 ECU_ADDRESS 0x0 /* @MemoryAddress@VSM_ELK_Con_LongitudeAcc_Active2Ready@ */ BIT_MASK 0x01 /end MEASUREMENT
/begin MEASUREMENT VSM_ELK_Con_EpsSta_Active2Ready "" UBYTE PubIfStateVSM_MDL_CM_boolean 0 0 0 1 ECU_ADDRESS 0x0 /* @MemoryAddress@VSM_ELK_Con_EpsSta_Active2Ready@ */ BIT_MASK 0x01 /end MEASUREMENT
/begin MEASUREMENT VSM_ELK_Con_OverRide_Active2Ready "" UBYTE PubIfStateVSM_MDL_CM_boolean 0 0 0 1 ECU_ADDRESS 0x0 /* @MemoryAddress@VSM_ELK_Con_OverRide_Active2Ready@ */ BIT_MASK 0x01 /end MEASUREMENT
/begin MEASUREMENT VSM_ELK_Con_CURRENT_GEAR_Active2Ready "" UBYTE PubIfStateVSM_MDL_CM_boolean 0 0 0 1 ECU_ADDRESS 0x0 /* @MemoryAddress@VSM_ELK_Con_CURRENT_GEAR_Active2Ready@ */ BIT_MASK 0x01 /end MEASUREMENT
/begin MEASUREMENT VSM_ELK_Con_LaneChange_Active2Ready "" UBYTE PubIfStateVSM_MDL_CM_boolean 0 0 0 1 ECU_ADDRESS 0x0 /* @MemoryAddress@VSM_ELK_Con_LaneChange_Active2Ready@ */ BIT_MASK 0x01 /end MEASUREMENT
/begin MEASUREMENT VSM_ELK_Active2Ready "" UBYTE PubIfStateVSM_MDL_CM_boolean 0 0 0 1 ECU_ADDRESS 0x0 /* @MemoryAddress@VSM_ELK_Active2Ready@ */ BIT_MASK 0x01 /end MEASUREMENT
/begin MEASUREMENT VSM_ACCFastExitCons_EngLimpHome "" UBYTE PubIfStateVSM_MDL_CM_boolean 0 0 0 1 ECU_ADDRESS 0x0 /* @MemoryAddress@VSM_ACCFastExitCons_EngLimpHome@ */ BIT_MASK 0x01 /end MEASUREMENT
/begin MEASUREMENT VSM_User_ACCRes "" UBYTE PubIfStateVSM_MDL_CM_boolean 0 0 0 1 ECU_ADDRESS 0x0 /* @MemoryAddress@VSM_User_ACCRes@ */ BIT_MASK 0x01 /end MEASUREMENT
/begin MEASUREMENT VSM_HandsOffDetd "" UBYTE PubIfStateVSM_MDL_CM_boolean 0 0 0 1 ECU_ADDRESS 0x0 /* @MemoryAddress@VSM_HandsOffDetd@ */ BIT_MASK 0x01 /end MEASUREMENT
/begin MEASUREMENT VSM_ESS_DelayReady "" UBYTE PubIfStateVSM_MDL_CM_boolean 0 0 0 1 ECU_ADDRESS 0x0 /* @MemoryAddress@VSM_ESS_DelayReady@ */ BIT_MASK 0x01 /end MEASUREMENT
/begin MEASUREMENT VSM_HWA_ParkShiftReq "" UBYTE PubIfStateVSM_MDL_CM_boolean 0 0 0 1 ECU_ADDRESS 0x0 /* @MemoryAddress@VSM_HWA_ParkShiftReq@ */ BIT_MASK 0x01 /end MEASUREMENT
/begin MEASUREMENT VSM_HWAActive "" UBYTE PubIfStateVSM_MDL_CM_boolean 0 0 0 1 ECU_ADDRESS 0x0 /* @MemoryAddress@VSM_HWAActive@ */ BIT_MASK 0x01 /end MEASUREMENT
/begin MEASUREMENT VSM_HWASafeStopEn "" UBYTE PubIfStateVSM_MDL_CM_boolean 0 0 0 1 ECU_ADDRESS 0x0 /* @MemoryAddress@VSM_HWASafeStopEn@ */ BIT_MASK 0x01 /end MEASUREMENT
/begin MEASUREMENT VSM_HWAFastExit_b "" UBYTE PubIfStateVSM_MDL_CM_boolean 0 0 0 1 ECU_ADDRESS 0x0 /* @MemoryAddress@VSM_HWAFastExit_b@ */ BIT_MASK 0x01 /end MEASUREMENT
/begin MEASUREMENT VSM_HWASlowExit_b "" UBYTE PubIfStateVSM_MDL_CM_boolean 0 0 0 1 ECU_ADDRESS 0x0 /* @MemoryAddress@VSM_HWASlowExit_b@ */ BIT_MASK 0x01 /end MEASUREMENT
/begin MEASUREMENT VSM_TJASts "" UBYTE PubIfStateVSM_MDL_CM_TJA_STATE 0 0 0 10 ECU_ADDRESS 0x0 /* @MemoryAddress@VSM_TJASts@ */ /end MEASUREMENT
/begin MEASUREMENT VSM_TJALCKState "" UBYTE PubIfStateVSM_MDL_CM_LCK_STATE 0 0 0 7 ECU_ADDRESS 0x0 /* @MemoryAddress@VSM_TJALCKState@ */ /end MEASUREMENT
/begin MEASUREMENT VSM_HWASts "" UBYTE PubIfStateVSM_MDL_CM_HWA_STATE 0 0 0 12 ECU_ADDRESS 0x0 /* @MemoryAddress@VSM_HWASts@ */ /end MEASUREMENT
/begin COMPU_METHOD PubIfControlLONC_MDL_CM_single "Q = V" RAT_FUNC "%8.6" "" COEFFS 0 1 0 0 0 1 /end COMPU_METHOD
/begin COMPU_METHOD PubIfControlLONC_MDL_CM_single_m_s_2 "Q = V" RAT_FUNC "%8.6" "m/s^2" COEFFS 0 1 0 0 0 1 /end COMPU_METHOD
/begin COMPU_METHOD PubIfControlLONC_MDL_CM_single_m_s_3 "Q = V" RAT_FUNC "%8.6" "m/s^3" COEFFS 0 1 0 0 0 1 /end COMPU_METHOD
/begin COMPU_METHOD PubIfControlLONC_MDL_CM_single_km_h "Q = V" RAT_FUNC "%8.6" "km/h" COEFFS 0 1 0 0 0 1 /end COMPU_METHOD
/begin COMPU_METHOD PubIfControlLONC_MDL_CM_single__ "Q = V" RAT_FUNC "%8.6" "%" COEFFS 0 1 0 0 0 1 /end COMPU_METHOD
/begin COMPU_METHOD PubIfControlLONC_MDL_CM_single_m_s "Q = V" RAT_FUNC "%8.6" "m/s" COEFFS 0 1 0 0 0 1 /end COMPU_METHOD
/begin COMPU_METHOD PubIfControlLONC_MDL_CM_single_N "Q = V" RAT_FUNC "%8.6" "N" COEFFS 0 1 0 0 0 1 /end COMPU_METHOD
/begin COMPU_METHOD PubIfControlLONC_MDL_CM_single_m_2 "Q = V" RAT_FUNC "%8.6" "m^2" COEFFS 0 1 0 0 0 1 /end COMPU_METHOD
/begin COMPU_METHOD PubIfControlLONC_MDL_CM_boolean "Q = V" RAT_FUNC "%1.0" "" COEFFS 0 1 0 0 0 1 /end COMPU_METHOD
/begin COMPU_METHOD PubIfControlLONC_MDL_CM_double "Q = V" RAT_FUNC "%15.10" "" COEFFS 0 1 0 0 0 1 /end COMPU_METHOD
/begin COMPU_METHOD PubIfDecisionPLAN_MDL_CM_single_m "Q = V" RAT_FUNC "%8.6" "m" COEFFS 0 1 0 0 0 1 /end COMPU_METHOD
/begin COMPU_METHOD PubIfDecisionPLAN_MDL_CM_boolean "Q = V" RAT_FUNC "%1.0" "" COEFFS 0 1 0 0 0 1 /end COMPU_METHOD
/begin COMPU_METHOD PubIfStateVSM_MDL_CM_single "Q = V" RAT_FUNC "%8.6" "" COEFFS 0 1 0 0 0 1 /end COMPU_METHOD
/begin COMPU_METHOD PubIfStateVSM_MDL_CM_double "Q = V" RAT_FUNC "%15.10" "" COEFFS 0 1 0 0 0 1 /end COMPU_METHOD
/begin COMPU_METHOD PubIfStateVSM_MDL_CM_single_m "Q = V" RAT_FUNC "%8.6" "m" COEFFS 0 1 0 0 0 1 /end COMPU_METHOD
/begin COMPU_METHOD PubIfStateVSM_MDL_CM_uint16_s "Q = V" RAT_FUNC "%5.0" "s" COEFFS 0 1 0 0 0 1 /end COMPU_METHOD
/begin COMPU_METHOD PubIfStateVSM_MDL_CM_uint16__S_ "Q = V" RAT_FUNC "%5.0" "<S>" COEFFS 0 1 0 0 0 1 /end COMPU_METHOD
/begin COMPU_METHOD PubIfStateVSM_MDL_CM_uint16_num "Q = V" RAT_FUNC "%5.0" "num" COEFFS 0 1 0 0 0 1 /end COMPU_METHOD
/begin COMPU_METHOD PubIfStateVSM_MDL_CM_uint16 "Q = V" RAT_FUNC "%5.0" "" COEFFS 0 1 0 0 0 1 /end COMPU_METHOD
/begin COMPU_METHOD PubIfStateVSM_MDL_CM_boolean "Q = V" RAT_FUNC "%1.0" "" COEFFS 0 1 0 0 0 1 /end COMPU_METHOD
/begin COMPU_METHOD PubIfStateVSM_MDL_CM_uint8 "Q = V" RAT_FUNC "%3.0" "" COEFFS 0 1 0 0 0 1 /end COMPU_METHOD
/begin COMPU_METHOD PubIfStateVSM_MDL_CM_uint8_s "Q = V" RAT_FUNC "%3.0" "s" COEFFS 0 1 0 0 0 1 /end COMPU_METHOD
/begin COMPU_METHOD PubIfStateVSM_MDL_CM_uint32 "Q = V" RAT_FUNC "%10.0" "" COEFFS 0 1 0 0 0 1 /end COMPU_METHOD
/begin COMPU_METHOD PubIfStateVSM_MDL_CM_ACC_STATE "Enumerated data type: ACC_STATE" TAB_VERB "%10.6" "" COMPU_TAB_REF VTAB_FOR_PubIfStateVSM_MDL_CM_ACC_STATE /end COMPU_METHOD
/begin COMPU_METHOD PubIfStateVSM_MDL_CM_TJA_STATE "Enumerated data type: TJA_STATE" TAB_VERB "%10.6" "" COMPU_TAB_REF VTAB_FOR_PubIfStateVSM_MDL_CM_TJA_STATE /end COMPU_METHOD
/begin COMPU_METHOD PubIfStateVSM_MDL_CM_LCK_STATE "Enumerated data type: LCK_STATE" TAB_VERB "%10.6" "" COMPU_TAB_REF VTAB_FOR_PubIfStateVSM_MDL_CM_LCK_STATE /end COMPU_METHOD
/begin COMPU_METHOD PubIfStateVSM_MDL_CM_HWA_STATE "Enumerated data type: HWA_STATE" TAB_VERB "%10.6" "" COMPU_TAB_REF VTAB_FOR_PubIfStateVSM_MDL_CM_HWA_STATE /end COMPU_METHOD
/begin COMPU_VTAB VTAB_FOR_PubIfStateVSM_MDL_CM_ACC_STATE "Enumerated data type: ACC_STATE" TAB_VERB 9 0 "ACC_STATE_ACC_Off" 1 "ACC_STATE_ACC_Reject" 2 "ACC_STATE_ACC_Standby" 3 "ACC_STATE_ACC_ActiveControl" 4 "ACC_STATE_ACC_BrakeOnly" 5 "ACC_STATE_ACC_Override" 6 "ACC_STATE_ACC_StandWait" 7 "ACC_STATE_ACC_Failure" 9 "ACC_STATE_ACC_StandActive" /end COMPU_VTAB
/begin COMPU_VTAB VTAB_FOR_PubIfStateVSM_MDL_CM_TJA_STATE "Enumerated data type: TJA_STATE" TAB_VERB 8 0 "TJA_STATE_TJA_Off" 1 "TJA_STATE_TJA_Idle" 2 "TJA_STATE_TJA_Ready" 3 "TJA_STATE_TJA_Active" 7 "TJA_STATE_TJA_Error" 9 "TJA_STATE_TJA_SafeStop" 6 "TJA_STATE_TJA_Wait" 10 "TJA_STATE_TJA_SlowRetreat" /end COMPU_VTAB
/begin COMPU_VTAB VTAB_FOR_PubIfStateVSM_MDL_CM_LCK_STATE "Enumerated data type: LCK_STATE" TAB_VERB 5 0 "LCK_STATE_LCK_Off" 1 "LCK_STATE_LCK_Idle" 2 "LCK_STATE_LCK_Ready" 3 "LCK_STATE_LCK_Active" 7 "LCK_STATE_LCK_Error" /end COMPU_VTAB
/begin COMPU_VTAB VTAB_FOR_PubIfStateVSM_MDL_CM_HWA_STATE "Enumerated data type: HWA_STATE" TAB_VERB 12 0 "HWA_STATE_HWA_Off" 1 "HWA_STATE_HWA_Idle" 2 "HWA_STATE_HWA_Ready" 3 "HWA_STATE_HWA_CCAct" 4 "HWA_STATE_HWA_Pause" 5 "HWA_STATE_HWA_LeftTurn" 6 "HWA_STATE_HWA_RightTurn" 7 "HWA_STATE_HWA_Error" 9 "HWA_STATE_HWA_SafeStop" 10 "HWA_STATE_HWA_SlowRetreat" 11 "HWA_STATE_HWA_LeftTurnPrepare" 12 "HWA_STATE_HWA_RightTurnPrepare" /end COMPU_VTAB
/begin GROUP S6_DC "PubIfControlLONC_MDL/Subsystem/VLC/Vlc/DC"
 /begin REF_CHARACTERISTIC P_LongCtrl_VLCaccelMinHoldXAxis P_LongCtrl_VLCaccelMinHoldYAxis P_LongCtrl_VLCaccelMinSlidHoldXAxis P_LongCtrl_VLCaccelMinSlidHoldYAxis P_LongCtrl_VLCjerkHoldXAxis P_LongCtrl_VLCjerkHoldYAxis P_LongCtrl_VLCjerkSlidHoldXAxis P_LongCtrl_VLCjerkSlidHoldYAxis /end REF_CHARACTERISTIC
 /begin REF_MEASUREMENT LongCtrl_ACC_Decel_ReqValue LongCtrl_accelHoldMin LongCtrl_accelSlidHold LongCtrl_jerkHold LongCtrl_jerkSlidHold /end REF_MEASUREMENT
/end GROUP
/begin GROUP S6_EC "PubIfControlLONC_MDL/Subsystem/VLC/Vlc/EC"
 /begin REF_CHARACTERISTIC P_Global_Weight_N P_LongCtrl_VLCCounterDC2ECTorqDelay P_LongCtrl_VLCCounterDrvOff2EC P_LongCtrl_VLCLowerJerkCounterDrvOff2EC P_LongCtrl_VLCUpperJerkCounterDrvOff2EC P_LongCtrl_VLCcoefPIYAxis P_LongCtrl_VLCvelCharCoefPIXAxis /end REF_CHARACTERISTIC
 /begin REF_MEASUREMENT LongCtrl_ACC_EngTrqReq LongCtrl_UpdateLowerValue LongCtrl_UpdateUpperValue /end REF_MEASUREMENT
/end GROUP
/begin GROUP S6_FF_Control "PubIfControlLONC_MDL/Subsystem/VLC/Vlc/FF_Control"
 /begin REF_CHARACTERISTIC P_Global_Weight_N P_LongCtrl_VLCengInverseEfficientYAxis P_LongCtrl_VLCtorqCharEngInverseEfficientXAxis /end REF_CHARACTERISTIC
 /begin REF_MEASUREMENT LongCtrl_FF_NetEngTorqInc LongCtrl_FF_NetEngTorqMax /end REF_MEASUREMENT
/end GROUP
/begin GROUP S6_PI_Control "PubIfControlLONC_MDL/Subsystem/VLC/Vlc/PI_Control"
 /begin REF_CHARACTERISTIC P_LongCtrl_VLCAxTarDtThreEnableI P_LongCtrl_VLCIACompensionNeg P_LongCtrl_VLCIACompensionPos P_LongCtrl_VLCaDiffCharCoefKiEnableXAxis P_LongCtrl_VLCaDiffCharCoefKiXAxis P_LongCtrl_VLCcoefIFadeOut1Calc P_LongCtrl_VLCcoefIFadeOut1Condition P_LongCtrl_VLCcoefIFadeOut2Calc P_LongCtrl_VLCcoefIFadeOut2Condition P_LongCtrl_VLCcoefIFadeOut3Calc P_LongCtrl_VLCcoefIFadeOut3Condition P_LongCtrl_VLCcoefKiDiffDtEnlargeYAxis P_LongCtrl_VLCcoefKiEnableYAxis P_LongCtrl_VLCdiffDtCharCoefKiEnlargeXAxis P_LongCtrl_VLCvelCharAxCtrlDevDeadZoneXAxis /end REF_CHARACTERISTIC
 /begin REF_MEASUREMENT LongCtrl_PI_NetEngTorqInc /end REF_MEASUREMENT
/end GROUP
/begin GROUP S6_SlidJudge "PubIfControlLONC_MDL/Subsystem/VLC/Vlc/SlidJudge"
 /begin REF_CHARACTERISTIC P_LongCtrl_AxvRoadSlopeThrd P_LongCtrl_SlideFlagEnable P_LongCtrl_TotWheelTrqRatio P_LongCtrl_VxvRefThrd /end REF_CHARACTERISTIC
 /begin REF_MEASUREMENT LongCtrl_ForwardFlagTrq LongCtrl_ForwardFlagVxv LongCtrl_ICEActWheelTrq LongCtrl_ICEFzNm LongCtrl_SlideFlag /end REF_MEASUREMENT
/end GROUP
/begin GROUP S6_SwitchToBrakeMode "PubIfControlLONC_MDL/Subsystem/VLC/Vlc/SwitchToBrakeMode"
 /begin REF_CHARACTERISTIC P_LongCtrl_VLCAxvTracMinDC1FullFillXAxis P_LongCtrl_VLCAxvTracMinDC1FullFillYAxis P_LongCtrl_VLCCounterAxvTracMinTimeout P_LongCtrl_VLCDtAxvRef2UpperBandDC5 P_LongCtrl_VLCTorqDiffThreAxvTracMinTimeout P_LongCtrl_VLCVlcAccThresAxvTracMinTimeout P_LongCtrl_VLCaxDtCharAxCtrlDevTresAddEC2DCXAxis P_LongCtrl_VLCaxvRoadSlopeDC4CharXAxis P_LongCtrl_VLCaxvRoadSlopeDC4CharYAxis /end REF_CHARACTERISTIC
 /begin REF_MEASUREMENT LongCtrl_Sw2DC1 LongCtrl_Sw2DC2 LongCtrl_Sw2DC3 LongCtrl_Sw2DC4 LongCtrl_Sw2DC5 LongCtrl_Sw2DC6 LongCtrl_Sw2DC7 /end REF_MEASUREMENT
/end GROUP
/begin GROUP S6_SwitchToDriveMode "PubIfControlLONC_MDL/Subsystem/VLC/Vlc/SwitchToDriveMode" /begin REF_CHARACTERISTIC P_LongCtrl_VLCaxDtCharAxCtrlDevTresAddDC2ECXAxis /end REF_CHARACTERISTIC
 /begin REF_MEASUREMENT LongCtrl_Sw2EC1 LongCtrl_Sw2EC2 LongCtrl_Sw2EC3 LongCtrl_Sw2EC4 LongCtrl_Sw2EC5 /end REF_MEASUREMENT
/end GROUP
/begin GROUP S6_UpdateFlagCalc "PubIfControlLONC_MDL/Subsystem/VLC/Vlc/UpdateFlagCalc"
 /begin REF_CHARACTERISTIC P_LongCtrl_VLCaDtThresUpdateTorq P_LongCtrl_VLCvelThresUpdateTorq /end REF_CHARACTERISTIC
 /begin REF_MEASUREMENT LongCtrl_UpdateEnable_axvModeldiff /end REF_MEASUREMENT
/end GROUP
/begin GROUP S6_axvClosedLoopControlCalc "PubIfControlLONC_MDL/Subsystem/VLC/Vlc/axvClosedLoopControlCalc" /begin REF_MEASUREMENT LongCtrl_axvClosedLoopControl LongCtrl_axvDiff /end REF_MEASUREMENT /end GROUP
/begin GROUP S6_axvModelResidualCalc "PubIfControlLONC_MDL/Subsystem/VLC/Vlc/axvModelResidualCalc"
 /begin REF_MEASUREMENT LongCtrl_axvModelDiff LongCtrl_axvModelRef LongCtrl_axvModelResidual /end REF_MEASUREMENT
/end GROUP
/begin GROUP S6_axvTracActMean_calc "PubIfControlLONC_MDL/Subsystem/VLC/Vlc/axvTracActMean_calc"
 /begin REF_CHARACTERISTIC P_Global_Weight_N P_LongCtrl_VLC_WindArea P_LongCtrl_VLC_fRollCoef P_LongCtrl_VLCcoefFXAxis P_LongCtrl_VLCcoefFYAxis P_LongCtrl_VLCengEfficientCharYAxis P_LongCtrl_VLCtorqCharEngEfficientXAxis /end REF_CHARACTERISTIC
 /begin REF_MEASUREMENT LongCtrl_Fz LongCtrl_axvTracActMean /end REF_MEASUREMENT
/end GROUP
/begin GROUP S6_axvTracMin_calc "PubIfControlLONC_MDL/Subsystem/VLC/Vlc/axvTracMin_calc"
 /begin REF_CHARACTERISTIC P_Global_Weight_N P_LongCtrl_VLC_WindArea P_LongCtrl_VLC_fRollCoef P_LongCtrl_VLCcoefFXAxis P_LongCtrl_VLCcoefFYAxis P_LongCtrl_VLCengEfficientCharYAxis P_LongCtrl_VLCtorqCharEngEfficientXAxis /end REF_CHARACTERISTIC
 /begin REF_MEASUREMENT LongCtrl_axvTracMin /end REF_MEASUREMENT
/end GROUP
/begin GROUP PubIfDecisionPLAN_MDL "PubIfDecisionPLAN_MDL" /begin SUB_GROUP Root_Subsystem_Reference2 /end SUB_GROUP /end GROUP
/begin GROUP Root_Subsystem_Reference2 "PubIfDecisionPLAN_MDL/Subsystem Reference" /begin SUB_GROUP S1_Subsystem_Reference1 S1_Subsystem_Reference2 /end SUB_GROUP /end GROUP
/begin GROUP S1_Subsystem_Reference1 "PubIfDecisionPLAN_MDL/Subsystem Reference/Subsystem Reference1" /begin SUB_GROUP S4_LcCancelFinishCalc1 S4_LcOverTk /end SUB_GROUP /end GROUP
/begin GROUP S1_Subsystem_Reference2 "PubIfDecisionPLAN_MDL/Subsystem Reference/Subsystem Reference2" /begin SUB_GROUP S5_DPCLock S5_DangerPlausCalc /end SUB_GROUP /end GROUP
/begin GROUP S4_LcCancelFinishCalc1 "PubIfDecisionPLAN_MDL/Subsystem Reference/Subsystem Reference1/LcCancelFinishCalc1" /begin SUB_GROUP S184_Subsystem3 /end SUB_GROUP /end GROUP
/begin GROUP S4_LcOverTk "PubIfDecisionPLAN_MDL/Subsystem Reference/Subsystem Reference1/LcOverTk" /begin REF_MEASUREMENT PLAN_ALC_LcOverTkLe_ALCSwtOn PLAN_ALC_LcOverTkRi_ALCSwtOn /end REF_MEASUREMENT /end GROUP
/begin GROUP S5_DPCLock "PubIfDecisionPLAN_MDL/Subsystem Reference/Subsystem Reference2/DPCLock" /begin REF_CHARACTERISTIC P_Global_DxvRearBumper_m /end REF_CHARACTERISTIC /end GROUP
/begin GROUP S5_DangerPlausCalc "PubIfDecisionPLAN_MDL/Subsystem Reference/Subsystem Reference2/DangerPlausCalc" /begin REF_CHARACTERISTIC P_Global_DxvRearBumper_m /end REF_CHARACTERISTIC /end GROUP
/begin GROUP PubIfStateVSM_MDL "PubIfStateVSM_MDL" /begin SUB_GROUP Root_Subsystem_Reference3 /end SUB_GROUP /end GROUP
/begin GROUP Root_Subsystem_Reference3 "PubIfStateVSM_MDL/Subsystem Reference" /begin SUB_GROUP S1_Subsystem /end SUB_GROUP /end GROUP
/begin GROUP S1_Subsystem "PubIfStateVSM_MDL/Subsystem Reference/Subsystem" /begin SUB_GROUP S2_StateManage /end SUB_GROUP /begin REF_MEASUREMENT VSM_Counter /end REF_MEASUREMENT /end GROUP
/begin GROUP S2_StateManage "PubIfStateVSM_MDL/Subsystem Reference/Subsystem/StateManage" /begin SUB_GROUP S6_Cruise S6_ESS S6_Enlong2s1 S6_HOD S6_LSS S6_UOM /end SUB_GROUP
 /begin REF_CHARACTERISTIC P_VSM_ACCSOS_SW P_VSM_AESSwtReq P_VSM_ELKSwtReq P_VSM_ESS_VehSwtReq P_VSM_ICA_HandsOffSwtReq P_VSM_ISLSwtReq P_VSM_IntelligentEvaSwtReq P_VSM_LCKSwtReq P_VSM_LDWSwtReq P_VSM_LKASwtReq P_VSM_LSSSwtReq P_VSM_NOH_Act_Req P_VSM_NOH_Swt_Req P_VSM_TSRSwtReq P_VSM_TSRWarnSwtReq /end REF_CHARACTERISTIC
/end GROUP
/begin GROUP S6_Cruise "PubIfStateVSM_MDL/Subsystem Reference/Subsystem/StateManage/Cruise" /begin SUB_GROUP S19_Cruise /end SUB_GROUP /end GROUP
/begin GROUP S6_ESS "PubIfStateVSM_MDL/Subsystem Reference/Subsystem/StateManage/ESS" /begin SUB_GROUP S21_ESS /end SUB_GROUP /end GROUP
/begin GROUP S6_Enlong2s1 "PubIfStateVSM_MDL/Subsystem Reference/Subsystem/StateManage/Enlong2s1" /begin REF_CHARACTERISTIC P_VSM_SOSContinueTime P_VSM_SOSSpdLimit /end REF_CHARACTERISTIC /end GROUP
/begin GROUP S6_HOD "PubIfStateVSM_MDL/Subsystem Reference/Subsystem/StateManage/HOD" /begin SUB_GROUP S23_HOD /end SUB_GROUP /end GROUP
/begin GROUP S6_LSS "PubIfStateVSM_MDL/Subsystem Reference/Subsystem/StateManage/LSS" /begin SUB_GROUP S24_LCK_LKA_LDW_ELKStateMachine3 S24_TLS /end SUB_GROUP /end GROUP
/begin GROUP S6_UOM "PubIfStateVSM_MDL/Subsystem Reference/Subsystem/StateManage/UOM" /begin SUB_GROUP S28_GW_V71 /end SUB_GROUP /begin REF_CHARACTERISTIC P_VSM_CruiseFunUserInputMappingWays /end REF_CHARACTERISTIC /end GROUP
/begin GROUP S19_Cruise "PubIfStateVSM_MDL/Subsystem Reference/Subsystem/StateManage/Cruise/Cruise" /begin SUB_GROUP S29_ACC S29_HWA S29_ISL S29_LngHMI S29_SetSpd /end SUB_GROUP
 /begin REF_MEASUREMENT VSM_ACC_VehCnfgACC VSM_Diagnostic_ACCError VSM_Diagnostic_HWAError VSM_Diagnostic_TJAError VSM_HandsOn /end REF_MEASUREMENT
/end GROUP
/begin GROUP S21_ESS "PubIfStateVSM_MDL/Subsystem Reference/Subsystem/StateManage/ESS/ESS" /begin SUB_GROUP S490_Subsystem1 /end SUB_GROUP /end GROUP
/begin GROUP S23_HOD "PubIfStateVSM_MDL/Subsystem Reference/Subsystem/StateManage/HOD/HOD" /begin SUB_GROUP S620_LP_filter /end SUB_GROUP
 /begin REF_CHARACTERISTIC P_VSM_HOD_HWA_HandsOffLev1TimeCnt P_VSM_HOD_HWA_HandsOffLev2TimeCnt P_VSM_HOD_HWA_HandsOffLev3TimeCnt P_VSM_HOD_HWA_HandsOffLev4TimeCnt P_VSM_HOD_HandsOff_Tr P_VSM_HOD_HandsOn_Tr P_VSM_HOD_Handson_TimeInsertPoint P_VSM_HOD_Handson_TrqInsertPoint P_VSM_HOD_LCKTJA_HandsOffLev1TimeCnt P_VSM_HOD_LCKTJA_HandsOffLev2TimeCnt P_VSM_HOD_LCKTJA_HandsOffLev3TimeCnt P_VSM_HOD_LCKTJA_HandsOffLev4TimeCnt /end REF_CHARACTERISTIC
 /begin REF_MEASUREMENT VSM_HandsOff VSM_HandsOffDetd VSM_HandsOffWarningLevel /end REF_MEASUREMENT
/end GROUP
/begin GROUP S24_LCK_LKA_LDW_ELKStateMachine3 "PubIfStateVSM_MDL/Subsystem Reference/Subsystem/StateManage/LSS/LCK_LKA_LDW_ELKStateMachine3"
 /begin SUB_GROUP S641_ELKState_Machine S641_LCK S641_LCKIE S641_LDW S641_LKA S641_Signal_calculate /end SUB_GROUP
/end GROUP
/begin GROUP S24_TLS "PubIfStateVSM_MDL/Subsystem Reference/Subsystem/StateManage/LSS/TLS" /begin SUB_GROUP S642_TargetLineSelect /end SUB_GROUP /end GROUP
/begin GROUP S28_GW_V71 "PubIfStateVSM_MDL/Subsystem Reference/Subsystem/StateManage/UOM/GW_V71" /begin SUB_GROUP S1686_UOM /end SUB_GROUP /end GROUP
/begin GROUP S29_ACC "PubIfStateVSM_MDL/Subsystem Reference/Subsystem/StateManage/Cruise/Cruise/ACC" /begin SUB_GROUP S30_Subsystem /end SUB_GROUP /end GROUP
/begin GROUP S29_HWA "PubIfStateVSM_MDL/Subsystem Reference/Subsystem/StateManage/Cruise/Cruise/HWA" /begin SUB_GROUP S31_Subsystem /end SUB_GROUP /end GROUP
/begin GROUP S29_ISL "PubIfStateVSM_MDL/Subsystem Reference/Subsystem/StateManage/Cruise/Cruise/ISL" /begin SUB_GROUP S32_SM_Conds /end SUB_GROUP /end GROUP
/begin GROUP S29_LngHMI "PubIfStateVSM_MDL/Subsystem Reference/Subsystem/StateManage/Cruise/Cruise/LngHMI" /begin SUB_GROUP S33_Subsystem3 /end SUB_GROUP /end GROUP
/begin GROUP S29_SetSpd "PubIfStateVSM_MDL/Subsystem Reference/Subsystem/StateManage/Cruise/Cruise/SetSpd" /begin SUB_GROUP S34_Subsystem /end SUB_GROUP /end GROUP
/begin GROUP S490_Subsystem1 "PubIfStateVSM_MDL/Subsystem Reference/Subsystem/StateManage/ESS/ESS/Subsystem1" /begin SUB_GROUP S491_ESS_StateMachine /end SUB_GROUP /begin REF_MEASUREMENT VSM_ESS_SubModel_Number VSM_ESS_SubModel_VERSION /end REF_MEASUREMENT /end GROUP
/begin GROUP S620_LP_filter "PubIfStateVSM_MDL/Subsystem Reference/Subsystem/StateManage/HOD/HOD/LP filter" /begin REF_CHARACTERISTIC P_VSM_HOD_DrvTrqFlterTIme /end REF_CHARACTERISTIC /begin REF_MEASUREMENT VSM_HOD_DrvTrqFilted /end REF_MEASUREMENT /end GROUP
/begin GROUP S641_ELKState_Machine "PubIfStateVSM_MDL/Subsystem Reference/Subsystem/StateManage/LSS/LCK_LKA_LDW_ELKStateMachine3/ELKState_Machine" /begin SUB_GROUP S643_ELK /end SUB_GROUP /end GROUP
/begin GROUP S641_LCK "PubIfStateVSM_MDL/Subsystem Reference/Subsystem/StateManage/LSS/LCK_LKA_LDW_ELKStateMachine3/LCK" /begin SUB_GROUP S645_LCK /end SUB_GROUP /end GROUP
/begin GROUP S641_LCKIE "PubIfStateVSM_MDL/Subsystem Reference/Subsystem/StateManage/LSS/LCK_LKA_LDW_ELKStateMachine3/LCKIE" /begin SUB_GROUP S646_LCKIE /end SUB_GROUP /end GROUP
/begin GROUP S641_LDW "PubIfStateVSM_MDL/Subsystem Reference/Subsystem/StateManage/LSS/LCK_LKA_LDW_ELKStateMachine3/LDW" /begin SUB_GROUP S647_LDW /end SUB_GROUP /end GROUP
/begin GROUP S641_LKA "PubIfStateVSM_MDL/Subsystem Reference/Subsystem/StateManage/LSS/LCK_LKA_LDW_ELKStateMachine3/LKA" /begin SUB_GROUP S648_LKA /end SUB_GROUP /end GROUP
/begin GROUP S641_Signal_calculate "PubIfStateVSM_MDL/Subsystem Reference/Subsystem/StateManage/LSS/LCK_LKA_LDW_ELKStateMachine3/Signal_calculate" /begin SUB_GROUP S650_LKA_LDW_SignalProcess S650_LaneAndRe_SignalProcess /end SUB_GROUP /end GROUP
/begin GROUP S642_TargetLineSelect "PubIfStateVSM_MDL/Subsystem Reference/Subsystem/StateManage/LSS/TLS/TargetLineSelect" /begin SUB_GROUP S1615_Enlong3s1 S1615_Enlong3s3 /end SUB_GROUP /begin REF_MEASUREMENT VSM_TarDangerLevel /end REF_MEASUREMENT /end GROUP
/begin GROUP S1686_UOM "PubIfStateVSM_MDL/Subsystem Reference/Subsystem/StateManage/UOM/GW_V71/UOM" /begin SUB_GROUP S1687_Subsystem /end SUB_GROUP /begin REF_CHARACTERISTIC P_VSM_ALCSwtReq /end REF_CHARACTERISTIC /end GROUP
/begin GROUP S30_Subsystem "PubIfStateVSM_MDL/Subsystem Reference/Subsystem/StateManage/Cruise/Cruise/ACC/Subsystem" /begin SUB_GROUP S36_ACCTJA_SM S36_ACC_Condotion S36_Subsystem /end SUB_GROUP /end GROUP
/begin GROUP S31_Subsystem "PubIfStateVSM_MDL/Subsystem Reference/Subsystem/StateManage/Cruise/Cruise/HWA/Subsystem" /begin SUB_GROUP S226_HWA_Condotion S226_HWA_SM /end SUB_GROUP /begin REF_CHARACTERISTIC P_VSM_HWA_ALCStsSW /end REF_CHARACTERISTIC /begin REF_MEASUREMENT VSM_HWA_LaneChangeReq /end REF_MEASUREMENT /end GROUP
/begin GROUP S32_SM_Conds "PubIfStateVSM_MDL/Subsystem Reference/Subsystem/StateManage/Cruise/Cruise/ISL/SM_Conds" /begin REF_CHARACTERISTIC P_VSM_ISL_TimeInformDis P_VSM_ISL_TimeTakeOver /end REF_CHARACTERISTIC /end GROUP
/begin GROUP S33_Subsystem3 "PubIfStateVSM_MDL/Subsystem Reference/Subsystem/StateManage/Cruise/Cruise/LngHMI/Subsystem3" /begin SUB_GROUP S365_Enlong3s S365_Enlong3s1 S365_Enlong3s2 /end SUB_GROUP
 /begin REF_MEASUREMENT VSM_ACC_HazActv VSM_ACC_ModeDisp VSM_HWA_ModeDisp VSM_TJA_ModeDisp /end REF_MEASUREMENT
/end GROUP
/begin GROUP S34_Subsystem "PubIfStateVSM_MDL/Subsystem Reference/Subsystem/StateManage/Cruise/Cruise/SetSpd/Subsystem" /begin REF_CHARACTERISTIC P_VSM_TimeGapHMI_SW /end REF_CHARACTERISTIC
 /begin REF_MEASUREMENT VSM_ACC_SpdSetValue VSM_ACC_TimeGapSet VSM_ACC_VsetBelowMin /end REF_MEASUREMENT
/end GROUP
/begin GROUP S491_ESS_StateMachine "PubIfStateVSM_MDL/Subsystem Reference/Subsystem/StateManage/ESS/ESS/Subsystem1/ESS_StateMachine" /begin SUB_GROUP S492_ESS_Condition S492_Subsystem /end SUB_GROUP
 /begin REF_CHARACTERISTIC P_VSM_ESS_ACtiveTime P_VSM_ESS_AngleSpdTable_deg P_VSM_ESS_SafeDistance_m P_VSM_ESS_SpdPoint_kmh P_VSM_ESS_SpdTime_s /end REF_CHARACTERISTIC
 /begin REF_MEASUREMENT VSM_ESSState VSM_ESS_LastPoint VSM_ESS_PedSwtReq VSM_ESS_Sensor_idle2error VSM_ESS_StateL VSM_ESS_StateR VSM_ESS_VehCnfgESS VSM_ESS_VehSwtReq /end REF_MEASUREMENT
/end GROUP
/begin GROUP S643_ELK "PubIfStateVSM_MDL/Subsystem Reference/Subsystem/StateManage/LSS/LCK_LKA_LDW_ELKStateMachine3/ELKState_Machine/ELK" /begin SUB_GROUP S651_ELK_Condition S651_ELK_OnComing_OverTaking /end SUB_GROUP /begin REF_MEASUREMENT VSM_ELKState VSM_ELK_VehConfigELK VSM_ELK_Warning /end REF_MEASUREMENT /end GROUP
/begin GROUP S645_LCK "PubIfStateVSM_MDL/Subsystem Reference/Subsystem/StateManage/LSS/LCK_LKA_LDW_ELKStateMachine3/LCK/LCK" /begin SUB_GROUP S844_LCK2 /end SUB_GROUP /end GROUP
/begin GROUP S646_LCKIE "PubIfStateVSM_MDL/Subsystem Reference/Subsystem/StateManage/LSS/LCK_LKA_LDW_ELKStateMachine3/LCKIE/LCKIE" /begin SUB_GROUP S1133_LCKIE_StateMachine S1133_Subsystem1 /end SUB_GROUP
 /begin REF_MEASUREMENT VSM_LCKIE_State VSM_LCKIE_SubModel_Number VSM_LCKIE_SubModel_VERSION /end REF_MEASUREMENT
/end GROUP
/begin GROUP S647_LDW "PubIfStateVSM_MDL/Subsystem Reference/Subsystem/StateManage/LSS/LCK_LKA_LDW_ELKStateMachine3/LDW/LDW" /begin SUB_GROUP S1225_LDW2 /end SUB_GROUP /end GROUP
/begin GROUP S648_LKA "PubIfStateVSM_MDL/Subsystem Reference/Subsystem/StateManage/LSS/LCK_LKA_LDW_ELKStateMachine3/LKA/LKA" /begin SUB_GROUP S1354_LKA2 /end SUB_GROUP /end GROUP
/begin GROUP S650_LKA_LDW_SignalProcess "PubIfStateVSM_MDL/Subsystem Reference/Subsystem/StateManage/LSS/LCK_LKA_LDW_ELKStateMachine3/Signal_calculate/LKA_LDW_SignalProcess"
 /begin REF_CHARACTERISTIC P_Global_VehicleWidthMin_m P_VSM_LDW_State_Param_LaneTime P_VSM_LDW_State_Param_Speed /end REF_CHARACTERISTIC
 /begin REF_MEASUREMENT VSM_FLWhelDy VSM_FRWhelDy VSM_preFLWhelDy VSM_preFRWhelDy /end REF_MEASUREMENT
/end GROUP
/begin GROUP S650_LaneAndRe_SignalProcess "PubIfStateVSM_MDL/Subsystem Reference/Subsystem/StateManage/LSS/LCK_LKA_LDW_ELKStateMachine3/Signal_calculate/LaneAndRe_SignalProcess" /begin SUB_GROUP S1544_InCondition1 S1544_LaneRage_Handle /end SUB_GROUP /end GROUP
/begin GROUP S1615_Enlong3s1 "PubIfStateVSM_MDL/Subsystem Reference/Subsystem/StateManage/LSS/TLS/TargetLineSelect/Enlong3s1" /begin REF_CHARACTERISTIC P_VSM_TLS_LCCancelTime /end REF_CHARACTERISTIC /end GROUP
/begin GROUP S1615_Enlong3s3 "PubIfStateVSM_MDL/Subsystem Reference/Subsystem/StateManage/LSS/TLS/TargetLineSelect/Enlong3s3" /begin REF_CHARACTERISTIC P_VSM_TLS_LCCancelTime /end REF_CHARACTERISTIC /end GROUP
/begin GROUP S1687_Subsystem "PubIfStateVSM_MDL/Subsystem Reference/Subsystem/StateManage/UOM/GW_V71/UOM/Subsystem"
 /begin REF_MEASUREMENT VSM_ACC_SWCruise VSM_ACC_SWEngState VSM_ACC_SWRes VSM_ACC_SWSet VSM_TJA_ACC_SelSts VSM_User_ACCRes VSM_User_ACCSet VSM_User_TJASet /end REF_MEASUREMENT
/end GROUP
/begin GROUP S36_ACCTJA_SM "PubIfStateVSM_MDL/Subsystem Reference/Subsystem/StateManage/Cruise/Cruise/ACC/Subsystem/ACCTJA_SM" /begin SUB_GROUP S37_Subsystem /end SUB_GROUP /begin REF_CHARACTERISTIC P_VSM_ACC_BrakeOnlyNum /end REF_CHARACTERISTIC /begin REF_MEASUREMENT VSM_ACCSts /end REF_MEASUREMENT /end GROUP
/begin GROUP S36_ACC_Condotion "PubIfStateVSM_MDL/Subsystem Reference/Subsystem/StateManage/Cruise/Cruise/ACC/Subsystem/ACC_Condotion" /begin SUB_GROUP S38_StandstillNoBrakeForce /end SUB_GROUP
 /begin REF_CHARACTERISTIC P_Global_VehiclePowerType P_VSM_ACCExit_AccOverride P_VSM_ACCExit_StandWaitTime P_VSM_ACC_BOMEntry_ACCDecReqValue P_VSM_ACC_BOMEntry_AxvRefMs2 P_VSM_ACC_BOMExit_ACCDecReqValue /end REF_CHARACTERISTIC
 /begin REF_MEASUREMENT VSM_ACCActCondF VSM_ACCFastExit VSM_ACCFastExitCons_ACCError_Inhibit VSM_ACCFastExitCons_ACCOverride VSM_ACCFastExitCons_AEBTrigger VSM_ACCFastExitCons_APSGuidance VSM_ACCFastExitCons_BrakeDiskOverHeat VSM_ACCFastExitCons_Cancel VSM_ACCFastExitCons_DriveBrakeExit VSM_ACCFastExitCons_DriverDoorOpen VSM_ACCFastExitCons_DriverSBR VSM_ACCFastExitCons_DrivingModExit VSM_ACCFastExitCons_EPBClosed VSM_ACCFastExitCons_EngLimpHome VSM_ACCFastExitCons_EngineOff VSM_ACCFastExitCons_EspOff VSM_ACCFastExitCons_NoForwardGear VSM_ACCFastExitCons_RollingBack VSM_ACCFastExitCons_Standstill3min VSM_ACCFastExitCons_VehSpdExit VSM_ACCSlowExit VSM_ACCSlowExitCons_ABSactive400ms VSM_ACCSlowExitCons_EspActive400ms VSM_ACCSlowExitCons_HDCactive40ms VSM_ACCSlowExitCons_MSRactive800ms VSM_ACCSlowExitCons_TCS1active3000ms VSM_ACCSlowExitCons_TCS2active3000ms VSM_ACC_AccPedalTouch VSM_ACC_BOMExit VSM_ACC_DecReqValue VSM_ACC_DriverBrake VSM_AccOverride VSM_ActiveEnable VSM_DriveBrake VSM_VehicleStandStill /end REF_MEASUREMENT
/end GROUP
/begin GROUP S36_Subsystem "PubIfStateVSM_MDL/Subsystem Reference/Subsystem/StateManage/Cruise/Cruise/ACC/Subsystem/Subsystem"
 /begin REF_CHARACTERISTIC P_VSM_ACC_AutoGoSW P_VSM_ACC_RadarOffset P_VSM_ACC_StandActiveNumACCMode P_VSM_ACC_StandActiveNumHWAMode /end REF_CHARACTERISTIC
 /begin REF_MEASUREMENT VSM_ACCStandActive2Active_DrvrSts VSM_ACCStandActive2Wait_DrvrSts VSM_ACCStandActive2Wait_USS VSM_ACCStandActiveTime VSM_ACC_DrvOfftoSM VSM_ACC_DrvrOff_Disp VSM_ACC_P0DxThrehod VSM_ACC_USSObjDxMin VSM_ACC_USSObjExist /end REF_MEASUREMENT
/end GROUP
/begin GROUP S226_HWA_Condotion "PubIfStateVSM_MDL/Subsystem Reference/Subsystem/StateManage/Cruise/Cruise/HWA/Subsystem/HWA_Condotion"
 /begin REF_CHARACTERISTIC P_VSM_HWAActivation_NOAMOd_Spd P_VSM_HWAActivation_Spd_Low P_VSM_HWAActivation_Spd_Up P_VSM_HWA_EHR_Enable /end REF_CHARACTERISTIC
 /begin REF_MEASUREMENT VSM_HWAFastExit_b VSM_HWANOA_Mode VSM_HWASafeStopEn VSM_HWASlowExitConditions_b VSM_HWASlowExitCons_ACCError VSM_HWASlowExitCons_NotHighWayArterialRoad5s VSM_HWASlowExit_b VSM_HWAWarningLevel VSM_SomeHWASafeStop2ExitConditions_b /end REF_MEASUREMENT
/end GROUP
/begin GROUP S226_HWA_SM "PubIfStateVSM_MDL/Subsystem Reference/Subsystem/StateManage/Cruise/Cruise/HWA/Subsystem/HWA_SM"
 /begin REF_CHARACTERISTIC P_VSM_NOH_PilotSelc_SW P_VSM_NOH_Swt_Req_SW P_VSM_TJA_ActiveWaitNum /end REF_CHARACTERISTIC
 /begin REF_MEASUREMENT VSM_HWAActive VSM_HWASts VSM_HWA_ParkShiftReq VSM_TJASts /end REF_MEASUREMENT
/end GROUP
/begin GROUP S365_Enlong3s "PubIfStateVSM_MDL/Subsystem Reference/Subsystem/StateManage/Cruise/Cruise/LngHMI/Subsystem3/Enlong3s" /begin REF_MEASUREMENT VSM_TJATextDisp /end REF_MEASUREMENT /end GROUP
/begin GROUP S365_Enlong3s1 "PubIfStateVSM_MDL/Subsystem Reference/Subsystem/StateManage/Cruise/Cruise/LngHMI/Subsystem3/Enlong3s1" /begin REF_MEASUREMENT VSM_ACCTextDisp /end REF_MEASUREMENT /end GROUP
/begin GROUP S365_Enlong3s2 "PubIfStateVSM_MDL/Subsystem Reference/Subsystem/StateManage/Cruise/Cruise/LngHMI/Subsystem3/Enlong3s2" /begin REF_MEASUREMENT VSM_HWATextDisp /end REF_MEASUREMENT /end GROUP
/begin GROUP S492_ESS_Condition "PubIfStateVSM_MDL/Subsystem Reference/Subsystem/StateManage/ESS/ESS/Subsystem1/ESS_StateMachine/ESS_Condition"
 /begin REF_CHARACTERISTIC P_VSM_ESS_AEBFlag_enable P_VSM_ESS_AccPedlPosn_Param P_VSM_ESS_AccelPed_enable P_VSM_ESS_DangerPlausLeft P_VSM_ESS_DangerPlausRight P_VSM_ESS_DoorSts_enable P_VSM_ESS_DriveIn P_VSM_ESS_DriveIn_BP P_VSM_ESS_DriverInputTrq_Param P_VSM_ESS_DrvOverTime_Param P_VSM_ESS_DrvSBR_enable P_VSM_ESS_ESPActive_enable P_VSM_ESS_ESPFuncOffSts_enable P_VSM_ESS_FcwDisFlag_enable P_VSM_ESS_FcwSw_enable P_VSM_ESS_HiLoBeam_enable P_VSM_ESS_IPSpeed_kmh P_VSM_ESS_LateralAccel_enable P_VSM_ESS_LgtAccelLower_Param P_VSM_ESS_LgtAccelUpper_Param P_VSM_ESS_MasterCylindBrake P_VSM_ESS_MaxLateral_mss P_VSM_ESS_OVERRIDE_SW P_VSM_ESS_SteerWheelSpd_BP P_VSM_ESS_SteerWheelSpd_Param P_VSM_ESS_SteerWheelSpd_enable P_VSM_ESS_StopA0_Param P_VSM_ESS_StopA1Time_Param P_VSM_ESS_StopA1_Param P_VSM_ESS_TrailerSts_enable P_VSM_ESS_VehLgtAccel_enable P_VSM_ESS_Vehspeed_enable P_VSM_ESS_WiprReq_enable /end REF_CHARACTERISTIC
 /begin REF_MEASUREMENT VSM_ESS_ACTIVE2IDLE VSM_ESS_AEBFlag_READY2ACTIVE VSM_ESS_AEBTrigFlag_ACTIVE2IDLE VSM_ESS_AEBVehFlag_Ready2Active VSM_ESS_AEBVruFlag_Ready2Active VSM_ESS_AccelPed_READY2ACTIVE VSM_ESS_DPC_L_Active2Ready VSM_ESS_DPC_R_Active2Ready VSM_ESS_DangerPlausLeft_Ready2Active VSM_ESS_DangerPlausRight_Ready2Active VSM_ESS_DoorSts_ACTIVE2IDLE VSM_ESS_DoorSts_IDLE2READY VSM_ESS_DoorSts_READY2IDLE VSM_ESS_DrvOver_Active2Ready VSM_ESS_DrvOver_Active2Ready_DiffDirc VSM_ESS_DrvOver_Active2Ready_SamDirc VSM_ESS_DrvSBR_ACTIVE2IDLE VSM_ESS_DrvSBR_IDLE2READY VSM_ESS_DrvSBR_READY2IDLE VSM_ESS_ESPActive_ACTIVE2IDLE VSM_ESS_ESPActive_IDLE2READY VSM_ESS_ESPActive_READY2IDLE VSM_ESS_ESPFuncOffSts_ACTIVE2IDLE VSM_ESS_ESPFuncOffSts_IDLE2READY VSM_ESS_ESPFuncOffSts_READY2IDLE VSM_ESS_FcwDisFlag_Ready2Active VSM_ESS_FcwFlag_READY2ACTIVE VSM_ESS_FcwWarn_Ready2Active VSM_ESS_HiLoBeam_IDLE2READY VSM_ESS_HiLoBeam_READY2IDLE VSM_ESS_IDLE2READY VSM_ESS_LValid_Active2Ready VSM_ESS_L_ACTIVE2READY VSM_ESS_L_Oncoming_Active2Ready VSM_ESS_L_SteerWheelSpdSign_Ready2Active VSM_ESS_LateralAccel_ACTIVE2IDLE VSM_ESS_LateralAccel_IDLE2READY VSM_ESS_LateralAccel_READY2IDLE VSM_ESS_LeftOncoming_Ready2Active VSM_ESS_Left_READY2ACTIVE VSM_ESS_LineA0_Active2Ready VSM_ESS_LineA1_Active2Ready VSM_ESS_LineLValid_Ready2Active VSM_ESS_LineRValid_Ready2Active VSM_ESS_MasterCylindBrakePress_ACTIVE2IDLE VSM_ESS_READY2ACTIVE VSM_ESS_READY2IDLE VSM_ESS_RValid_Active2Ready VSM_ESS_R_ACTIVE2READY VSM_ESS_R_Oncoming_Active2Ready VSM_ESS_R_SteerWheelSpdSign_Ready2Active VSM_ESS_RightOncoming_Ready2Active VSM_ESS_Right_READY2ACTIVE VSM_ESS_SteerWheelSpd_READY2ACTIVE VSM_ESS_TrailerSts_IDLE2READY VSM_ESS_TrailerSts_READY2IDLE VSM_ESS_VehLgtAccel_READY2ACTIVE VSM_ESS_VehicleSpd_ACTIVE2IDLE VSM_ESS_VehicleSpd_IDLE2READY VSM_ESS_VehicleSpd_READY2IDLE VSM_ESS_WiprReq_IDLE2READY VSM_ESS_WiprReq_READY2IDLE /end REF_MEASUREMENT
/end GROUP
/begin GROUP S492_Subsystem "PubIfStateVSM_MDL/Subsystem Reference/Subsystem/StateManage/ESS/ESS/Subsystem1/ESS_StateMachine/Subsystem" /begin REF_CHARACTERISTIC P_VSM_ESS_DelayTime /end REF_CHARACTERISTIC /begin REF_MEASUREMENT VSM_ESS_DelayReady /end REF_MEASUREMENT /end GROUP
/begin GROUP S651_ELK_Condition "PubIfStateVSM_MDL/Subsystem Reference/Subsystem/StateManage/LSS/LCK_LKA_LDW_ELKStateMachine3/ELKState_Machine/ELK/ELK_Condition"
 /begin SUB_GROUP S653_Subsystem S653_Subsystem1 S653_Subsystem10 S653_Subsystem11 S653_Subsystem12 S653_Subsystem15 S653_Subsystem17 S653_Subsystem4 S653_Subsystem5 S653_Subsystem6 S653_Subsystem7 S653_Subsystem8 S653_Subsystem9 /end SUB_GROUP
 /begin REF_CHARACTERISTIC P_VSM_ELK_State_Absesp_enable P_VSM_ELK_State_Accpedalrate_enable P_VSM_ELK_State_Breakpressure_enable P_VSM_ELK_State_DriverInputTrqValue_enable P_VSM_ELK_State_ESSSts_enable P_VSM_ELK_State_Eps_enable P_VSM_ELK_State_Failsafe_enable P_VSM_ELK_State_GEAR_enable P_VSM_ELK_State_Headingangle_enable P_VSM_ELK_State_LaneChange_enable P_VSM_ELK_State_Lane_enable P_VSM_ELK_State_Lanecurve_enable P_VSM_ELK_State_LateralAcce_enable P_VSM_ELK_State_LongitudeAcc_enable P_VSM_ELK_State_Overide_enable P_VSM_ELK_State_SteerWheelAngle_enable P_VSM_ELK_State_SteerWheelSpd_enable P_VSM_ELK_State_Vehspeed_enable P_VSM_ELK_State_Yawsup_enable /end REF_CHARACTERISTIC
 /begin REF_MEASUREMENT VSM_ELK_Active2Ready VSM_ELK_Con_AbsEsp_Idle2Ready VSM_ELK_Con_AbsEsp_Ready2Idle VSM_ELK_Con_AccPedalRate_Active2Ready VSM_ELK_Con_AccPedalRate_Ready2Active VSM_ELK_Con_BrakePressure_Active2Ready VSM_ELK_Con_BrakePressure_Ready2Active VSM_ELK_Con_CURRENT_GEAR_Active2Ready VSM_ELK_Con_CURRENT_GEAR_Ready2Active VSM_ELK_Con_DriverInput_Active2Ready VSM_ELK_Con_DriverInput_Ready2Active VSM_ELK_Con_ESSSts_Idle2Ready VSM_ELK_Con_ESSSts_Ready2Idle VSM_ELK_Con_EpsSta_Active2Ready VSM_ELK_Con_EpsSta_Ready2Active VSM_ELK_Con_Failsafe_Idle2Ready VSM_ELK_Con_Failsafe_Ready2Idle VSM_ELK_Con_Headingangel_Idle2Ready VSM_ELK_Con_Headingangle_Ready2Idle VSM_ELK_Con_LaneChange_Active2Ready VSM_ELK_Con_LaneChange_Ready2Active VSM_ELK_Con_LaneCurve_Idle2Ready VSM_ELK_Con_LaneCurve_Ready2Idle VSM_ELK_Con_Lane_Idle2Ready VSM_ELK_Con_Lane_Ready2Idle VSM_ELK_Con_LateralAcc_Active2Ready VSM_ELK_Con_LateralAcc_Ready2Active VSM_ELK_Con_LongitudeAcc_Active2Ready VSM_ELK_Con_LongitudeAcc_Ready2Active VSM_ELK_Con_OverRide_Active2Ready VSM_ELK_Con_Override_Ready2Active VSM_ELK_Con_SteerWheelAngle_Active2Ready VSM_ELK_Con_SteerWheelAngle_Ready2Active VSM_ELK_Con_SteerWheelSpd_Active2Ready VSM_ELK_Con_SteerWheelSpd_Ready2Active VSM_ELK_Con_VehicleSpeed_Idle2ReadyELK VSM_ELK_Con_VehicleSpeed_Ready2Idle VSM_ELK_Con_YawRate_Idle2Ready VSM_ELK_Con_YawRate_Ready2Idle VSM_ELK_Idle2Ready VSM_ELK_Other2Idle VSM_ELK_Ready2Active /end REF_MEASUREMENT
/end GROUP
/begin GROUP S651_ELK_OnComing_OverTaking "PubIfStateVSM_MDL/Subsystem Reference/Subsystem/StateManage/LSS/LCK_LKA_LDW_ELKStateMachine3/ELKState_Machine/ELK/ELK_OnComing_OverTaking"
 /begin SUB_GROUP S654_OnComing S654_OverTaking S654_Subsystem S654_Subsystem2 S654_Subsystem3 /end SUB_GROUP
 /begin REF_CHARACTERISTIC P_VSM_ELK_Lane_Width_Table P_VSM_ELK_Lane_Width_Table_Calibration P_VSM_ELK_Sensitive_Table P_VSM_ELK_Sensitive_Table_Calibration P_VSM_ELK_State_Param_AngleOffset P_VSM_ELK_State_Param_OnTime P_VSM_ELK_State_Param_Oncoming P_VSM_ELK_State_Param_OutOffset P_VSM_ELK_State_Param_OvTime P_VSM_ELK_State_Param_Over P_VSM_ELK_State_Param_Speed /end REF_CHARACTERISTIC
/end GROUP
/begin GROUP S844_LCK2 "PubIfStateVSM_MDL/Subsystem Reference/Subsystem/StateManage/LSS/LCK_LKA_LDW_ELKStateMachine3/LCK/LCK/LCK2" /begin SUB_GROUP S845_LCK S845_LCK_Condition1 /end SUB_GROUP
 /begin REF_MEASUREMENT VSM_LCKState VSM_LCK_Counter VSM_LCK_VERSION VSM_TJALCKState /end REF_MEASUREMENT
/end GROUP
/begin GROUP S1133_LCKIE_StateMachine "PubIfStateVSM_MDL/Subsystem Reference/Subsystem/StateManage/LSS/LCK_LKA_LDW_ELKStateMachine3/LCKIE/LCKIE/LCKIE_StateMachine" /begin SUB_GROUP S1134_Subsystem S1134_Subsystem1 /end SUB_GROUP /begin REF_CHARACTERISTIC P_VSM_LCKIE_Laneoffset P_VSM_LCKIE_Laneoffset_BP /end REF_CHARACTERISTIC /end GROUP
/begin GROUP S1133_Subsystem1 "PubIfStateVSM_MDL/Subsystem Reference/Subsystem/StateManage/LSS/LCK_LKA_LDW_ELKStateMachine3/LCKIE/LCKIE/Subsystem1" /begin SUB_GROUP S1135_IEStateClc S1135_LCKIE_SignalProcess1 /end SUB_GROUP /end GROUP
/begin GROUP S1225_LDW2 "PubIfStateVSM_MDL/Subsystem Reference/Subsystem/StateManage/LSS/LCK_LKA_LDW_ELKStateMachine3/LDW/LDW/LDW2"
 /begin SUB_GROUP S1226_LDWSignal_calculate S1226_LDW_Condition S1226_LDW_StateMachine /end SUB_GROUP
 /begin REF_CHARACTERISTIC P_VSM_LDW_State_Param_LaneWidth_Offset P_VSM_LDW_State_Param_Sensitive_Offset /end REF_CHARACTERISTIC
 /begin REF_MEASUREMENT VSM_LDWSts VSM_LDW_Counter VSM_LDW_Error VSM_LDW_VERSION /end REF_MEASUREMENT
/end GROUP
/begin GROUP S1354_LKA2 "PubIfStateVSM_MDL/Subsystem Reference/Subsystem/StateManage/LSS/LCK_LKA_LDW_ELKStateMachine3/LKA/LKA/LKA2" /begin SUB_GROUP S1355_LKA S1355_LKA_Condition S1355_LKA_StateMachine /end SUB_GROUP
 /begin REF_CHARACTERISTIC P_VSM_LKA_State_Param_LaneCurve P_VSM_LKA_State_Param_LaneCurve_Offset P_VSM_LKA_State_Param_LaneWidth_Offset P_VSM_LKA_State_Param_Sensitive_Offset /end REF_CHARACTERISTIC
 /begin REF_MEASUREMENT VSM_LKAState VSM_LKA_Counter VSM_LKA_VERSION /end REF_MEASUREMENT
/end GROUP
/begin GROUP S1544_InCondition1 "PubIfStateVSM_MDL/Subsystem Reference/Subsystem/StateManage/LSS/LCK_LKA_LDW_ELKStateMachine3/Signal_calculate/LaneAndRe_SignalProcess/InCondition1" /begin REF_CHARACTERISTIC P_VSM_LSMC_SampleTime /end REF_CHARACTERISTIC /end GROUP
/begin GROUP S653_Subsystem "PubIfStateVSM_MDL/Subsystem Reference/Subsystem/StateManage/LSS/LCK_LKA_LDW_ELKStateMachine3/ELKState_Machine/ELK/ELK_Condition/Subsystem" /begin REF_CHARACTERISTIC P_VSM_LSMC_SampleTime /end REF_CHARACTERISTIC /end GROUP
/begin GROUP S653_Subsystem1 "PubIfStateVSM_MDL/Subsystem Reference/Subsystem/StateManage/LSS/LCK_LKA_LDW_ELKStateMachine3/ELKState_Machine/ELK/ELK_Condition/Subsystem1" /begin REF_CHARACTERISTIC P_VSM_LSMC_SampleTime /end REF_CHARACTERISTIC /end GROUP
/begin GROUP S653_Subsystem10 "PubIfStateVSM_MDL/Subsystem Reference/Subsystem/StateManage/LSS/LCK_LKA_LDW_ELKStateMachine3/ELKState_Machine/ELK/ELK_Condition/Subsystem10" /begin REF_CHARACTERISTIC P_VSM_LSMC_SampleTime /end REF_CHARACTERISTIC /end GROUP
/begin GROUP S653_Subsystem11 "PubIfStateVSM_MDL/Subsystem Reference/Subsystem/StateManage/LSS/LCK_LKA_LDW_ELKStateMachine3/ELKState_Machine/ELK/ELK_Condition/Subsystem11" /begin REF_CHARACTERISTIC P_VSM_LSMC_SampleTime /end REF_CHARACTERISTIC /end GROUP
/begin GROUP S653_Subsystem12 "PubIfStateVSM_MDL/Subsystem Reference/Subsystem/StateManage/LSS/LCK_LKA_LDW_ELKStateMachine3/ELKState_Machine/ELK/ELK_Condition/Subsystem12" /begin REF_CHARACTERISTIC P_VSM_LSMC_SampleTime /end REF_CHARACTERISTIC /end GROUP
/begin GROUP S653_Subsystem15 "PubIfStateVSM_MDL/Subsystem Reference/Subsystem/StateManage/LSS/LCK_LKA_LDW_ELKStateMachine3/ELKState_Machine/ELK/ELK_Condition/Subsystem15" /begin REF_CHARACTERISTIC P_VSM_LSMC_SampleTime /end REF_CHARACTERISTIC /end GROUP
/begin GROUP S653_Subsystem17 "PubIfStateVSM_MDL/Subsystem Reference/Subsystem/StateManage/LSS/LCK_LKA_LDW_ELKStateMachine3/ELKState_Machine/ELK/ELK_Condition/Subsystem17" /begin REF_CHARACTERISTIC P_VSM_LSMC_SampleTime /end REF_CHARACTERISTIC /end GROUP
/begin GROUP S653_Subsystem4 "PubIfStateVSM_MDL/Subsystem Reference/Subsystem/StateManage/LSS/LCK_LKA_LDW_ELKStateMachine3/ELKState_Machine/ELK/ELK_Condition/Subsystem4" /begin REF_CHARACTERISTIC P_VSM_LSMC_SampleTime /end REF_CHARACTERISTIC /end GROUP
/begin GROUP S653_Subsystem5 "PubIfStateVSM_MDL/Subsystem Reference/Subsystem/StateManage/LSS/LCK_LKA_LDW_ELKStateMachine3/ELKState_Machine/ELK/ELK_Condition/Subsystem5" /begin REF_CHARACTERISTIC P_VSM_LSMC_SampleTime /end REF_CHARACTERISTIC /end GROUP
/begin GROUP S653_Subsystem6 "PubIfStateVSM_MDL/Subsystem Reference/Subsystem/StateManage/LSS/LCK_LKA_LDW_ELKStateMachine3/ELKState_Machine/ELK/ELK_Condition/Subsystem6" /begin REF_CHARACTERISTIC P_VSM_LSMC_SampleTime /end REF_CHARACTERISTIC /end GROUP
/begin GROUP S653_Subsystem7 "PubIfStateVSM_MDL/Subsystem Reference/Subsystem/StateManage/LSS/LCK_LKA_LDW_ELKStateMachine3/ELKState_Machine/ELK/ELK_Condition/Subsystem7" /begin REF_CHARACTERISTIC P_VSM_LSMC_SampleTime /end REF_CHARACTERISTIC /end GROUP
/begin GROUP S653_Subsystem8 "PubIfStateVSM_MDL/Subsystem Reference/Subsystem/StateManage/LSS/LCK_LKA_LDW_ELKStateMachine3/ELKState_Machine/ELK/ELK_Condition/Subsystem8" /begin REF_CHARACTERISTIC P_VSM_LSMC_SampleTime /end REF_CHARACTERISTIC /end GROUP
/begin GROUP S653_Subsystem9 "PubIfStateVSM_MDL/Subsystem Reference/Subsystem/StateManage/LSS/LCK_LKA_LDW_ELKStateMachine3/ELKState_Machine/ELK/ELK_Condition/Subsystem9" /begin REF_CHARACTERISTIC P_VSM_LSMC_SampleTime /end REF_CHARACTERISTIC /end GROUP
/begin GROUP S654_OnComing "PubIfStateVSM_MDL/Subsystem Reference/Subsystem/StateManage/LSS/LCK_LKA_LDW_ELKStateMachine3/ELKState_Machine/ELK/ELK_OnComing_OverTaking/OnComing" /begin REF_CHARACTERISTIC P_Global_VehicleWidthMin_m /end REF_CHARACTERISTIC /end GROUP
/begin GROUP S654_OverTaking "PubIfStateVSM_MDL/Subsystem Reference/Subsystem/StateManage/LSS/LCK_LKA_LDW_ELKStateMachine3/ELKState_Machine/ELK/ELK_OnComing_OverTaking/OverTaking" /begin REF_CHARACTERISTIC P_Global_DxvRearBumper_m P_Global_VehicleWidthMin_m /end REF_CHARACTERISTIC /end GROUP
/begin GROUP S654_Subsystem "PubIfStateVSM_MDL/Subsystem Reference/Subsystem/StateManage/LSS/LCK_LKA_LDW_ELKStateMachine3/ELKState_Machine/ELK/ELK_OnComing_OverTaking/Subsystem" /begin REF_CHARACTERISTIC P_Global_VehicleWidthMin_m /end REF_CHARACTERISTIC /end GROUP
/begin GROUP S654_Subsystem2 "PubIfStateVSM_MDL/Subsystem Reference/Subsystem/StateManage/LSS/LCK_LKA_LDW_ELKStateMachine3/ELKState_Machine/ELK/ELK_OnComing_OverTaking/Subsystem2" /begin REF_CHARACTERISTIC P_VSM_LSMC_SampleTime /end REF_CHARACTERISTIC /end GROUP
/begin GROUP S654_Subsystem3 "PubIfStateVSM_MDL/Subsystem Reference/Subsystem/StateManage/LSS/LCK_LKA_LDW_ELKStateMachine3/ELKState_Machine/ELK/ELK_OnComing_OverTaking/Subsystem3" /begin REF_CHARACTERISTIC P_VSM_LSMC_SampleTime /end REF_CHARACTERISTIC /end GROUP
/begin GROUP S1135_LCKIE_SignalProcess1 "PubIfStateVSM_MDL/Subsystem Reference/Subsystem/StateManage/LSS/LCK_LKA_LDW_ELKStateMachine3/LCKIE/LCKIE/Subsystem1/LCKIE_SignalProcess1" /begin REF_CHARACTERISTIC P_Global_VehicleWidthMin_m /end REF_CHARACTERISTIC /end GROUP
/begin GROUP S1548_Subsystem4 "PubIfStateVSM_MDL/Subsystem Reference/Subsystem/StateManage/LSS/LCK_LKA_LDW_ELKStateMachine3/Signal_calculate/LaneAndRe_SignalProcess/LaneRage_Handle/Subsystem4" /begin REF_CHARACTERISTIC P_VSM_LSMC_SampleTime /end REF_CHARACTERISTIC /end GROUP
/begin GROUP S1548_Subsystem6 "PubIfStateVSM_MDL/Subsystem Reference/Subsystem/StateManage/LSS/LCK_LKA_LDW_ELKStateMachine3/Signal_calculate/LaneAndRe_SignalProcess/LaneRage_Handle/Subsystem6" /begin REF_CHARACTERISTIC P_VSM_LSMC_SampleTime /end REF_CHARACTERISTIC /end GROUP
/begin GROUP S782_Subsystem1 "PubIfStateVSM_MDL/Subsystem Reference/Subsystem/StateManage/LSS/LCK_LKA_LDW_ELKStateMachine3/ELKState_Machine/ELK/ELK_OnComing_OverTaking/Subsystem/Subsystem1" /begin REF_CHARACTERISTIC P_VSM_LSMC_SampleTime /end REF_CHARACTERISTIC /end GROUP
/begin GROUP S782_Subsystem4 "PubIfStateVSM_MDL/Subsystem Reference/Subsystem/StateManage/LSS/LCK_LKA_LDW_ELKStateMachine3/ELKState_Machine/ELK/ELK_OnComing_OverTaking/Subsystem/Subsystem4" /begin REF_CHARACTERISTIC P_VSM_LSMC_SampleTime /end REF_CHARACTERISTIC /end GROUP
/begin GROUP S782_Subsystem7 "PubIfStateVSM_MDL/Subsystem Reference/Subsystem/StateManage/LSS/LCK_LKA_LDW_ELKStateMachine3/ELKState_Machine/ELK/ELK_OnComing_OverTaking/Subsystem/Subsystem7" /begin REF_CHARACTERISTIC P_VSM_LSMC_SampleTime /end REF_CHARACTERISTIC /end GROUP
/begin GROUP S847_Subsystem2 "PubIfStateVSM_MDL/Subsystem Reference/Subsystem/StateManage/LSS/LCK_LKA_LDW_ELKStateMachine3/LCK/LCK/LCK2/LCK/Subsystem2" /begin REF_CHARACTERISTIC P_VSM_LSMC_SampleTime /end REF_CHARACTERISTIC /end GROUP
/begin GROUP S847_Subsystem3 "PubIfStateVSM_MDL/Subsystem Reference/Subsystem/StateManage/LSS/LCK_LKA_LDW_ELKStateMachine3/LCK/LCK/LCK2/LCK/Subsystem3" /begin REF_CHARACTERISTIC P_VSM_LSMC_SampleTime /end REF_CHARACTERISTIC /end GROUP
/begin GROUP S848_Subsystem1 "PubIfStateVSM_MDL/Subsystem Reference/Subsystem/StateManage/LSS/LCK_LKA_LDW_ELKStateMachine3/LCK/LCK/LCK2/LCK_Condition1/Subsystem1" /begin REF_CHARACTERISTIC P_VSM_LSMC_SampleTime /end REF_CHARACTERISTIC /end GROUP
/begin GROUP S848_Subsystem10 "PubIfStateVSM_MDL/Subsystem Reference/Subsystem/StateManage/LSS/LCK_LKA_LDW_ELKStateMachine3/LCK/LCK/LCK2/LCK_Condition1/Subsystem10" /begin REF_CHARACTERISTIC P_VSM_LSMC_SampleTime /end REF_CHARACTERISTIC /end GROUP
/begin GROUP S848_Subsystem11 "PubIfStateVSM_MDL/Subsystem Reference/Subsystem/StateManage/LSS/LCK_LKA_LDW_ELKStateMachine3/LCK/LCK/LCK2/LCK_Condition1/Subsystem11" /begin REF_CHARACTERISTIC P_VSM_LSMC_SampleTime /end REF_CHARACTERISTIC /end GROUP
/begin GROUP S848_Subsystem12 "PubIfStateVSM_MDL/Subsystem Reference/Subsystem/StateManage/LSS/LCK_LKA_LDW_ELKStateMachine3/LCK/LCK/LCK2/LCK_Condition1/Subsystem12" /begin REF_CHARACTERISTIC P_VSM_LSMC_SampleTime /end REF_CHARACTERISTIC /end GROUP
/begin GROUP S848_Subsystem13 "PubIfStateVSM_MDL/Subsystem Reference/Subsystem/StateManage/LSS/LCK_LKA_LDW_ELKStateMachine3/LCK/LCK/LCK2/LCK_Condition1/Subsystem13" /begin REF_CHARACTERISTIC P_VSM_LSMC_SampleTime /end REF_CHARACTERISTIC /end GROUP
/begin GROUP S848_Subsystem14 "PubIfStateVSM_MDL/Subsystem Reference/Subsystem/StateManage/LSS/LCK_LKA_LDW_ELKStateMachine3/LCK/LCK/LCK2/LCK_Condition1/Subsystem14" /begin REF_CHARACTERISTIC P_VSM_LSMC_SampleTime /end REF_CHARACTERISTIC /end GROUP
/begin GROUP S848_Subsystem15 "PubIfStateVSM_MDL/Subsystem Reference/Subsystem/StateManage/LSS/LCK_LKA_LDW_ELKStateMachine3/LCK/LCK/LCK2/LCK_Condition1/Subsystem15" /begin REF_CHARACTERISTIC P_VSM_LSMC_SampleTime /end REF_CHARACTERISTIC /end GROUP
/begin GROUP S848_Subsystem16 "PubIfStateVSM_MDL/Subsystem Reference/Subsystem/StateManage/LSS/LCK_LKA_LDW_ELKStateMachine3/LCK/LCK/LCK2/LCK_Condition1/Subsystem16" /begin REF_CHARACTERISTIC P_VSM_LSMC_SampleTime /end REF_CHARACTERISTIC /end GROUP
/begin GROUP S848_Subsystem17 "PubIfStateVSM_MDL/Subsystem Reference/Subsystem/StateManage/LSS/LCK_LKA_LDW_ELKStateMachine3/LCK/LCK/LCK2/LCK_Condition1/Subsystem17" /begin REF_CHARACTERISTIC P_VSM_LSMC_SampleTime /end REF_CHARACTERISTIC /end GROUP
/begin GROUP S848_Subsystem18 "PubIfStateVSM_MDL/Subsystem Reference/Subsystem/StateManage/LSS/LCK_LKA_LDW_ELKStateMachine3/LCK/LCK/LCK2/LCK_Condition1/Subsystem18" /begin REF_CHARACTERISTIC P_VSM_LSMC_SampleTime /end REF_CHARACTERISTIC /end GROUP
/begin GROUP S848_Subsystem19 "PubIfStateVSM_MDL/Subsystem Reference/Subsystem/StateManage/LSS/LCK_LKA_LDW_ELKStateMachine3/LCK/LCK/LCK2/LCK_Condition1/Subsystem19" /begin REF_CHARACTERISTIC P_VSM_LSMC_SampleTime /end REF_CHARACTERISTIC /end GROUP
/begin GROUP S848_Subsystem2 "PubIfStateVSM_MDL/Subsystem Reference/Subsystem/StateManage/LSS/LCK_LKA_LDW_ELKStateMachine3/LCK/LCK/LCK2/LCK_Condition1/Subsystem2" /begin REF_CHARACTERISTIC P_VSM_LSMC_SampleTime /end REF_CHARACTERISTIC /end GROUP
/begin GROUP S848_Subsystem20 "PubIfStateVSM_MDL/Subsystem Reference/Subsystem/StateManage/LSS/LCK_LKA_LDW_ELKStateMachine3/LCK/LCK/LCK2/LCK_Condition1/Subsystem20" /begin REF_CHARACTERISTIC P_VSM_LSMC_SampleTime /end REF_CHARACTERISTIC /end GROUP
/begin GROUP S848_Subsystem21 "PubIfStateVSM_MDL/Subsystem Reference/Subsystem/StateManage/LSS/LCK_LKA_LDW_ELKStateMachine3/LCK/LCK/LCK2/LCK_Condition1/Subsystem21" /begin REF_CHARACTERISTIC P_VSM_LSMC_SampleTime /end REF_CHARACTERISTIC /end GROUP
/begin GROUP S848_Subsystem3 "PubIfStateVSM_MDL/Subsystem Reference/Subsystem/StateManage/LSS/LCK_LKA_LDW_ELKStateMachine3/LCK/LCK/LCK2/LCK_Condition1/Subsystem3" /begin REF_CHARACTERISTIC P_VSM_LSMC_SampleTime /end REF_CHARACTERISTIC /end GROUP
/begin GROUP S848_Subsystem4 "PubIfStateVSM_MDL/Subsystem Reference/Subsystem/StateManage/LSS/LCK_LKA_LDW_ELKStateMachine3/LCK/LCK/LCK2/LCK_Condition1/Subsystem4" /begin REF_CHARACTERISTIC P_VSM_LSMC_SampleTime /end REF_CHARACTERISTIC /end GROUP
/begin GROUP S848_Subsystem5 "PubIfStateVSM_MDL/Subsystem Reference/Subsystem/StateManage/LSS/LCK_LKA_LDW_ELKStateMachine3/LCK/LCK/LCK2/LCK_Condition1/Subsystem5" /begin REF_CHARACTERISTIC P_VSM_LSMC_SampleTime /end REF_CHARACTERISTIC /end GROUP
/begin GROUP S848_Subsystem7 "PubIfStateVSM_MDL/Subsystem Reference/Subsystem/StateManage/LSS/LCK_LKA_LDW_ELKStateMachine3/LCK/LCK/LCK2/LCK_Condition1/Subsystem7" /begin REF_CHARACTERISTIC P_VSM_LSMC_SampleTime /end REF_CHARACTERISTIC /end GROUP
/begin GROUP S848_Subsystem8 "PubIfStateVSM_MDL/Subsystem Reference/Subsystem/StateManage/LSS/LCK_LKA_LDW_ELKStateMachine3/LCK/LCK/LCK2/LCK_Condition1/Subsystem8" /begin REF_CHARACTERISTIC P_VSM_LSMC_SampleTime /end REF_CHARACTERISTIC /end GROUP
/begin GROUP S848_Subsystem9 "PubIfStateVSM_MDL/Subsystem Reference/Subsystem/StateManage/LSS/LCK_LKA_LDW_ELKStateMachine3/LCK/LCK/LCK2/LCK_Condition1/Subsystem9" /begin REF_CHARACTERISTIC P_VSM_LSMC_SampleTime /end REF_CHARACTERISTIC /end GROUP
/begin GROUP S1146_Subsystem1 "PubIfStateVSM_MDL/Subsystem Reference/Subsystem/StateManage/LSS/LCK_LKA_LDW_ELKStateMachine3/LCKIE/LCKIE/Subsystem1/IEStateClc/Subsystem1" /begin REF_CHARACTERISTIC P_VSM_LSMC_SampleTime /end REF_CHARACTERISTIC /end GROUP
/begin GROUP S1146_Subsystem12 "PubIfStateVSM_MDL/Subsystem Reference/Subsystem/StateManage/LSS/LCK_LKA_LDW_ELKStateMachine3/LCKIE/LCKIE/Subsystem1/IEStateClc/Subsystem12" /begin REF_CHARACTERISTIC P_VSM_LSMC_SampleTime /end REF_CHARACTERISTIC /end GROUP
/begin GROUP S1146_Subsystem4 "PubIfStateVSM_MDL/Subsystem Reference/Subsystem/StateManage/LSS/LCK_LKA_LDW_ELKStateMachine3/LCKIE/LCKIE/Subsystem1/IEStateClc/Subsystem4" /begin REF_CHARACTERISTIC P_VSM_LSMC_SampleTime /end REF_CHARACTERISTIC /end GROUP
/begin GROUP S1228_Subsystem1 "PubIfStateVSM_MDL/Subsystem Reference/Subsystem/StateManage/LSS/LCK_LKA_LDW_ELKStateMachine3/LDW/LDW/LDW2/LDWSignal_calculate/Subsystem1" /begin REF_CHARACTERISTIC P_VSM_LSMC_SampleTime /end REF_CHARACTERISTIC /end GROUP
/begin GROUP S1228_Subsystem4 "PubIfStateVSM_MDL/Subsystem Reference/Subsystem/StateManage/LSS/LCK_LKA_LDW_ELKStateMachine3/LDW/LDW/LDW2/LDWSignal_calculate/Subsystem4" /begin REF_CHARACTERISTIC P_VSM_LSMC_SampleTime /end REF_CHARACTERISTIC /end GROUP
/begin GROUP S1228_Subsystem7 "PubIfStateVSM_MDL/Subsystem Reference/Subsystem/StateManage/LSS/LCK_LKA_LDW_ELKStateMachine3/LDW/LDW/LDW2/LDWSignal_calculate/Subsystem7" /begin REF_CHARACTERISTIC P_VSM_LSMC_SampleTime /end REF_CHARACTERISTIC /end GROUP
/begin GROUP S1229_Subsystem "PubIfStateVSM_MDL/Subsystem Reference/Subsystem/StateManage/LSS/LCK_LKA_LDW_ELKStateMachine3/LDW/LDW/LDW2/LDW_Condition/Subsystem" /begin REF_CHARACTERISTIC P_VSM_LSMC_SampleTime /end REF_CHARACTERISTIC /end GROUP
/begin GROUP S1229_Subsystem1 "PubIfStateVSM_MDL/Subsystem Reference/Subsystem/StateManage/LSS/LCK_LKA_LDW_ELKStateMachine3/LDW/LDW/LDW2/LDW_Condition/Subsystem1" /begin REF_CHARACTERISTIC P_VSM_LSMC_SampleTime /end REF_CHARACTERISTIC /end GROUP
/begin GROUP S1229_Subsystem10 "PubIfStateVSM_MDL/Subsystem Reference/Subsystem/StateManage/LSS/LCK_LKA_LDW_ELKStateMachine3/LDW/LDW/LDW2/LDW_Condition/Subsystem10" /begin REF_CHARACTERISTIC P_VSM_LSMC_SampleTime /end REF_CHARACTERISTIC /end GROUP
/begin GROUP S1229_Subsystem17 "PubIfStateVSM_MDL/Subsystem Reference/Subsystem/StateManage/LSS/LCK_LKA_LDW_ELKStateMachine3/LDW/LDW/LDW2/LDW_Condition/Subsystem17" /begin REF_CHARACTERISTIC P_VSM_LSMC_SampleTime /end REF_CHARACTERISTIC /end GROUP
/begin GROUP S1229_Subsystem2 "PubIfStateVSM_MDL/Subsystem Reference/Subsystem/StateManage/LSS/LCK_LKA_LDW_ELKStateMachine3/LDW/LDW/LDW2/LDW_Condition/Subsystem2" /begin REF_CHARACTERISTIC P_VSM_LSMC_SampleTime /end REF_CHARACTERISTIC /end GROUP
/begin GROUP S1229_Subsystem3 "PubIfStateVSM_MDL/Subsystem Reference/Subsystem/StateManage/LSS/LCK_LKA_LDW_ELKStateMachine3/LDW/LDW/LDW2/LDW_Condition/Subsystem3" /begin REF_CHARACTERISTIC P_VSM_LSMC_SampleTime /end REF_CHARACTERISTIC /end GROUP
/begin GROUP S1229_Subsystem4 "PubIfStateVSM_MDL/Subsystem Reference/Subsystem/StateManage/LSS/LCK_LKA_LDW_ELKStateMachine3/LDW/LDW/LDW2/LDW_Condition/Subsystem4" /begin REF_CHARACTERISTIC P_VSM_LSMC_SampleTime /end REF_CHARACTERISTIC /end GROUP
/begin GROUP S1229_Subsystem5 "PubIfStateVSM_MDL/Subsystem Reference/Subsystem/StateManage/LSS/LCK_LKA_LDW_ELKStateMachine3/LDW/LDW/LDW2/LDW_Condition/Subsystem5" /begin REF_CHARACTERISTIC P_VSM_LSMC_SampleTime /end REF_CHARACTERISTIC /end GROUP
/begin GROUP S1229_Subsystem6 "PubIfStateVSM_MDL/Subsystem Reference/Subsystem/StateManage/LSS/LCK_LKA_LDW_ELKStateMachine3/LDW/LDW/LDW2/LDW_Condition/Subsystem6" /begin REF_CHARACTERISTIC P_VSM_LSMC_SampleTime /end REF_CHARACTERISTIC /end GROUP
/begin GROUP S1229_Subsystem7 "PubIfStateVSM_MDL/Subsystem Reference/Subsystem/StateManage/LSS/LCK_LKA_LDW_ELKStateMachine3/LDW/LDW/LDW2/LDW_Condition/Subsystem7" /begin REF_CHARACTERISTIC P_VSM_LSMC_SampleTime /end REF_CHARACTERISTIC /end GROUP
/begin GROUP S1229_Subsystem8 "PubIfStateVSM_MDL/Subsystem Reference/Subsystem/StateManage/LSS/LCK_LKA_LDW_ELKStateMachine3/LDW/LDW/LDW2/LDW_Condition/Subsystem8" /begin REF_CHARACTERISTIC P_VSM_LSMC_SampleTime /end REF_CHARACTERISTIC /end GROUP
/begin GROUP S1357_Subsystem1 "PubIfStateVSM_MDL/Subsystem Reference/Subsystem/StateManage/LSS/LCK_LKA_LDW_ELKStateMachine3/LKA/LKA/LKA2/LKA/Subsystem1" /begin REF_CHARACTERISTIC P_VSM_LSMC_SampleTime /end REF_CHARACTERISTIC /end GROUP
/begin GROUP S1357_Subsystem10 "PubIfStateVSM_MDL/Subsystem Reference/Subsystem/StateManage/LSS/LCK_LKA_LDW_ELKStateMachine3/LKA/LKA/LKA2/LKA/Subsystem10" /begin REF_CHARACTERISTIC P_VSM_LSMC_SampleTime /end REF_CHARACTERISTIC /end GROUP
/begin GROUP S1357_Subsystem2 "PubIfStateVSM_MDL/Subsystem Reference/Subsystem/StateManage/LSS/LCK_LKA_LDW_ELKStateMachine3/LKA/LKA/LKA2/LKA/Subsystem2" /begin REF_CHARACTERISTIC P_VSM_LSMC_SampleTime /end REF_CHARACTERISTIC /end GROUP
/begin GROUP S1357_Subsystem3 "PubIfStateVSM_MDL/Subsystem Reference/Subsystem/StateManage/LSS/LCK_LKA_LDW_ELKStateMachine3/LKA/LKA/LKA2/LKA/Subsystem3" /begin REF_CHARACTERISTIC P_VSM_LSMC_SampleTime /end REF_CHARACTERISTIC /end GROUP
/begin GROUP S1357_Subsystem4 "PubIfStateVSM_MDL/Subsystem Reference/Subsystem/StateManage/LSS/LCK_LKA_LDW_ELKStateMachine3/LKA/LKA/LKA2/LKA/Subsystem4" /begin REF_CHARACTERISTIC P_VSM_LSMC_SampleTime /end REF_CHARACTERISTIC /end GROUP
/begin GROUP S1357_Subsystem7 "PubIfStateVSM_MDL/Subsystem Reference/Subsystem/StateManage/LSS/LCK_LKA_LDW_ELKStateMachine3/LKA/LKA/LKA2/LKA/Subsystem7" /begin REF_CHARACTERISTIC P_VSM_LSMC_SampleTime /end REF_CHARACTERISTIC /end GROUP
/begin GROUP S1358_Subsystem1 "PubIfStateVSM_MDL/Subsystem Reference/Subsystem/StateManage/LSS/LCK_LKA_LDW_ELKStateMachine3/LKA/LKA/LKA2/LKA_Condition/Subsystem1" /begin REF_CHARACTERISTIC P_VSM_LSMC_SampleTime /end REF_CHARACTERISTIC /end GROUP
/begin GROUP S1358_Subsystem10 "PubIfStateVSM_MDL/Subsystem Reference/Subsystem/StateManage/LSS/LCK_LKA_LDW_ELKStateMachine3/LKA/LKA/LKA2/LKA_Condition/Subsystem10" /begin REF_CHARACTERISTIC P_VSM_LSMC_SampleTime /end REF_CHARACTERISTIC /end GROUP
/begin GROUP S1358_Subsystem12 "PubIfStateVSM_MDL/Subsystem Reference/Subsystem/StateManage/LSS/LCK_LKA_LDW_ELKStateMachine3/LKA/LKA/LKA2/LKA_Condition/Subsystem12" /begin REF_CHARACTERISTIC P_VSM_LSMC_SampleTime /end REF_CHARACTERISTIC /end GROUP
/begin GROUP S1358_Subsystem13 "PubIfStateVSM_MDL/Subsystem Reference/Subsystem/StateManage/LSS/LCK_LKA_LDW_ELKStateMachine3/LKA/LKA/LKA2/LKA_Condition/Subsystem13" /begin REF_CHARACTERISTIC P_VSM_LSMC_SampleTime /end REF_CHARACTERISTIC /end GROUP
/begin GROUP S1358_Subsystem15 "PubIfStateVSM_MDL/Subsystem Reference/Subsystem/StateManage/LSS/LCK_LKA_LDW_ELKStateMachine3/LKA/LKA/LKA2/LKA_Condition/Subsystem15" /begin REF_CHARACTERISTIC P_VSM_LSMC_SampleTime /end REF_CHARACTERISTIC /end GROUP
/begin GROUP S1358_Subsystem18 "PubIfStateVSM_MDL/Subsystem Reference/Subsystem/StateManage/LSS/LCK_LKA_LDW_ELKStateMachine3/LKA/LKA/LKA2/LKA_Condition/Subsystem18" /begin REF_CHARACTERISTIC P_VSM_LSMC_SampleTime /end REF_CHARACTERISTIC /end GROUP
/begin GROUP S1358_Subsystem2 "PubIfStateVSM_MDL/Subsystem Reference/Subsystem/StateManage/LSS/LCK_LKA_LDW_ELKStateMachine3/LKA/LKA/LKA2/LKA_Condition/Subsystem2" /begin REF_CHARACTERISTIC P_VSM_LSMC_SampleTime /end REF_CHARACTERISTIC /end GROUP
/begin GROUP S1358_Subsystem3 "PubIfStateVSM_MDL/Subsystem Reference/Subsystem/StateManage/LSS/LCK_LKA_LDW_ELKStateMachine3/LKA/LKA/LKA2/LKA_Condition/Subsystem3" /begin REF_CHARACTERISTIC P_VSM_LSMC_SampleTime /end REF_CHARACTERISTIC /end GROUP
/begin GROUP S1358_Subsystem4 "PubIfStateVSM_MDL/Subsystem Reference/Subsystem/StateManage/LSS/LCK_LKA_LDW_ELKStateMachine3/LKA/LKA/LKA2/LKA_Condition/Subsystem4" /begin REF_CHARACTERISTIC P_VSM_LSMC_SampleTime /end REF_CHARACTERISTIC /end GROUP
/begin GROUP S1358_Subsystem5 "PubIfStateVSM_MDL/Subsystem Reference/Subsystem/StateManage/LSS/LCK_LKA_LDW_ELKStateMachine3/LKA/LKA/LKA2/LKA_Condition/Subsystem5" /begin REF_CHARACTERISTIC P_VSM_LSMC_SampleTime /end REF_CHARACTERISTIC /end GROUP
/begin GROUP S1358_Subsystem6 "PubIfStateVSM_MDL/Subsystem Reference/Subsystem/StateManage/LSS/LCK_LKA_LDW_ELKStateMachine3/LKA/LKA/LKA2/LKA_Condition/Subsystem6" /begin REF_CHARACTERISTIC P_VSM_LSMC_SampleTime /end REF_CHARACTERISTIC /end GROUP
/begin GROUP S1358_Subsystem7 "PubIfStateVSM_MDL/Subsystem Reference/Subsystem/StateManage/LSS/LCK_LKA_LDW_ELKStateMachine3/LKA/LKA/LKA2/LKA_Condition/Subsystem7" /begin REF_CHARACTERISTIC P_VSM_LSMC_SampleTime /end REF_CHARACTERISTIC /end GROUP
/begin GROUP S1358_Subsystem8 "PubIfStateVSM_MDL/Subsystem Reference/Subsystem/StateManage/LSS/LCK_LKA_LDW_ELKStateMachine3/LKA/LKA/LKA2/LKA_Condition/Subsystem8" /begin REF_CHARACTERISTIC P_VSM_LSMC_SampleTime /end REF_CHARACTERISTIC /end GROUP
/begin GROUP S1358_Subsystem9 "PubIfStateVSM_MDL/Subsystem Reference/Subsystem/StateManage/LSS/LCK_LKA_LDW_ELKStateMachine3/LKA/LKA/LKA2/LKA_Condition/Subsystem9" /begin REF_CHARACTERISTIC P_VSM_LSMC_SampleTime /end REF_CHARACTERISTIC /end GROUP
/end MODULE
/end PROJECT
