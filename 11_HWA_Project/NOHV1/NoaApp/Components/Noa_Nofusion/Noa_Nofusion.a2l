/*
* ASAP2 file: Noa_Nofusion.a2l
* Copyright 2022, dSPACE GmbH. All rights reserved.
*/
/* Version 1.61 */
ASAP2_VERSION 1 61
/begin PROJECT Noa_Nofusion ""
/begin HEADER "" VERSION "1.579" PROJECT_NO Noa_Nofusion /end HEADER
/begin MODULE Noa_Nofusion ""
/begin RECORD_LAYOUT Scalar_BOOLEAN FNC_VALUES 1 UBYTE ROW_DIR DIRECT /end RECORD_LAYOUT
/begin RECORD_LAYOUT Scalar_UBYTE FNC_VALUES 1 UBYTE ROW_DIR DIRECT /end RECORD_LAYOUT
/begin RECORD_LAYOUT Scalar_BYTE FNC_VALUES 1 SBYTE ROW_DIR DIRECT /end RECORD_LAYOUT
/begin RECORD_LAYOUT Scalar_UWORD FNC_VALUES 1 UWORD ROW_DIR DIRECT /end RECORD_LAYOUT
/begin RECORD_LAYOUT Scalar_SWORD FNC_VALUES 1 SWORD ROW_DIR DIRECT /end RECORD_LAYOUT
/begin RECORD_LAYOUT Scalar_ULONG FNC_VALUES 1 ULONG ROW_DIR DIRECT /end RECORD_LAYOUT
/begin RECORD_LAYOUT Scalar_LONG FNC_VALUES 1 SLONG ROW_DIR DIRECT /end RECORD_LAYOUT
/begin RECORD_LAYOUT Scalar_FLOAT32_IEEE FNC_VALUES 1 FLOAT32_IEEE ROW_DIR DIRECT /end RECORD_LAYOUT
/begin RECORD_LAYOUT Scalar_FLOAT64_IEEE FNC_VALUES 1 FLOAT64_IEEE ROW_DIR DIRECT /end RECORD_LAYOUT
/begin RECORD_LAYOUT Lookup1D_BOOLEAN FNC_VALUES 1 UBYTE ROW_DIR DIRECT /end RECORD_LAYOUT
/begin RECORD_LAYOUT Lookup1D_BYTE FNC_VALUES 1 SBYTE ROW_DIR DIRECT /end RECORD_LAYOUT
/begin RECORD_LAYOUT Lookup1D_UBYTE FNC_VALUES 1 UBYTE ROW_DIR DIRECT /end RECORD_LAYOUT
/begin RECORD_LAYOUT Lookup1D_UWORD FNC_VALUES 1 UWORD ROW_DIR DIRECT /end RECORD_LAYOUT
/begin RECORD_LAYOUT Lookup1D_WORD FNC_VALUES 1 SWORD ROW_DIR DIRECT /end RECORD_LAYOUT
/begin RECORD_LAYOUT Lookup1D_ULONG FNC_VALUES 1 ULONG ROW_DIR DIRECT /end RECORD_LAYOUT
/begin RECORD_LAYOUT Lookup1D_LONG FNC_VALUES 1 SLONG ROW_DIR DIRECT /end RECORD_LAYOUT
/begin RECORD_LAYOUT Lookup1D_FLOAT32_IEEE FNC_VALUES 1 FLOAT32_IEEE ROW_DIR DIRECT /end RECORD_LAYOUT
/begin RECORD_LAYOUT Lookup1D_FLOAT64_IEEE FNC_VALUES 1 FLOAT64_IEEE ROW_DIR DIRECT /end RECORD_LAYOUT
/begin RECORD_LAYOUT Lookup1D_X_BOOLEAN AXIS_PTS_X 1 UBYTE INDEX_INCR DIRECT /end RECORD_LAYOUT
/begin RECORD_LAYOUT Lookup1D_X_BYTE AXIS_PTS_X 1 SBYTE INDEX_INCR DIRECT /end RECORD_LAYOUT
/begin RECORD_LAYOUT Lookup1D_X_FLOAT32_IEEE AXIS_PTS_X 1 FLOAT32_IEEE INDEX_INCR DIRECT /end RECORD_LAYOUT
/begin RECORD_LAYOUT Lookup2D_FLOAT32_IEEE FNC_VALUES 1 FLOAT32_IEEE ROW_DIR DIRECT /end RECORD_LAYOUT
/begin RECORD_LAYOUT Lookup2D_X_UBYTE AXIS_PTS_X 1 UBYTE INDEX_INCR DIRECT /end RECORD_LAYOUT
/begin RECORD_LAYOUT Lookup2D_X_FLOAT32_IEEE AXIS_PTS_X 1 FLOAT32_IEEE INDEX_INCR DIRECT /end RECORD_LAYOUT
/begin RECORD_LAYOUT Lookup2D_X_FLOAT64_IEEE AXIS_PTS_X 1 FLOAT64_IEEE INDEX_INCR DIRECT /end RECORD_LAYOUT
/begin CHARACTERISTIC P_EQ4_BC0Gain "" VALUE 0x0 /* @MemoryAddress@P_EQ4_BC0Gain@ */ Scalar_FLOAT64_IEEE 0 Noa_Nofusion_CM_double -1.7E+308 1.7E+308 /end CHARACTERISTIC
/begin CHARACTERISTIC P_HWA_TOS_P0HeadingAngle "" VALUE 0x0 /* @MemoryAddress@P_HWA_TOS_P0HeadingAngle@ */ Scalar_FLOAT64_IEEE 0 Noa_Nofusion_CM_double -1.7E+308 1.7E+308 /end CHARACTERISTIC
/begin CHARACTERISTIC P_Global_DxvFrontBumper_m "后轴到前杠前边缘的X向位置" VALUE 0x0 /* @MemoryAddress@P_Global_DxvFrontBumper_m@ */ Scalar_FLOAT32_IEEE 0 Noa_Nofusion_CM_single_m -3.4E+38 3.4E+38 /end CHARACTERISTIC
/begin CHARACTERISTIC P_Global_EQ2RearAxisX_m "后轴中心点到摄像头光心的X向位置" VALUE 0x0 /* @MemoryAddress@P_Global_EQ2RearAxisX_m@ */ Scalar_FLOAT32_IEEE 0 Noa_Nofusion_CM_single_m -3.4E+38 3.4E+38 /end CHARACTERISTIC
/begin CHARACTERISTIC P_Global_EQ2RearAxisY_m "摄像头光心到后轴中心点的Y向位置" VALUE 0x0 /* @MemoryAddress@P_Global_EQ2RearAxisY_m@ */ Scalar_FLOAT32_IEEE 0 Noa_Nofusion_CM_single_m -3.4E+38 3.4E+38 /end CHARACTERISTIC
/begin CHARACTERISTIC P_Global_SteeringAngleRatio "方向盘与前轮转角传动比" VALUE 0x0 /* @MemoryAddress@P_Global_SteeringAngleRatio@ */ Scalar_FLOAT32_IEEE 0 Noa_Nofusion_CM_single -3.4E+38 3.4E+38 /end CHARACTERISTIC
/begin CHARACTERISTIC P_TOSS_DxOffset "" VALUE 0x0 /* @MemoryAddress@P_TOSS_DxOffset@ */ Scalar_FLOAT32_IEEE 0 Noa_Nofusion_CM_single -3.4E+38 3.4E+38 /end CHARACTERISTIC
/begin CHARACTERISTIC P_RFM_RoadType "" VALUE 0x0 /* @MemoryAddress@P_RFM_RoadType@ */ Scalar_UBYTE 0 Noa_Nofusion_CM_uint8 0 255 /end CHARACTERISTIC
/begin CHARACTERISTIC P_RFM_mapvalid "" VALUE 0x0 /* @MemoryAddress@P_RFM_mapvalid@ */ Scalar_UBYTE 0 Noa_Nofusion_CM_uint8 0 255 /end CHARACTERISTIC
/begin CHARACTERISTIC P_HMI_LDW_LKAWarnTime "" VALUE 0x0 /* @MemoryAddress@P_HMI_LDW_LKAWarnTime@ */ Scalar_FLOAT32_IEEE 0 PubIfChassisHMI_MDL_CM_single -3.4E+38 3.4E+38 /end CHARACTERISTIC
/begin CHARACTERISTIC P_HMI_ObjectTypeFilter "" VALUE 0x0 /* @MemoryAddress@P_HMI_ObjectTypeFilter@ */ Scalar_FLOAT32_IEEE 0 PubIfChassisHMI_MDL_CM_single -3.4E+38 3.4E+38 /end CHARACTERISTIC
/begin CHARACTERISTIC P_Global_CharSpd_ms "车辆特征车速（过渡转向和转向不足的临界车速，ESP提供）" VALUE 0x0 /* @MemoryAddress@P_Global_CharSpd_ms@ */ Scalar_FLOAT32_IEEE 0 PubIfCommonVIE_MDL_CM_single_m_s -3.4E+38 3.4E+38 /end CHARACTERISTIC
/begin CHARACTERISTIC P_Global_FrontAxleToCenter_m "前轴距到车辆质心距离" VALUE 0x0 /* @MemoryAddress@P_Global_FrontAxleToCenter_m@ */ Scalar_FLOAT32_IEEE 0 PubIfCommonVIE_MDL_CM_single_m -3.4E+38 3.4E+38 /end CHARACTERISTIC
/begin CHARACTERISTIC P_Global_RearAxleToCenter_m "后轴到车辆质心的X向位置" VALUE 0x0 /* @MemoryAddress@P_Global_RearAxleToCenter_m@ */ Scalar_FLOAT32_IEEE 0 PubIfCommonVIE_MDL_CM_single_m -3.4E+38 3.4E+38 /end CHARACTERISTIC
/begin CHARACTERISTIC P_Global_SideSlipAnglefactor "侧滑角系数" VALUE 0x0 /* @MemoryAddress@P_Global_SideSlipAnglefactor@ */ Scalar_FLOAT32_IEEE 0 PubIfCommonVIE_MDL_CM_single -3.4E+38 3.4E+38 /end CHARACTERISTIC
/begin CHARACTERISTIC P_Global_WheelBase_m "轴距" VALUE 0x0 /* @MemoryAddress@P_Global_WheelBase_m@ */ Scalar_FLOAT32_IEEE 0 PubIfCommonVIE_MDL_CM_single_m -3.4E+38 3.4E+38 /end CHARACTERISTIC
/begin CHARACTERISTIC P_Global_WheelTrack_m "轮距" VALUE 0x0 /* @MemoryAddress@P_Global_WheelTrack_m@ */ Scalar_FLOAT32_IEEE 0 PubIfCommonVIE_MDL_CM_single_m -3.4E+38 3.4E+38 /end CHARACTERISTIC
/begin CHARACTERISTIC P_LCS_ESS_SteerAngleErr "" CURVE 0x0 /* @MemoryAddress@P_LCS_ESS_SteerAngleErr@ */ Lookup1D_FLOAT32_IEEE 0 PubIfControlLATC_MDL_CM_single -3.4E+38 3.4E+38
 /begin AXIS_DESCR COM_AXIS NO_INPUT_QUANTITY PubIfControlLATC_MDL_CM_single 12 -3.4E+38 3.4E+38 AXIS_PTS_REF P_LCS_LATC_VehicleSpd_TabX_Kph /end AXIS_DESCR
/end CHARACTERISTIC
/begin CHARACTERISTIC P_LCS_LATC_MPCMatrixQ1_st "" CURVE 0x0 /* @MemoryAddress@P_LCS_LATC_MPCMatrixQ1_st@ */ Lookup1D_FLOAT32_IEEE 0 PubIfControlLATC_MDL_CM_single -3.4E+38 3.4E+38
 /begin AXIS_DESCR COM_AXIS LCS_IN_Spd_Kph PubIfControlLATC_MDL_CM_single 16 -3.4E+38 3.4E+38 AXIS_PTS_REF P_LCS_VehicleSpd_TabX_Kph /end AXIS_DESCR
/end CHARACTERISTIC
/begin CHARACTERISTIC P_LCS_LATC_MPCMatrixQ2_st "" CURVE 0x0 /* @MemoryAddress@P_LCS_LATC_MPCMatrixQ2_st@ */ Lookup1D_FLOAT32_IEEE 0 PubIfControlLATC_MDL_CM_single -3.4E+38 3.4E+38
 /begin AXIS_DESCR COM_AXIS LCS_IN_Spd_Kph PubIfControlLATC_MDL_CM_single 16 -3.4E+38 3.4E+38 AXIS_PTS_REF P_LCS_VehicleSpd_TabX_Kph /end AXIS_DESCR
/end CHARACTERISTIC
/begin CHARACTERISTIC P_LCS_LATC_MPCMatrixR_st "" CURVE 0x0 /* @MemoryAddress@P_LCS_LATC_MPCMatrixR_st@ */ Lookup1D_FLOAT32_IEEE 0 PubIfControlLATC_MDL_CM_single -3.4E+38 3.4E+38
 /begin AXIS_DESCR COM_AXIS LCS_IN_Spd_Kph PubIfControlLATC_MDL_CM_single 16 -3.4E+38 3.4E+38 AXIS_PTS_REF P_LCS_VehicleSpd_TabX_Kph /end AXIS_DESCR
/end CHARACTERISTIC
/begin CHARACTERISTIC P_LCS_LATC_ELKAngleSlope_ratio "" CURVE 0x0 /* @MemoryAddress@P_LCS_LATC_ELKAngleSlope_ratio@ */ Lookup1D_FLOAT32_IEEE 0 PubIfControlLATC_MDL_CM_single -3.4E+38 3.4E+38
 /begin AXIS_DESCR COM_AXIS LCS_IN_Spd_Kph PubIfControlLATC_MDL_CM_single 16 -3.4E+38 3.4E+38 AXIS_PTS_REF P_LCS_VehicleSpd_TabX_Kph /end AXIS_DESCR
/end CHARACTERISTIC
/begin CHARACTERISTIC P_LCS_LATC_ELKMaxLatAcc_ms2 "" CURVE 0x0 /* @MemoryAddress@P_LCS_LATC_ELKMaxLatAcc_ms2@ */ Lookup1D_FLOAT32_IEEE 0 PubIfControlLATC_MDL_CM_single -3.4E+38 3.4E+38
 /begin AXIS_DESCR COM_AXIS LCS_IN_Spd_Kph PubIfControlLATC_MDL_CM_single 16 -3.4E+38 3.4E+38 AXIS_PTS_REF P_LCS_VehicleSpd_TabX_Kph /end AXIS_DESCR
/end CHARACTERISTIC
/begin CHARACTERISTIC P_LCS_LATC_ESSAngleSlope_ratio "" CURVE 0x0 /* @MemoryAddress@P_LCS_LATC_ESSAngleSlope_ratio@ */ Lookup1D_FLOAT32_IEEE 0 PubIfControlLATC_MDL_CM_single -3.4E+38 3.4E+38
 /begin AXIS_DESCR COM_AXIS LCS_IN_Spd_Kph PubIfControlLATC_MDL_CM_single 16 -3.4E+38 3.4E+38 AXIS_PTS_REF P_LCS_VehicleSpd_TabX_Kph /end AXIS_DESCR
/end CHARACTERISTIC
/begin CHARACTERISTIC P_LCS_LATC_ESSMaxLatAcc_ms2 "" CURVE 0x0 /* @MemoryAddress@P_LCS_LATC_ESSMaxLatAcc_ms2@ */ Lookup1D_FLOAT32_IEEE 0 PubIfControlLATC_MDL_CM_single -3.4E+38 3.4E+38
 /begin AXIS_DESCR COM_AXIS LCS_IN_Spd_Kph PubIfControlLATC_MDL_CM_single 16 -3.4E+38 3.4E+38 AXIS_PTS_REF P_LCS_VehicleSpd_TabX_Kph /end AXIS_DESCR
/end CHARACTERISTIC
/begin CHARACTERISTIC P_LCS_LATC_LCAngleSlope_ratio "" CURVE 0x0 /* @MemoryAddress@P_LCS_LATC_LCAngleSlope_ratio@ */ Lookup1D_FLOAT32_IEEE 0 PubIfControlLATC_MDL_CM_single -3.4E+38 3.4E+38
 /begin AXIS_DESCR COM_AXIS LCS_IN_Spd_Kph PubIfControlLATC_MDL_CM_single 16 -3.4E+38 3.4E+38 AXIS_PTS_REF P_LCS_VehicleSpd_TabX_Kph /end AXIS_DESCR
/end CHARACTERISTIC
/begin CHARACTERISTIC P_LCS_LATC_LCEcoAngleSlope_ratio "" CURVE 0x0 /* @MemoryAddress@P_LCS_LATC_LCEcoAngleSlope_ratio@ */ Lookup1D_FLOAT32_IEEE 0 PubIfControlLATC_MDL_CM_single -3.4E+38 3.4E+38
 /begin AXIS_DESCR COM_AXIS LCS_IN_Spd_Kph PubIfControlLATC_MDL_CM_single 16 -3.4E+38 3.4E+38 AXIS_PTS_REF P_LCS_VehicleSpd_TabX_Kph /end AXIS_DESCR
/end CHARACTERISTIC
/begin CHARACTERISTIC P_LCS_LATC_LCNormalAngleSlope_ratio "" CURVE 0x0 /* @MemoryAddress@P_LCS_LATC_LCNormalAngleSlope_ratio@ */ Lookup1D_FLOAT32_IEEE 0 PubIfControlLATC_MDL_CM_single -3.4E+38 3.4E+38
 /begin AXIS_DESCR COM_AXIS LCS_IN_Spd_Kph PubIfControlLATC_MDL_CM_single 16 -3.4E+38 3.4E+38 AXIS_PTS_REF P_LCS_VehicleSpd_TabX_Kph /end AXIS_DESCR
/end CHARACTERISTIC
/begin CHARACTERISTIC P_LCS_LATC_LCSportAngleSlope_ratio "" CURVE 0x0 /* @MemoryAddress@P_LCS_LATC_LCSportAngleSlope_ratio@ */ Lookup1D_FLOAT32_IEEE 0 PubIfControlLATC_MDL_CM_single -3.4E+38 3.4E+38
 /begin AXIS_DESCR COM_AXIS LCS_IN_Spd_Kph PubIfControlLATC_MDL_CM_single 16 -3.4E+38 3.4E+38 AXIS_PTS_REF P_LCS_VehicleSpd_TabX_Kph /end AXIS_DESCR
/end CHARACTERISTIC
/begin CHARACTERISTIC P_LCS_LATC_LCKIEMaxLatAcc_ms2 "" CURVE 0x0 /* @MemoryAddress@P_LCS_LATC_LCKIEMaxLatAcc_ms2@ */ Lookup1D_FLOAT32_IEEE 0 PubIfControlLATC_MDL_CM_single -3.4E+38 3.4E+38
 /begin AXIS_DESCR COM_AXIS LCS_IN_Spd_Kph PubIfControlLATC_MDL_CM_single 16 -3.4E+38 3.4E+38 AXIS_PTS_REF P_LCS_VehicleSpd_TabX_Kph /end AXIS_DESCR
/end CHARACTERISTIC
/begin CHARACTERISTIC P_LCS_LATC_LCKIEAngleSlope_ratio "" CURVE 0x0 /* @MemoryAddress@P_LCS_LATC_LCKIEAngleSlope_ratio@ */ Lookup1D_FLOAT32_IEEE 0 PubIfControlLATC_MDL_CM_single -3.4E+38 3.4E+38
 /begin AXIS_DESCR COM_AXIS LCS_IN_Spd_Kph PubIfControlLATC_MDL_CM_single 16 -3.4E+38 3.4E+38 AXIS_PTS_REF P_LCS_VehicleSpd_TabX_Kph /end AXIS_DESCR
/end CHARACTERISTIC
/begin CHARACTERISTIC P_LCS_LATC_LCKMaxLatAcc_ms2 "" CURVE 0x0 /* @MemoryAddress@P_LCS_LATC_LCKMaxLatAcc_ms2@ */ Lookup1D_FLOAT32_IEEE 0 PubIfControlLATC_MDL_CM_single -3.4E+38 3.4E+38
 /begin AXIS_DESCR COM_AXIS LCS_IN_Spd_Kph PubIfControlLATC_MDL_CM_single 16 -3.4E+38 3.4E+38 AXIS_PTS_REF P_LCS_VehicleSpd_TabX_Kph /end AXIS_DESCR
/end CHARACTERISTIC
/begin CHARACTERISTIC P_LCS_LATC_LCNormalMaxLatAcc_ms2 "" CURVE 0x0 /* @MemoryAddress@P_LCS_LATC_LCNormalMaxLatAcc_ms2@ */ Lookup1D_FLOAT32_IEEE 0 PubIfControlLATC_MDL_CM_single -3.4E+38 3.4E+38
 /begin AXIS_DESCR COM_AXIS LCS_IN_Spd_Kph PubIfControlLATC_MDL_CM_single 16 -3.4E+38 3.4E+38 AXIS_PTS_REF P_LCS_VehicleSpd_TabX_Kph /end AXIS_DESCR
/end CHARACTERISTIC
/begin CHARACTERISTIC P_LCS_LATC_LCCancleMaxLatAcc_ms2 "" CURVE 0x0 /* @MemoryAddress@P_LCS_LATC_LCCancleMaxLatAcc_ms2@ */ Lookup1D_FLOAT32_IEEE 0 PubIfControlLATC_MDL_CM_single -3.4E+38 3.4E+38
 /begin AXIS_DESCR COM_AXIS LCS_IN_Spd_Kph PubIfControlLATC_MDL_CM_single 16 -3.4E+38 3.4E+38 AXIS_PTS_REF P_LCS_VehicleSpd_TabX_Kph /end AXIS_DESCR
/end CHARACTERISTIC
/begin CHARACTERISTIC P_LCS_LATC_LCEcoMaxLatAcc_ms2 "" CURVE 0x0 /* @MemoryAddress@P_LCS_LATC_LCEcoMaxLatAcc_ms2@ */ Lookup1D_FLOAT32_IEEE 0 PubIfControlLATC_MDL_CM_single -3.4E+38 3.4E+38
 /begin AXIS_DESCR COM_AXIS LCS_IN_Spd_Kph PubIfControlLATC_MDL_CM_single 16 -3.4E+38 3.4E+38 AXIS_PTS_REF P_LCS_VehicleSpd_TabX_Kph /end AXIS_DESCR
/end CHARACTERISTIC
/begin CHARACTERISTIC P_LCS_LATC_LCSportMaxLatAcc_ms2 "" CURVE 0x0 /* @MemoryAddress@P_LCS_LATC_LCSportMaxLatAcc_ms2@ */ Lookup1D_FLOAT32_IEEE 0 PubIfControlLATC_MDL_CM_single -3.4E+38 3.4E+38
 /begin AXIS_DESCR COM_AXIS LCS_IN_Spd_Kph PubIfControlLATC_MDL_CM_single 16 -3.4E+38 3.4E+38 AXIS_PTS_REF P_LCS_VehicleSpd_TabX_Kph /end AXIS_DESCR
/end CHARACTERISTIC
/begin CHARACTERISTIC P_LCS_LATC_LKAAngleSlope_ratio "" CURVE 0x0 /* @MemoryAddress@P_LCS_LATC_LKAAngleSlope_ratio@ */ Lookup1D_FLOAT32_IEEE 0 PubIfControlLATC_MDL_CM_single -3.4E+38 3.4E+38
 /begin AXIS_DESCR COM_AXIS LCS_IN_Spd_Kph PubIfControlLATC_MDL_CM_single 16 -3.4E+38 3.4E+38 AXIS_PTS_REF P_LCS_VehicleSpd_TabX_Kph /end AXIS_DESCR
/end CHARACTERISTIC
/begin CHARACTERISTIC P_LCS_LATC_LKAMaxLatAcc_ms2 "" CURVE 0x0 /* @MemoryAddress@P_LCS_LATC_LKAMaxLatAcc_ms2@ */ Lookup1D_FLOAT32_IEEE 0 PubIfControlLATC_MDL_CM_single -3.4E+38 3.4E+38
 /begin AXIS_DESCR COM_AXIS LCS_IN_Spd_Kph PubIfControlLATC_MDL_CM_single 16 -3.4E+38 3.4E+38 AXIS_PTS_REF P_LCS_VehicleSpd_TabX_Kph /end AXIS_DESCR
/end CHARACTERISTIC
/begin CHARACTERISTIC P_LCS_LATC_LCKAngleSlope_ratio "" CURVE 0x0 /* @MemoryAddress@P_LCS_LATC_LCKAngleSlope_ratio@ */ Lookup1D_FLOAT32_IEEE 0 PubIfControlLATC_MDL_CM_single -3.4E+38 3.4E+38
 /begin AXIS_DESCR COM_AXIS LCS_IN_Spd_Kph PubIfControlLATC_MDL_CM_single 16 -3.4E+38 3.4E+38 AXIS_PTS_REF P_LCS_VehicleSpd_TabX_Kph /end AXIS_DESCR
/end CHARACTERISTIC
/begin CHARACTERISTIC P_LCS_PLAN_LCPreDisFac_ratio "" MAP 0x0 /* @MemoryAddress@P_LCS_PLAN_LCPreDisFac_ratio@ */ Lookup2D_FLOAT32_IEEE 0 PubIfControlLATC_MDL_CM_single -3.4E+38 3.4E+38
 /begin AXIS_DESCR COM_AXIS NO_INPUT_QUANTITY PubIfControlLATC_MDL_CM_single 3 -3.4E+38 3.4E+38 AXIS_PTS_REF P_LCS_PLAN_TarDangerlLevel_Tabx_st /end AXIS_DESCR
 /begin AXIS_DESCR COM_AXIS NO_INPUT_QUANTITY PubIfControlLATC_MDL_CM_single 7 -3.4E+38 3.4E+38 AXIS_PTS_REF P_LCS_PLAN_DesLineA0_TabY_m /end AXIS_DESCR
/end CHARACTERISTIC
/begin CHARACTERISTIC P_LCS_Plan_LCNomalAyDtLimit_Tab_ms3 "" MAP 0x0 /* @MemoryAddress@P_LCS_Plan_LCNomalAyDtLimit_Tab_ms3@ */ Lookup2D_FLOAT32_IEEE 0 PubIfControlLATC_MDL_CM_single -3.4E+38 3.4E+38
 /begin AXIS_DESCR COM_AXIS LCS_PreDisCurve_m PubIfControlLATC_MDL_CM_single 13 -3.4E+38 3.4E+38 AXIS_PTS_REF P_LCS_PLAN_PreDisCurve_TabX_m /end AXIS_DESCR
 /begin AXIS_DESCR COM_AXIS LCS_IN_Spd_Kph PubIfControlLATC_MDL_CM_single 16 -3.4E+38 3.4E+38 AXIS_PTS_REF P_LCS_PLAN_VehicleSpd_TabY_Kph /end AXIS_DESCR
/end CHARACTERISTIC
/begin CHARACTERISTIC P_LCS_PLAN_LCKAyDtLimit_Tab_ms3 "" MAP 0x0 /* @MemoryAddress@P_LCS_PLAN_LCKAyDtLimit_Tab_ms3@ */ Lookup2D_FLOAT32_IEEE 0 PubIfControlLATC_MDL_CM_single -3.4E+38 3.4E+38
 /begin AXIS_DESCR COM_AXIS LCS_PreDisCurve_m PubIfControlLATC_MDL_CM_single 13 -3.4E+38 3.4E+38 AXIS_PTS_REF P_LCS_PLAN_PreDisCurve_TabX_m /end AXIS_DESCR
 /begin AXIS_DESCR COM_AXIS LCS_IN_Spd_Kph PubIfControlLATC_MDL_CM_single 16 -3.4E+38 3.4E+38 AXIS_PTS_REF P_LCS_PLAN_VehicleSpd_TabY_Kph /end AXIS_DESCR
/end CHARACTERISTIC
/begin CHARACTERISTIC P_LCS_Plan_LKAAyDtLimit_Tab_ms3 "" MAP 0x0 /* @MemoryAddress@P_LCS_Plan_LKAAyDtLimit_Tab_ms3@ */ Lookup2D_FLOAT32_IEEE 0 PubIfControlLATC_MDL_CM_single -3.4E+38 3.4E+38
 /begin AXIS_DESCR COM_AXIS LCS_PreDisCurve_m PubIfControlLATC_MDL_CM_single 13 -3.4E+38 3.4E+38 AXIS_PTS_REF P_LCS_PLAN_PreDisCurve_TabX_m /end AXIS_DESCR
 /begin AXIS_DESCR COM_AXIS LCS_IN_Spd_Kph PubIfControlLATC_MDL_CM_single 16 -3.4E+38 3.4E+38 AXIS_PTS_REF P_LCS_PLAN_VehicleSpd_TabY_Kph /end AXIS_DESCR
/end CHARACTERISTIC
/begin CHARACTERISTIC P_LCS_Plan_ELKAyDtLimit_Tab_ms3 "" MAP 0x0 /* @MemoryAddress@P_LCS_Plan_ELKAyDtLimit_Tab_ms3@ */ Lookup2D_FLOAT32_IEEE 0 PubIfControlLATC_MDL_CM_single -3.4E+38 3.4E+38
 /begin AXIS_DESCR COM_AXIS LCS_PreDisCurve_m PubIfControlLATC_MDL_CM_single 13 -3.4E+38 3.4E+38 AXIS_PTS_REF P_LCS_PLAN_PreDisCurve_TabX_m /end AXIS_DESCR
 /begin AXIS_DESCR COM_AXIS LCS_IN_Spd_Kph PubIfControlLATC_MDL_CM_single 16 -3.4E+38 3.4E+38 AXIS_PTS_REF P_LCS_PLAN_VehicleSpd_TabY_Kph /end AXIS_DESCR
/end CHARACTERISTIC
/begin CHARACTERISTIC P_LCS_Plan_LCSportAyDtLimit_Tab_ms3 "" MAP 0x0 /* @MemoryAddress@P_LCS_Plan_LCSportAyDtLimit_Tab_ms3@ */ Lookup2D_FLOAT32_IEEE 0 PubIfControlLATC_MDL_CM_single -3.4E+38 3.4E+38
 /begin AXIS_DESCR COM_AXIS LCS_PreDisCurve_m PubIfControlLATC_MDL_CM_single 13 -3.4E+38 3.4E+38 AXIS_PTS_REF P_LCS_PLAN_PreDisCurve_TabX_m /end AXIS_DESCR
 /begin AXIS_DESCR COM_AXIS LCS_IN_Spd_Kph PubIfControlLATC_MDL_CM_single 16 -3.4E+38 3.4E+38 AXIS_PTS_REF P_LCS_PLAN_VehicleSpd_TabY_Kph /end AXIS_DESCR
/end CHARACTERISTIC
/begin CHARACTERISTIC P_LCS_Plan_LCAyDtLimit_Tab_ms3 "" MAP 0x0 /* @MemoryAddress@P_LCS_Plan_LCAyDtLimit_Tab_ms3@ */ Lookup2D_FLOAT32_IEEE 0 PubIfControlLATC_MDL_CM_single -3.4E+38 3.4E+38
 /begin AXIS_DESCR COM_AXIS LCS_PreDisCurve_m PubIfControlLATC_MDL_CM_single 13 -3.4E+38 3.4E+38 AXIS_PTS_REF P_LCS_PLAN_PreDisCurve_TabX_m /end AXIS_DESCR
 /begin AXIS_DESCR COM_AXIS LCS_IN_Spd_Kph PubIfControlLATC_MDL_CM_single 16 -3.4E+38 3.4E+38 AXIS_PTS_REF P_LCS_PLAN_VehicleSpd_TabY_Kph /end AXIS_DESCR
/end CHARACTERISTIC
/begin CHARACTERISTIC P_LCS_Plan_LCKIEAyDtLimit_Tab_ms3 "" MAP 0x0 /* @MemoryAddress@P_LCS_Plan_LCKIEAyDtLimit_Tab_ms3@ */ Lookup2D_FLOAT32_IEEE 0 PubIfControlLATC_MDL_CM_single -3.4E+38 3.4E+38
 /begin AXIS_DESCR COM_AXIS LCS_PreDisCurve_m PubIfControlLATC_MDL_CM_single 13 -3.4E+38 3.4E+38 AXIS_PTS_REF P_LCS_PLAN_PreDisCurve_TabX_m /end AXIS_DESCR
 /begin AXIS_DESCR COM_AXIS LCS_IN_Spd_Kph PubIfControlLATC_MDL_CM_single 16 -3.4E+38 3.4E+38 AXIS_PTS_REF P_LCS_PLAN_VehicleSpd_TabY_Kph /end AXIS_DESCR
/end CHARACTERISTIC
/begin CHARACTERISTIC P_LCS_LATC_StateActivAngleSlopeLimit_ratio "" MAP 0x0 /* @MemoryAddress@P_LCS_LATC_StateActivAngleSlopeLimit_ratio@ */ Lookup2D_FLOAT32_IEEE 0 PubIfControlLATC_MDL_CM_single -3.4E+38 3.4E+38
 /begin AXIS_DESCR COM_AXIS LCS_LATC_AngleSlopeFlg_st PubIfControlLATC_MDL_CM_uint8 5 0 255 AXIS_PTS_REF P_LCS_LATC_StateActiveFlg_TabX_st /end AXIS_DESCR
 /begin AXIS_DESCR COM_AXIS LCS_LATC_HoldTime_s PubIfControlLATC_MDL_CM_double 15 -1.7E+308 1.7E+308 AXIS_PTS_REF P_LCS_LATC_StateActiveHoldTime_TabY_st /end AXIS_DESCR
/end CHARACTERISTIC
/begin CHARACTERISTIC P_LCS_LATC_CurOffsetCurveFliterTime_Tab_s "" CURVE 0x0 /* @MemoryAddress@P_LCS_LATC_CurOffsetCurveFliterTime_Tab_s@ */ Lookup1D_FLOAT32_IEEE 0 PubIfControlLATC_MDL_CM_single -3.4E+38 3.4E+38
 /begin AXIS_DESCR COM_AXIS NO_INPUT_QUANTITY PubIfControlLATC_MDL_CM_single 10 -3.4E+38 3.4E+38 AXIS_PTS_REF P_LCS_LATC_CurOffsetCurve_TabX_m /end AXIS_DESCR
/end CHARACTERISTIC
/begin CHARACTERISTIC P_LCS_PLAN_StateActivAngleSlope_Tab_ratio "" MAP 0x0 /* @MemoryAddress@P_LCS_PLAN_StateActivAngleSlope_Tab_ratio@ */ Lookup2D_FLOAT32_IEEE 0 PubIfControlLATC_MDL_CM_single -3.4E+38 3.4E+38
 /begin AXIS_DESCR COM_AXIS NO_INPUT_QUANTITY PubIfControlLATC_MDL_CM_uint8 5 0 255 AXIS_PTS_REF P_LCS_PLAN_StateActiveFlg_TabX_st /end AXIS_DESCR
 /begin AXIS_DESCR COM_AXIS NO_INPUT_QUANTITY PubIfControlLATC_MDL_CM_double 15 -1.7E+308 1.7E+308 AXIS_PTS_REF P_LCS_PLAN_StateActiveHoldTime_TabY_s /end AXIS_DESCR
/end CHARACTERISTIC
/begin CHARACTERISTIC P_LCS_PLAN_StateCompleteAngleSlope_Tab_ratio "" MAP 0x0 /* @MemoryAddress@P_LCS_PLAN_StateCompleteAngleSlope_Tab_ratio@ */ Lookup2D_FLOAT32_IEEE 0 PubIfControlLATC_MDL_CM_single -3.4E+38 3.4E+38
 /begin AXIS_DESCR COM_AXIS NO_INPUT_QUANTITY PubIfControlLATC_MDL_CM_uint8 3 0 255 AXIS_PTS_REF P_LCS_PLAN_StateCompleteFlg_TabX_st /end AXIS_DESCR
 /begin AXIS_DESCR COM_AXIS NO_INPUT_QUANTITY PubIfControlLATC_MDL_CM_double 15 -1.7E+308 1.7E+308 AXIS_PTS_REF P_LCS_PLAN_StateActiveHoldTime_TabY_s /end AXIS_DESCR
/end CHARACTERISTIC
/begin CHARACTERISTIC P_LCS_PLAN_LCCompletePreDisFac_Tab_ratio "" MAP 0x0 /* @MemoryAddress@P_LCS_PLAN_LCCompletePreDisFac_Tab_ratio@ */ Lookup2D_FLOAT32_IEEE 0 PubIfControlLATC_MDL_CM_single -3.4E+38 3.4E+38
 /begin AXIS_DESCR COM_AXIS NO_INPUT_QUANTITY PubIfControlLATC_MDL_CM_uint8 3 0 255 AXIS_PTS_REF P_LCS_PLAN_StateCompleteFlg_TabX_st /end AXIS_DESCR
 /begin AXIS_DESCR COM_AXIS NO_INPUT_QUANTITY PubIfControlLATC_MDL_CM_double 15 -1.7E+308 1.7E+308 AXIS_PTS_REF P_LCS_PLAN_StateActiveHoldTime_TabY_s /end AXIS_DESCR
/end CHARACTERISTIC
/begin CHARACTERISTIC P_LCS_ESSOverrideTime1 "" VALUE 0x0 /* @MemoryAddress@P_LCS_ESSOverrideTime1@ */ Scalar_FLOAT64_IEEE 0 PubIfControlLATC_MDL_CM_double -1.7E+308 1.7E+308 /end CHARACTERISTIC
/begin CHARACTERISTIC P_LCS_ESSOverrideTime2 "" VALUE 0x0 /* @MemoryAddress@P_LCS_ESSOverrideTime2@ */ Scalar_FLOAT64_IEEE 0 PubIfControlLATC_MDL_CM_double -1.7E+308 1.7E+308 /end CHARACTERISTIC
/begin CHARACTERISTIC P_LCS_ESSOverrideTime3 "" VALUE 0x0 /* @MemoryAddress@P_LCS_ESSOverrideTime3@ */ Scalar_FLOAT64_IEEE 0 PubIfControlLATC_MDL_CM_double -1.7E+308 1.7E+308 /end CHARACTERISTIC
/begin CHARACTERISTIC P_LCS_LATC_TarAngleFliterWindowSize "" VALUE 0x0 /* @MemoryAddress@P_LCS_LATC_TarAngleFliterWindowSize@ */ Scalar_FLOAT64_IEEE 0 PubIfControlLATC_MDL_CM_double -1.7E+308 1.7E+308 /end CHARACTERISTIC
/begin CHARACTERISTIC P_LCS_NoOverRideTime_TH_s "" VALUE 0x0 /* @MemoryAddress@P_LCS_NoOverRideTime_TH_s@ */ Scalar_FLOAT64_IEEE 0 PubIfControlLATC_MDL_CM_double -1.7E+308 1.7E+308 /end CHARACTERISTIC
/begin CHARACTERISTIC P_LCS_OverRideDetect_b "" VALUE 0x0 /* @MemoryAddress@P_LCS_OverRideDetect_b@ */ Scalar_FLOAT64_IEEE 0 PubIfControlLATC_MDL_CM_double -1.7E+308 1.7E+308 /end CHARACTERISTIC
/begin CHARACTERISTIC P_LCS_OverRideTime_TH_s "" VALUE 0x0 /* @MemoryAddress@P_LCS_OverRideTime_TH_s@ */ Scalar_FLOAT64_IEEE 0 PubIfControlLATC_MDL_CM_double -1.7E+308 1.7E+308 /end CHARACTERISTIC
/begin CHARACTERISTIC P_LCS_DetNoOverRide_DrvTrq_TH "" VALUE 0x0 /* @MemoryAddress@P_LCS_DetNoOverRide_DrvTrq_TH@ */ Scalar_FLOAT32_IEEE 0 PubIfControlLATC_MDL_CM_single -3.4E+38 3.4E+38 /end CHARACTERISTIC
/begin CHARACTERISTIC P_LCS_DetOverRide_DrvTrq_TH "" VALUE 0x0 /* @MemoryAddress@P_LCS_DetOverRide_DrvTrq_TH@ */ Scalar_FLOAT32_IEEE 0 PubIfControlLATC_MDL_CM_single -3.4E+38 3.4E+38 /end CHARACTERISTIC
/begin CHARACTERISTIC P_LCS_ESSOverrideValue1 "" VALUE 0x0 /* @MemoryAddress@P_LCS_ESSOverrideValue1@ */ Scalar_FLOAT32_IEEE 0 PubIfControlLATC_MDL_CM_single -3.4E+38 3.4E+38 /end CHARACTERISTIC
/begin CHARACTERISTIC P_LCS_ESSOverrideValue2 "" VALUE 0x0 /* @MemoryAddress@P_LCS_ESSOverrideValue2@ */ Scalar_FLOAT32_IEEE 0 PubIfControlLATC_MDL_CM_single -3.4E+38 3.4E+38 /end CHARACTERISTIC
/begin CHARACTERISTIC P_LCS_ESS_NotActiveFlgDelayTime "" VALUE 0x0 /* @MemoryAddress@P_LCS_ESS_NotActiveFlgDelayTime@ */ Scalar_FLOAT32_IEEE 0 PubIfControlLATC_MDL_CM_single -3.4E+38 3.4E+38 /end CHARACTERISTIC
/begin CHARACTERISTIC P_LCS_ESS_NotActiveFlgDelayTimeSW "" VALUE 0x0 /* @MemoryAddress@P_LCS_ESS_NotActiveFlgDelayTimeSW@ */ Scalar_FLOAT32_IEEE 0 PubIfControlLATC_MDL_CM_single -3.4E+38 3.4E+38 /end CHARACTERISTIC
/begin CHARACTERISTIC P_LCS_ESS_SteerAngleFilterTime "" VALUE 0x0 /* @MemoryAddress@P_LCS_ESS_SteerAngleFilterTime@ */ Scalar_FLOAT32_IEEE 0 PubIfControlLATC_MDL_CM_single -3.4E+38 3.4E+38 /end CHARACTERISTIC
/begin CHARACTERISTIC P_LCS_ESS_TarAngleFilterTime "" VALUE 0x0 /* @MemoryAddress@P_LCS_ESS_TarAngleFilterTime@ */ Scalar_FLOAT32_IEEE 0 PubIfControlLATC_MDL_CM_single -3.4E+38 3.4E+38 /end CHARACTERISTIC
/begin CHARACTERISTIC P_LCS_IN_Offset_Test_Value "" VALUE 0x0 /* @MemoryAddress@P_LCS_IN_Offset_Test_Value@ */ Scalar_FLOAT32_IEEE 0 PubIfControlLATC_MDL_CM_single -3.4E+38 3.4E+38 /end CHARACTERISTIC
/begin CHARACTERISTIC P_LCS_LATC_CurOffsetA2FliterT_s "" VALUE 0x0 /* @MemoryAddress@P_LCS_LATC_CurOffsetA2FliterT_s@ */ Scalar_FLOAT32_IEEE 0 PubIfControlLATC_MDL_CM_single -3.4E+38 3.4E+38 /end CHARACTERISTIC
/begin CHARACTERISTIC P_LCS_LATC_CurOffsetVehicleSpdLimitValue_degs "" VALUE 0x0 /* @MemoryAddress@P_LCS_LATC_CurOffsetVehicleSpdLimitValue_degs@ */ Scalar_FLOAT32_IEEE 0 PubIfControlLATC_MDL_CM_single -3.4E+38 3.4E+38 /end CHARACTERISTIC
/begin CHARACTERISTIC P_LCS_LATC_MPCDeltaT_s "" VALUE 0x0 /* @MemoryAddress@P_LCS_LATC_MPCDeltaT_s@ */ Scalar_FLOAT32_IEEE 0 PubIfControlLATC_MDL_CM_single -3.4E+38 3.4E+38 /end CHARACTERISTIC
/begin CHARACTERISTIC P_LCS_LATC_MPCMaxSterAngleSpd_degs "" VALUE 0x0 /* @MemoryAddress@P_LCS_LATC_MPCMaxSterAngleSpd_degs@ */ Scalar_FLOAT32_IEEE 0 PubIfControlLATC_MDL_CM_single -3.4E+38 3.4E+38 /end CHARACTERISTIC
/begin CHARACTERISTIC P_LCS_LATC_MPCMaxSterAngle_deg "" VALUE 0x0 /* @MemoryAddress@P_LCS_LATC_MPCMaxSterAngle_deg@ */ Scalar_FLOAT32_IEEE 0 PubIfControlLATC_MDL_CM_single -3.4E+38 3.4E+38 /end CHARACTERISTIC
/begin CHARACTERISTIC P_LCS_LCC_HeadingErRrateTime_s "" VALUE 0x0 /* @MemoryAddress@P_LCS_LCC_HeadingErRrateTime_s@ */ Scalar_FLOAT32_IEEE 0 PubIfControlLATC_MDL_CM_single -3.4E+38 3.4E+38 /end CHARACTERISTIC
/begin CHARACTERISTIC P_LCS_LCC_HeadingErrTime_s "" VALUE 0x0 /* @MemoryAddress@P_LCS_LCC_HeadingErrTime_s@ */ Scalar_FLOAT32_IEEE 0 PubIfControlLATC_MDL_CM_single -3.4E+38 3.4E+38 /end CHARACTERISTIC
/begin CHARACTERISTIC P_LCS_LCC_LaterErrRateTime_s "" VALUE 0x0 /* @MemoryAddress@P_LCS_LCC_LaterErrRateTime_s@ */ Scalar_FLOAT32_IEEE 0 PubIfControlLATC_MDL_CM_single -3.4E+38 3.4E+38 /end CHARACTERISTIC
/begin CHARACTERISTIC P_LCS_LCC_LaterErrTime_s "" VALUE 0x0 /* @MemoryAddress@P_LCS_LCC_LaterErrTime_s@ */ Scalar_FLOAT32_IEEE 0 PubIfControlLATC_MDL_CM_single -3.4E+38 3.4E+38 /end CHARACTERISTIC
/begin CHARACTERISTIC P_LCS_LCC_RefThetaTime_s "" VALUE 0x0 /* @MemoryAddress@P_LCS_LCC_RefThetaTime_s@ */ Scalar_FLOAT32_IEEE 0 PubIfControlLATC_MDL_CM_single -3.4E+38 3.4E+38 /end CHARACTERISTIC
/begin CHARACTERISTIC P_LCS_LCC_RefcurveTime_s "" VALUE 0x0 /* @MemoryAddress@P_LCS_LCC_RefcurveTime_s@ */ Scalar_FLOAT32_IEEE 0 PubIfControlLATC_MDL_CM_single -3.4E+38 3.4E+38 /end CHARACTERISTIC
/begin CHARACTERISTIC P_LCS_PLAN_A2FliterTime_s "" VALUE 0x0 /* @MemoryAddress@P_LCS_PLAN_A2FliterTime_s@ */ Scalar_FLOAT32_IEEE 0 PubIfControlLATC_MDL_CM_single -3.4E+38 3.4E+38 /end CHARACTERISTIC
/begin CHARACTERISTIC P_LCS_PLAN_DisFac_Tab_ratio "" VALUE 0x0 /* @MemoryAddress@P_LCS_PLAN_DisFac_Tab_ratio@ */ Scalar_FLOAT32_IEEE 0 PubIfControlLATC_MDL_CM_single -3.4E+38 3.4E+38 /end CHARACTERISTIC
/begin CHARACTERISTIC P_LCS_PLAN_MinDis_m "" VALUE 0x0 /* @MemoryAddress@P_LCS_PLAN_MinDis_m@ */ Scalar_FLOAT32_IEEE 0 PubIfControlLATC_MDL_CM_single -3.4E+38 3.4E+38 /end CHARACTERISTIC
/begin CHARACTERISTIC P_LCS_PLAN_PreDis_Tab_m "" VAL_BLK 0x0 /* @MemoryAddress@P_LCS_PLAN_PreDis_Tab_m@ */ Scalar_FLOAT32_IEEE 0 PubIfControlLATC_MDL_CM_single -3.4E+38 3.4E+38 MATRIX_DIM 1 16 1 /end CHARACTERISTIC
/begin CHARACTERISTIC P_LCS_PlLAN_PreDisFac_Tab_ratio "" VAL_BLK 0x0 /* @MemoryAddress@P_LCS_PlLAN_PreDisFac_Tab_ratio@ */ Scalar_FLOAT32_IEEE 0 PubIfControlLATC_MDL_CM_single -3.4E+38 3.4E+38 MATRIX_DIM 7 13 1 /end CHARACTERISTIC
/begin CHARACTERISTIC P_LCS_Plan_A2Pretime_s "" VALUE 0x0 /* @MemoryAddress@P_LCS_Plan_A2Pretime_s@ */ Scalar_FLOAT32_IEEE 0 PubIfControlLATC_MDL_CM_single -3.4E+38 3.4E+38 /end CHARACTERISTIC
/begin CHARACTERISTIC P_LCS_LATC_StateHoldTime_st "" VALUE 0x0 /* @MemoryAddress@P_LCS_LATC_StateHoldTime_st@ */ Scalar_UWORD 0 PubIfControlLATC_MDL_CM_uint16 0 65535 /end CHARACTERISTIC
/begin CHARACTERISTIC P_LCS_PLAN_StateHoldTime_st "" VALUE 0x0 /* @MemoryAddress@P_LCS_PLAN_StateHoldTime_st@ */ Scalar_UWORD 0 PubIfControlLATC_MDL_CM_uint16 0 65535 /end CHARACTERISTIC
/begin CHARACTERISTIC P_LCS_ESS_LogicTest_Enable "" VALUE 0x0 /* @MemoryAddress@P_LCS_ESS_LogicTest_Enable@ */ Scalar_BOOLEAN 0 PubIfControlLATC_MDL_CM_boolean 0 1 BIT_MASK 0x01 /end CHARACTERISTIC
/begin CHARACTERISTIC P_LCS_IN_Offset_Test_SW "" VALUE 0x0 /* @MemoryAddress@P_LCS_IN_Offset_Test_SW@ */ Scalar_UBYTE 0 PubIfControlLATC_MDL_CM_uint8 0 255 /end CHARACTERISTIC
/begin CHARACTERISTIC P_LCS_Trq_Switch "" VALUE 0x0 /* @MemoryAddress@P_LCS_Trq_Switch@ */ Scalar_UBYTE 0 PubIfControlLATC_MDL_CM_uint8 0 255 /end CHARACTERISTIC
/begin AXIS_PTS P_LCS_LATC_VehicleSpd_TabX_Kph "" 0x0 /* @MemoryAddress@P_LCS_LATC_VehicleSpd_TabX_Kph@ */ NO_INPUT_QUANTITY Lookup1D_X_FLOAT32_IEEE 0 PubIfControlLATC_MDL_CM_single 12 -3.4E+38 3.4E+38 /end AXIS_PTS
/begin AXIS_PTS P_LCS_VehicleSpd_TabX_Kph "" 0x0 /* @MemoryAddress@P_LCS_VehicleSpd_TabX_Kph@ */ LCS_IN_Spd_Kph Lookup1D_X_FLOAT32_IEEE 0 PubIfControlLATC_MDL_CM_single 16 -3.4E+38 3.4E+38 /end AXIS_PTS
/begin AXIS_PTS P_LCS_PLAN_TarDangerlLevel_Tabx_st "" 0x0 /* @MemoryAddress@P_LCS_PLAN_TarDangerlLevel_Tabx_st@ */ NO_INPUT_QUANTITY Lookup2D_X_FLOAT32_IEEE 0 PubIfControlLATC_MDL_CM_single 3 -3.4E+38 3.4E+38 /end AXIS_PTS
/begin AXIS_PTS P_LCS_PLAN_DesLineA0_TabY_m "" 0x0 /* @MemoryAddress@P_LCS_PLAN_DesLineA0_TabY_m@ */ NO_INPUT_QUANTITY Lookup2D_X_FLOAT32_IEEE 0 PubIfControlLATC_MDL_CM_single 7 -3.4E+38 3.4E+38 /end AXIS_PTS
/begin AXIS_PTS P_LCS_PLAN_PreDisCurve_TabX_m "" 0x0 /* @MemoryAddress@P_LCS_PLAN_PreDisCurve_TabX_m@ */ LCS_PreDisCurve_m Lookup2D_X_FLOAT32_IEEE 0 PubIfControlLATC_MDL_CM_single 13 -3.4E+38 3.4E+38 /end AXIS_PTS
/begin AXIS_PTS P_LCS_PLAN_VehicleSpd_TabY_Kph "" 0x0 /* @MemoryAddress@P_LCS_PLAN_VehicleSpd_TabY_Kph@ */ LCS_IN_Spd_Kph Lookup2D_X_FLOAT32_IEEE 0 PubIfControlLATC_MDL_CM_single 16 -3.4E+38 3.4E+38 /end AXIS_PTS
/begin AXIS_PTS P_LCS_LATC_StateActiveFlg_TabX_st "" 0x0 /* @MemoryAddress@P_LCS_LATC_StateActiveFlg_TabX_st@ */ LCS_LATC_AngleSlopeFlg_st Lookup2D_X_UBYTE 0 PubIfControlLATC_MDL_CM_uint8 5 0 255 /end AXIS_PTS
/begin AXIS_PTS P_LCS_LATC_StateActiveHoldTime_TabY_st "" 0x0 /* @MemoryAddress@P_LCS_LATC_StateActiveHoldTime_TabY_st@ */ LCS_LATC_HoldTime_s Lookup2D_X_FLOAT64_IEEE 0 PubIfControlLATC_MDL_CM_double 15 -1.7E+308 1.7E+308 /end AXIS_PTS
/begin AXIS_PTS P_LCS_LATC_CurOffsetCurve_TabX_m "" 0x0 /* @MemoryAddress@P_LCS_LATC_CurOffsetCurve_TabX_m@ */ NO_INPUT_QUANTITY Lookup1D_X_FLOAT32_IEEE 0 PubIfControlLATC_MDL_CM_single 10 -3.4E+38 3.4E+38 /end AXIS_PTS
/begin AXIS_PTS P_LCS_PLAN_StateActiveFlg_TabX_st "" 0x0 /* @MemoryAddress@P_LCS_PLAN_StateActiveFlg_TabX_st@ */ NO_INPUT_QUANTITY Lookup2D_X_UBYTE 0 PubIfControlLATC_MDL_CM_uint8 5 0 255 /end AXIS_PTS
/begin AXIS_PTS P_LCS_PLAN_StateActiveHoldTime_TabY_s "" 0x0 /* @MemoryAddress@P_LCS_PLAN_StateActiveHoldTime_TabY_s@ */ NO_INPUT_QUANTITY Lookup2D_X_FLOAT64_IEEE 0 PubIfControlLATC_MDL_CM_double 15 -1.7E+308 1.7E+308 /end AXIS_PTS
/begin AXIS_PTS P_LCS_PLAN_StateCompleteFlg_TabX_st "" 0x0 /* @MemoryAddress@P_LCS_PLAN_StateCompleteFlg_TabX_st@ */ NO_INPUT_QUANTITY Lookup2D_X_UBYTE 0 PubIfControlLATC_MDL_CM_uint8 3 0 255 /end AXIS_PTS
/begin CHARACTERISTIC P_LSM_DOP_PreDis_Y "" CURVE 0x0 /* @MemoryAddress@P_LSM_DOP_PreDis_Y@ */ Lookup1D_FLOAT32_IEEE 0 PubIfDecisionLSM_MDL_CM_single -3.4E+38 3.4E+38
 /begin AXIS_DESCR COM_AXIS NO_INPUT_QUANTITY PubIfDecisionLSM_MDL_CM_single 16 -3.4E+38 3.4E+38 AXIS_PTS_REF P_LSM_DOP_PreDis_X /end AXIS_DESCR
/end CHARACTERISTIC
/begin CHARACTERISTIC P_LSM_DOP_C1_EN_Limit "" CURVE 0x0 /* @MemoryAddress@P_LSM_DOP_C1_EN_Limit@ */ Lookup1D_FLOAT32_IEEE 0 PubIfDecisionLSM_MDL_CM_single -3.4E+38 3.4E+38
 /begin AXIS_DESCR COM_AXIS NO_INPUT_QUANTITY PubIfDecisionLSM_MDL_CM_single 7 -3.4E+38 3.4E+38 AXIS_PTS_REF P_LSM_DOP_C1AndC2_Lim_X /end AXIS_DESCR
/end CHARACTERISTIC
/begin CHARACTERISTIC P_LSM_DOP_C2_EN_Limit "" CURVE 0x0 /* @MemoryAddress@P_LSM_DOP_C2_EN_Limit@ */ Lookup1D_FLOAT32_IEEE 0 PubIfDecisionLSM_MDL_CM_single -3.4E+38 3.4E+38
 /begin AXIS_DESCR COM_AXIS NO_INPUT_QUANTITY PubIfDecisionLSM_MDL_CM_single 7 -3.4E+38 3.4E+38 AXIS_PTS_REF P_LSM_DOP_C1AndC2_Lim_X /end AXIS_DESCR
/end CHARACTERISTIC
/begin CHARACTERISTIC P_LSM_DOP_C1_out_Limit "" CURVE 0x0 /* @MemoryAddress@P_LSM_DOP_C1_out_Limit@ */ Lookup1D_FLOAT32_IEEE 0 PubIfDecisionLSM_MDL_CM_single -3.4E+38 3.4E+38
 /begin AXIS_DESCR COM_AXIS NO_INPUT_QUANTITY PubIfDecisionLSM_MDL_CM_single 7 -3.4E+38 3.4E+38 AXIS_PTS_REF P_LSM_DOP_C1AndC2_Lim_X /end AXIS_DESCR
/end CHARACTERISTIC
/begin CHARACTERISTIC P_LSM_DOP_C2_out_Limit "" CURVE 0x0 /* @MemoryAddress@P_LSM_DOP_C2_out_Limit@ */ Lookup1D_FLOAT32_IEEE 0 PubIfDecisionLSM_MDL_CM_single -3.4E+38 3.4E+38
 /begin AXIS_DESCR COM_AXIS NO_INPUT_QUANTITY PubIfDecisionLSM_MDL_CM_single 7 -3.4E+38 3.4E+38 AXIS_PTS_REF P_LSM_DOP_C1AndC2_Lim_X /end AXIS_DESCR
/end CHARACTERISTIC
/begin CHARACTERISTIC P_LSM_DoubleLine_DOPOut_C1 "" CURVE 0x0 /* @MemoryAddress@P_LSM_DoubleLine_DOPOut_C1@ */ Lookup1D_FLOAT32_IEEE 0 PubIfDecisionLSM_MDL_CM_single -3.4E+38 3.4E+38
 /begin AXIS_DESCR COM_AXIS NO_INPUT_QUANTITY PubIfDecisionLSM_MDL_CM_single 7 -3.4E+38 3.4E+38 AXIS_PTS_REF P_LSM_DOP_C1AndC2_Lim_X /end AXIS_DESCR
/end CHARACTERISTIC
/begin CHARACTERISTIC P_LSM_SingleLine_DOPOut_C1 "" CURVE 0x0 /* @MemoryAddress@P_LSM_SingleLine_DOPOut_C1@ */ Lookup1D_FLOAT32_IEEE 0 PubIfDecisionLSM_MDL_CM_single -3.4E+38 3.4E+38
 /begin AXIS_DESCR COM_AXIS NO_INPUT_QUANTITY PubIfDecisionLSM_MDL_CM_single 7 -3.4E+38 3.4E+38 AXIS_PTS_REF P_LSM_DOP_C1AndC2_Lim_X /end AXIS_DESCR
/end CHARACTERISTIC
/begin CHARACTERISTIC P_LSM_DOP_C0_EN_Limit "" VALUE 0x0 /* @MemoryAddress@P_LSM_DOP_C0_EN_Limit@ */ Scalar_FLOAT64_IEEE 0 PubIfDecisionLSM_MDL_CM_double -1.7E+308 1.7E+308 /end CHARACTERISTIC
/begin CHARACTERISTIC P_LSM_DOP_C0_out_Limit "" VALUE 0x0 /* @MemoryAddress@P_LSM_DOP_C0_out_Limit@ */ Scalar_FLOAT64_IEEE 0 PubIfDecisionLSM_MDL_CM_double -1.7E+308 1.7E+308 /end CHARACTERISTIC
/begin CHARACTERISTIC P_LSM_NOH_Switch "" VALUE 0x0 /* @MemoryAddress@P_LSM_NOH_Switch@ */ Scalar_FLOAT64_IEEE 0 PubIfDecisionLSM_MDL_CM_double -1.7E+308 1.7E+308 /end CHARACTERISTIC
/begin CHARACTERISTIC P_LSM_DOPValid_CheckTime "" VALUE 0x0 /* @MemoryAddress@P_LSM_DOPValid_CheckTime@ */ Scalar_FLOAT32_IEEE 0 PubIfDecisionLSM_MDL_CM_single -3.4E+38 3.4E+38 /end CHARACTERISTIC
/begin CHARACTERISTIC P_LSM_DOP_In_Pre2Dop_Dis "" VALUE 0x0 /* @MemoryAddress@P_LSM_DOP_In_Pre2Dop_Dis@ */ Scalar_FLOAT32_IEEE 0 PubIfDecisionLSM_MDL_CM_single -3.4E+38 3.4E+38 /end CHARACTERISTIC
/begin CHARACTERISTIC P_LSM_DOP_Out_Pre2Dop_Dis "" VALUE 0x0 /* @MemoryAddress@P_LSM_DOP_Out_Pre2Dop_Dis@ */ Scalar_FLOAT32_IEEE 0 PubIfDecisionLSM_MDL_CM_single -3.4E+38 3.4E+38 /end CHARACTERISTIC
/begin CHARACTERISTIC P_LSM_DoubleLine_Curr2Cent_Dislimit "" VALUE 0x0 /* @MemoryAddress@P_LSM_DoubleLine_Curr2Cent_Dislimit@ */ Scalar_FLOAT32_IEEE 0 PubIfDecisionLSM_MDL_CM_single -3.4E+38 3.4E+38 /end CHARACTERISTIC
/begin CHARACTERISTIC P_LSM_DoubleLine_Dop2Cent_Dislimit "" VALUE 0x0 /* @MemoryAddress@P_LSM_DoubleLine_Dop2Cent_Dislimit@ */ Scalar_FLOAT32_IEEE 0 PubIfDecisionLSM_MDL_CM_single -3.4E+38 3.4E+38 /end CHARACTERISTIC
/begin CHARACTERISTIC P_LSM_DoubleLine_Pre2Cent_Dislimit "" VALUE 0x0 /* @MemoryAddress@P_LSM_DoubleLine_Pre2Cent_Dislimit@ */ Scalar_FLOAT32_IEEE 0 PubIfDecisionLSM_MDL_CM_single -3.4E+38 3.4E+38 /end CHARACTERISTIC
/begin CHARACTERISTIC P_LSM_IFV2CenterAxis "" VALUE 0x0 /* @MemoryAddress@P_LSM_IFV2CenterAxis@ */ Scalar_FLOAT32_IEEE 0 PubIfDecisionLSM_MDL_CM_single -3.4E+38 3.4E+38 /end CHARACTERISTIC
/begin CHARACTERISTIC P_LSM_IFV2RearAxis "" VALUE 0x0 /* @MemoryAddress@P_LSM_IFV2RearAxis@ */ Scalar_FLOAT32_IEEE 0 PubIfDecisionLSM_MDL_CM_single -3.4E+38 3.4E+38 /end CHARACTERISTIC
/begin CHARACTERISTIC P_LSM_LineSTD_Limit "" VALUE 0x0 /* @MemoryAddress@P_LSM_LineSTD_Limit@ */ Scalar_FLOAT32_IEEE 0 PubIfDecisionLSM_MDL_CM_single -3.4E+38 3.4E+38 /end CHARACTERISTIC
/begin CHARACTERISTIC P_LSM_LineWijCal_C12 "" VALUE 0x0 /* @MemoryAddress@P_LSM_LineWijCal_C12@ */ Scalar_FLOAT32_IEEE 0 PubIfDecisionLSM_MDL_CM_single -3.4E+38 3.4E+38 /end CHARACTERISTIC
/begin CHARACTERISTIC P_LSM_LineWijCal_C13 "" VALUE 0x0 /* @MemoryAddress@P_LSM_LineWijCal_C13@ */ Scalar_FLOAT32_IEEE 0 PubIfDecisionLSM_MDL_CM_single -3.4E+38 3.4E+38 /end CHARACTERISTIC
/begin CHARACTERISTIC P_LSM_PosLineLcFac "" VALUE 0x0 /* @MemoryAddress@P_LSM_PosLineLcFac@ */ Scalar_FLOAT32_IEEE 0 PubIfDecisionLSM_MDL_CM_single -3.4E+38 3.4E+38 /end CHARACTERISTIC
/begin CHARACTERISTIC P_LSM_Pre_t "" VALUE 0x0 /* @MemoryAddress@P_LSM_Pre_t@ */ Scalar_FLOAT32_IEEE 0 PubIfDecisionLSM_MDL_CM_single -3.4E+38 3.4E+38 /end CHARACTERISTIC
/begin CHARACTERISTIC P_LSM_SingleLine_Cent2Edge_Dislimit "" VALUE 0x0 /* @MemoryAddress@P_LSM_SingleLine_Cent2Edge_Dislimit@ */ Scalar_FLOAT32_IEEE 0 PubIfDecisionLSM_MDL_CM_single -3.4E+38 3.4E+38 /end CHARACTERISTIC
/begin CHARACTERISTIC P_LSM_SingleLine_Curr2Cent_Dislimit "" VALUE 0x0 /* @MemoryAddress@P_LSM_SingleLine_Curr2Cent_Dislimit@ */ Scalar_FLOAT32_IEEE 0 PubIfDecisionLSM_MDL_CM_single -3.4E+38 3.4E+38 /end CHARACTERISTIC
/begin CHARACTERISTIC P_LSM_SingleLine_Dop2Cent_Dislimit "" VALUE 0x0 /* @MemoryAddress@P_LSM_SingleLine_Dop2Cent_Dislimit@ */ Scalar_FLOAT32_IEEE 0 PubIfDecisionLSM_MDL_CM_single -3.4E+38 3.4E+38 /end CHARACTERISTIC
/begin CHARACTERISTIC P_LSM_SingleLine_Pre2Cent_Dislimit "" VALUE 0x0 /* @MemoryAddress@P_LSM_SingleLine_Pre2Cent_Dislimit@ */ Scalar_FLOAT32_IEEE 0 PubIfDecisionLSM_MDL_CM_single -3.4E+38 3.4E+38 /end CHARACTERISTIC
/begin CHARACTERISTIC P_LSM_ALC_Enable "" VALUE 0x0 /* @MemoryAddress@P_LSM_ALC_Enable@ */ Scalar_UBYTE 0 PubIfDecisionLSM_MDL_CM_uint8 0 255 /end CHARACTERISTIC
/begin AXIS_PTS P_LSM_DOP_PreDis_X "" 0x0 /* @MemoryAddress@P_LSM_DOP_PreDis_X@ */ NO_INPUT_QUANTITY Lookup1D_X_FLOAT32_IEEE 0 PubIfDecisionLSM_MDL_CM_single 16 -3.4E+38 3.4E+38 /end AXIS_PTS
/begin AXIS_PTS P_LSM_DOP_C1AndC2_Lim_X "" 0x0 /* @MemoryAddress@P_LSM_DOP_C1AndC2_Lim_X@ */ NO_INPUT_QUANTITY Lookup1D_X_FLOAT32_IEEE 0 PubIfDecisionLSM_MDL_CM_single 7 -3.4E+38 3.4E+38 /end AXIS_PTS
/begin CHARACTERISTIC P_LongCtrl_VLCMaRatioCharMaYAxis "" CURVE 0x0 /* @MemoryAddress@P_LongCtrl_VLCMaRatioCharMaYAxis@ */ Lookup1D_FLOAT32_IEEE 0 PubIfControlLONC_MDL_CM_single 0.0 3.0
 /begin AXIS_DESCR COM_AXIS LongCtrl_Tr_Ratio PubIfControlLONC_MDL_CM_single 18 1.0 30.0 AXIS_PTS_REF P_LongCtrl_VLCTrRatioCharMaXAxis /end AXIS_DESCR
/end CHARACTERISTIC
/begin CHARACTERISTIC P_Global_TireRadius_m "轮胎半径" VALUE 0x0 /* @MemoryAddress@P_Global_TireRadius_m@ */ Scalar_FLOAT32_IEEE 0 PubIfControlLONC_MDL_CM_single_m -3.4E+38 3.4E+38 /end CHARACTERISTIC
/begin CHARACTERISTIC P_LongCtrl_VLCTrTatioMax "" VALUE 0x0 /* @MemoryAddress@P_LongCtrl_VLCTrTatioMax@ */ Scalar_FLOAT32_IEEE 0 PubIfControlLONC_MDL_CM_single 10.0 30.0 /end CHARACTERISTIC
/begin CHARACTERISTIC P_LongCtrl_VLCTrTatioMin "" VALUE 0x0 /* @MemoryAddress@P_LongCtrl_VLCTrTatioMin@ */ Scalar_FLOAT32_IEEE 0 PubIfControlLONC_MDL_CM_single 0.1 1.0 /end CHARACTERISTIC
/begin CHARACTERISTIC P_LongCtrl_VLCaXCDeadZoneProp_Y "" VAL_BLK 0x0 /* @MemoryAddress@P_LongCtrl_VLCaXCDeadZoneProp_Y@ */ Scalar_FLOAT32_IEEE 0 PubIfControlLONC_MDL_CM_single -3.4E+38 3.4E+38 MATRIX_DIM 1 7 1 /end CHARACTERISTIC
/begin CHARACTERISTIC P_LongCtrl_VLCaxCtrlDevDeadZoneChar_Y "" VAL_BLK 0x0 /* @MemoryAddress@P_LongCtrl_VLCaxCtrlDevDeadZoneChar_Y@ */ Scalar_FLOAT32_IEEE 0 PubIfControlLONC_MDL_CM_single -3.4E+38 3.4E+38 MATRIX_DIM 1 5 1 /end CHARACTERISTIC
/begin CHARACTERISTIC P_LongCtrl_VLCaxCtrlDevEC2DCMax "" VALUE 0x0 /* @MemoryAddress@P_LongCtrl_VLCaxCtrlDevEC2DCMax@ */ Scalar_FLOAT32_IEEE 0 PubIfControlLONC_MDL_CM_single -3.4E+38 3.4E+38 /end CHARACTERISTIC
/begin CHARACTERISTIC P_LongCtrl_VLCaxCtrlDevFastQuitDCMode "" VALUE 0x0 /* @MemoryAddress@P_LongCtrl_VLCaxCtrlDevFastQuitDCMode@ */ Scalar_FLOAT32_IEEE 0 PubIfControlLONC_MDL_CM_single -3.4E+38 3.4E+38 /end CHARACTERISTIC
/begin CHARACTERISTIC P_LongCtrl_VLCaxCtrlDevThresAddEC2DCCharYAxis "" VAL_BLK 0x0 /* @MemoryAddress@P_LongCtrl_VLCaxCtrlDevThresAddEC2DCCharYAxis@ */ Scalar_FLOAT32_IEEE 0 PubIfControlLONC_MDL_CM_single -3.4E+38 3.4E+38 MATRIX_DIM 1 5 1 /end CHARACTERISTIC
/begin CHARACTERISTIC P_LongCtrl_VLCaxCtrlDevTresAddDC2ECYAxis "" VAL_BLK 0x0 /* @MemoryAddress@P_LongCtrl_VLCaxCtrlDevTresAddDC2ECYAxis@ */ Scalar_FLOAT32_IEEE 0 PubIfControlLONC_MDL_CM_single -3.4E+38 3.4E+38 MATRIX_DIM 1 5 1 /end CHARACTERISTIC
/begin CHARACTERISTIC P_LongCtrl_VLCcoefKiEnlargeADiffYAxis "" VAL_BLK 0x0 /* @MemoryAddress@P_LongCtrl_VLCcoefKiEnlargeADiffYAxis@ */ Scalar_FLOAT32_IEEE 0 PubIfControlLONC_MDL_CM_single -3.4E+38 3.4E+38 MATRIX_DIM 1 11 1 /end CHARACTERISTIC
/begin CHARACTERISTIC P_LongCtrl_VLCdaxTarEC2DCMax "" VALUE 0x0 /* @MemoryAddress@P_LongCtrl_VLCdaxTarEC2DCMax@ */ Scalar_FLOAT32_IEEE 0 PubIfControlLONC_MDL_CM_single -3.4E+38 3.4E+38 /end CHARACTERISTIC
/begin CHARACTERISTIC P_LongCtrl_VLCdriveOffAxUpLimXAxix "" VAL_BLK 0x0 /* @MemoryAddress@P_LongCtrl_VLCdriveOffAxUpLimXAxix@ */ Scalar_FLOAT32_IEEE 0 PubIfControlLONC_MDL_CM_single -3.4E+38 3.4E+38 MATRIX_DIM 1 5 1 /end CHARACTERISTIC
/begin CHARACTERISTIC P_LongCtrl_VLCdriveOffAxUpLimYAxix "" VAL_BLK 0x0 /* @MemoryAddress@P_LongCtrl_VLCdriveOffAxUpLimYAxix@ */ Scalar_FLOAT32_IEEE 0 PubIfControlLONC_MDL_CM_single -3.4E+38 3.4E+38 MATRIX_DIM 1 5 1 /end CHARACTERISTIC
/begin CHARACTERISTIC P_LongCtrl_VLCki "" VALUE 0x0 /* @MemoryAddress@P_LongCtrl_VLCki@ */ Scalar_FLOAT32_IEEE 0 PubIfControlLONC_MDL_CM_single -3.4E+38 3.4E+38 /end CHARACTERISTIC
/begin CHARACTERISTIC P_LongCtrl_VLCkp "" VALUE 0x0 /* @MemoryAddress@P_LongCtrl_VLCkp@ */ Scalar_FLOAT32_IEEE 0 PubIfControlLONC_MDL_CM_single -3.4E+38 3.4E+38 /end CHARACTERISTIC
/begin CHARACTERISTIC P_LongCtrl_VLCks "" VALUE 0x0 /* @MemoryAddress@P_LongCtrl_VLCks@ */ Scalar_FLOAT32_IEEE 0 PubIfControlLONC_MDL_CM_single -3.4E+38 3.4E+38 /end CHARACTERISTIC
/begin AXIS_PTS P_LongCtrl_VLCTrRatioCharMaXAxis "" 0x0 /* @MemoryAddress@P_LongCtrl_VLCTrRatioCharMaXAxis@ */ LongCtrl_Tr_Ratio Lookup1D_X_FLOAT32_IEEE 0 PubIfControlLONC_MDL_CM_single 18 1.0 30.0 /end AXIS_PTS
/begin MEASUREMENT RFM_R1_dDisFront "" FLOAT32_IEEE Noa_Nofusion_CM_single 0 0 0.0 200.0 ECU_ADDRESS 0x0 /* @MemoryAddress@RFM_R1_dDisFront@ */ /end MEASUREMENT
/begin MEASUREMENT RFM_R1_dDisStart "" FLOAT32_IEEE Noa_Nofusion_CM_single 0 0 0.0 200.0 ECU_ADDRESS 0x0 /* @MemoryAddress@RFM_R1_dDisStart@ */ /end MEASUREMENT
/begin MEASUREMENT RFM_R1_dC3V "" FLOAT32_IEEE Noa_Nofusion_CM_single 0 0 -0.004 0.004 ECU_ADDRESS 0x0 /* @MemoryAddress@RFM_R1_dC3V@ */ /end MEASUREMENT
/begin MEASUREMENT RFM_R1_dC2V "" FLOAT32_IEEE Noa_Nofusion_CM_single 0 0 -0.125 0.125 ECU_ADDRESS 0x0 /* @MemoryAddress@RFM_R1_dC2V@ */ /end MEASUREMENT
/begin MEASUREMENT RFM_R1_dC1V "" FLOAT32_IEEE Noa_Nofusion_CM_single 0 0 -2.0 2.0 ECU_ADDRESS 0x0 /* @MemoryAddress@RFM_R1_dC1V@ */ /end MEASUREMENT
/begin MEASUREMENT RFM_R1_dC0V "" FLOAT32_IEEE Noa_Nofusion_CM_single 0 0 -30.0 30.0 ECU_ADDRESS 0x0 /* @MemoryAddress@RFM_R1_dC0V@ */ /end MEASUREMENT
/begin MEASUREMENT RFM_L1_dDisFront "" FLOAT32_IEEE Noa_Nofusion_CM_single 0 0 0.0 200.0 ECU_ADDRESS 0x0 /* @MemoryAddress@RFM_L1_dDisFront@ */ /end MEASUREMENT
/begin MEASUREMENT RFM_L1_dDisStart "" FLOAT32_IEEE Noa_Nofusion_CM_single 0 0 0.0 200.0 ECU_ADDRESS 0x0 /* @MemoryAddress@RFM_L1_dDisStart@ */ /end MEASUREMENT
/begin MEASUREMENT RFM_L1_dC3V "" FLOAT32_IEEE Noa_Nofusion_CM_single 0 0 -0.004 0.004 ECU_ADDRESS 0x0 /* @MemoryAddress@RFM_L1_dC3V@ */ /end MEASUREMENT
/begin MEASUREMENT RFM_L1_dC1V "" FLOAT32_IEEE Noa_Nofusion_CM_single 0 0 -2.0 2.0 ECU_ADDRESS 0x0 /* @MemoryAddress@RFM_L1_dC1V@ */ /end MEASUREMENT
/begin MEASUREMENT RFM_L1_dC0V "" FLOAT32_IEEE Noa_Nofusion_CM_single 0 0 -30.0 30.0 ECU_ADDRESS 0x0 /* @MemoryAddress@RFM_L1_dC0V@ */ /end MEASUREMENT
/begin MEASUREMENT EQ4_DX "" FLOAT32_IEEE Noa_Nofusion_CM_single 0 0 -3.4E+38 3.4E+38 LAYOUT ROW_DIR MATRIX_DIM 20 1 1 ECU_ADDRESS 0x0 /* @MemoryAddress@EQ4_DX@ */ /end MEASUREMENT
/begin MEASUREMENT LCKIE_DX "" FLOAT32_IEEE Noa_Nofusion_CM_single 0 0 -3.4E+38 3.4E+38 LAYOUT ROW_DIR MATRIX_DIM 9 1 1 ECU_ADDRESS 0x0 /* @MemoryAddress@LCKIE_DX@ */ /end MEASUREMENT
/begin MEASUREMENT LCKIE_DY "" FLOAT32_IEEE Noa_Nofusion_CM_single 0 0 -3.4E+38 3.4E+38 LAYOUT ROW_DIR MATRIX_DIM 9 1 1 ECU_ADDRESS 0x0 /* @MemoryAddress@LCKIE_DY@ */ /end MEASUREMENT
/begin MEASUREMENT LCKIE_VX "" FLOAT32_IEEE Noa_Nofusion_CM_single 0 0 -3.4E+38 3.4E+38 LAYOUT ROW_DIR MATRIX_DIM 9 1 1 ECU_ADDRESS 0x0 /* @MemoryAddress@LCKIE_VX@ */ /end MEASUREMENT
/begin MEASUREMENT dxP0 "" FLOAT32_IEEE Noa_Nofusion_CM_single 0 0 -3.4E+38 3.4E+38 ECU_ADDRESS 0x0 /* @MemoryAddress@dxP0@ */ /end MEASUREMENT
/begin MEASUREMENT LongCtrl_VlcInternalAcc "" FLOAT32_IEEE Noa_Nofusion_CM_single 0 0 -3.4E+38 3.4E+38 ECU_ADDRESS 0x0 /* @MemoryAddress@LongCtrl_VlcInternalAcc@ */ /end MEASUREMENT
/begin MEASUREMENT LCKIE_ID "" UWORD Noa_Nofusion_CM_ufix16_En7 0 0 0 511.9921875 LAYOUT ROW_DIR MATRIX_DIM 9 1 1 ECU_ADDRESS 0x0 /* @MemoryAddress@LCKIE_ID@ */ /end MEASUREMENT
/begin MEASUREMENT RFM_R1_eLineType "" UBYTE Noa_Nofusion_CM_uint8 0 0 0 255 ECU_ADDRESS 0x0 /* @MemoryAddress@RFM_R1_eLineType@ */ /end MEASUREMENT
/begin MEASUREMENT RFM_R1_bIsLineExist "" UBYTE Noa_Nofusion_CM_uint8 0 0 0 255 ECU_ADDRESS 0x0 /* @MemoryAddress@RFM_R1_bIsLineExist@ */ /end MEASUREMENT
/begin MEASUREMENT RFM_L1_eLineType "" UBYTE Noa_Nofusion_CM_uint8 0 0 0 255 ECU_ADDRESS 0x0 /* @MemoryAddress@RFM_L1_eLineType@ */ /end MEASUREMENT
/begin MEASUREMENT RFM_L1_bIsLineExist "" UBYTE Noa_Nofusion_CM_uint8 0 0 0 255 ECU_ADDRESS 0x0 /* @MemoryAddress@RFM_L1_bIsLineExist@ */ /end MEASUREMENT
/begin MEASUREMENT EQ4_Type "" UBYTE Noa_Nofusion_CM_uint8 0 0 0 255 LAYOUT ROW_DIR MATRIX_DIM 20 1 1 ECU_ADDRESS 0x0 /* @MemoryAddress@EQ4_Type@ */ /end MEASUREMENT
/begin MEASUREMENT Object_Type "" UBYTE Noa_Nofusion_CM_uint8 0 0 0 255 LAYOUT ROW_DIR MATRIX_DIM 9 1 1 ECU_ADDRESS 0x0 /* @MemoryAddress@Object_Type@ */ /end MEASUREMENT
/begin MEASUREMENT LSM_Line_source "" UBYTE Noa_Nofusion_CM_uint8 0 0 0 255 ECU_ADDRESS 0x0 /* @MemoryAddress@LSM_Line_source@ */ /end MEASUREMENT
/begin MEASUREMENT HMI_Counter "" UBYTE PubIfChassisHMI_MDL_CM_uint8 0 0 0 255 ECU_ADDRESS 0x0 /* @MemoryAddress@HMI_Counter@ */ /end MEASUREMENT
/begin MEASUREMENT VIE_SW_VERSION "" ULONG PubIfCommonVIE_MDL_CM_uint32 0 0 0 4294967295 ECU_ADDRESS 0x0 /* @MemoryAddress@VIE_SW_VERSION@ */ /end MEASUREMENT
/begin MEASUREMENT VSM_SteerAngOffsetInit "" FLOAT32_IEEE PubIfCommonVIE_MDL_CM_single 0 0 -3.4E+38 3.4E+38 ECU_ADDRESS 0x0 /* @MemoryAddress@VSM_SteerAngOffsetInit@ */ /end MEASUREMENT
/begin MEASUREMENT VSM_SteerAngleOffset_deg "" FLOAT32_IEEE PubIfCommonVIE_MDL_CM_single 0 0 -3.4E+38 3.4E+38 ECU_ADDRESS 0x0 /* @MemoryAddress@VSM_SteerAngleOffset_deg@ */ /end MEASUREMENT
/begin MEASUREMENT LCS_LATC_HoldTime_s "" FLOAT64_IEEE PubIfControlLATC_MDL_CM_double 0 0 -1.7E+308 1.7E+308 ECU_ADDRESS 0x0 /* @MemoryAddress@LCS_LATC_HoldTime_s@ */ /end MEASUREMENT
/begin MEASUREMENT LCS_PLAN_Trajectory_NumTraj "" FLOAT64_IEEE PubIfControlLATC_MDL_CM_double 0 0 -1.7E+308 1.7E+308 ECU_ADDRESS 0x0 /* @MemoryAddress@LCS_PLAN_Trajectory_NumTraj@ */ /end MEASUREMENT
/begin MEASUREMENT LCS_SubModel_Number "" ULONG PubIfControlLATC_MDL_CM_uint32 0 0 0 4294967295 ECU_ADDRESS 0x0 /* @MemoryAddress@LCS_SubModel_Number@ */ /end MEASUREMENT
/begin MEASUREMENT LCS_SubModel_VERSION "" ULONG PubIfControlLATC_MDL_CM_uint32 0 0 0 4294967295 ECU_ADDRESS 0x0 /* @MemoryAddress@LCS_SubModel_VERSION@ */ /end MEASUREMENT
/begin MEASUREMENT LCS_IN_EPS_DrvInpTrqVal "" FLOAT32_IEEE PubIfControlLATC_MDL_CM_single 0 0 -3.4E+38 3.4E+38 ECU_ADDRESS 0x0 /* @MemoryAddress@LCS_IN_EPS_DrvInpTrqVal@ */ /end MEASUREMENT
/begin MEASUREMENT LCS_IN_SteerWheelSpd "" FLOAT32_IEEE PubIfControlLATC_MDL_CM_single 0 0 -3.4E+38 3.4E+38 ECU_ADDRESS 0x0 /* @MemoryAddress@LCS_IN_SteerWheelSpd@ */ /end MEASUREMENT
/begin MEASUREMENT LCS_ESS_SteerWheelAngleSpd "" FLOAT32_IEEE PubIfControlLATC_MDL_CM_single 0 0 -3.4E+38 3.4E+38 ECU_ADDRESS 0x0 /* @MemoryAddress@LCS_ESS_SteerWheelAngleSpd@ */ /end MEASUREMENT
/begin MEASUREMENT LCS_ESS_SteerWheelAngleSpdFilter "" FLOAT32_IEEE PubIfControlLATC_MDL_CM_single 0 0 -3.4E+38 3.4E+38 ECU_ADDRESS 0x0 /* @MemoryAddress@LCS_ESS_SteerWheelAngleSpdFilter@ */ /end MEASUREMENT
/begin MEASUREMENT LCS_ESS_TarAngleSpd "" FLOAT32_IEEE PubIfControlLATC_MDL_CM_single 0 0 -3.4E+38 3.4E+38 ECU_ADDRESS 0x0 /* @MemoryAddress@LCS_ESS_TarAngleSpd@ */ /end MEASUREMENT
/begin MEASUREMENT LCS_ESS_TarAngleSpdFilter "" FLOAT32_IEEE PubIfControlLATC_MDL_CM_single 0 0 -3.4E+38 3.4E+38 ECU_ADDRESS 0x0 /* @MemoryAddress@LCS_ESS_TarAngleSpdFilter@ */ /end MEASUREMENT
/begin MEASUREMENT LCS_IN_vxvRefMs "" FLOAT32_IEEE PubIfControlLATC_MDL_CM_single 0 0 -3.4E+38 3.4E+38 ECU_ADDRESS 0x0 /* @MemoryAddress@LCS_IN_vxvRefMs@ */ /end MEASUREMENT
/begin MEASUREMENT LCS_IN_SteerWheelSpdSign "" FLOAT32_IEEE PubIfControlLATC_MDL_CM_single 0 0 -3.4E+38 3.4E+38 ECU_ADDRESS 0x0 /* @MemoryAddress@LCS_IN_SteerWheelSpdSign@ */ /end MEASUREMENT
/begin MEASUREMENT LCS_IN_SteerWheelAngleSign "" FLOAT32_IEEE PubIfControlLATC_MDL_CM_single 0 0 -3.4E+38 3.4E+38 ECU_ADDRESS 0x0 /* @MemoryAddress@LCS_IN_SteerWheelAngleSign@ */ /end MEASUREMENT
/begin MEASUREMENT LCS_IN_SteerWheelAng "" FLOAT32_IEEE PubIfControlLATC_MDL_CM_single 0 0 -3.4E+38 3.4E+38 ECU_ADDRESS 0x0 /* @MemoryAddress@LCS_IN_SteerWheelAng@ */ /end MEASUREMENT
/begin MEASUREMENT LCS_IN_CurrentLaneWidth "" FLOAT32_IEEE PubIfControlLATC_MDL_CM_single 0 0 -3.4E+38 3.4E+38 ECU_ADDRESS 0x0 /* @MemoryAddress@LCS_IN_CurrentLaneWidth@ */ /end MEASUREMENT
/begin MEASUREMENT LCS_IN_EPS_LKATorqOvrlDlvd "" FLOAT32_IEEE PubIfControlLATC_MDL_CM_single 0 0 -3.4E+38 3.4E+38 ECU_ADDRESS 0x0 /* @MemoryAddress@LCS_IN_EPS_LKATorqOvrlDlvd@ */ /end MEASUREMENT
/begin MEASUREMENT LCS_IN_EPS_LKATorqOvrlDlvdVld "" FLOAT32_IEEE PubIfControlLATC_MDL_CM_single 0 0 -3.4E+38 3.4E+38 ECU_ADDRESS 0x0 /* @MemoryAddress@LCS_IN_EPS_LKATorqOvrlDlvdVld@ */ /end MEASUREMENT
/begin MEASUREMENT LCS_IN_CurSteerAngle_deg "" FLOAT32_IEEE PubIfControlLATC_MDL_CM_single 0 0 -3.4E+38 3.4E+38 ECU_ADDRESS 0x0 /* @MemoryAddress@LCS_IN_CurSteerAngle_deg@ */ /end MEASUREMENT
/begin MEASUREMENT LCS_IN_SteerAngOffset_deg "" FLOAT32_IEEE PubIfControlLATC_MDL_CM_single 0 0 -3.4E+38 3.4E+38 ECU_ADDRESS 0x0 /* @MemoryAddress@LCS_IN_SteerAngOffset_deg@ */ /end MEASUREMENT
/begin MEASUREMENT LCS_LATC_CorrectSteerAngle_deg "" FLOAT32_IEEE PubIfControlLATC_MDL_CM_single 0 0 -3.4E+38 3.4E+38 ECU_ADDRESS 0x0 /* @MemoryAddress@LCS_LATC_CorrectSteerAngle_deg@ */ /end MEASUREMENT
/begin MEASUREMENT LCS_IN_Spd_Kph "" FLOAT32_IEEE PubIfControlLATC_MDL_CM_single 0 0 -3.4E+38 3.4E+38 ECU_ADDRESS 0x0 /* @MemoryAddress@LCS_IN_Spd_Kph@ */ /end MEASUREMENT
/begin MEASUREMENT LCS_LATC_MaxAy_ms2 "" FLOAT32_IEEE PubIfControlLATC_MDL_CM_single 0 0 -3.4E+38 3.4E+38 ECU_ADDRESS 0x0 /* @MemoryAddress@LCS_LATC_MaxAy_ms2@ */ /end MEASUREMENT
/begin MEASUREMENT LCS_LATC_StateActAngleSlope_degs "" FLOAT32_IEEE PubIfControlLATC_MDL_CM_single 0 0 -3.4E+38 3.4E+38 ECU_ADDRESS 0x0 /* @MemoryAddress@LCS_LATC_StateActAngleSlope_degs@ */ /end MEASUREMENT
/begin MEASUREMENT LCS_LATC_StateAngleSlope_degs "" FLOAT32_IEEE PubIfControlLATC_MDL_CM_single 0 0 -3.4E+38 3.4E+38 ECU_ADDRESS 0x0 /* @MemoryAddress@LCS_LATC_StateAngleSlope_degs@ */ /end MEASUREMENT
/begin MEASUREMENT LCS_IN_psiDtOpt "" FLOAT32_IEEE PubIfControlLATC_MDL_CM_single 0 0 -3.4E+38 3.4E+38 ECU_ADDRESS 0x0 /* @MemoryAddress@LCS_IN_psiDtOpt@ */ /end MEASUREMENT
/begin MEASUREMENT LCS_IN_desLaneA2 "" FLOAT32_IEEE PubIfControlLATC_MDL_CM_single 0 0 -3.4E+38 3.4E+38 ECU_ADDRESS 0x0 /* @MemoryAddress@LCS_IN_desLaneA2@ */ /end MEASUREMENT
/begin MEASUREMENT LCS_LATC_TarAngleFilter_deg "" FLOAT32_IEEE PubIfControlLATC_MDL_CM_single 0 0 -3.4E+38 3.4E+38 ECU_ADDRESS 0x0 /* @MemoryAddress@LCS_LATC_TarAngleFilter_deg@ */ /end MEASUREMENT
/begin MEASUREMENT LCS_LATC_OutTrgSteerAngle "" FLOAT32_IEEE PubIfControlLATC_MDL_CM_single 0 0 -3.4E+38 3.4E+38 ECU_ADDRESS 0x0 /* @MemoryAddress@LCS_LATC_OutTrgSteerAngle@ */ /end MEASUREMENT
/begin MEASUREMENT LCS_IN_kapTraj "" FLOAT32_IEEE PubIfControlLATC_MDL_CM_single 0 0 -3.4E+38 3.4E+38 ECU_ADDRESS 0x0 /* @MemoryAddress@LCS_IN_kapTraj@ */ /end MEASUREMENT
/begin MEASUREMENT LCS_IN_axvRefMs2 "" FLOAT32_IEEE PubIfControlLATC_MDL_CM_single 0 0 -3.4E+38 3.4E+38 ECU_ADDRESS 0x0 /* @MemoryAddress@LCS_IN_axvRefMs2@ */ /end MEASUREMENT
/begin MEASUREMENT LCS_IN_desLaneA3 "" FLOAT32_IEEE PubIfControlLATC_MDL_CM_single 0 0 -3.4E+38 3.4E+38 ECU_ADDRESS 0x0 /* @MemoryAddress@LCS_IN_desLaneA3@ */ /end MEASUREMENT
/begin MEASUREMENT LCS_IN_desLaneA1 "" FLOAT32_IEEE PubIfControlLATC_MDL_CM_single 0 0 -3.4E+38 3.4E+38 ECU_ADDRESS 0x0 /* @MemoryAddress@LCS_IN_desLaneA1@ */ /end MEASUREMENT
/begin MEASUREMENT LCS_IN_desLaneA0 "" FLOAT32_IEEE PubIfControlLATC_MDL_CM_single 0 0 -3.4E+38 3.4E+38 ECU_ADDRESS 0x0 /* @MemoryAddress@LCS_IN_desLaneA0@ */ /end MEASUREMENT
/begin MEASUREMENT LCS_PreDisCurve_m "" FLOAT32_IEEE PubIfControlLATC_MDL_CM_single 0 0 -3.4E+38 3.4E+38 ECU_ADDRESS 0x0 /* @MemoryAddress@LCS_PreDisCurve_m@ */ /end MEASUREMENT
/begin MEASUREMENT LCS_Plan_AyDtlimit "" FLOAT32_IEEE PubIfControlLATC_MDL_CM_single 0 0 -3.4E+38 3.4E+38 ECU_ADDRESS 0x0 /* @MemoryAddress@LCS_Plan_AyDtlimit@ */ /end MEASUREMENT
/begin MEASUREMENT LCS_Plan_FinalpreDis "" FLOAT32_IEEE PubIfControlLATC_MDL_CM_single 0 0 -3.4E+38 3.4E+38 ECU_ADDRESS 0x0 /* @MemoryAddress@LCS_Plan_FinalpreDis@ */ /end MEASUREMENT
/begin MEASUREMENT LCS_CurSteerAngle_deg "" FLOAT32_IEEE PubIfControlLATC_MDL_CM_single 0 0 -3.4E+38 3.4E+38 ECU_ADDRESS 0x0 /* @MemoryAddress@LCS_CurSteerAngle_deg@ */ /end MEASUREMENT
/begin MEASUREMENT LCS_IN_SteerAngleSpd_degs "" FLOAT32_IEEE PubIfControlLATC_MDL_CM_single 0 0 -3.4E+38 3.4E+38 ECU_ADDRESS 0x0 /* @MemoryAddress@LCS_IN_SteerAngleSpd_degs@ */ /end MEASUREMENT
/begin MEASUREMENT LCS_EqA0 "" FLOAT32_IEEE PubIfControlLATC_MDL_CM_single 0 0 -3.4E+38 3.4E+38 ECU_ADDRESS 0x0 /* @MemoryAddress@LCS_EqA0@ */ /end MEASUREMENT
/begin MEASUREMENT LCS_IN_ayvRefMs2 "" FLOAT32_IEEE PubIfControlLATC_MDL_CM_single 0 0 -3.4E+38 3.4E+38 ECU_ADDRESS 0x0 /* @MemoryAddress@LCS_IN_ayvRefMs2@ */ /end MEASUREMENT
/begin MEASUREMENT LCS_IN_alpSideSlipAngle "" FLOAT32_IEEE PubIfControlLATC_MDL_CM_single 0 0 -3.4E+38 3.4E+38 ECU_ADDRESS 0x0 /* @MemoryAddress@LCS_IN_alpSideSlipAngle@ */ /end MEASUREMENT
/begin MEASUREMENT LCS_PLAN_TrajectoryX "" FLOAT32_IEEE PubIfControlLATC_MDL_CM_single 0 0 -3.4E+38 3.4E+38 LAYOUT ROW_DIR MATRIX_DIM 11 1 1 ECU_ADDRESS 0x0 /* @MemoryAddress@LCS_PLAN_TrajectoryX@ */ /end MEASUREMENT
/begin MEASUREMENT LCS_PLAN_Trajectory_PlanY "" FLOAT32_IEEE PubIfControlLATC_MDL_CM_single 0 0 -3.4E+38 3.4E+38 LAYOUT ROW_DIR MATRIX_DIM 11 1 1 ECU_ADDRESS 0x0 /* @MemoryAddress@LCS_PLAN_Trajectory_PlanY@ */ /end MEASUREMENT
/begin MEASUREMENT LCS_LATC_PlanT "" FLOAT32_IEEE PubIfControlLATC_MDL_CM_single 0 0 -3.4E+38 3.4E+38 ECU_ADDRESS 0x0 /* @MemoryAddress@LCS_LATC_PlanT@ */ /end MEASUREMENT
/begin MEASUREMENT LCS_LATC_PlanLength "" FLOAT32_IEEE PubIfControlLATC_MDL_CM_single 0 0 -3.4E+38 3.4E+38 ECU_ADDRESS 0x0 /* @MemoryAddress@LCS_LATC_PlanLength@ */ /end MEASUREMENT
/begin MEASUREMENT LCS_LATC_PlanAyDt "" FLOAT32_IEEE PubIfControlLATC_MDL_CM_single 0 0 -3.4E+38 3.4E+38 LAYOUT ROW_DIR MATRIX_DIM 11 1 1 ECU_ADDRESS 0x0 /* @MemoryAddress@LCS_LATC_PlanAyDt@ */ /end MEASUREMENT
/begin MEASUREMENT LCS_LATC_CurrentSteerAngleOffset_deg "" FLOAT32_IEEE PubIfControlLATC_MDL_CM_single 0 0 -3.4E+38 3.4E+38 ECU_ADDRESS 0x0 /* @MemoryAddress@LCS_LATC_CurrentSteerAngleOffset_deg@ */ /end MEASUREMENT
/begin MEASUREMENT LCS_LATC_SteerAngleCmd_deg "" FLOAT32_IEEE PubIfControlLATC_MDL_CM_single 0 0 -3.4E+38 3.4E+38 ECU_ADDRESS 0x0 /* @MemoryAddress@LCS_LATC_SteerAngleCmd_deg@ */ /end MEASUREMENT
/begin MEASUREMENT LCS_LATC_Feedforward_deg "" FLOAT32_IEEE PubIfControlLATC_MDL_CM_single 0 0 -3.4E+38 3.4E+38 ECU_ADDRESS 0x0 /* @MemoryAddress@LCS_LATC_Feedforward_deg@ */ /end MEASUREMENT
/begin MEASUREMENT LCS_LATC_Feedback_deg "" FLOAT32_IEEE PubIfControlLATC_MDL_CM_single 0 0 -3.4E+38 3.4E+38 ECU_ADDRESS 0x0 /* @MemoryAddress@LCS_LATC_Feedback_deg@ */ /end MEASUREMENT
/begin MEASUREMENT LCS_LATC_SteerAngleLimit_deg "" FLOAT32_IEEE PubIfControlLATC_MDL_CM_single 0 0 -3.4E+38 3.4E+38 ECU_ADDRESS 0x0 /* @MemoryAddress@LCS_LATC_SteerAngleLimit_deg@ */ /end MEASUREMENT
/begin MEASUREMENT LCS_LATC_MatrixResult_deg "" FLOAT32_IEEE PubIfControlLATC_MDL_CM_single 0 0 -3.4E+38 3.4E+38 LAYOUT ROW_DIR MATRIX_DIM 6 1 1 ECU_ADDRESS 0x0 /* @MemoryAddress@LCS_LATC_MatrixResult_deg@ */ /end MEASUREMENT
/begin MEASUREMENT LCS_LATC_TarAngle_deg "" FLOAT32_IEEE PubIfControlLATC_MDL_CM_single 0 0 -3.4E+38 3.4E+38 ECU_ADDRESS 0x0 /* @MemoryAddress@LCS_LATC_TarAngle_deg@ */ /end MEASUREMENT
/begin MEASUREMENT LCS_LATC_MPCDeltaT_s "" FLOAT32_IEEE PubIfControlLATC_MDL_CM_single 0 0 -3.4E+38 3.4E+38 ECU_ADDRESS 0x0 /* @MemoryAddress@LCS_LATC_MPCDeltaT_s@ */ /end MEASUREMENT
/begin MEASUREMENT LCS_Trq_Switch "" UBYTE PubIfControlLATC_MDL_CM_uint8 0 0 0 255 ECU_ADDRESS 0x0 /* @MemoryAddress@LCS_Trq_Switch@ */ /end MEASUREMENT
/begin MEASUREMENT LCS_IN_EPS_FailSts "" UBYTE PubIfControlLATC_MDL_CM_uint8 0 0 0 255 ECU_ADDRESS 0x0 /* @MemoryAddress@LCS_IN_EPS_FailSts@ */ /end MEASUREMENT
/begin MEASUREMENT LCS_IN_EPS_LKATrqOvlDlvdSts "" UBYTE PubIfControlLATC_MDL_CM_uint8 0 0 0 255 ECU_ADDRESS 0x0 /* @MemoryAddress@LCS_IN_EPS_LKATrqOvlDlvdSts@ */ /end MEASUREMENT
/begin MEASUREMENT LCS_IN_TarDangerlLevel_Delay2Frame "" UBYTE PubIfControlLATC_MDL_CM_uint8 0 0 0 255 ECU_ADDRESS 0x0 /* @MemoryAddress@LCS_IN_TarDangerlLevel_Delay2Frame@ */ /end MEASUREMENT
/begin MEASUREMENT LCS_IN_TarDangerlLevel "" UBYTE PubIfControlLATC_MDL_CM_uint8 0 0 0 255 ECU_ADDRESS 0x0 /* @MemoryAddress@LCS_IN_TarDangerlLevel@ */ /end MEASUREMENT
/begin MEASUREMENT LCS_OUT_AngCmdReqValVld "" UBYTE PubIfControlLATC_MDL_CM_uint8 0 0 0 255 ECU_ADDRESS 0x0 /* @MemoryAddress@LCS_OUT_AngCmdReqValVld@ */ /end MEASUREMENT
/begin MEASUREMENT LCS_Counter "" UBYTE PubIfControlLATC_MDL_CM_uint8 0 0 0 255 ECU_ADDRESS 0x0 /* @MemoryAddress@LCS_Counter@ */ /end MEASUREMENT
/begin MEASUREMENT LCS_IN_EPS_LKAAngDlvdSts "" UBYTE PubIfControlLATC_MDL_CM_uint8 0 0 0 255 ECU_ADDRESS 0x0 /* @MemoryAddress@LCS_IN_EPS_LKAAngDlvdSts@ */ /end MEASUREMENT
/begin MEASUREMENT LCS_LATC_AngleSlopeFlg_st "" UBYTE PubIfControlLATC_MDL_CM_uint8 0 0 0 255 ECU_ADDRESS 0x0 /* @MemoryAddress@LCS_LATC_AngleSlopeFlg_st@ */ /end MEASUREMENT
/begin MEASUREMENT LCS_EPSFault "" UBYTE PubIfControlLATC_MDL_CM_uint8 0 0 0 255 ECU_ADDRESS 0x0 /* @MemoryAddress@LCS_EPSFault@ */ /end MEASUREMENT
/begin MEASUREMENT LCS_ESS_NotActiveFlg1 "" UBYTE PubIfControlLATC_MDL_CM_boolean 0 0 0 1 ECU_ADDRESS 0x0 /* @MemoryAddress@LCS_ESS_NotActiveFlg1@ */ BIT_MASK 0x01 /end MEASUREMENT
/begin MEASUREMENT LCS_ESS_NotActiveFlg2 "" UBYTE PubIfControlLATC_MDL_CM_boolean 0 0 0 1 ECU_ADDRESS 0x0 /* @MemoryAddress@LCS_ESS_NotActiveFlg2@ */ BIT_MASK 0x01 /end MEASUREMENT
/begin MEASUREMENT LCS_ESS_NotActiveFlg3 "" UBYTE PubIfControlLATC_MDL_CM_boolean 0 0 0 1 ECU_ADDRESS 0x0 /* @MemoryAddress@LCS_ESS_NotActiveFlg3@ */ BIT_MASK 0x01 /end MEASUREMENT
/begin MEASUREMENT LCS_ESS_NotActiveFlgOriginal "" UBYTE PubIfControlLATC_MDL_CM_boolean 0 0 0 1 ECU_ADDRESS 0x0 /* @MemoryAddress@LCS_ESS_NotActiveFlgOriginal@ */ BIT_MASK 0x01 /end MEASUREMENT
/begin MEASUREMENT LCS_ESS_NotActiveFlg "" UBYTE PubIfControlLATC_MDL_CM_boolean 0 0 0 1 ECU_ADDRESS 0x0 /* @MemoryAddress@LCS_ESS_NotActiveFlg@ */ BIT_MASK 0x01 /end MEASUREMENT
/begin MEASUREMENT LCS_IN_desLaneValid "" UBYTE PubIfControlLATC_MDL_CM_boolean 0 0 0 1 ECU_ADDRESS 0x0 /* @MemoryAddress@LCS_IN_desLaneValid@ */ BIT_MASK 0x01 /end MEASUREMENT
/begin MEASUREMENT LCS_OffSetUpdate_Flg "" UBYTE PubIfControlLATC_MDL_CM_boolean 0 0 0 1 ECU_ADDRESS 0x0 /* @MemoryAddress@LCS_OffSetUpdate_Flg@ */ BIT_MASK 0x01 /end MEASUREMENT
/begin MEASUREMENT LCS_OverRideDetect_b "" UBYTE PubIfControlLATC_MDL_CM_boolean 0 0 0 1 ECU_ADDRESS 0x0 /* @MemoryAddress@LCS_OverRideDetect_b@ */ BIT_MASK 0x01 /end MEASUREMENT
/begin MEASUREMENT LCS_ESS_NotActiveDelayFlg "" UBYTE PubIfControlLATC_MDL_CM_boolean 0 0 0 1 ECU_ADDRESS 0x0 /* @MemoryAddress@LCS_ESS_NotActiveDelayFlg@ */ BIT_MASK 0x01 /end MEASUREMENT
/begin MEASUREMENT LSM_UpdateCnt "" ULONG PubIfDecisionLSM_MDL_CM_uint32 0 0 0 4294967295 ECU_ADDRESS 0x0 /* @MemoryAddress@LSM_UpdateCnt@ */ /end MEASUREMENT
/begin MEASUREMENT LSM_QualityK1 "" FLOAT32_IEEE PubIfDecisionLSM_MDL_CM_single 0 0 -3.4E+38 3.4E+38 ECU_ADDRESS 0x0 /* @MemoryAddress@LSM_QualityK1@ */ /end MEASUREMENT
/begin MEASUREMENT LSM_A3K1 "" FLOAT32_IEEE PubIfDecisionLSM_MDL_CM_single 0 0 -3.4E+38 3.4E+38 ECU_ADDRESS 0x0 /* @MemoryAddress@LSM_A3K1@ */ /end MEASUREMENT
/begin MEASUREMENT LSM_A2K1 "" FLOAT32_IEEE PubIfDecisionLSM_MDL_CM_single 0 0 -3.4E+38 3.4E+38 ECU_ADDRESS 0x0 /* @MemoryAddress@LSM_A2K1@ */ /end MEASUREMENT
/begin MEASUREMENT LSM_A1K1 "" FLOAT32_IEEE PubIfDecisionLSM_MDL_CM_single 0 0 -3.4E+38 3.4E+38 ECU_ADDRESS 0x0 /* @MemoryAddress@LSM_A1K1@ */ /end MEASUREMENT
/begin MEASUREMENT LSM_A0K1 "" FLOAT32_IEEE PubIfDecisionLSM_MDL_CM_single 0 0 -3.4E+38 3.4E+38 ECU_ADDRESS 0x0 /* @MemoryAddress@LSM_A0K1@ */ /end MEASUREMENT
/begin MEASUREMENT LSM_RangeK1 "" FLOAT32_IEEE PubIfDecisionLSM_MDL_CM_single 0 0 -3.4E+38 3.4E+38 ECU_ADDRESS 0x0 /* @MemoryAddress@LSM_RangeK1@ */ /end MEASUREMENT
/begin MEASUREMENT LSM_tLostK1 "" FLOAT32_IEEE PubIfDecisionLSM_MDL_CM_single 0 0 -3.4E+38 3.4E+38 ECU_ADDRESS 0x0 /* @MemoryAddress@LSM_tLostK1@ */ /end MEASUREMENT
/begin MEASUREMENT LSM_HWALineC0K1 "" FLOAT32_IEEE PubIfDecisionLSM_MDL_CM_single 0 0 -3.4E+38 3.4E+38 ECU_ADDRESS 0x0 /* @MemoryAddress@LSM_HWALineC0K1@ */ /end MEASUREMENT
/begin MEASUREMENT LSM_LH21 "" FLOAT32_IEEE PubIfDecisionLSM_MDL_CM_single 0 0 -3.4E+38 3.4E+38 ECU_ADDRESS 0x0 /* @MemoryAddress@LSM_LH21@ */ /end MEASUREMENT
/begin MEASUREMENT LSM_LH22 "" FLOAT32_IEEE PubIfDecisionLSM_MDL_CM_single 0 0 -3.4E+38 3.4E+38 ECU_ADDRESS 0x0 /* @MemoryAddress@LSM_LH22@ */ /end MEASUREMENT
/begin MEASUREMENT LSM_LH23 "" FLOAT32_IEEE PubIfDecisionLSM_MDL_CM_single 0 0 -3.4E+38 3.4E+38 ECU_ADDRESS 0x0 /* @MemoryAddress@LSM_LH23@ */ /end MEASUREMENT
/begin MEASUREMENT LSM_LH1Wij "" FLOAT32_IEEE PubIfDecisionLSM_MDL_CM_single 0 0 -3.4E+38 3.4E+38 ECU_ADDRESS 0x0 /* @MemoryAddress@LSM_LH1Wij@ */ /end MEASUREMENT
/begin MEASUREMENT LSM_LH31 "" FLOAT32_IEEE PubIfDecisionLSM_MDL_CM_single 0 0 -3.4E+38 3.4E+38 ECU_ADDRESS 0x0 /* @MemoryAddress@LSM_LH31@ */ /end MEASUREMENT
/begin MEASUREMENT LSM_LH32 "" FLOAT32_IEEE PubIfDecisionLSM_MDL_CM_single 0 0 -3.4E+38 3.4E+38 ECU_ADDRESS 0x0 /* @MemoryAddress@LSM_LH32@ */ /end MEASUREMENT
/begin MEASUREMENT LSM_LH33 "" FLOAT32_IEEE PubIfDecisionLSM_MDL_CM_single 0 0 -3.4E+38 3.4E+38 ECU_ADDRESS 0x0 /* @MemoryAddress@LSM_LH33@ */ /end MEASUREMENT
/begin MEASUREMENT LSM_LH2Wij "" FLOAT32_IEEE PubIfDecisionLSM_MDL_CM_single 0 0 -3.4E+38 3.4E+38 ECU_ADDRESS 0x0 /* @MemoryAddress@LSM_LH2Wij@ */ /end MEASUREMENT
/begin MEASUREMENT LSM_TJALineC3 "" FLOAT32_IEEE PubIfDecisionLSM_MDL_CM_single 0 0 -3.4E+38 3.4E+38 ECU_ADDRESS 0x0 /* @MemoryAddress@LSM_TJALineC3@ */ /end MEASUREMENT
/begin MEASUREMENT LSM_LCKLineC0 "" FLOAT32_IEEE PubIfDecisionLSM_MDL_CM_single 0 0 -3.4E+38 3.4E+38 ECU_ADDRESS 0x0 /* @MemoryAddress@LSM_LCKLineC0@ */ /end MEASUREMENT
/begin MEASUREMENT LSM_LCKRange "" FLOAT32_IEEE PubIfDecisionLSM_MDL_CM_single 0 0 -3.4E+38 3.4E+38 ECU_ADDRESS 0x0 /* @MemoryAddress@LSM_LCKRange@ */ /end MEASUREMENT
/begin MEASUREMENT LSM_HWALineC3 "" FLOAT32_IEEE PubIfDecisionLSM_MDL_CM_single 0 0 -3.4E+38 3.4E+38 ECU_ADDRESS 0x0 /* @MemoryAddress@LSM_HWALineC3@ */ /end MEASUREMENT
/begin MEASUREMENT LSM_HWALineC2 "" FLOAT32_IEEE PubIfDecisionLSM_MDL_CM_single 0 0 -3.4E+38 3.4E+38 ECU_ADDRESS 0x0 /* @MemoryAddress@LSM_HWALineC2@ */ /end MEASUREMENT
/begin MEASUREMENT LSM_HWALineC1 "" FLOAT32_IEEE PubIfDecisionLSM_MDL_CM_single 0 0 -3.4E+38 3.4E+38 ECU_ADDRESS 0x0 /* @MemoryAddress@LSM_HWALineC1@ */ /end MEASUREMENT
/begin MEASUREMENT LSM_HWALeLineC3 "" FLOAT32_IEEE PubIfDecisionLSM_MDL_CM_single 0 0 -3.4E+38 3.4E+38 ECU_ADDRESS 0x0 /* @MemoryAddress@LSM_HWALeLineC3@ */ /end MEASUREMENT
/begin MEASUREMENT LSM_HWALeLineC2 "" FLOAT32_IEEE PubIfDecisionLSM_MDL_CM_single 0 0 -3.4E+38 3.4E+38 ECU_ADDRESS 0x0 /* @MemoryAddress@LSM_HWALeLineC2@ */ /end MEASUREMENT
/begin MEASUREMENT LSM_HWALeLineC1 "" FLOAT32_IEEE PubIfDecisionLSM_MDL_CM_single 0 0 -3.4E+38 3.4E+38 ECU_ADDRESS 0x0 /* @MemoryAddress@LSM_HWALeLineC1@ */ /end MEASUREMENT
/begin MEASUREMENT LSM_HWALeLineC0 "" FLOAT32_IEEE PubIfDecisionLSM_MDL_CM_single 0 0 -3.4E+38 3.4E+38 ECU_ADDRESS 0x0 /* @MemoryAddress@LSM_HWALeLineC0@ */ /end MEASUREMENT
/begin MEASUREMENT LSM_TJALineC2 "" FLOAT32_IEEE PubIfDecisionLSM_MDL_CM_single 0 0 -3.4E+38 3.4E+38 ECU_ADDRESS 0x0 /* @MemoryAddress@LSM_TJALineC2@ */ /end MEASUREMENT
/begin MEASUREMENT LSM_HWALeRange "" FLOAT32_IEEE PubIfDecisionLSM_MDL_CM_single 0 0 -3.4E+38 3.4E+38 ECU_ADDRESS 0x0 /* @MemoryAddress@LSM_HWALeRange@ */ /end MEASUREMENT
/begin MEASUREMENT LSM_HWALineC0 "" FLOAT32_IEEE PubIfDecisionLSM_MDL_CM_single 0 0 -3.4E+38 3.4E+38 ECU_ADDRESS 0x0 /* @MemoryAddress@LSM_HWALineC0@ */ /end MEASUREMENT
/begin MEASUREMENT LSM_HWARange "" FLOAT32_IEEE PubIfDecisionLSM_MDL_CM_single 0 0 -3.4E+38 3.4E+38 ECU_ADDRESS 0x0 /* @MemoryAddress@LSM_HWARange@ */ /end MEASUREMENT
/begin MEASUREMENT LSM_HWARiLineC1 "" FLOAT32_IEEE PubIfDecisionLSM_MDL_CM_single 0 0 -3.4E+38 3.4E+38 ECU_ADDRESS 0x0 /* @MemoryAddress@LSM_HWARiLineC1@ */ /end MEASUREMENT
/begin MEASUREMENT LSM_HWARiLineC0 "" FLOAT32_IEEE PubIfDecisionLSM_MDL_CM_single 0 0 -3.4E+38 3.4E+38 ECU_ADDRESS 0x0 /* @MemoryAddress@LSM_HWARiLineC0@ */ /end MEASUREMENT
/begin MEASUREMENT LSM_HWARiRange "" FLOAT32_IEEE PubIfDecisionLSM_MDL_CM_single 0 0 -3.4E+38 3.4E+38 ECU_ADDRESS 0x0 /* @MemoryAddress@LSM_HWARiRange@ */ /end MEASUREMENT
/begin MEASUREMENT LSM_TJALineC1 "" FLOAT32_IEEE PubIfDecisionLSM_MDL_CM_single 0 0 -3.4E+38 3.4E+38 ECU_ADDRESS 0x0 /* @MemoryAddress@LSM_TJALineC1@ */ /end MEASUREMENT
/begin MEASUREMENT LSM_HeadAngDiff "" FLOAT32_IEEE PubIfDecisionLSM_MDL_CM_single 0 0 -3.4E+38 3.4E+38 ECU_ADDRESS 0x0 /* @MemoryAddress@LSM_HeadAngDiff@ */ /end MEASUREMENT
/begin MEASUREMENT LSM_HWARiLineC3 "" FLOAT32_IEEE PubIfDecisionLSM_MDL_CM_single 0 0 -3.4E+38 3.4E+38 ECU_ADDRESS 0x0 /* @MemoryAddress@LSM_HWARiLineC3@ */ /end MEASUREMENT
/begin MEASUREMENT LSM_HWARiLineC2 "" FLOAT32_IEEE PubIfDecisionLSM_MDL_CM_single 0 0 -3.4E+38 3.4E+38 ECU_ADDRESS 0x0 /* @MemoryAddress@LSM_HWARiLineC2@ */ /end MEASUREMENT
/begin MEASUREMENT LSM_ESSLineC2 "" FLOAT32_IEEE PubIfDecisionLSM_MDL_CM_single 0 0 -3.4E+38 3.4E+38 ECU_ADDRESS 0x0 /* @MemoryAddress@LSM_ESSLineC2@ */ /end MEASUREMENT
/begin MEASUREMENT LSM_ESSLineC1 "" FLOAT32_IEEE PubIfDecisionLSM_MDL_CM_single 0 0 -3.4E+38 3.4E+38 ECU_ADDRESS 0x0 /* @MemoryAddress@LSM_ESSLineC1@ */ /end MEASUREMENT
/begin MEASUREMENT LSM_ESSLineC0 "" FLOAT32_IEEE PubIfDecisionLSM_MDL_CM_single 0 0 -3.4E+38 3.4E+38 ECU_ADDRESS 0x0 /* @MemoryAddress@LSM_ESSLineC0@ */ /end MEASUREMENT
/begin MEASUREMENT LSM_ESSRange "" FLOAT32_IEEE PubIfDecisionLSM_MDL_CM_single 0 0 -3.4E+38 3.4E+38 ECU_ADDRESS 0x0 /* @MemoryAddress@LSM_ESSRange@ */ /end MEASUREMENT
/begin MEASUREMENT LSM_ESSLeLineC3 "" FLOAT32_IEEE PubIfDecisionLSM_MDL_CM_single 0 0 -3.4E+38 3.4E+38 ECU_ADDRESS 0x0 /* @MemoryAddress@LSM_ESSLeLineC3@ */ /end MEASUREMENT
/begin MEASUREMENT LSM_TJALineC0 "" FLOAT32_IEEE PubIfDecisionLSM_MDL_CM_single 0 0 -3.4E+38 3.4E+38 ECU_ADDRESS 0x0 /* @MemoryAddress@LSM_TJALineC0@ */ /end MEASUREMENT
/begin MEASUREMENT LSM_ESSLineC3 "" FLOAT32_IEEE PubIfDecisionLSM_MDL_CM_single 0 0 -3.4E+38 3.4E+38 ECU_ADDRESS 0x0 /* @MemoryAddress@LSM_ESSLineC3@ */ /end MEASUREMENT
/begin MEASUREMENT LSM_ESSLeLineC0 "" FLOAT32_IEEE PubIfDecisionLSM_MDL_CM_single 0 0 -3.4E+38 3.4E+38 ECU_ADDRESS 0x0 /* @MemoryAddress@LSM_ESSLeLineC0@ */ /end MEASUREMENT
/begin MEASUREMENT LSM_ESSLeRange "" FLOAT32_IEEE PubIfDecisionLSM_MDL_CM_single 0 0 -3.4E+38 3.4E+38 ECU_ADDRESS 0x0 /* @MemoryAddress@LSM_ESSLeRange@ */ /end MEASUREMENT
/begin MEASUREMENT LSM_ESSRiLineC3 "" FLOAT32_IEEE PubIfDecisionLSM_MDL_CM_single 0 0 -3.4E+38 3.4E+38 ECU_ADDRESS 0x0 /* @MemoryAddress@LSM_ESSRiLineC3@ */ /end MEASUREMENT
/begin MEASUREMENT LSM_ESSRiLineC2 "" FLOAT32_IEEE PubIfDecisionLSM_MDL_CM_single 0 0 -3.4E+38 3.4E+38 ECU_ADDRESS 0x0 /* @MemoryAddress@LSM_ESSRiLineC2@ */ /end MEASUREMENT
/begin MEASUREMENT LSM_ESSRiLineC1 "" FLOAT32_IEEE PubIfDecisionLSM_MDL_CM_single 0 0 -3.4E+38 3.4E+38 ECU_ADDRESS 0x0 /* @MemoryAddress@LSM_ESSRiLineC1@ */ /end MEASUREMENT
/begin MEASUREMENT LSM_ESSLeLineC2 "" FLOAT32_IEEE PubIfDecisionLSM_MDL_CM_single 0 0 -3.4E+38 3.4E+38 ECU_ADDRESS 0x0 /* @MemoryAddress@LSM_ESSLeLineC2@ */ /end MEASUREMENT
/begin MEASUREMENT LSM_ESSLeLineC1 "" FLOAT32_IEEE PubIfDecisionLSM_MDL_CM_single 0 0 -3.4E+38 3.4E+38 ECU_ADDRESS 0x0 /* @MemoryAddress@LSM_ESSLeLineC1@ */ /end MEASUREMENT
/begin MEASUREMENT LSM_ESSRiLineC0 "" FLOAT32_IEEE PubIfDecisionLSM_MDL_CM_single 0 0 -3.4E+38 3.4E+38 ECU_ADDRESS 0x0 /* @MemoryAddress@LSM_ESSRiLineC0@ */ /end MEASUREMENT
/begin MEASUREMENT LSM_TJARange "" FLOAT32_IEEE PubIfDecisionLSM_MDL_CM_single 0 0 -3.4E+38 3.4E+38 ECU_ADDRESS 0x0 /* @MemoryAddress@LSM_TJARange@ */ /end MEASUREMENT
/begin MEASUREMENT LSM_ESSRiRange "" FLOAT32_IEEE PubIfDecisionLSM_MDL_CM_single 0 0 -3.4E+38 3.4E+38 ECU_ADDRESS 0x0 /* @MemoryAddress@LSM_ESSRiRange@ */ /end MEASUREMENT
/begin MEASUREMENT LSM_dyDiff "" FLOAT32_IEEE PubIfDecisionLSM_MDL_CM_single 0 0 -3.4E+38 3.4E+38 ECU_ADDRESS 0x0 /* @MemoryAddress@LSM_dyDiff@ */ /end MEASUREMENT
/begin MEASUREMENT LSM_RoadWidth "" FLOAT32_IEEE PubIfDecisionLSM_MDL_CM_single 0 0 -3.4E+38 3.4E+38 ECU_ADDRESS 0x0 /* @MemoryAddress@LSM_RoadWidth@ */ /end MEASUREMENT
/begin MEASUREMENT LSM_LCKLineC3 "" FLOAT32_IEEE PubIfDecisionLSM_MDL_CM_single 0 0 -3.4E+38 3.4E+38 ECU_ADDRESS 0x0 /* @MemoryAddress@LSM_LCKLineC3@ */ /end MEASUREMENT
/begin MEASUREMENT LSM_LCKLineC2 "" FLOAT32_IEEE PubIfDecisionLSM_MDL_CM_single 0 0 -3.4E+38 3.4E+38 ECU_ADDRESS 0x0 /* @MemoryAddress@LSM_LCKLineC2@ */ /end MEASUREMENT
/begin MEASUREMENT LSM_LCKLineC1 "" FLOAT32_IEEE PubIfDecisionLSM_MDL_CM_single 0 0 -3.4E+38 3.4E+38 ECU_ADDRESS 0x0 /* @MemoryAddress@LSM_LCKLineC1@ */ /end MEASUREMENT
/begin MEASUREMENT LSM_OTL_A3 "" FLOAT32_IEEE PubIfDecisionLSM_MDL_CM_single 0 0 -3.4E+38 3.4E+38 ECU_ADDRESS 0x0 /* @MemoryAddress@LSM_OTL_A3@ */ /end MEASUREMENT
/begin MEASUREMENT LSM_OTL_A2 "" FLOAT32_IEEE PubIfDecisionLSM_MDL_CM_single 0 0 -3.4E+38 3.4E+38 ECU_ADDRESS 0x0 /* @MemoryAddress@LSM_OTL_A2@ */ /end MEASUREMENT
/begin MEASUREMENT LSM_OTL_A1 "" FLOAT32_IEEE PubIfDecisionLSM_MDL_CM_single 0 0 -3.4E+38 3.4E+38 ECU_ADDRESS 0x0 /* @MemoryAddress@LSM_OTL_A1@ */ /end MEASUREMENT
/begin MEASUREMENT LSM_OTL_A0 "" FLOAT32_IEEE PubIfDecisionLSM_MDL_CM_single 0 0 -3.4E+38 3.4E+38 ECU_ADDRESS 0x0 /* @MemoryAddress@LSM_OTL_A0@ */ /end MEASUREMENT
/begin MEASUREMENT LSM_OTL_Range "" FLOAT32_IEEE PubIfDecisionLSM_MDL_CM_single 0 0 -3.4E+38 3.4E+38 ECU_ADDRESS 0x0 /* @MemoryAddress@LSM_OTL_Range@ */ /end MEASUREMENT
/begin MEASUREMENT LSM_RFM_LineCenter_C0 "" FLOAT32_IEEE PubIfDecisionLSM_MDL_CM_single 0 0 -3.4E+38 3.4E+38 ECU_ADDRESS 0x0 /* @MemoryAddress@LSM_RFM_LineCenter_C0@ */ /end MEASUREMENT
/begin MEASUREMENT LSM_RFM_LineL1_C2 "" FLOAT32_IEEE PubIfDecisionLSM_MDL_CM_single 0 0 -3.4E+38 3.4E+38 ECU_ADDRESS 0x0 /* @MemoryAddress@LSM_RFM_LineL1_C2@ */ /end MEASUREMENT
/begin MEASUREMENT LSM_RFM_LineL1_C3 "" FLOAT32_IEEE PubIfDecisionLSM_MDL_CM_single 0 0 -3.4E+38 3.4E+38 ECU_ADDRESS 0x0 /* @MemoryAddress@LSM_RFM_LineL1_C3@ */ /end MEASUREMENT
/begin MEASUREMENT LSM_RFM_LineL1_Start "" FLOAT32_IEEE PubIfDecisionLSM_MDL_CM_single 0 0 -3.4E+38 3.4E+38 ECU_ADDRESS 0x0 /* @MemoryAddress@LSM_RFM_LineL1_Start@ */ /end MEASUREMENT
/begin MEASUREMENT LSM_RFM_LineL1_Front "" FLOAT32_IEEE PubIfDecisionLSM_MDL_CM_single 0 0 -3.4E+38 3.4E+38 ECU_ADDRESS 0x0 /* @MemoryAddress@LSM_RFM_LineL1_Front@ */ /end MEASUREMENT
/begin MEASUREMENT LSM_RFM_LineR1_C2 "" FLOAT32_IEEE PubIfDecisionLSM_MDL_CM_single 0 0 -3.4E+38 3.4E+38 ECU_ADDRESS 0x0 /* @MemoryAddress@LSM_RFM_LineR1_C2@ */ /end MEASUREMENT
/begin MEASUREMENT LSM_RFM_LineR1_C3 "" FLOAT32_IEEE PubIfDecisionLSM_MDL_CM_single 0 0 -3.4E+38 3.4E+38 ECU_ADDRESS 0x0 /* @MemoryAddress@LSM_RFM_LineR1_C3@ */ /end MEASUREMENT
/begin MEASUREMENT LSM_RFM_LineR1_Start "" FLOAT32_IEEE PubIfDecisionLSM_MDL_CM_single 0 0 -3.4E+38 3.4E+38 ECU_ADDRESS 0x0 /* @MemoryAddress@LSM_RFM_LineR1_Start@ */ /end MEASUREMENT
/begin MEASUREMENT LSM_RFM_LineR1_Front "" FLOAT32_IEEE PubIfDecisionLSM_MDL_CM_single 0 0 -3.4E+38 3.4E+38 ECU_ADDRESS 0x0 /* @MemoryAddress@LSM_RFM_LineR1_Front@ */ /end MEASUREMENT
/begin MEASUREMENT LSM_RFM_LineR1_C0 "" FLOAT32_IEEE PubIfDecisionLSM_MDL_CM_single 0 0 -3.4E+38 3.4E+38 ECU_ADDRESS 0x0 /* @MemoryAddress@LSM_RFM_LineR1_C0@ */ /end MEASUREMENT
/begin MEASUREMENT LSM_RFM_LineCenter_C1 "" FLOAT32_IEEE PubIfDecisionLSM_MDL_CM_single 0 0 -3.4E+38 3.4E+38 ECU_ADDRESS 0x0 /* @MemoryAddress@LSM_RFM_LineCenter_C1@ */ /end MEASUREMENT
/begin MEASUREMENT LSM_RFM_LineR1_C1 "" FLOAT32_IEEE PubIfDecisionLSM_MDL_CM_single 0 0 -3.4E+38 3.4E+38 ECU_ADDRESS 0x0 /* @MemoryAddress@LSM_RFM_LineR1_C1@ */ /end MEASUREMENT
/begin MEASUREMENT LSM_RFM_LineCenter_C2 "" FLOAT32_IEEE PubIfDecisionLSM_MDL_CM_single 0 0 -3.4E+38 3.4E+38 ECU_ADDRESS 0x0 /* @MemoryAddress@LSM_RFM_LineCenter_C2@ */ /end MEASUREMENT
/begin MEASUREMENT LSM_RFM_LineCenter_C3 "" FLOAT32_IEEE PubIfDecisionLSM_MDL_CM_single 0 0 -3.4E+38 3.4E+38 ECU_ADDRESS 0x0 /* @MemoryAddress@LSM_RFM_LineCenter_C3@ */ /end MEASUREMENT
/begin MEASUREMENT LSM_RFM_LineCenter_Start "" FLOAT32_IEEE PubIfDecisionLSM_MDL_CM_single 0 0 -3.4E+38 3.4E+38 ECU_ADDRESS 0x0 /* @MemoryAddress@LSM_RFM_LineCenter_Start@ */ /end MEASUREMENT
/begin MEASUREMENT LSM_RFM_LineCenter_Front "" FLOAT32_IEEE PubIfDecisionLSM_MDL_CM_single 0 0 -3.4E+38 3.4E+38 ECU_ADDRESS 0x0 /* @MemoryAddress@LSM_RFM_LineCenter_Front@ */ /end MEASUREMENT
/begin MEASUREMENT LSM_RFM_LineL1_C0 "" FLOAT32_IEEE PubIfDecisionLSM_MDL_CM_single 0 0 -3.4E+38 3.4E+38 ECU_ADDRESS 0x0 /* @MemoryAddress@LSM_RFM_LineL1_C0@ */ /end MEASUREMENT
/begin MEASUREMENT LSM_RFM_LineL1_C1 "" FLOAT32_IEEE PubIfDecisionLSM_MDL_CM_single 0 0 -3.4E+38 3.4E+38 ECU_ADDRESS 0x0 /* @MemoryAddress@LSM_RFM_LineL1_C1@ */ /end MEASUREMENT
/begin MEASUREMENT LSM_L1_Range "" FLOAT32_IEEE PubIfDecisionLSM_MDL_CM_single 0 0 -3.4E+38 3.4E+38 ECU_ADDRESS 0x0 /* @MemoryAddress@LSM_L1_Range@ */ /end MEASUREMENT
/begin MEASUREMENT LSM_LA_ELEM_0_C1 "" FLOAT32_IEEE PubIfDecisionLSM_MDL_CM_single 0 0 -3.4E+38 3.4E+38 ECU_ADDRESS 0x0 /* @MemoryAddress@LSM_LA_ELEM_0_C1@ */ /end MEASUREMENT
/begin MEASUREMENT LSM_LRE_ELEM_1_C0 "" FLOAT32_IEEE PubIfDecisionLSM_MDL_CM_single 0 0 -3.4E+38 3.4E+38 ECU_ADDRESS 0x0 /* @MemoryAddress@LSM_LRE_ELEM_1_C0@ */ /end MEASUREMENT
/begin MEASUREMENT LSM_LRE_ELEM_1_Range_Start "" FLOAT32_IEEE PubIfDecisionLSM_MDL_CM_single 0 0 -3.4E+38 3.4E+38 ECU_ADDRESS 0x0 /* @MemoryAddress@LSM_LRE_ELEM_1_Range_Start@ */ /end MEASUREMENT
/begin MEASUREMENT LSM_LA_ELEM_0_C2 "" FLOAT32_IEEE PubIfDecisionLSM_MDL_CM_single 0 0 -3.4E+38 3.4E+38 ECU_ADDRESS 0x0 /* @MemoryAddress@LSM_LA_ELEM_0_C2@ */ /end MEASUREMENT
/begin MEASUREMENT LSM_LA_ELEM_0_C3 "" FLOAT32_IEEE PubIfDecisionLSM_MDL_CM_single 0 0 -3.4E+38 3.4E+38 ECU_ADDRESS 0x0 /* @MemoryAddress@LSM_LA_ELEM_0_C3@ */ /end MEASUREMENT
/begin MEASUREMENT LSM_LA_ELEM_0_Range_Start "" FLOAT32_IEEE PubIfDecisionLSM_MDL_CM_single 0 0 -3.4E+38 3.4E+38 ECU_ADDRESS 0x0 /* @MemoryAddress@LSM_LA_ELEM_0_Range_Start@ */ /end MEASUREMENT
/begin MEASUREMENT LSM_LA_ELEM_0_Range_End "" FLOAT32_IEEE PubIfDecisionLSM_MDL_CM_single 0 0 -3.4E+38 3.4E+38 ECU_ADDRESS 0x0 /* @MemoryAddress@LSM_LA_ELEM_0_Range_End@ */ /end MEASUREMENT
/begin MEASUREMENT LSM_LA_ELEM_0_Marker_Width "" FLOAT32_IEEE PubIfDecisionLSM_MDL_CM_single 0 0 -3.4E+38 3.4E+38 ECU_ADDRESS 0x0 /* @MemoryAddress@LSM_LA_ELEM_0_Marker_Width@ */ /end MEASUREMENT
/begin MEASUREMENT LSM_LA_ELEM_0_Confidence "" FLOAT32_IEEE PubIfDecisionLSM_MDL_CM_single 0 0 -3.4E+38 3.4E+38 ECU_ADDRESS 0x0 /* @MemoryAddress@LSM_LA_ELEM_0_Confidence@ */ /end MEASUREMENT
/begin MEASUREMENT LSM_LA_ELEM_1_C0 "" FLOAT32_IEEE PubIfDecisionLSM_MDL_CM_single 0 0 -3.4E+38 3.4E+38 ECU_ADDRESS 0x0 /* @MemoryAddress@LSM_LA_ELEM_1_C0@ */ /end MEASUREMENT
/begin MEASUREMENT LSM_LA_ELEM_1_C1 "" FLOAT32_IEEE PubIfDecisionLSM_MDL_CM_single 0 0 -3.4E+38 3.4E+38 ECU_ADDRESS 0x0 /* @MemoryAddress@LSM_LA_ELEM_1_C1@ */ /end MEASUREMENT
/begin MEASUREMENT LSM_LA_ELEM_1_C2 "" FLOAT32_IEEE PubIfDecisionLSM_MDL_CM_single 0 0 -3.4E+38 3.4E+38 ECU_ADDRESS 0x0 /* @MemoryAddress@LSM_LA_ELEM_1_C2@ */ /end MEASUREMENT
/begin MEASUREMENT LSM_LA_ELEM_1_C3 "" FLOAT32_IEEE PubIfDecisionLSM_MDL_CM_single 0 0 -3.4E+38 3.4E+38 ECU_ADDRESS 0x0 /* @MemoryAddress@LSM_LA_ELEM_1_C3@ */ /end MEASUREMENT
/begin MEASUREMENT LSM_LA_ELEM_1_Range_Start "" FLOAT32_IEEE PubIfDecisionLSM_MDL_CM_single 0 0 -3.4E+38 3.4E+38 ECU_ADDRESS 0x0 /* @MemoryAddress@LSM_LA_ELEM_1_Range_Start@ */ /end MEASUREMENT
/begin MEASUREMENT LSM_LA_ELEM_1_Range_End "" FLOAT32_IEEE PubIfDecisionLSM_MDL_CM_single 0 0 -3.4E+38 3.4E+38 ECU_ADDRESS 0x0 /* @MemoryAddress@LSM_LA_ELEM_1_Range_End@ */ /end MEASUREMENT
/begin MEASUREMENT LSM_L2_Range "" FLOAT32_IEEE PubIfDecisionLSM_MDL_CM_single 0 0 -3.4E+38 3.4E+38 ECU_ADDRESS 0x0 /* @MemoryAddress@LSM_L2_Range@ */ /end MEASUREMENT
/begin MEASUREMENT LSM_LA_ELEM_1_Confidence "" FLOAT32_IEEE PubIfDecisionLSM_MDL_CM_single 0 0 -3.4E+38 3.4E+38 ECU_ADDRESS 0x0 /* @MemoryAddress@LSM_LA_ELEM_1_Confidence@ */ /end MEASUREMENT
/begin MEASUREMENT LSM_LA_ELEM_1_Marker_Width "" FLOAT32_IEEE PubIfDecisionLSM_MDL_CM_single 0 0 -3.4E+38 3.4E+38 ECU_ADDRESS 0x0 /* @MemoryAddress@LSM_LA_ELEM_1_Marker_Width@ */ /end MEASUREMENT
/begin MEASUREMENT LSM_LA_ELEM_2_C0 "" FLOAT32_IEEE PubIfDecisionLSM_MDL_CM_single 0 0 -3.4E+38 3.4E+38 ECU_ADDRESS 0x0 /* @MemoryAddress@LSM_LA_ELEM_2_C0@ */ /end MEASUREMENT
/begin MEASUREMENT LSM_LA_ELEM_2_C1 "" FLOAT32_IEEE PubIfDecisionLSM_MDL_CM_single 0 0 -3.4E+38 3.4E+38 ECU_ADDRESS 0x0 /* @MemoryAddress@LSM_LA_ELEM_2_C1@ */ /end MEASUREMENT
/begin MEASUREMENT LSM_LA_ELEM_2_C2 "" FLOAT32_IEEE PubIfDecisionLSM_MDL_CM_single 0 0 -3.4E+38 3.4E+38 ECU_ADDRESS 0x0 /* @MemoryAddress@LSM_LA_ELEM_2_C2@ */ /end MEASUREMENT
/begin MEASUREMENT LSM_LA_ELEM_2_C3 "" FLOAT32_IEEE PubIfDecisionLSM_MDL_CM_single 0 0 -3.4E+38 3.4E+38 ECU_ADDRESS 0x0 /* @MemoryAddress@LSM_LA_ELEM_2_C3@ */ /end MEASUREMENT
/begin MEASUREMENT LSM_LA_ELEM_2_Range_Start "" FLOAT32_IEEE PubIfDecisionLSM_MDL_CM_single 0 0 -3.4E+38 3.4E+38 ECU_ADDRESS 0x0 /* @MemoryAddress@LSM_LA_ELEM_2_Range_Start@ */ /end MEASUREMENT
/begin MEASUREMENT LSM_LA_ELEM_2_Range_End "" FLOAT32_IEEE PubIfDecisionLSM_MDL_CM_single 0 0 -3.4E+38 3.4E+38 ECU_ADDRESS 0x0 /* @MemoryAddress@LSM_LA_ELEM_2_Range_End@ */ /end MEASUREMENT
/begin MEASUREMENT LSM_LA_ELEM_2_Confidence "" FLOAT32_IEEE PubIfDecisionLSM_MDL_CM_single 0 0 -3.4E+38 3.4E+38 ECU_ADDRESS 0x0 /* @MemoryAddress@LSM_LA_ELEM_2_Confidence@ */ /end MEASUREMENT
/begin MEASUREMENT LSM_LA_ELEM_2_Marker_Width "" FLOAT32_IEEE PubIfDecisionLSM_MDL_CM_single 0 0 -3.4E+38 3.4E+38 ECU_ADDRESS 0x0 /* @MemoryAddress@LSM_LA_ELEM_2_Marker_Width@ */ /end MEASUREMENT
/begin MEASUREMENT LSM_LA_ELEM_3_C0 "" FLOAT32_IEEE PubIfDecisionLSM_MDL_CM_single 0 0 -3.4E+38 3.4E+38 ECU_ADDRESS 0x0 /* @MemoryAddress@LSM_LA_ELEM_3_C0@ */ /end MEASUREMENT
/begin MEASUREMENT LSM_LA_ELEM_3_C1 "" FLOAT32_IEEE PubIfDecisionLSM_MDL_CM_single 0 0 -3.4E+38 3.4E+38 ECU_ADDRESS 0x0 /* @MemoryAddress@LSM_LA_ELEM_3_C1@ */ /end MEASUREMENT
/begin MEASUREMENT LSM_LA_ELEM_3_C2 "" FLOAT32_IEEE PubIfDecisionLSM_MDL_CM_single 0 0 -3.4E+38 3.4E+38 ECU_ADDRESS 0x0 /* @MemoryAddress@LSM_LA_ELEM_3_C2@ */ /end MEASUREMENT
/begin MEASUREMENT LSM_LA_ELEM_3_C3 "" FLOAT32_IEEE PubIfDecisionLSM_MDL_CM_single 0 0 -3.4E+38 3.4E+38 ECU_ADDRESS 0x0 /* @MemoryAddress@LSM_LA_ELEM_3_C3@ */ /end MEASUREMENT
/begin MEASUREMENT LSM_LA_ELEM_3_Range_Start "" FLOAT32_IEEE PubIfDecisionLSM_MDL_CM_single 0 0 -3.4E+38 3.4E+38 ECU_ADDRESS 0x0 /* @MemoryAddress@LSM_LA_ELEM_3_Range_Start@ */ /end MEASUREMENT
/begin MEASUREMENT LSM_L3_Range "" FLOAT32_IEEE PubIfDecisionLSM_MDL_CM_single 0 0 -3.4E+38 3.4E+38 ECU_ADDRESS 0x0 /* @MemoryAddress@LSM_L3_Range@ */ /end MEASUREMENT
/begin MEASUREMENT LSM_LA_ELEM_3_Range_End "" FLOAT32_IEEE PubIfDecisionLSM_MDL_CM_single 0 0 -3.4E+38 3.4E+38 ECU_ADDRESS 0x0 /* @MemoryAddress@LSM_LA_ELEM_3_Range_End@ */ /end MEASUREMENT
/begin MEASUREMENT LSM_LA_ELEM_3_Confidence "" FLOAT32_IEEE PubIfDecisionLSM_MDL_CM_single 0 0 -3.4E+38 3.4E+38 ECU_ADDRESS 0x0 /* @MemoryAddress@LSM_LA_ELEM_3_Confidence@ */ /end MEASUREMENT
/begin MEASUREMENT LSM_LA_ELEM_3_Marker_Width "" FLOAT32_IEEE PubIfDecisionLSM_MDL_CM_single 0 0 -3.4E+38 3.4E+38 ECU_ADDRESS 0x0 /* @MemoryAddress@LSM_LA_ELEM_3_Marker_Width@ */ /end MEASUREMENT
/begin MEASUREMENT LSM_LH_ELEM_0_C0 "" FLOAT32_IEEE PubIfDecisionLSM_MDL_CM_single 0 0 -3.4E+38 3.4E+38 ECU_ADDRESS 0x0 /* @MemoryAddress@LSM_LH_ELEM_0_C0@ */ /end MEASUREMENT
/begin MEASUREMENT LSM_LH_ELEM_0_C1 "" FLOAT32_IEEE PubIfDecisionLSM_MDL_CM_single 0 0 -3.4E+38 3.4E+38 ECU_ADDRESS 0x0 /* @MemoryAddress@LSM_LH_ELEM_0_C1@ */ /end MEASUREMENT
/begin MEASUREMENT LSM_LH_ELEM_0_C2 "" FLOAT32_IEEE PubIfDecisionLSM_MDL_CM_single 0 0 -3.4E+38 3.4E+38 ECU_ADDRESS 0x0 /* @MemoryAddress@LSM_LH_ELEM_0_C2@ */ /end MEASUREMENT
/begin MEASUREMENT LSM_LH_ELEM_0_Confidence "" FLOAT32_IEEE PubIfDecisionLSM_MDL_CM_single 0 0 -3.4E+38 3.4E+38 ECU_ADDRESS 0x0 /* @MemoryAddress@LSM_LH_ELEM_0_Confidence@ */ /end MEASUREMENT
/begin MEASUREMENT LSM_LH_ELEM_0_C3 "" FLOAT32_IEEE PubIfDecisionLSM_MDL_CM_single 0 0 -3.4E+38 3.4E+38 ECU_ADDRESS 0x0 /* @MemoryAddress@LSM_LH_ELEM_0_C3@ */ /end MEASUREMENT
/begin MEASUREMENT LSM_LH_ELEM_0_VR_End "" FLOAT32_IEEE PubIfDecisionLSM_MDL_CM_single 0 0 -3.4E+38 3.4E+38 ECU_ADDRESS 0x0 /* @MemoryAddress@LSM_LH_ELEM_0_VR_End@ */ /end MEASUREMENT
/begin MEASUREMENT LSM_LH_ELEM_0_Marker_Width "" FLOAT32_IEEE PubIfDecisionLSM_MDL_CM_single 0 0 -3.4E+38 3.4E+38 ECU_ADDRESS 0x0 /* @MemoryAddress@LSM_LH_ELEM_0_Marker_Width@ */ /end MEASUREMENT
/begin MEASUREMENT LSM_L4_Range "" FLOAT32_IEEE PubIfDecisionLSM_MDL_CM_single 0 0 -3.4E+38 3.4E+38 ECU_ADDRESS 0x0 /* @MemoryAddress@LSM_L4_Range@ */ /end MEASUREMENT
/begin MEASUREMENT LSM_LH_ELEM_0_VR_Start "" FLOAT32_IEEE PubIfDecisionLSM_MDL_CM_single 0 0 -3.4E+38 3.4E+38 ECU_ADDRESS 0x0 /* @MemoryAddress@LSM_LH_ELEM_0_VR_Start@ */ /end MEASUREMENT
/begin MEASUREMENT LSM_LH_ELEM_1_C0 "" FLOAT32_IEEE PubIfDecisionLSM_MDL_CM_single 0 0 -3.4E+38 3.4E+38 ECU_ADDRESS 0x0 /* @MemoryAddress@LSM_LH_ELEM_1_C0@ */ /end MEASUREMENT
/begin MEASUREMENT LSM_LH_ELEM_1_C1 "" FLOAT32_IEEE PubIfDecisionLSM_MDL_CM_single 0 0 -3.4E+38 3.4E+38 ECU_ADDRESS 0x0 /* @MemoryAddress@LSM_LH_ELEM_1_C1@ */ /end MEASUREMENT
/begin MEASUREMENT LSM_LH_ELEM_1_C2 "" FLOAT32_IEEE PubIfDecisionLSM_MDL_CM_single 0 0 -3.4E+38 3.4E+38 ECU_ADDRESS 0x0 /* @MemoryAddress@LSM_LH_ELEM_1_C2@ */ /end MEASUREMENT
/begin MEASUREMENT LSM_LH_ELEM_1_Confidence "" FLOAT32_IEEE PubIfDecisionLSM_MDL_CM_single 0 0 -3.4E+38 3.4E+38 ECU_ADDRESS 0x0 /* @MemoryAddress@LSM_LH_ELEM_1_Confidence@ */ /end MEASUREMENT
/begin MEASUREMENT LSM_LH_ELEM_1_C3 "" FLOAT32_IEEE PubIfDecisionLSM_MDL_CM_single 0 0 -3.4E+38 3.4E+38 ECU_ADDRESS 0x0 /* @MemoryAddress@LSM_LH_ELEM_1_C3@ */ /end MEASUREMENT
/begin MEASUREMENT LSM_LH_ELEM_1_VR_Start "" FLOAT32_IEEE PubIfDecisionLSM_MDL_CM_single 0 0 -3.4E+38 3.4E+38 ECU_ADDRESS 0x0 /* @MemoryAddress@LSM_LH_ELEM_1_VR_Start@ */ /end MEASUREMENT
/begin MEASUREMENT LSM_LH_ELEM_1_Marker_Width "" FLOAT32_IEEE PubIfDecisionLSM_MDL_CM_single 0 0 -3.4E+38 3.4E+38 ECU_ADDRESS 0x0 /* @MemoryAddress@LSM_LH_ELEM_1_Marker_Width@ */ /end MEASUREMENT
/begin MEASUREMENT LSM_LH_ELEM_1_VR_End "" FLOAT32_IEEE PubIfDecisionLSM_MDL_CM_single 0 0 -3.4E+38 3.4E+38 ECU_ADDRESS 0x0 /* @MemoryAddress@LSM_LH_ELEM_1_VR_End@ */ /end MEASUREMENT
/begin MEASUREMENT LSM_LRE_ELEM_0_C1 "" FLOAT32_IEEE PubIfDecisionLSM_MDL_CM_single 0 0 -3.4E+38 3.4E+38 ECU_ADDRESS 0x0 /* @MemoryAddress@LSM_LRE_ELEM_0_C1@ */ /end MEASUREMENT
/begin MEASUREMENT LSM_LRE_ELEM_0_C2 "" FLOAT32_IEEE PubIfDecisionLSM_MDL_CM_single 0 0 -3.4E+38 3.4E+38 ECU_ADDRESS 0x0 /* @MemoryAddress@LSM_LRE_ELEM_0_C2@ */ /end MEASUREMENT
/begin MEASUREMENT LSM_LRE_ELEM_0_C3 "" FLOAT32_IEEE PubIfDecisionLSM_MDL_CM_single 0 0 -3.4E+38 3.4E+38 ECU_ADDRESS 0x0 /* @MemoryAddress@LSM_LRE_ELEM_0_C3@ */ /end MEASUREMENT
/begin MEASUREMENT LSM_LRE_ELEM_0_Range_End "" FLOAT32_IEEE PubIfDecisionLSM_MDL_CM_single 0 0 -3.4E+38 3.4E+38 ECU_ADDRESS 0x0 /* @MemoryAddress@LSM_LRE_ELEM_0_Range_End@ */ /end MEASUREMENT
/begin MEASUREMENT LSM_LA_ELEM_0_C0 "" FLOAT32_IEEE PubIfDecisionLSM_MDL_CM_single 0 0 -3.4E+38 3.4E+38 ECU_ADDRESS 0x0 /* @MemoryAddress@LSM_LA_ELEM_0_C0@ */ /end MEASUREMENT
/begin MEASUREMENT LSM_LRE_ELEM_0_Range_Start "" FLOAT32_IEEE PubIfDecisionLSM_MDL_CM_single 0 0 -3.4E+38 3.4E+38 ECU_ADDRESS 0x0 /* @MemoryAddress@LSM_LRE_ELEM_0_Range_Start@ */ /end MEASUREMENT
/begin MEASUREMENT LSM_LRE_ELEM_0_C0 "" FLOAT32_IEEE PubIfDecisionLSM_MDL_CM_single 0 0 -3.4E+38 3.4E+38 ECU_ADDRESS 0x0 /* @MemoryAddress@LSM_LRE_ELEM_0_C0@ */ /end MEASUREMENT
/begin MEASUREMENT LSM_LRE_ELEM_0_Confidence "" FLOAT32_IEEE PubIfDecisionLSM_MDL_CM_single 0 0 -3.4E+38 3.4E+38 ECU_ADDRESS 0x0 /* @MemoryAddress@LSM_LRE_ELEM_0_Confidence@ */ /end MEASUREMENT
/begin MEASUREMENT LSM_LRE_ELEM_1_Confidence "" FLOAT32_IEEE PubIfDecisionLSM_MDL_CM_single 0 0 -3.4E+38 3.4E+38 ECU_ADDRESS 0x0 /* @MemoryAddress@LSM_LRE_ELEM_1_Confidence@ */ /end MEASUREMENT
/begin MEASUREMENT LSM_LRE_ELEM_1_C1 "" FLOAT32_IEEE PubIfDecisionLSM_MDL_CM_single 0 0 -3.4E+38 3.4E+38 ECU_ADDRESS 0x0 /* @MemoryAddress@LSM_LRE_ELEM_1_C1@ */ /end MEASUREMENT
/begin MEASUREMENT LSM_LRE_ELEM_1_C2 "" FLOAT32_IEEE PubIfDecisionLSM_MDL_CM_single 0 0 -3.4E+38 3.4E+38 ECU_ADDRESS 0x0 /* @MemoryAddress@LSM_LRE_ELEM_1_C2@ */ /end MEASUREMENT
/begin MEASUREMENT LSM_LRE_ELEM_1_C3 "" FLOAT32_IEEE PubIfDecisionLSM_MDL_CM_single 0 0 -3.4E+38 3.4E+38 ECU_ADDRESS 0x0 /* @MemoryAddress@LSM_LRE_ELEM_1_C3@ */ /end MEASUREMENT
/begin MEASUREMENT LSM_LRE_ELEM_1_Range_End "" FLOAT32_IEEE PubIfDecisionLSM_MDL_CM_single 0 0 -3.4E+38 3.4E+38 ECU_ADDRESS 0x0 /* @MemoryAddress@LSM_LRE_ELEM_1_Range_End@ */ /end MEASUREMENT
/begin MEASUREMENT LSM_EN_C0 "" FLOAT32_IEEE PubIfDecisionLSM_MDL_CM_single 0 0 -3.4E+38 3.4E+38 ECU_ADDRESS 0x0 /* @MemoryAddress@LSM_EN_C0@ */ /end MEASUREMENT
/begin MEASUREMENT LSM_EN_C1 "" FLOAT32_IEEE PubIfDecisionLSM_MDL_CM_single 0 0 -3.4E+38 3.4E+38 ECU_ADDRESS 0x0 /* @MemoryAddress@LSM_EN_C1@ */ /end MEASUREMENT
/begin MEASUREMENT LSM_EN_C2 "" FLOAT32_IEEE PubIfDecisionLSM_MDL_CM_single 0 0 -3.4E+38 3.4E+38 ECU_ADDRESS 0x0 /* @MemoryAddress@LSM_EN_C2@ */ /end MEASUREMENT
/begin MEASUREMENT LSM_EN_C3 "" FLOAT32_IEEE PubIfDecisionLSM_MDL_CM_single 0 0 -3.4E+38 3.4E+38 ECU_ADDRESS 0x0 /* @MemoryAddress@LSM_EN_C3@ */ /end MEASUREMENT
/begin MEASUREMENT LSM_EN_Start "" FLOAT32_IEEE PubIfDecisionLSM_MDL_CM_single 0 0 -3.4E+38 3.4E+38 ECU_ADDRESS 0x0 /* @MemoryAddress@LSM_EN_Start@ */ /end MEASUREMENT
/begin MEASUREMENT LSM_EN_Front "" FLOAT32_IEEE PubIfDecisionLSM_MDL_CM_single 0 0 -3.4E+38 3.4E+38 ECU_ADDRESS 0x0 /* @MemoryAddress@LSM_EN_Front@ */ /end MEASUREMENT
/begin MEASUREMENT LSM_Exit_C0 "" FLOAT32_IEEE PubIfDecisionLSM_MDL_CM_single 0 0 -3.4E+38 3.4E+38 ECU_ADDRESS 0x0 /* @MemoryAddress@LSM_Exit_C0@ */ /end MEASUREMENT
/begin MEASUREMENT LSM_Exit_C1 "" FLOAT32_IEEE PubIfDecisionLSM_MDL_CM_single 0 0 -3.4E+38 3.4E+38 ECU_ADDRESS 0x0 /* @MemoryAddress@LSM_Exit_C1@ */ /end MEASUREMENT
/begin MEASUREMENT LSM_Exit_C2 "" FLOAT32_IEEE PubIfDecisionLSM_MDL_CM_single 0 0 -3.4E+38 3.4E+38 ECU_ADDRESS 0x0 /* @MemoryAddress@LSM_Exit_C2@ */ /end MEASUREMENT
/begin MEASUREMENT LSM_Exit_C3 "" FLOAT32_IEEE PubIfDecisionLSM_MDL_CM_single 0 0 -3.4E+38 3.4E+38 ECU_ADDRESS 0x0 /* @MemoryAddress@LSM_Exit_C3@ */ /end MEASUREMENT
/begin MEASUREMENT LSM_Exit_Start "" FLOAT32_IEEE PubIfDecisionLSM_MDL_CM_single 0 0 -3.4E+38 3.4E+38 ECU_ADDRESS 0x0 /* @MemoryAddress@LSM_Exit_Start@ */ /end MEASUREMENT
/begin MEASUREMENT LSM_Exit_Front "" FLOAT32_IEEE PubIfDecisionLSM_MDL_CM_single 0 0 -3.4E+38 3.4E+38 ECU_ADDRESS 0x0 /* @MemoryAddress@LSM_Exit_Front@ */ /end MEASUREMENT
/begin MEASUREMENT LSM_L3_AvaliTime "" FLOAT32_IEEE PubIfDecisionLSM_MDL_CM_single 0 0 -3.4E+38 3.4E+38 ECU_ADDRESS 0x0 /* @MemoryAddress@LSM_L3_AvaliTime@ */ /end MEASUREMENT
/begin MEASUREMENT LSM_L2_AvaliTime "" FLOAT32_IEEE PubIfDecisionLSM_MDL_CM_single 0 0 -3.4E+38 3.4E+38 ECU_ADDRESS 0x0 /* @MemoryAddress@LSM_L2_AvaliTime@ */ /end MEASUREMENT
/begin MEASUREMENT LSM_L1_AvaliDis "" FLOAT32_IEEE PubIfDecisionLSM_MDL_CM_single 0 0 -3.4E+38 3.4E+38 ECU_ADDRESS 0x0 /* @MemoryAddress@LSM_L1_AvaliDis@ */ /end MEASUREMENT
/begin MEASUREMENT LSM_L2_AvaliDis "" FLOAT32_IEEE PubIfDecisionLSM_MDL_CM_single 0 0 -3.4E+38 3.4E+38 ECU_ADDRESS 0x0 /* @MemoryAddress@LSM_L2_AvaliDis@ */ /end MEASUREMENT
/begin MEASUREMENT LSM_L1_AvaliTime "" FLOAT32_IEEE PubIfDecisionLSM_MDL_CM_single 0 0 -3.4E+38 3.4E+38 ECU_ADDRESS 0x0 /* @MemoryAddress@LSM_L1_AvaliTime@ */ /end MEASUREMENT
/begin MEASUREMENT LSM_L4_AvaliTime "" FLOAT32_IEEE PubIfDecisionLSM_MDL_CM_single 0 0 -3.4E+38 3.4E+38 ECU_ADDRESS 0x0 /* @MemoryAddress@LSM_L4_AvaliTime@ */ /end MEASUREMENT
/begin MEASUREMENT LSM_L3_AvaliDis "" FLOAT32_IEEE PubIfDecisionLSM_MDL_CM_single 0 0 -3.4E+38 3.4E+38 ECU_ADDRESS 0x0 /* @MemoryAddress@LSM_L3_AvaliDis@ */ /end MEASUREMENT
/begin MEASUREMENT LSM_L4_AvaliDis "" FLOAT32_IEEE PubIfDecisionLSM_MDL_CM_single 0 0 -3.4E+38 3.4E+38 ECU_ADDRESS 0x0 /* @MemoryAddress@LSM_L4_AvaliDis@ */ /end MEASUREMENT
/begin MEASUREMENT LSM_L1_A0 "" FLOAT32_IEEE PubIfDecisionLSM_MDL_CM_single 0 0 -3.4E+38 3.4E+38 ECU_ADDRESS 0x0 /* @MemoryAddress@LSM_L1_A0@ */ /end MEASUREMENT
/begin MEASUREMENT LSM_L2_A0 "" FLOAT32_IEEE PubIfDecisionLSM_MDL_CM_single 0 0 -3.4E+38 3.4E+38 ECU_ADDRESS 0x0 /* @MemoryAddress@LSM_L2_A0@ */ /end MEASUREMENT
/begin MEASUREMENT LSM_L3_A0 "" FLOAT32_IEEE PubIfDecisionLSM_MDL_CM_single 0 0 -3.4E+38 3.4E+38 ECU_ADDRESS 0x0 /* @MemoryAddress@LSM_L3_A0@ */ /end MEASUREMENT
/begin MEASUREMENT LSM_L4_A0 "" FLOAT32_IEEE PubIfDecisionLSM_MDL_CM_single 0 0 -3.4E+38 3.4E+38 ECU_ADDRESS 0x0 /* @MemoryAddress@LSM_L4_A0@ */ /end MEASUREMENT
/begin MEASUREMENT LSM_CurDis2 "" FLOAT32_IEEE PubIfDecisionLSM_MDL_CM_single 0 0 -3.4E+38 3.4E+38 ECU_ADDRESS 0x0 /* @MemoryAddress@LSM_CurDis2@ */ /end MEASUREMENT
/begin MEASUREMENT LSM_DeltaDis2 "" FLOAT32_IEEE PubIfDecisionLSM_MDL_CM_single 0 0 -3.4E+38 3.4E+38 ECU_ADDRESS 0x0 /* @MemoryAddress@LSM_DeltaDis2@ */ /end MEASUREMENT
/begin MEASUREMENT LSM_CurDis3 "" FLOAT32_IEEE PubIfDecisionLSM_MDL_CM_single 0 0 -3.4E+38 3.4E+38 ECU_ADDRESS 0x0 /* @MemoryAddress@LSM_CurDis3@ */ /end MEASUREMENT
/begin MEASUREMENT LSM_DeltaDis3 "" FLOAT32_IEEE PubIfDecisionLSM_MDL_CM_single 0 0 -3.4E+38 3.4E+38 ECU_ADDRESS 0x0 /* @MemoryAddress@LSM_DeltaDis3@ */ /end MEASUREMENT
/begin MEASUREMENT LSM_RoadWidth1 "" FLOAT32_IEEE PubIfDecisionLSM_MDL_CM_single 0 0 -3.4E+38 3.4E+38 ECU_ADDRESS 0x0 /* @MemoryAddress@LSM_RoadWidth1@ */ /end MEASUREMENT
/begin MEASUREMENT LSM_CentLineA3 "" FLOAT32_IEEE PubIfDecisionLSM_MDL_CM_single 0 0 -3.4E+38 3.4E+38 ECU_ADDRESS 0x0 /* @MemoryAddress@LSM_CentLineA3@ */ /end MEASUREMENT
/begin MEASUREMENT LSM_CentLineA2 "" FLOAT32_IEEE PubIfDecisionLSM_MDL_CM_single 0 0 -3.4E+38 3.4E+38 ECU_ADDRESS 0x0 /* @MemoryAddress@LSM_CentLineA2@ */ /end MEASUREMENT
/begin MEASUREMENT LSM_CentLineA1 "" FLOAT32_IEEE PubIfDecisionLSM_MDL_CM_single 0 0 -3.4E+38 3.4E+38 ECU_ADDRESS 0x0 /* @MemoryAddress@LSM_CentLineA1@ */ /end MEASUREMENT
/begin MEASUREMENT LSM_CentLineA0 "" FLOAT32_IEEE PubIfDecisionLSM_MDL_CM_single 0 0 -3.4E+38 3.4E+38 ECU_ADDRESS 0x0 /* @MemoryAddress@LSM_CentLineA0@ */ /end MEASUREMENT
/begin MEASUREMENT LSM_CentLineRange "" FLOAT32_IEEE PubIfDecisionLSM_MDL_CM_single 0 0 -3.4E+38 3.4E+38 ECU_ADDRESS 0x0 /* @MemoryAddress@LSM_CentLineRange@ */ /end MEASUREMENT
/begin MEASUREMENT LSM_CentQ "" FLOAT32_IEEE PubIfDecisionLSM_MDL_CM_single 0 0 -3.4E+38 3.4E+38 ECU_ADDRESS 0x0 /* @MemoryAddress@LSM_CentQ@ */ /end MEASUREMENT
/begin MEASUREMENT LSM_dDeltaX "" FLOAT32_IEEE PubIfDecisionLSM_MDL_CM_single 0 0 -3.4E+38 3.4E+38 ECU_ADDRESS 0x0 /* @MemoryAddress@LSM_dDeltaX@ */ /end MEASUREMENT
/begin MEASUREMENT LSM_dDeltaY "" FLOAT32_IEEE PubIfDecisionLSM_MDL_CM_single 0 0 -3.4E+38 3.4E+38 ECU_ADDRESS 0x0 /* @MemoryAddress@LSM_dDeltaY@ */ /end MEASUREMENT
/begin MEASUREMENT LSM_CosOfPsi "" FLOAT32_IEEE PubIfDecisionLSM_MDL_CM_single 0 0 -3.4E+38 3.4E+38 ECU_ADDRESS 0x0 /* @MemoryAddress@LSM_CosOfPsi@ */ /end MEASUREMENT
/begin MEASUREMENT LSM_SinOfsi "" FLOAT32_IEEE PubIfDecisionLSM_MDL_CM_single 0 0 -3.4E+38 3.4E+38 ECU_ADDRESS 0x0 /* @MemoryAddress@LSM_SinOfsi@ */ /end MEASUREMENT
/begin MEASUREMENT LSM_TJA_Line_State1 "" UBYTE PubIfDecisionLSM_MDL_CM_uint8 0 0 0 255 ECU_ADDRESS 0x0 /* @MemoryAddress@LSM_TJA_Line_State1@ */ /end MEASUREMENT
/begin MEASUREMENT LSM_HWASts "" UBYTE PubIfDecisionLSM_MDL_CM_uint8 0 0 0 255 ECU_ADDRESS 0x0 /* @MemoryAddress@LSM_HWASts@ */ /end MEASUREMENT
/begin MEASUREMENT LSM_OTL_Count "" UBYTE PubIfDecisionLSM_MDL_CM_uint8 0 0 0 255 ECU_ADDRESS 0x0 /* @MemoryAddress@LSM_OTL_Count@ */ /end MEASUREMENT
/begin MEASUREMENT LSM_RFM_LineCenter_Valid "" UBYTE PubIfDecisionLSM_MDL_CM_uint8 0 0 0 255 ECU_ADDRESS 0x0 /* @MemoryAddress@LSM_RFM_LineCenter_Valid@ */ /end MEASUREMENT
/begin MEASUREMENT LSM_RFM_LineR1_Valid "" UBYTE PubIfDecisionLSM_MDL_CM_uint8 0 0 0 255 ECU_ADDRESS 0x0 /* @MemoryAddress@LSM_RFM_LineR1_Valid@ */ /end MEASUREMENT
/begin MEASUREMENT LSM_RFM_LineL1_Valid "" UBYTE PubIfDecisionLSM_MDL_CM_uint8 0 0 0 255 ECU_ADDRESS 0x0 /* @MemoryAddress@LSM_RFM_LineL1_Valid@ */ /end MEASUREMENT
/begin MEASUREMENT LSM_L1_Conf "" UBYTE PubIfDecisionLSM_MDL_CM_uint8 0 0 0 255 ECU_ADDRESS 0x0 /* @MemoryAddress@LSM_L1_Conf@ */ /end MEASUREMENT
/begin MEASUREMENT LSM_LRE_ELEM_1_Line_Side "" UBYTE PubIfDecisionLSM_MDL_CM_uint8 0 0 0 255 ECU_ADDRESS 0x0 /* @MemoryAddress@LSM_LRE_ELEM_1_Line_Side@ */ /end MEASUREMENT
/begin MEASUREMENT LSM_LA_ELEM_0_Availability_State "" UBYTE PubIfDecisionLSM_MDL_CM_uint8 0 0 0 255 ECU_ADDRESS 0x0 /* @MemoryAddress@LSM_LA_ELEM_0_Availability_State@ */ /end MEASUREMENT
/begin MEASUREMENT LSM_LA_ELEM_0_Lanemark_Type "" UBYTE PubIfDecisionLSM_MDL_CM_uint8 0 0 0 255 ECU_ADDRESS 0x0 /* @MemoryAddress@LSM_LA_ELEM_0_Lanemark_Type@ */ /end MEASUREMENT
/begin MEASUREMENT LSM_LA_ELEM_0_DLM_Type "" UBYTE PubIfDecisionLSM_MDL_CM_uint8 0 0 0 255 ECU_ADDRESS 0x0 /* @MemoryAddress@LSM_LA_ELEM_0_DLM_Type@ */ /end MEASUREMENT
/begin MEASUREMENT LSM_LA_ELEM_0_Line_Side "" UBYTE PubIfDecisionLSM_MDL_CM_uint8 0 0 0 255 ECU_ADDRESS 0x0 /* @MemoryAddress@LSM_LA_ELEM_0_Line_Side@ */ /end MEASUREMENT
/begin MEASUREMENT LSM_L2_Conf "" UBYTE PubIfDecisionLSM_MDL_CM_uint8 0 0 0 255 ECU_ADDRESS 0x0 /* @MemoryAddress@LSM_L2_Conf@ */ /end MEASUREMENT
/begin MEASUREMENT LSM_LA_ELEM_1_Availability_State "" UBYTE PubIfDecisionLSM_MDL_CM_uint8 0 0 0 255 ECU_ADDRESS 0x0 /* @MemoryAddress@LSM_LA_ELEM_1_Availability_State@ */ /end MEASUREMENT
/begin MEASUREMENT LSM_LA_ELEM_1_Lanemark_Type "" UBYTE PubIfDecisionLSM_MDL_CM_uint8 0 0 0 255 ECU_ADDRESS 0x0 /* @MemoryAddress@LSM_LA_ELEM_1_Lanemark_Type@ */ /end MEASUREMENT
/begin MEASUREMENT LSM_LA_ELEM_1_DLM_Type "" UBYTE PubIfDecisionLSM_MDL_CM_uint8 0 0 0 255 ECU_ADDRESS 0x0 /* @MemoryAddress@LSM_LA_ELEM_1_DLM_Type@ */ /end MEASUREMENT
/begin MEASUREMENT LSM_LA_ELEM_1_Line_Side "" UBYTE PubIfDecisionLSM_MDL_CM_uint8 0 0 0 255 ECU_ADDRESS 0x0 /* @MemoryAddress@LSM_LA_ELEM_1_Line_Side@ */ /end MEASUREMENT
/begin MEASUREMENT LSM_LA_ELEM_2_Availability_State "" UBYTE PubIfDecisionLSM_MDL_CM_uint8 0 0 0 255 ECU_ADDRESS 0x0 /* @MemoryAddress@LSM_LA_ELEM_2_Availability_State@ */ /end MEASUREMENT
/begin MEASUREMENT LSM_L3_Conf "" UBYTE PubIfDecisionLSM_MDL_CM_uint8 0 0 0 255 ECU_ADDRESS 0x0 /* @MemoryAddress@LSM_L3_Conf@ */ /end MEASUREMENT
/begin MEASUREMENT LSM_LA_ELEM_2_Lanemark_Type "" UBYTE PubIfDecisionLSM_MDL_CM_uint8 0 0 0 255 ECU_ADDRESS 0x0 /* @MemoryAddress@LSM_LA_ELEM_2_Lanemark_Type@ */ /end MEASUREMENT
/begin MEASUREMENT LSM_LA_ELEM_2_DLM_Type "" UBYTE PubIfDecisionLSM_MDL_CM_uint8 0 0 0 255 ECU_ADDRESS 0x0 /* @MemoryAddress@LSM_LA_ELEM_2_DLM_Type@ */ /end MEASUREMENT
/begin MEASUREMENT LSM_LA_ELEM_2_Line_Side "" UBYTE PubIfDecisionLSM_MDL_CM_uint8 0 0 0 255 ECU_ADDRESS 0x0 /* @MemoryAddress@LSM_LA_ELEM_2_Line_Side@ */ /end MEASUREMENT
/begin MEASUREMENT LSM_LA_ELEM_3_Availability_State "" UBYTE PubIfDecisionLSM_MDL_CM_uint8 0 0 0 255 ECU_ADDRESS 0x0 /* @MemoryAddress@LSM_LA_ELEM_3_Availability_State@ */ /end MEASUREMENT
/begin MEASUREMENT LSM_LA_ELEM_3_Lanemark_Type "" UBYTE PubIfDecisionLSM_MDL_CM_uint8 0 0 0 255 ECU_ADDRESS 0x0 /* @MemoryAddress@LSM_LA_ELEM_3_Lanemark_Type@ */ /end MEASUREMENT
/begin MEASUREMENT LSM_LA_ELEM_3_DLM_Type "" UBYTE PubIfDecisionLSM_MDL_CM_uint8 0 0 0 255 ECU_ADDRESS 0x0 /* @MemoryAddress@LSM_LA_ELEM_3_DLM_Type@ */ /end MEASUREMENT
/begin MEASUREMENT LSM_LA_ELEM_3_Line_Side "" UBYTE PubIfDecisionLSM_MDL_CM_uint8 0 0 0 255 ECU_ADDRESS 0x0 /* @MemoryAddress@LSM_LA_ELEM_3_Line_Side@ */ /end MEASUREMENT
/begin MEASUREMENT LSM_LH_Count "" UBYTE PubIfDecisionLSM_MDL_CM_uint8 0 0 0 255 ECU_ADDRESS 0x0 /* @MemoryAddress@LSM_LH_Count@ */ /end MEASUREMENT
/begin MEASUREMENT LSM_L4_Conf "" UBYTE PubIfDecisionLSM_MDL_CM_uint8 0 0 0 255 ECU_ADDRESS 0x0 /* @MemoryAddress@LSM_L4_Conf@ */ /end MEASUREMENT
/begin MEASUREMENT LSM_LH_ELEM_0_Availability_State "" UBYTE PubIfDecisionLSM_MDL_CM_uint8 0 0 0 255 ECU_ADDRESS 0x0 /* @MemoryAddress@LSM_LH_ELEM_0_Availability_State@ */ /end MEASUREMENT
/begin MEASUREMENT LSM_LH_ELEM_0_Lanemark_Type "" UBYTE PubIfDecisionLSM_MDL_CM_uint8 0 0 0 255 ECU_ADDRESS 0x0 /* @MemoryAddress@LSM_LH_ELEM_0_Lanemark_Type@ */ /end MEASUREMENT
/begin MEASUREMENT LSM_LH_ELEM_0_DLM_Type "" UBYTE PubIfDecisionLSM_MDL_CM_uint8 0 0 0 255 ECU_ADDRESS 0x0 /* @MemoryAddress@LSM_LH_ELEM_0_DLM_Type@ */ /end MEASUREMENT
/begin MEASUREMENT LSM_LH_ELEM_0_Line_Side "" UBYTE PubIfDecisionLSM_MDL_CM_uint8 0 0 0 255 ECU_ADDRESS 0x0 /* @MemoryAddress@LSM_LH_ELEM_0_Line_Side@ */ /end MEASUREMENT
/begin MEASUREMENT LSM_LH_ELEM_0_Crossing "" UBYTE PubIfDecisionLSM_MDL_CM_uint8 0 0 0 255 ECU_ADDRESS 0x0 /* @MemoryAddress@LSM_LH_ELEM_0_Crossing@ */ /end MEASUREMENT
/begin MEASUREMENT LSM_LH_ELEM_1_Availability_State "" UBYTE PubIfDecisionLSM_MDL_CM_uint8 0 0 0 255 ECU_ADDRESS 0x0 /* @MemoryAddress@LSM_LH_ELEM_1_Availability_State@ */ /end MEASUREMENT
/begin MEASUREMENT LSM_LH_ELEM_1_Lanemark_Type "" UBYTE PubIfDecisionLSM_MDL_CM_uint8 0 0 0 255 ECU_ADDRESS 0x0 /* @MemoryAddress@LSM_LH_ELEM_1_Lanemark_Type@ */ /end MEASUREMENT
/begin MEASUREMENT LSM_LH_ELEM_1_DLM_Type "" UBYTE PubIfDecisionLSM_MDL_CM_uint8 0 0 0 255 ECU_ADDRESS 0x0 /* @MemoryAddress@LSM_LH_ELEM_1_DLM_Type@ */ /end MEASUREMENT
/begin MEASUREMENT LSM_LA_Adjacent_Count "" UBYTE PubIfDecisionLSM_MDL_CM_uint8 0 0 0 255 ECU_ADDRESS 0x0 /* @MemoryAddress@LSM_LA_Adjacent_Count@ */ /end MEASUREMENT
/begin MEASUREMENT LSM_LH_ELEM_1_Line_Side "" UBYTE PubIfDecisionLSM_MDL_CM_uint8 0 0 0 255 ECU_ADDRESS 0x0 /* @MemoryAddress@LSM_LH_ELEM_1_Line_Side@ */ /end MEASUREMENT
/begin MEASUREMENT LSM_LH_ELEM_1_Crossing "" UBYTE PubIfDecisionLSM_MDL_CM_uint8 0 0 0 255 ECU_ADDRESS 0x0 /* @MemoryAddress@LSM_LH_ELEM_1_Crossing@ */ /end MEASUREMENT
/begin MEASUREMENT LSM_LRE_Count "" UBYTE PubIfDecisionLSM_MDL_CM_uint8 0 0 0 255 ECU_ADDRESS 0x0 /* @MemoryAddress@LSM_LRE_Count@ */ /end MEASUREMENT
/begin MEASUREMENT LSM_LRE_ELEM_0_Line_Side "" UBYTE PubIfDecisionLSM_MDL_CM_uint8 0 0 0 255 ECU_ADDRESS 0x0 /* @MemoryAddress@LSM_LRE_ELEM_0_Line_Side@ */ /end MEASUREMENT
/begin MEASUREMENT LSM_LRE_ELEM_0_Availability_State "" UBYTE PubIfDecisionLSM_MDL_CM_uint8 0 0 0 255 ECU_ADDRESS 0x0 /* @MemoryAddress@LSM_LRE_ELEM_0_Availability_State@ */ /end MEASUREMENT
/begin MEASUREMENT LSM_LRE_ELEM_1_Availability_State "" UBYTE PubIfDecisionLSM_MDL_CM_uint8 0 0 0 255 ECU_ADDRESS 0x0 /* @MemoryAddress@LSM_LRE_ELEM_1_Availability_State@ */ /end MEASUREMENT
/begin MEASUREMENT LSM_EN_Valid "" UBYTE PubIfDecisionLSM_MDL_CM_uint8 0 0 0 255 ECU_ADDRESS 0x0 /* @MemoryAddress@LSM_EN_Valid@ */ /end MEASUREMENT
/begin MEASUREMENT LSM_Exit_Valid "" UBYTE PubIfDecisionLSM_MDL_CM_uint8 0 0 0 255 ECU_ADDRESS 0x0 /* @MemoryAddress@LSM_Exit_Valid@ */ /end MEASUREMENT
/begin MEASUREMENT LSM_LeftLineConf "" UBYTE PubIfDecisionLSM_MDL_CM_uint8 0 0 0 255 ECU_ADDRESS 0x0 /* @MemoryAddress@LSM_LeftLineConf@ */ /end MEASUREMENT
/begin MEASUREMENT LSM_RightLineConf "" UBYTE PubIfDecisionLSM_MDL_CM_uint8 0 0 0 255 ECU_ADDRESS 0x0 /* @MemoryAddress@LSM_RightLineConf@ */ /end MEASUREMENT
/begin MEASUREMENT LSM_TJA_Line_State "" UBYTE PubIfDecisionLSM_MDL_CM_uint8 0 0 0 255 ECU_ADDRESS 0x0 /* @MemoryAddress@LSM_TJA_Line_State@ */ /end MEASUREMENT
/begin MEASUREMENT LSM_Wij_State "" UBYTE PubIfDecisionLSM_MDL_CM_uint8 0 0 0 255 ECU_ADDRESS 0x0 /* @MemoryAddress@LSM_Wij_State@ */ /end MEASUREMENT
/begin MEASUREMENT LSM_Line_State "" UBYTE PubIfDecisionLSM_MDL_CM_uint8 0 0 0 255 ECU_ADDRESS 0x0 /* @MemoryAddress@LSM_Line_State@ */ /end MEASUREMENT
/begin MEASUREMENT LSM_LockCounter "" UBYTE PubIfDecisionLSM_MDL_CM_uint8 0 0 0 255 ECU_ADDRESS 0x0 /* @MemoryAddress@LSM_LockCounter@ */ /end MEASUREMENT
/begin MEASUREMENT LSM_MoveID "" SBYTE PubIfDecisionLSM_MDL_CM_int8 0 0 -128 127 ECU_ADDRESS 0x0 /* @MemoryAddress@LSM_MoveID@ */ /end MEASUREMENT
/begin MEASUREMENT LSM_LockID "" SBYTE PubIfDecisionLSM_MDL_CM_int8 0 0 -128 127 ECU_ADDRESS 0x0 /* @MemoryAddress@LSM_LockID@ */ /end MEASUREMENT
/begin MEASUREMENT LSM_LineValidK1 "" UBYTE PubIfDecisionLSM_MDL_CM_boolean 0 0 0 1 ECU_ADDRESS 0x0 /* @MemoryAddress@LSM_LineValidK1@ */ BIT_MASK 0x01 /end MEASUREMENT
/begin MEASUREMENT LSM_LeftMostLane "" UBYTE PubIfDecisionLSM_MDL_CM_boolean 0 0 0 1 ECU_ADDRESS 0x0 /* @MemoryAddress@LSM_LeftMostLane@ */ BIT_MASK 0x01 /end MEASUREMENT
/begin MEASUREMENT LSM_TJALineValid "" UBYTE PubIfDecisionLSM_MDL_CM_boolean 0 0 0 1 ECU_ADDRESS 0x0 /* @MemoryAddress@LSM_TJALineValid@ */ BIT_MASK 0x01 /end MEASUREMENT
/begin MEASUREMENT LSM_HWALineValid "" UBYTE PubIfDecisionLSM_MDL_CM_boolean 0 0 0 1 ECU_ADDRESS 0x0 /* @MemoryAddress@LSM_HWALineValid@ */ BIT_MASK 0x01 /end MEASUREMENT
/begin MEASUREMENT LSM_HWARiLineValid "" UBYTE PubIfDecisionLSM_MDL_CM_boolean 0 0 0 1 ECU_ADDRESS 0x0 /* @MemoryAddress@LSM_HWARiLineValid@ */ BIT_MASK 0x01 /end MEASUREMENT
/begin MEASUREMENT LSM_HWALeLineValid "" UBYTE PubIfDecisionLSM_MDL_CM_boolean 0 0 0 1 ECU_ADDRESS 0x0 /* @MemoryAddress@LSM_HWALeLineValid@ */ BIT_MASK 0x01 /end MEASUREMENT
/begin MEASUREMENT LSM_DoubleLineLost_b "" UBYTE PubIfDecisionLSM_MDL_CM_boolean 0 0 0 1 ECU_ADDRESS 0x0 /* @MemoryAddress@LSM_DoubleLineLost_b@ */ BIT_MASK 0x01 /end MEASUREMENT
/begin MEASUREMENT LSM_ESSLeLineValid "" UBYTE PubIfDecisionLSM_MDL_CM_boolean 0 0 0 1 ECU_ADDRESS 0x0 /* @MemoryAddress@LSM_ESSLeLineValid@ */ BIT_MASK 0x01 /end MEASUREMENT
/begin MEASUREMENT LSM_ESSLineValid "" UBYTE PubIfDecisionLSM_MDL_CM_boolean 0 0 0 1 ECU_ADDRESS 0x0 /* @MemoryAddress@LSM_ESSLineValid@ */ BIT_MASK 0x01 /end MEASUREMENT
/begin MEASUREMENT LSM_ESSRiLineValid "" UBYTE PubIfDecisionLSM_MDL_CM_boolean 0 0 0 1 ECU_ADDRESS 0x0 /* @MemoryAddress@LSM_ESSRiLineValid@ */ BIT_MASK 0x01 /end MEASUREMENT
/begin MEASUREMENT LSM_LCKLineValid "" UBYTE PubIfDecisionLSM_MDL_CM_boolean 0 0 0 1 ECU_ADDRESS 0x0 /* @MemoryAddress@LSM_LCKLineValid@ */ BIT_MASK 0x01 /end MEASUREMENT
/begin MEASUREMENT LSM_MLeLane "" UBYTE PubIfDecisionLSM_MDL_CM_boolean 0 0 0 1 ECU_ADDRESS 0x0 /* @MemoryAddress@LSM_MLeLane@ */ BIT_MASK 0x01 /end MEASUREMENT
/begin MEASUREMENT LSM_LeftLaneChange "" UBYTE PubIfDecisionLSM_MDL_CM_boolean 0 0 0 1 ECU_ADDRESS 0x0 /* @MemoryAddress@LSM_LeftLaneChange@ */ BIT_MASK 0x01 /end MEASUREMENT
/begin MEASUREMENT LSM_RightLaneChange "" UBYTE PubIfDecisionLSM_MDL_CM_boolean 0 0 0 1 ECU_ADDRESS 0x0 /* @MemoryAddress@LSM_RightLaneChange@ */ BIT_MASK 0x01 /end MEASUREMENT
/begin MEASUREMENT LSM_OTLineValid "" UBYTE PubIfDecisionLSM_MDL_CM_boolean 0 0 0 1 ECU_ADDRESS 0x0 /* @MemoryAddress@LSM_OTLineValid@ */ BIT_MASK 0x01 /end MEASUREMENT
/begin MEASUREMENT LSM_SingleLineLost_b "" UBYTE PubIfDecisionLSM_MDL_CM_boolean 0 0 0 1 ECU_ADDRESS 0x0 /* @MemoryAddress@LSM_SingleLineLost_b@ */ BIT_MASK 0x01 /end MEASUREMENT
/begin MEASUREMENT LSM_PathLaneAvail "" UBYTE PubIfDecisionLSM_MDL_CM_boolean 0 0 0 1 LAYOUT ROW_DIR MATRIX_DIM 3 1 1 ECU_ADDRESS 0x0 /* @MemoryAddress@LSM_PathLaneAvail@ */ BIT_MASK 0x01 /end MEASUREMENT
/begin MEASUREMENT LSM_LeftOffset_b "" UBYTE PubIfDecisionLSM_MDL_CM_boolean 0 0 0 1 ECU_ADDRESS 0x0 /* @MemoryAddress@LSM_LeftOffset_b@ */ BIT_MASK 0x01 /end MEASUREMENT
/begin MEASUREMENT LSM_RightOffset_b "" UBYTE PubIfDecisionLSM_MDL_CM_boolean 0 0 0 1 ECU_ADDRESS 0x0 /* @MemoryAddress@LSM_RightOffset_b@ */ BIT_MASK 0x01 /end MEASUREMENT
/begin MEASUREMENT LSM_LeftLineTypeEN "" UBYTE PubIfDecisionLSM_MDL_CM_boolean 0 0 0 1 ECU_ADDRESS 0x0 /* @MemoryAddress@LSM_LeftLineTypeEN@ */ BIT_MASK 0x01 /end MEASUREMENT
/begin MEASUREMENT LSM_RightLineTypeEN "" UBYTE PubIfDecisionLSM_MDL_CM_boolean 0 0 0 1 ECU_ADDRESS 0x0 /* @MemoryAddress@LSM_RightLineTypeEN@ */ BIT_MASK 0x01 /end MEASUREMENT
/begin MEASUREMENT LSM_DOP_EN "" UBYTE PubIfDecisionLSM_MDL_CM_boolean 0 0 0 1 ECU_ADDRESS 0x0 /* @MemoryAddress@LSM_DOP_EN@ */ BIT_MASK 0x01 /end MEASUREMENT
/begin MEASUREMENT LSM_DOP_Out "" UBYTE PubIfDecisionLSM_MDL_CM_boolean 0 0 0 1 ECU_ADDRESS 0x0 /* @MemoryAddress@LSM_DOP_Out@ */ BIT_MASK 0x01 /end MEASUREMENT
/begin MEASUREMENT LSM_LH1Valid "" UBYTE PubIfDecisionLSM_MDL_CM_boolean 0 0 0 1 ECU_ADDRESS 0x0 /* @MemoryAddress@LSM_LH1Valid@ */ BIT_MASK 0x01 /end MEASUREMENT
/begin MEASUREMENT LSM_LH2Valid "" UBYTE PubIfDecisionLSM_MDL_CM_boolean 0 0 0 1 ECU_ADDRESS 0x0 /* @MemoryAddress@LSM_LH2Valid@ */ BIT_MASK 0x01 /end MEASUREMENT
/begin MEASUREMENT LSM_CentLineValid "" UBYTE PubIfDecisionLSM_MDL_CM_boolean 0 0 0 1 ECU_ADDRESS 0x0 /* @MemoryAddress@LSM_CentLineValid@ */ BIT_MASK 0x01 /end MEASUREMENT
/begin MEASUREMENT LSM_VisLineUpdate "" UBYTE PubIfDecisionLSM_MDL_CM_boolean 0 0 0 1 ECU_ADDRESS 0x0 /* @MemoryAddress@LSM_VisLineUpdate@ */ BIT_MASK 0x01 /end MEASUREMENT
/begin MEASUREMENT LongCtrl_VLCState "" FLOAT64_IEEE PubIfControlLONC_MDL_CM_double 0 0 -1.7E+308 1.7E+308 ECU_ADDRESS 0x0 /* @MemoryAddress@LongCtrl_VLCState@ */ /end MEASUREMENT
/begin MEASUREMENT LongCtrl_tECDC "" FLOAT64_IEEE PubIfControlLONC_MDL_CM_double 0 0 -1.7E+308 1.7E+308 ECU_ADDRESS 0x0 /* @MemoryAddress@LongCtrl_tECDC@ */ /end MEASUREMENT
/begin MEASUREMENT LongCtrl_SubModel_VERSION "" ULONG PubIfControlLONC_MDL_CM_uint32 0 0 0 4294967295 ECU_ADDRESS 0x0 /* @MemoryAddress@LongCtrl_SubModel_VERSION@ */ /end MEASUREMENT
/begin MEASUREMENT LongCtrl_SubModel_Number "" ULONG PubIfControlLONC_MDL_CM_uint32 0 0 0 4294967295 ECU_ADDRESS 0x0 /* @MemoryAddress@LongCtrl_SubModel_Number@ */ /end MEASUREMENT
/begin MEASUREMENT LongCtrl_vxvRefMs "" FLOAT32_IEEE PubIfControlLONC_MDL_CM_single 0 0 -3.4E+38 3.4E+38 ECU_ADDRESS 0x0 /* @MemoryAddress@LongCtrl_vxvRefMs@ */ /end MEASUREMENT
/begin MEASUREMENT LongCtrl_axvRoadSlopeMs2 "" FLOAT32_IEEE PubIfControlLONC_MDL_CM_single 0 0 -3.4E+38 3.4E+38 ECU_ADDRESS 0x0 /* @MemoryAddress@LongCtrl_axvRoadSlopeMs2@ */ /end MEASUREMENT
/begin MEASUREMENT LongCtrl_OverrideToDC "" FLOAT32_IEEE PubIfControlLONC_MDL_CM_single 0 0 -3.4E+38 3.4E+38 ECU_ADDRESS 0x0 /* @MemoryAddress@LongCtrl_OverrideToDC@ */ /end MEASUREMENT
/begin MEASUREMENT Longctrl_NetEngTrq "" FLOAT32_IEEE PubIfControlLONC_MDL_CM_single 0 0 -3.4E+38 3.4E+38 ECU_ADDRESS 0x0 /* @MemoryAddress@Longctrl_NetEngTrq@ */ /end MEASUREMENT
/begin MEASUREMENT Longctrl_NetEngTorqNorm "" FLOAT32_IEEE PubIfControlLONC_MDL_CM_single 0 0 -3.4E+38 3.4E+38 ECU_ADDRESS 0x0 /* @MemoryAddress@Longctrl_NetEngTorqNorm@ */ /end MEASUREMENT
/begin MEASUREMENT Longctrl_EngSpd "" FLOAT32_IEEE PubIfControlLONC_MDL_CM_single 0 0 -3.4E+38 3.4E+38 ECU_ADDRESS 0x0 /* @MemoryAddress@Longctrl_EngSpd@ */ /end MEASUREMENT
/begin MEASUREMENT LongCtrl_Tr_Ratio "" FLOAT32_IEEE PubIfControlLONC_MDL_CM_single 0 0 -3.4E+38 3.4E+38 ECU_ADDRESS 0x0 /* @MemoryAddress@LongCtrl_Tr_Ratio@ */ /end MEASUREMENT
/begin MEASUREMENT Longctrl_VIE_axRefMs2 "" FLOAT32_IEEE PubIfControlLONC_MDL_CM_single 0 0 -3.4E+38 3.4E+38 ECU_ADDRESS 0x0 /* @MemoryAddress@Longctrl_VIE_axRefMs2@ */ /end MEASUREMENT
/begin MEASUREMENT Longctrl_ACC_axvCvAim "" FLOAT32_IEEE PubIfControlLONC_MDL_CM_single 0 0 -3.4E+38 3.4E+38 ECU_ADDRESS 0x0 /* @MemoryAddress@Longctrl_ACC_axvCvAim@ */ /end MEASUREMENT
/begin MEASUREMENT Longctrl_ACC_AccelerateJerk "" FLOAT32_IEEE PubIfControlLONC_MDL_CM_single 0 0 -3.4E+38 3.4E+38 ECU_ADDRESS 0x0 /* @MemoryAddress@Longctrl_ACC_AccelerateJerk@ */ /end MEASUREMENT
/begin MEASUREMENT Longctrl_ACC_DecelerateJerk "" FLOAT32_IEEE PubIfControlLONC_MDL_CM_single 0 0 -3.4E+38 3.4E+38 ECU_ADDRESS 0x0 /* @MemoryAddress@Longctrl_ACC_DecelerateJerk@ */ /end MEASUREMENT
/begin MEASUREMENT Longctrl_VIE_AxRefDt "" FLOAT32_IEEE PubIfControlLONC_MDL_CM_single 0 0 -3.4E+38 3.4E+38 ECU_ADDRESS 0x0 /* @MemoryAddress@Longctrl_VIE_AxRefDt@ */ /end MEASUREMENT
/begin MEASUREMENT Longctrl_EngTqMinAct "" FLOAT32_IEEE PubIfControlLONC_MDL_CM_single 0 0 -3.4E+38 3.4E+38 ECU_ADDRESS 0x0 /* @MemoryAddress@Longctrl_EngTqMinAct@ */ /end MEASUREMENT
/begin MEASUREMENT Longctrl_ACC_axv_ComfortBandLowerValue "" FLOAT32_IEEE PubIfControlLONC_MDL_CM_single 0 0 -3.4E+38 3.4E+38 ECU_ADDRESS 0x0 /* @MemoryAddress@Longctrl_ACC_axv_ComfortBandLowerValue@ */ /end MEASUREMENT
/begin MEASUREMENT Longctrl_ACC_axv_ComfortBandUpperValue "" FLOAT32_IEEE PubIfControlLONC_MDL_CM_single 0 0 -3.4E+38 3.4E+38 ECU_ADDRESS 0x0 /* @MemoryAddress@Longctrl_ACC_axv_ComfortBandUpperValue@ */ /end MEASUREMENT
/begin MEASUREMENT LongCtrl_PI_NetEngTorq "" FLOAT32_IEEE PubIfControlLONC_MDL_CM_single 0 0 -3.4E+38 3.4E+38 ECU_ADDRESS 0x0 /* @MemoryAddress@LongCtrl_PI_NetEngTorq@ */ /end MEASUREMENT
/begin MEASUREMENT LongCtrl_FF_NetEngTorq "" FLOAT32_IEEE PubIfControlLONC_MDL_CM_single 0 0 -3.4E+38 3.4E+38 ECU_ADDRESS 0x0 /* @MemoryAddress@LongCtrl_FF_NetEngTorq@ */ /end MEASUREMENT
/begin MEASUREMENT Longctrl_VIE_alpSideSlipAngle "" FLOAT32_IEEE PubIfControlLONC_MDL_CM_single 0 0 -3.4E+38 3.4E+38 ECU_ADDRESS 0x0 /* @MemoryAddress@Longctrl_VIE_alpSideSlipAngle@ */ /end MEASUREMENT
/begin MEASUREMENT Longctrl_EngTqMaxActSpd "" FLOAT32_IEEE PubIfControlLONC_MDL_CM_single 0 0 -3.4E+38 3.4E+38 ECU_ADDRESS 0x0 /* @MemoryAddress@Longctrl_EngTqMaxActSpd@ */ /end MEASUREMENT
/begin MEASUREMENT Longctrl_tCycleVLC "" FLOAT32_IEEE PubIfControlLONC_MDL_CM_single 0 0 -3.4E+38 3.4E+38 ECU_ADDRESS 0x0 /* @MemoryAddress@Longctrl_tCycleVLC@ */ /end MEASUREMENT
/begin MEASUREMENT LongCtrl_tEC "" FLOAT32_IEEE PubIfControlLONC_MDL_CM_single 0 0 -3.4E+38 3.4E+38 ECU_ADDRESS 0x0 /* @MemoryAddress@LongCtrl_tEC@ */ /end MEASUREMENT
/begin MEASUREMENT LongCtrl_Counter "" UBYTE PubIfControlLONC_MDL_CM_uint8 0 0 0 255 ECU_ADDRESS 0x0 /* @MemoryAddress@LongCtrl_Counter@ */ /end MEASUREMENT
/begin MEASUREMENT Longctrl_ACCSts "" UBYTE PubIfControlLONC_MDL_CM_uint8 0 0 0 255 ECU_ADDRESS 0x0 /* @MemoryAddress@Longctrl_ACCSts@ */ /end MEASUREMENT
/begin MEASUREMENT LongCtrl_RRWheelDriveDirection "" UBYTE PubIfControlLONC_MDL_CM_uint8 0 0 0 255 ECU_ADDRESS 0x0 /* @MemoryAddress@LongCtrl_RRWheelDriveDirection@ */ /end MEASUREMENT
/begin MEASUREMENT LongCtrl_RLWheelDriveDirection "" UBYTE PubIfControlLONC_MDL_CM_uint8 0 0 0 255 ECU_ADDRESS 0x0 /* @MemoryAddress@LongCtrl_RLWheelDriveDirection@ */ /end MEASUREMENT
/begin MEASUREMENT LongCtrl_FRWheelDriveDirection "" UBYTE PubIfControlLONC_MDL_CM_uint8 0 0 0 255 ECU_ADDRESS 0x0 /* @MemoryAddress@LongCtrl_FRWheelDriveDirection@ */ /end MEASUREMENT
/begin MEASUREMENT LongCtrl_FLWheelDriveDirection "" UBYTE PubIfControlLONC_MDL_CM_uint8 0 0 0 255 ECU_ADDRESS 0x0 /* @MemoryAddress@LongCtrl_FLWheelDriveDirection@ */ /end MEASUREMENT
/begin MEASUREMENT Longctrl_CurrentGear "" UBYTE PubIfControlLONC_MDL_CM_uint8 0 0 0 255 ECU_ADDRESS 0x0 /* @MemoryAddress@Longctrl_CurrentGear@ */ /end MEASUREMENT
/begin MEASUREMENT Longctrl_VehicleStandStill "" UBYTE PubIfControlLONC_MDL_CM_boolean 0 0 0 1 ECU_ADDRESS 0x0 /* @MemoryAddress@Longctrl_VehicleStandStill@ */ BIT_MASK 0x01 /end MEASUREMENT
/begin MEASUREMENT LongCtrl_Sw2EC "" UBYTE PubIfControlLONC_MDL_CM_boolean 0 0 0 1 ECU_ADDRESS 0x0 /* @MemoryAddress@LongCtrl_Sw2EC@ */ BIT_MASK 0x01 /end MEASUREMENT
/begin MEASUREMENT LongCtrl_Sw2DC "" UBYTE PubIfControlLONC_MDL_CM_boolean 0 0 0 1 ECU_ADDRESS 0x0 /* @MemoryAddress@LongCtrl_Sw2DC@ */ BIT_MASK 0x01 /end MEASUREMENT
/begin MEASUREMENT LongCtrl_VLC_DriveOffConditonFulfilled "" UBYTE PubIfControlLONC_MDL_CM_boolean 0 0 0 1 ECU_ADDRESS 0x0 /* @MemoryAddress@LongCtrl_VLC_DriveOffConditonFulfilled@ */ BIT_MASK 0x01 /end MEASUREMENT
/begin MEASUREMENT Longctrl_ACC_DrvOFF_Req "" UBYTE PubIfControlLONC_MDL_CM_boolean 0 0 0 1 ECU_ADDRESS 0x0 /* @MemoryAddress@Longctrl_ACC_DrvOFF_Req@ */ BIT_MASK 0x01 /end MEASUREMENT
/begin MEASUREMENT Longctrl_ShiftinProgress "" UBYTE PubIfControlLONC_MDL_CM_boolean 0 0 0 1 ECU_ADDRESS 0x0 /* @MemoryAddress@Longctrl_ShiftinProgress@ */ BIT_MASK 0x01 /end MEASUREMENT
/begin MEASUREMENT Longctrl_NoBrakeForce "" UBYTE PubIfControlLONC_MDL_CM_boolean 0 0 0 1 ECU_ADDRESS 0x0 /* @MemoryAddress@Longctrl_NoBrakeForce@ */ BIT_MASK 0x01 /end MEASUREMENT
/begin MEASUREMENT Longctrl_ACC_BrakePrefer "" UBYTE PubIfControlLONC_MDL_CM_boolean 0 0 0 1 ECU_ADDRESS 0x0 /* @MemoryAddress@Longctrl_ACC_BrakePrefer@ */ BIT_MASK 0x01 /end MEASUREMENT
/begin MEASUREMENT Longctrl_ACC_DecelToStopReq "" UBYTE PubIfControlLONC_MDL_CM_boolean 0 0 0 1 ECU_ADDRESS 0x0 /* @MemoryAddress@Longctrl_ACC_DecelToStopReq@ */ BIT_MASK 0x01 /end MEASUREMENT
/begin MEASUREMENT LongCtrl_ECEnable "" UBYTE PubIfControlLONC_MDL_CM_boolean 0 0 0 1 ECU_ADDRESS 0x0 /* @MemoryAddress@LongCtrl_ECEnable@ */ BIT_MASK 0x01 /end MEASUREMENT
/begin MEASUREMENT LongCtrl_DCEnable "" UBYTE PubIfControlLONC_MDL_CM_boolean 0 0 0 1 ECU_ADDRESS 0x0 /* @MemoryAddress@LongCtrl_DCEnable@ */ BIT_MASK 0x01 /end MEASUREMENT
/begin COMPU_METHOD Noa_Nofusion_CM_double "Q = V" RAT_FUNC "%15.10" "" COEFFS 0 1 0 0 0 1 /end COMPU_METHOD
/begin COMPU_METHOD Noa_Nofusion_CM_single_m "Q = V" RAT_FUNC "%8.6" "m" COEFFS 0 1 0 0 0 1 /end COMPU_METHOD
/begin COMPU_METHOD Noa_Nofusion_CM_single "Q = V" RAT_FUNC "%8.6" "" COEFFS 0 1 0 0 0 1 /end COMPU_METHOD
/begin COMPU_METHOD Noa_Nofusion_CM_uint8 "Q = V" RAT_FUNC "%3.0" "" COEFFS 0 1 0 0 0 1 /end COMPU_METHOD
/begin COMPU_METHOD Noa_Nofusion_CM_ufix16_En7 "Q = V*128.000000" RAT_FUNC "%10.7" "" COEFFS 0 128.000000 0.000000 0 0 1.000000 /end COMPU_METHOD
/begin COMPU_METHOD PubIfChassisHMI_MDL_CM_single "Q = V" RAT_FUNC "%8.6" "" COEFFS 0 1 0 0 0 1 /end COMPU_METHOD
/begin COMPU_METHOD PubIfChassisHMI_MDL_CM_uint8 "Q = V" RAT_FUNC "%3.0" "" COEFFS 0 1 0 0 0 1 /end COMPU_METHOD
/begin COMPU_METHOD PubIfCommonVIE_MDL_CM_single_m_s "Q = V" RAT_FUNC "%8.6" "m/s" COEFFS 0 1 0 0 0 1 /end COMPU_METHOD
/begin COMPU_METHOD PubIfCommonVIE_MDL_CM_single_m "Q = V" RAT_FUNC "%8.6" "m" COEFFS 0 1 0 0 0 1 /end COMPU_METHOD
/begin COMPU_METHOD PubIfCommonVIE_MDL_CM_single "Q = V" RAT_FUNC "%8.6" "" COEFFS 0 1 0 0 0 1 /end COMPU_METHOD
/begin COMPU_METHOD PubIfCommonVIE_MDL_CM_uint32 "Q = V" RAT_FUNC "%10.0" "" COEFFS 0 1 0 0 0 1 /end COMPU_METHOD
/begin COMPU_METHOD PubIfControlLATC_MDL_CM_single "Q = V" RAT_FUNC "%8.6" "" COEFFS 0 1 0 0 0 1 /end COMPU_METHOD
/begin COMPU_METHOD PubIfControlLATC_MDL_CM_uint8 "Q = V" RAT_FUNC "%3.0" "" COEFFS 0 1 0 0 0 1 /end COMPU_METHOD
/begin COMPU_METHOD PubIfControlLATC_MDL_CM_double "Q = V" RAT_FUNC "%15.10" "" COEFFS 0 1 0 0 0 1 /end COMPU_METHOD
/begin COMPU_METHOD PubIfControlLATC_MDL_CM_uint16 "Q = V" RAT_FUNC "%5.0" "" COEFFS 0 1 0 0 0 1 /end COMPU_METHOD
/begin COMPU_METHOD PubIfControlLATC_MDL_CM_boolean "Q = V" RAT_FUNC "%1.0" "" COEFFS 0 1 0 0 0 1 /end COMPU_METHOD
/begin COMPU_METHOD PubIfControlLATC_MDL_CM_uint32 "Q = V" RAT_FUNC "%10.0" "" COEFFS 0 1 0 0 0 1 /end COMPU_METHOD
/begin COMPU_METHOD PubIfDecisionLSM_MDL_CM_single "Q = V" RAT_FUNC "%8.6" "" COEFFS 0 1 0 0 0 1 /end COMPU_METHOD
/begin COMPU_METHOD PubIfDecisionLSM_MDL_CM_double "Q = V" RAT_FUNC "%15.10" "" COEFFS 0 1 0 0 0 1 /end COMPU_METHOD
/begin COMPU_METHOD PubIfDecisionLSM_MDL_CM_uint8 "Q = V" RAT_FUNC "%3.0" "" COEFFS 0 1 0 0 0 1 /end COMPU_METHOD
/begin COMPU_METHOD PubIfDecisionLSM_MDL_CM_uint32 "Q = V" RAT_FUNC "%10.0" "" COEFFS 0 1 0 0 0 1 /end COMPU_METHOD
/begin COMPU_METHOD PubIfDecisionLSM_MDL_CM_int8 "Q = V" RAT_FUNC "%3.0" "" COEFFS 0 1 0 0 0 1 /end COMPU_METHOD
/begin COMPU_METHOD PubIfDecisionLSM_MDL_CM_boolean "Q = V" RAT_FUNC "%1.0" "" COEFFS 0 1 0 0 0 1 /end COMPU_METHOD
/begin COMPU_METHOD PubIfControlLONC_MDL_CM_single "Q = V" RAT_FUNC "%8.6" "" COEFFS 0 1 0 0 0 1 /end COMPU_METHOD
/begin COMPU_METHOD PubIfControlLONC_MDL_CM_single_m "Q = V" RAT_FUNC "%8.6" "m" COEFFS 0 1 0 0 0 1 /end COMPU_METHOD
/begin COMPU_METHOD PubIfControlLONC_MDL_CM_boolean "Q = V" RAT_FUNC "%1.0" "" COEFFS 0 1 0 0 0 1 /end COMPU_METHOD
/begin COMPU_METHOD PubIfControlLONC_MDL_CM_double "Q = V" RAT_FUNC "%15.10" "" COEFFS 0 1 0 0 0 1 /end COMPU_METHOD
/begin COMPU_METHOD PubIfControlLONC_MDL_CM_uint32 "Q = V" RAT_FUNC "%10.0" "" COEFFS 0 1 0 0 0 1 /end COMPU_METHOD
/begin COMPU_METHOD PubIfControlLONC_MDL_CM_uint8 "Q = V" RAT_FUNC "%3.0" "" COEFFS 0 1 0 0 0 1 /end COMPU_METHOD
/begin GROUP Noa_Nofusion "Noa_Nofusion" /* Root */ ROOT
 /begin SUB_GROUP Root_Chassis1 Root_Common Root_Control1 Root_LPV Root_Subsystem1 Root_Subsystem4 Root_TOS /end SUB_GROUP
/end GROUP
/begin GROUP Root_Chassis1 "Noa_Nofusion/Chassis1" /begin SUB_GROUP S6_HMI /end SUB_GROUP /end GROUP
/begin GROUP Root_Common "Noa_Nofusion/Common" /begin SUB_GROUP PubIfCommonVIE_MDL /end SUB_GROUP /end GROUP
/begin GROUP Root_Control1 "Noa_Nofusion/Control1" /begin SUB_GROUP PubIfControlLATC_MDL PubIfControlLONC_MDL /end SUB_GROUP /begin REF_MEASUREMENT LongCtrl_VlcInternalAcc /end REF_MEASUREMENT /end GROUP
/begin GROUP Root_LPV "Noa_Nofusion/LPV" /begin SUB_GROUP S17_Subsystem5 S17_VSM PubIfDecisionPLAN_MDL /end SUB_GROUP /end GROUP
/begin GROUP Root_Subsystem1 "Noa_Nofusion/Subsystem1" /begin REF_CHARACTERISTIC P_RFM_RoadType P_RFM_mapvalid /end REF_CHARACTERISTIC /end GROUP
/begin GROUP Root_Subsystem4 "Noa_Nofusion/Subsystem4" /begin SUB_GROUP S22_Simulink_Function /end SUB_GROUP
 /begin REF_CHARACTERISTIC P_EQ4_BC0Gain P_Global_EQ2RearAxisX_m P_Global_EQ2RearAxisY_m /end REF_CHARACTERISTIC
 /begin REF_MEASUREMENT RFM_L1_bIsLineExist RFM_L1_dC0V RFM_L1_dC1V RFM_L1_dC3V RFM_L1_dDisFront RFM_L1_dDisStart RFM_L1_eLineType RFM_R1_bIsLineExist RFM_R1_dC0V RFM_R1_dC1V RFM_R1_dC2V RFM_R1_dC3V RFM_R1_dDisFront RFM_R1_dDisStart RFM_R1_eLineType /end REF_MEASUREMENT
/end GROUP
/begin GROUP Root_TOS "Noa_Nofusion/TOS" /begin SUB_GROUP S23_Subsystem2 /end SUB_GROUP /end GROUP
/begin GROUP S6_HMI "Noa_Nofusion/Chassis1/HMI" /begin SUB_GROUP PubIfChassisHMI_MDL /end SUB_GROUP /end GROUP
/begin GROUP S17_Subsystem5 "Noa_Nofusion/LPV/Subsystem5" /begin SUB_GROUP PubIfDecisionLSM_MDL /end SUB_GROUP /begin REF_MEASUREMENT LSM_Line_source /end REF_MEASUREMENT /end GROUP
/begin GROUP S17_VSM "Noa_Nofusion/LPV/VSM" /begin SUB_GROUP PubIfStateVSM_MDL /end SUB_GROUP /end GROUP
/begin GROUP S22_Simulink_Function "Noa_Nofusion/Subsystem4/Simulink Function" /begin REF_CHARACTERISTIC P_Global_EQ2RearAxisX_m P_Global_EQ2RearAxisY_m /end REF_CHARACTERISTIC /end GROUP
/begin GROUP S23_Subsystem2 "Noa_Nofusion/TOS/Subsystem2" /begin SUB_GROUP S170_ACCOSM S170_DOP S170_Subsystem /end SUB_GROUP /end GROUP
/begin GROUP S170_ACCOSM "Noa_Nofusion/TOS/Subsystem2/ACCOSM" /begin SUB_GROUP S172_HWA_Task100ms1 /end SUB_GROUP
 /begin REF_CHARACTERISTIC P_Global_SteeringAngleRatio P_HWA_TOS_P0HeadingAngle P_TOSS_DxOffset /end REF_CHARACTERISTIC
 /begin REF_MEASUREMENT dxP0 /end REF_MEASUREMENT
/end GROUP
/begin GROUP S170_DOP "Noa_Nofusion/TOS/Subsystem2/DOP" /begin SUB_GROUP S174_HWA_Task100ms1 /end SUB_GROUP /begin REF_CHARACTERISTIC P_Global_SteeringAngleRatio /end REF_CHARACTERISTIC /end GROUP
/begin GROUP S170_Subsystem "Noa_Nofusion/TOS/Subsystem2/Subsystem"
 /begin REF_MEASUREMENT EQ4_DX EQ4_Type LCKIE_DX LCKIE_DY LCKIE_ID LCKIE_VX Object_Type /end REF_MEASUREMENT
/end GROUP
/begin GROUP S172_HWA_Task100ms1 "Noa_Nofusion/TOS/Subsystem2/ACCOSM/HWA_Task100ms1" /begin SUB_GROUP S179_VxVy /end SUB_GROUP /begin REF_CHARACTERISTIC P_Global_DxvFrontBumper_m /end REF_CHARACTERISTIC /end GROUP
/begin GROUP S174_HWA_Task100ms1 "Noa_Nofusion/TOS/Subsystem2/DOP/HWA_Task100ms1" /begin SUB_GROUP S220_VxVy /end SUB_GROUP /begin REF_CHARACTERISTIC P_Global_DxvFrontBumper_m /end REF_CHARACTERISTIC /end GROUP
/begin GROUP S179_VxVy "Noa_Nofusion/TOS/Subsystem2/ACCOSM/HWA_Task100ms1/VxVy" /begin REF_CHARACTERISTIC P_Global_EQ2RearAxisX_m /end REF_CHARACTERISTIC /end GROUP
/begin GROUP S220_VxVy "Noa_Nofusion/TOS/Subsystem2/DOP/HWA_Task100ms1/VxVy" /begin REF_CHARACTERISTIC P_Global_EQ2RearAxisX_m /end REF_CHARACTERISTIC /end GROUP
/begin GROUP PubIfChassisHMI_MDL "PubIfChassisHMI_MDL" /begin SUB_GROUP Root_Subsystem /end SUB_GROUP /end GROUP
/begin GROUP Root_Subsystem "PubIfChassisHMI_MDL/Subsystem" /begin SUB_GROUP S1_HMI2_12 /end SUB_GROUP /begin REF_MEASUREMENT HMI_Counter /end REF_MEASUREMENT /end GROUP
/begin GROUP S1_HMI2_12 "PubIfChassisHMI_MDL/Subsystem/HMI2.12" /begin SUB_GROUP S3_HWA__ACC__TJA_Signal1 S3_IFC_Signal1 /end SUB_GROUP /end GROUP
/begin GROUP S3_HWA__ACC__TJA_Signal1 "PubIfChassisHMI_MDL/Subsystem/HMI2.12/HWA//ACC//TJA_Signal1"
 /begin SUB_GROUP S7_Subsystem S7_Subsystem1 S7_Subsystem2 S7_Subsystem3 S7_Subsystem4 S7_Subsystem5 /end SUB_GROUP
/end GROUP
/begin GROUP S3_IFC_Signal1 "PubIfChassisHMI_MDL/Subsystem/HMI2.12/IFC_Signal1" /begin REF_CHARACTERISTIC P_HMI_LDW_LKAWarnTime /end REF_CHARACTERISTIC /end GROUP
/begin GROUP S7_Subsystem "PubIfChassisHMI_MDL/Subsystem/HMI2.12/HWA//ACC//TJA_Signal1/Subsystem" /begin REF_CHARACTERISTIC P_HMI_ObjectTypeFilter /end REF_CHARACTERISTIC /end GROUP
/begin GROUP S7_Subsystem1 "PubIfChassisHMI_MDL/Subsystem/HMI2.12/HWA//ACC//TJA_Signal1/Subsystem1" /begin REF_CHARACTERISTIC P_HMI_ObjectTypeFilter /end REF_CHARACTERISTIC /end GROUP
/begin GROUP S7_Subsystem2 "PubIfChassisHMI_MDL/Subsystem/HMI2.12/HWA//ACC//TJA_Signal1/Subsystem2" /begin REF_CHARACTERISTIC P_HMI_ObjectTypeFilter /end REF_CHARACTERISTIC /end GROUP
/begin GROUP S7_Subsystem3 "PubIfChassisHMI_MDL/Subsystem/HMI2.12/HWA//ACC//TJA_Signal1/Subsystem3" /begin REF_CHARACTERISTIC P_HMI_ObjectTypeFilter /end REF_CHARACTERISTIC /end GROUP
/begin GROUP S7_Subsystem4 "PubIfChassisHMI_MDL/Subsystem/HMI2.12/HWA//ACC//TJA_Signal1/Subsystem4" /begin REF_CHARACTERISTIC P_HMI_ObjectTypeFilter /end REF_CHARACTERISTIC /end GROUP
/begin GROUP S7_Subsystem5 "PubIfChassisHMI_MDL/Subsystem/HMI2.12/HWA//ACC//TJA_Signal1/Subsystem5" /begin REF_CHARACTERISTIC P_HMI_ObjectTypeFilter /end REF_CHARACTERISTIC /end GROUP
/begin GROUP PubIfCommonVIE_MDL "PubIfCommonVIE_MDL" /begin SUB_GROUP Root_Subsystem_Reference /end SUB_GROUP /begin REF_MEASUREMENT VIE_SW_VERSION /end REF_MEASUREMENT /end GROUP
/begin GROUP Root_Subsystem_Reference "PubIfCommonVIE_MDL/Subsystem Reference" /begin SUB_GROUP S1_VIE /end SUB_GROUP /end GROUP
/begin GROUP S1_VIE "PubIfCommonVIE_MDL/Subsystem Reference/VIE" /begin SUB_GROUP S2_VIE /end SUB_GROUP /begin REF_MEASUREMENT VSM_SteerAngOffsetInit /end REF_MEASUREMENT /end GROUP
/begin GROUP S2_VIE "PubIfCommonVIE_MDL/Subsystem Reference/VIE/VIE" /begin SUB_GROUP S3_AxRef S3_VxvRef_Calc /end SUB_GROUP /begin REF_CHARACTERISTIC P_Global_WheelBase_m /end REF_CHARACTERISTIC /end GROUP
/begin GROUP S3_AxRef "PubIfCommonVIE_MDL/Subsystem Reference/VIE/VIE/AxRef" /begin SUB_GROUP S4_axvRoadSlope_calc /end SUB_GROUP /end GROUP
/begin GROUP S3_VxvRef_Calc "PubIfCommonVIE_MDL/Subsystem Reference/VIE/VIE/VxvRef_Calc" /begin SUB_GROUP S8_VxvRef_Calc /end SUB_GROUP
 /begin REF_CHARACTERISTIC P_Global_FrontAxleToCenter_m P_Global_RearAxleToCenter_m P_Global_WheelTrack_m /end REF_CHARACTERISTIC
/end GROUP
/begin GROUP S4_axvRoadSlope_calc "PubIfCommonVIE_MDL/Subsystem Reference/VIE/VIE/AxRef/axvRoadSlope_calc" /begin REF_CHARACTERISTIC P_Global_SideSlipAnglefactor /end REF_CHARACTERISTIC /end GROUP
/begin GROUP S8_VxvRef_Calc "PubIfCommonVIE_MDL/Subsystem Reference/VIE/VIE/VxvRef_Calc/VxvRef_Calc" /begin SUB_GROUP S19_If_Action_Subsystem /end SUB_GROUP
 /begin REF_CHARACTERISTIC P_Global_CharSpd_ms P_Global_SteeringAngleRatio P_Global_WheelBase_m /end REF_CHARACTERISTIC
 /begin REF_MEASUREMENT VSM_SteerAngleOffset_deg /end REF_MEASUREMENT
/end GROUP
/begin GROUP S19_If_Action_Subsystem "PubIfCommonVIE_MDL/Subsystem Reference/VIE/VIE/VxvRef_Calc/VxvRef_Calc/If Action Subsystem" /begin REF_CHARACTERISTIC P_Global_SteeringAngleRatio /end REF_CHARACTERISTIC /end GROUP
/begin GROUP PubIfControlLATC_MDL "PubIfControlLATC_MDL" /begin SUB_GROUP Root_Subsystem_Reference1 /end SUB_GROUP /end GROUP
/begin GROUP Root_Subsystem_Reference1 "PubIfControlLATC_MDL/Subsystem Reference" /begin SUB_GROUP S1_LATC /end SUB_GROUP /end GROUP
/begin GROUP S1_LATC "PubIfControlLATC_MDL/Subsystem Reference/LATC" /begin SUB_GROUP S2_LateralControl /end SUB_GROUP /begin REF_CHARACTERISTIC P_LCS_Trq_Switch /end REF_CHARACTERISTIC
 /begin REF_MEASUREMENT LCS_Counter LCS_SubModel_Number LCS_SubModel_VERSION LCS_Trq_Switch /end REF_MEASUREMENT
/end GROUP
/begin GROUP S2_LateralControl "PubIfControlLATC_MDL/Subsystem Reference/LATC/LateralControl" /begin SUB_GROUP S4_EPSFaultCheck S4_ESS_SteerSpd_Test S4_LCS_Angle /end SUB_GROUP /begin REF_CHARACTERISTIC P_LCS_IN_Offset_Test_SW P_LCS_IN_Offset_Test_Value /end REF_CHARACTERISTIC
 /begin REF_MEASUREMENT LCS_IN_CurrentLaneWidth LCS_IN_EPS_DrvInpTrqVal LCS_IN_EPS_FailSts LCS_IN_EPS_LKAAngDlvdSts LCS_IN_EPS_LKATorqOvrlDlvd LCS_IN_EPS_LKATorqOvrlDlvdVld LCS_IN_EPS_LKATrqOvlDlvdSts LCS_IN_SteerAngOffset_deg LCS_IN_SteerWheelAng LCS_IN_SteerWheelAngleSign LCS_IN_SteerWheelSpd LCS_IN_SteerWheelSpdSign LCS_IN_alpSideSlipAngle LCS_IN_axvRefMs2 LCS_IN_ayvRefMs2 LCS_IN_desLaneA0 LCS_IN_desLaneA1 LCS_IN_desLaneA2 LCS_IN_desLaneA3 LCS_IN_kapTraj LCS_IN_psiDtOpt LCS_IN_vxvRefMs LCS_OUT_AngCmdReqValVld /end REF_MEASUREMENT
/end GROUP
/begin GROUP S4_EPSFaultCheck "PubIfControlLATC_MDL/Subsystem Reference/LATC/LateralControl/EPSFaultCheck" /begin REF_MEASUREMENT LCS_EPSFault /end REF_MEASUREMENT /end GROUP
/begin GROUP S4_ESS_SteerSpd_Test "PubIfControlLATC_MDL/Subsystem Reference/LATC/LateralControl/ESS_SteerSpd_Test" /begin SUB_GROUP S16_LP_filter S16_LP_filter1 S16_NotActiveFlgDelayTime /end SUB_GROUP
 /begin REF_CHARACTERISTIC P_LCS_ESSOverrideTime1 P_LCS_ESSOverrideTime2 P_LCS_ESSOverrideTime3 P_LCS_ESSOverrideValue1 P_LCS_ESSOverrideValue2 P_LCS_ESS_LogicTest_Enable P_LCS_ESS_NotActiveFlgDelayTime P_LCS_ESS_NotActiveFlgDelayTimeSW P_LCS_ESS_SteerAngleErr P_LCS_ESS_SteerAngleFilterTime P_LCS_ESS_TarAngleFilterTime P_LCS_LATC_VehicleSpd_TabX_Kph /end REF_CHARACTERISTIC
 /begin REF_MEASUREMENT LCS_ESS_NotActiveFlg LCS_ESS_NotActiveFlg1 LCS_ESS_NotActiveFlg2 LCS_ESS_NotActiveFlg3 LCS_ESS_NotActiveFlgOriginal LCS_ESS_SteerWheelAngleSpd LCS_ESS_TarAngleSpd /end REF_MEASUREMENT
/end GROUP
/begin GROUP S4_LCS_Angle "PubIfControlLATC_MDL/Subsystem Reference/LATC/LateralControl/LCS_Angle"
 /begin SUB_GROUP S17_Lateral_Control S17_Motion_Planning S17_OverRideDetect S17_SteerAngleCorrect S17_Subsystem S17_Vehicle_Speed /end SUB_GROUP
 /begin REF_MEASUREMENT LCS_IN_TarDangerlLevel LCS_IN_TarDangerlLevel_Delay2Frame LCS_IN_desLaneValid /end REF_MEASUREMENT
/end GROUP
/begin GROUP S16_LP_filter "PubIfControlLATC_MDL/Subsystem Reference/LATC/LateralControl/ESS_SteerSpd_Test/LP filter" /begin REF_MEASUREMENT LCS_ESS_TarAngleSpdFilter /end REF_MEASUREMENT /end GROUP
/begin GROUP S16_LP_filter1 "PubIfControlLATC_MDL/Subsystem Reference/LATC/LateralControl/ESS_SteerSpd_Test/LP filter1" /begin REF_MEASUREMENT LCS_ESS_SteerWheelAngleSpdFilter /end REF_MEASUREMENT /end GROUP
/begin GROUP S16_NotActiveFlgDelayTime "PubIfControlLATC_MDL/Subsystem Reference/LATC/LateralControl/ESS_SteerSpd_Test/NotActiveFlgDelayTime" /begin REF_MEASUREMENT LCS_ESS_NotActiveDelayFlg /end REF_MEASUREMENT /end GROUP
/begin GROUP S17_Lateral_Control "PubIfControlLATC_MDL/Subsystem Reference/LATC/LateralControl/LCS_Angle/Lateral_Control" /begin SUB_GROUP S36_kinematics_MPC /end SUB_GROUP /end GROUP
/begin GROUP S17_Motion_Planning "PubIfControlLATC_MDL/Subsystem Reference/LATC/LateralControl/LCS_Angle/Motion_Planning" /begin SUB_GROUP S37_CartesianTrajectory_MPC /end SUB_GROUP /end GROUP
/begin GROUP S17_OverRideDetect "PubIfControlLATC_MDL/Subsystem Reference/LATC/LateralControl/LCS_Angle/OverRideDetect"
 /begin REF_CHARACTERISTIC P_LCS_DetNoOverRide_DrvTrq_TH P_LCS_DetOverRide_DrvTrq_TH P_LCS_NoOverRideTime_TH_s P_LCS_OverRideDetect_b P_LCS_OverRideTime_TH_s /end REF_CHARACTERISTIC
 /begin REF_MEASUREMENT LCS_OverRideDetect_b /end REF_MEASUREMENT
/end GROUP
/begin GROUP S17_SteerAngleCorrect "PubIfControlLATC_MDL/Subsystem Reference/LATC/LateralControl/LCS_Angle/SteerAngleCorrect"
 /begin REF_MEASUREMENT LCS_CurSteerAngle_deg LCS_IN_CurSteerAngle_deg LCS_IN_SteerAngleSpd_degs /end REF_MEASUREMENT
/end GROUP
/begin GROUP S17_Subsystem "PubIfControlLATC_MDL/Subsystem Reference/LATC/LateralControl/LCS_Angle/Subsystem" /begin REF_MEASUREMENT LCS_EqA0 /end REF_MEASUREMENT /end GROUP
/begin GROUP S17_Vehicle_Speed "PubIfControlLATC_MDL/Subsystem Reference/LATC/LateralControl/LCS_Angle/Vehicle_Speed" /begin REF_MEASUREMENT LCS_IN_Spd_Kph /end REF_MEASUREMENT /end GROUP
/begin GROUP S36_kinematics_MPC "PubIfControlLATC_MDL/Subsystem Reference/LATC/LateralControl/LCS_Angle/Lateral_Control/kinematics_MPC"
 /begin SUB_GROUP S42_Median_Filter S42_SteerAngSlopeCalc S42_Understeer_Offset_Calc /end SUB_GROUP
 /begin REF_CHARACTERISTIC P_Global_SteeringAngleRatio P_LCS_LATC_MPCDeltaT_s P_LCS_LATC_MPCMatrixQ1_st P_LCS_LATC_MPCMatrixQ2_st P_LCS_LATC_MPCMatrixR_st P_LCS_LATC_MPCMaxSterAngleSpd_degs P_LCS_LATC_MPCMaxSterAngle_deg P_LCS_LCC_HeadingErRrateTime_s P_LCS_LCC_HeadingErrTime_s P_LCS_LCC_LaterErrRateTime_s P_LCS_LCC_LaterErrTime_s P_LCS_LCC_RefThetaTime_s P_LCS_LCC_RefcurveTime_s P_LCS_VehicleSpd_TabX_Kph /end REF_CHARACTERISTIC
 /begin REF_MEASUREMENT LCS_LATC_CorrectSteerAngle_deg LCS_LATC_Feedback_deg LCS_LATC_Feedforward_deg LCS_LATC_MPCDeltaT_s LCS_LATC_MatrixResult_deg LCS_LATC_OutTrgSteerAngle LCS_LATC_SteerAngleCmd_deg LCS_LATC_SteerAngleLimit_deg LCS_LATC_TarAngle_deg /end REF_MEASUREMENT
/end GROUP
/begin GROUP S37_CartesianTrajectory_MPC "PubIfControlLATC_MDL/Subsystem Reference/LATC/LateralControl/LCS_Angle/Motion_Planning/CartesianTrajectory_MPC" /begin SUB_GROUP S62_Subsystem /end SUB_GROUP /begin REF_CHARACTERISTIC P_LCS_PLAN_DisFac_Tab_ratio P_LCS_PLAN_MinDis_m /end REF_CHARACTERISTIC
 /begin REF_MEASUREMENT LCS_LATC_PlanAyDt LCS_LATC_PlanLength LCS_LATC_PlanT LCS_PLAN_TrajectoryX LCS_PLAN_Trajectory_NumTraj LCS_PLAN_Trajectory_PlanY /end REF_MEASUREMENT
/end GROUP
/begin GROUP S42_Median_Filter "PubIfControlLATC_MDL/Subsystem Reference/LATC/LateralControl/LCS_Angle/Lateral_Control/kinematics_MPC/Median_Filter" /begin REF_CHARACTERISTIC P_LCS_LATC_TarAngleFliterWindowSize /end REF_CHARACTERISTIC /begin REF_MEASUREMENT LCS_LATC_TarAngleFilter_deg /end REF_MEASUREMENT /end GROUP
/begin GROUP S42_SteerAngSlopeCalc "PubIfControlLATC_MDL/Subsystem Reference/LATC/LateralControl/LCS_Angle/Lateral_Control/kinematics_MPC/SteerAngSlopeCalc" /begin SUB_GROUP S51_Switch_Case_Action_Subsystem /end SUB_GROUP
 /begin REF_CHARACTERISTIC P_LCS_LATC_ELKAngleSlope_ratio P_LCS_LATC_ELKMaxLatAcc_ms2 P_LCS_LATC_ESSAngleSlope_ratio P_LCS_LATC_ESSMaxLatAcc_ms2 P_LCS_LATC_LCAngleSlope_ratio P_LCS_LATC_LCCancleMaxLatAcc_ms2 P_LCS_LATC_LCEcoAngleSlope_ratio P_LCS_LATC_LCEcoMaxLatAcc_ms2 P_LCS_LATC_LCKAngleSlope_ratio P_LCS_LATC_LCKIEAngleSlope_ratio P_LCS_LATC_LCKIEMaxLatAcc_ms2 P_LCS_LATC_LCKMaxLatAcc_ms2 P_LCS_LATC_LCNormalAngleSlope_ratio P_LCS_LATC_LCNormalMaxLatAcc_ms2 P_LCS_LATC_LCSportAngleSlope_ratio P_LCS_LATC_LCSportMaxLatAcc_ms2 P_LCS_LATC_LKAAngleSlope_ratio P_LCS_LATC_LKAMaxLatAcc_ms2 P_LCS_LATC_StateHoldTime_st P_LCS_VehicleSpd_TabX_Kph /end REF_CHARACTERISTIC
 /begin REF_MEASUREMENT LCS_LATC_AngleSlopeFlg_st LCS_LATC_HoldTime_s LCS_LATC_MaxAy_ms2 LCS_LATC_StateActAngleSlope_degs LCS_LATC_StateAngleSlope_degs /end REF_MEASUREMENT
/end GROUP
/begin GROUP S42_Understeer_Offset_Calc "PubIfControlLATC_MDL/Subsystem Reference/LATC/LateralControl/LCS_Angle/Lateral_Control/kinematics_MPC/Understeer&Offset_Calc" /begin SUB_GROUP S53_Enabled_Subsystem /end SUB_GROUP
 /begin REF_CHARACTERISTIC P_Global_CharSpd_ms P_Global_SteeringAngleRatio P_Global_WheelBase_m P_LCS_LATC_CurOffsetA2FliterT_s P_LCS_LATC_CurOffsetVehicleSpdLimitValue_degs /end REF_CHARACTERISTIC
 /begin REF_MEASUREMENT LCS_OffSetUpdate_Flg /end REF_MEASUREMENT
/end GROUP
/begin GROUP S62_Subsystem "PubIfControlLATC_MDL/Subsystem Reference/LATC/LateralControl/LCS_Angle/Motion_Planning/CartesianTrajectory_MPC/Subsystem" /begin SUB_GROUP S64_LP_filter S64_Subsystem /end SUB_GROUP
 /begin REF_CHARACTERISTIC P_LCS_PLAN_A2FliterTime_s P_LCS_PLAN_DesLineA0_TabY_m P_LCS_PLAN_LCKAyDtLimit_Tab_ms3 P_LCS_PLAN_LCPreDisFac_ratio P_LCS_PLAN_PreDisCurve_TabX_m P_LCS_PLAN_PreDis_Tab_m P_LCS_PLAN_StateHoldTime_st P_LCS_PLAN_TarDangerlLevel_Tabx_st P_LCS_PLAN_VehicleSpd_TabY_Kph P_LCS_PlLAN_PreDisFac_Tab_ratio P_LCS_Plan_A2Pretime_s P_LCS_Plan_ELKAyDtLimit_Tab_ms3 P_LCS_Plan_LCAyDtLimit_Tab_ms3 P_LCS_Plan_LCKIEAyDtLimit_Tab_ms3 P_LCS_Plan_LCNomalAyDtLimit_Tab_ms3 P_LCS_Plan_LCSportAyDtLimit_Tab_ms3 P_LCS_Plan_LKAAyDtLimit_Tab_ms3 /end REF_CHARACTERISTIC
 /begin REF_MEASUREMENT LCS_Plan_AyDtlimit LCS_Plan_FinalpreDis /end REF_MEASUREMENT
/end GROUP
/begin GROUP S51_Switch_Case_Action_Subsystem "PubIfControlLATC_MDL/Subsystem Reference/LATC/LateralControl/LCS_Angle/Lateral_Control/kinematics_MPC/SteerAngSlopeCalc/Switch Case Action Subsystem"
 /begin REF_CHARACTERISTIC P_LCS_LATC_StateActivAngleSlopeLimit_ratio P_LCS_LATC_StateActiveFlg_TabX_st P_LCS_LATC_StateActiveHoldTime_TabY_st /end REF_CHARACTERISTIC
/end GROUP
/begin GROUP S53_Enabled_Subsystem "PubIfControlLATC_MDL/Subsystem Reference/LATC/LateralControl/LCS_Angle/Lateral_Control/kinematics_MPC/Understeer&Offset_Calc/Enabled Subsystem"
 /begin REF_CHARACTERISTIC P_Global_SteeringAngleRatio P_LCS_LATC_CurOffsetCurveFliterTime_Tab_s P_LCS_LATC_CurOffsetCurve_TabX_m /end REF_CHARACTERISTIC
 /begin REF_MEASUREMENT LCS_LATC_CurrentSteerAngleOffset_deg /end REF_MEASUREMENT
/end GROUP
/begin GROUP S64_LP_filter "PubIfControlLATC_MDL/Subsystem Reference/LATC/LateralControl/LCS_Angle/Motion_Planning/CartesianTrajectory_MPC/Subsystem/LP filter" /begin REF_MEASUREMENT LCS_PreDisCurve_m /end REF_MEASUREMENT /end GROUP
/begin GROUP S64_Subsystem "PubIfControlLATC_MDL/Subsystem Reference/LATC/LateralControl/LCS_Angle/Motion_Planning/CartesianTrajectory_MPC/Subsystem/Subsystem"
 /begin SUB_GROUP S68_Switch_Case_Action_Subsystem S68_Switch_Case_Action_Subsystem2 S68_Switch_Case_Action_Subsystem5 /end SUB_GROUP
/end GROUP
/begin GROUP S68_Switch_Case_Action_Subsystem "PubIfControlLATC_MDL/Subsystem Reference/LATC/LateralControl/LCS_Angle/Motion_Planning/CartesianTrajectory_MPC/Subsystem/Subsystem/Switch Case Action Subsystem"
 /begin REF_CHARACTERISTIC P_LCS_PLAN_StateActivAngleSlope_Tab_ratio P_LCS_PLAN_StateActiveFlg_TabX_st P_LCS_PLAN_StateActiveHoldTime_TabY_s /end REF_CHARACTERISTIC
/end GROUP
/begin GROUP S68_Switch_Case_Action_Subsystem2 "PubIfControlLATC_MDL/Subsystem Reference/LATC/LateralControl/LCS_Angle/Motion_Planning/CartesianTrajectory_MPC/Subsystem/Subsystem/Switch Case Action Subsystem2"
 /begin REF_CHARACTERISTIC P_LCS_PLAN_StateActiveHoldTime_TabY_s P_LCS_PLAN_StateCompleteAngleSlope_Tab_ratio P_LCS_PLAN_StateCompleteFlg_TabX_st /end REF_CHARACTERISTIC
/end GROUP
/begin GROUP S68_Switch_Case_Action_Subsystem5 "PubIfControlLATC_MDL/Subsystem Reference/LATC/LateralControl/LCS_Angle/Motion_Planning/CartesianTrajectory_MPC/Subsystem/Subsystem/Switch Case Action Subsystem5"
 /begin REF_CHARACTERISTIC P_LCS_PLAN_LCCompletePreDisFac_Tab_ratio P_LCS_PLAN_StateActiveHoldTime_TabY_s P_LCS_PLAN_StateCompleteFlg_TabX_st /end REF_CHARACTERISTIC
/end GROUP
/begin GROUP PubIfDecisionLSM_MDL "PubIfDecisionLSM_MDL" /begin SUB_GROUP Root_Subsystem11 /end SUB_GROUP /end GROUP
/begin GROUP Root_Subsystem11 "PubIfDecisionLSM_MDL/Subsystem1" /begin SUB_GROUP S1_LSM_Signal S1_TargetLineCalc_20ms /end SUB_GROUP
 /begin REF_MEASUREMENT LSM_RFM_LineCenter_C0 LSM_RFM_LineCenter_C1 LSM_RFM_LineCenter_C2 LSM_RFM_LineCenter_C3 LSM_RFM_LineCenter_Front LSM_RFM_LineCenter_Start LSM_RFM_LineCenter_Valid LSM_RFM_LineL1_C0 LSM_RFM_LineL1_C1 LSM_RFM_LineL1_C2 LSM_RFM_LineL1_C3 LSM_RFM_LineL1_Front LSM_RFM_LineL1_Start LSM_RFM_LineL1_Valid LSM_RFM_LineR1_C0 LSM_RFM_LineR1_C1 LSM_RFM_LineR1_C2 LSM_RFM_LineR1_C3 LSM_RFM_LineR1_Front LSM_RFM_LineR1_Start LSM_RFM_LineR1_Valid /end REF_MEASUREMENT
/end GROUP
/begin GROUP S1_LSM_Signal "PubIfDecisionLSM_MDL/Subsystem1/LSM_Signal"
 /begin REF_MEASUREMENT LSM_DoubleLineLost_b LSM_ESSLeLineC0 LSM_ESSLeLineC1 LSM_ESSLeLineC2 LSM_ESSLeLineC3 LSM_ESSLeLineValid LSM_ESSLeRange LSM_ESSLineC0 LSM_ESSLineC1 LSM_ESSLineC2 LSM_ESSLineC3 LSM_ESSLineValid LSM_ESSRange LSM_ESSRiLineC0 LSM_ESSRiLineC1 LSM_ESSRiLineC2 LSM_ESSRiLineC3 LSM_ESSRiLineValid LSM_ESSRiRange LSM_HWALeLineC0 LSM_HWALeLineC1 LSM_HWALeLineC2 LSM_HWALeLineC3 LSM_HWALeLineValid LSM_HWALeRange LSM_HWALineC0 LSM_HWALineC1 LSM_HWALineC2 LSM_HWALineC3 LSM_HWALineValid LSM_HWARange LSM_HWARiLineC0 LSM_HWARiLineC1 LSM_HWARiLineC2 LSM_HWARiLineC3 LSM_HWARiLineValid LSM_HWARiRange LSM_HeadAngDiff LSM_LCKLineC0 LSM_LCKLineC1 LSM_LCKLineC2 LSM_LCKLineC3 LSM_LCKLineValid LSM_LCKRange LSM_LeftLaneChange LSM_MLeLane LSM_OTL_A0 LSM_OTL_A1 LSM_OTL_A2 LSM_OTL_A3 LSM_OTL_Count LSM_OTL_Range LSM_OTLineValid LSM_RightLaneChange LSM_RoadWidth LSM_SingleLineLost_b LSM_TJALineC0 LSM_TJALineC1 LSM_TJALineC2 LSM_TJALineC3 LSM_TJALineValid LSM_TJARange LSM_UpdateCnt LSM_dyDiff /end REF_MEASUREMENT
/end GROUP
/begin GROUP S1_TargetLineCalc_20ms "PubIfDecisionLSM_MDL/Subsystem1/TargetLineCalc_20ms" /begin SUB_GROUP S4_Simulink_Function S4_TargetLineCalc /end SUB_GROUP
 /begin REF_MEASUREMENT LSM_L1_Conf LSM_L1_Range LSM_L2_Conf LSM_L2_Range LSM_L3_Conf LSM_L3_Range LSM_L4_Conf LSM_L4_Range LSM_LA_Adjacent_Count LSM_LA_ELEM_0_Availability_State LSM_LA_ELEM_0_C0 LSM_LA_ELEM_0_C1 LSM_LA_ELEM_0_C2 LSM_LA_ELEM_0_C3 LSM_LA_ELEM_0_Confidence LSM_LA_ELEM_0_DLM_Type LSM_LA_ELEM_0_Lanemark_Type LSM_LA_ELEM_0_Line_Side LSM_LA_ELEM_0_Marker_Width LSM_LA_ELEM_0_Range_End LSM_LA_ELEM_0_Range_Start LSM_LA_ELEM_1_Availability_State LSM_LA_ELEM_1_C0 LSM_LA_ELEM_1_C1 LSM_LA_ELEM_1_C2 LSM_LA_ELEM_1_C3 LSM_LA_ELEM_1_Confidence LSM_LA_ELEM_1_DLM_Type LSM_LA_ELEM_1_Lanemark_Type LSM_LA_ELEM_1_Line_Side LSM_LA_ELEM_1_Marker_Width LSM_LA_ELEM_1_Range_End LSM_LA_ELEM_1_Range_Start LSM_LA_ELEM_2_Availability_State LSM_LA_ELEM_2_C0 LSM_LA_ELEM_2_C1 LSM_LA_ELEM_2_C2 LSM_LA_ELEM_2_C3 LSM_LA_ELEM_2_Confidence LSM_LA_ELEM_2_DLM_Type LSM_LA_ELEM_2_Lanemark_Type LSM_LA_ELEM_2_Line_Side LSM_LA_ELEM_2_Marker_Width LSM_LA_ELEM_2_Range_End LSM_LA_ELEM_2_Range_Start LSM_LA_ELEM_3_Availability_State LSM_LA_ELEM_3_C0 LSM_LA_ELEM_3_C1 LSM_LA_ELEM_3_C2 LSM_LA_ELEM_3_C3 LSM_LA_ELEM_3_Confidence LSM_LA_ELEM_3_DLM_Type LSM_LA_ELEM_3_Lanemark_Type LSM_LA_ELEM_3_Line_Side LSM_LA_ELEM_3_Marker_Width LSM_LA_ELEM_3_Range_End LSM_LA_ELEM_3_Range_Start LSM_LH_Count LSM_LH_ELEM_0_Availability_State LSM_LH_ELEM_0_C0 LSM_LH_ELEM_0_C1 LSM_LH_ELEM_0_C2 LSM_LH_ELEM_0_C3 LSM_LH_ELEM_0_Confidence LSM_LH_ELEM_0_Crossing LSM_LH_ELEM_0_DLM_Type LSM_LH_ELEM_0_Lanemark_Type LSM_LH_ELEM_0_Line_Side LSM_LH_ELEM_0_Marker_Width LSM_LH_ELEM_0_VR_End LSM_LH_ELEM_0_VR_Start LSM_LH_ELEM_1_Availability_State LSM_LH_ELEM_1_C0 LSM_LH_ELEM_1_C1 LSM_LH_ELEM_1_C2 LSM_LH_ELEM_1_C3 LSM_LH_ELEM_1_Confidence LSM_LH_ELEM_1_Crossing LSM_LH_ELEM_1_DLM_Type LSM_LH_ELEM_1_Lanemark_Type LSM_LH_ELEM_1_Line_Side LSM_LH_ELEM_1_Marker_Width LSM_LH_ELEM_1_VR_End LSM_LH_ELEM_1_VR_Start LSM_LRE_Count LSM_LRE_ELEM_0_Availability_State LSM_LRE_ELEM_0_C0 LSM_LRE_ELEM_0_C1 LSM_LRE_ELEM_0_C2 LSM_LRE_ELEM_0_C3 LSM_LRE_ELEM_0_Confidence LSM_LRE_ELEM_0_Line_Side LSM_LRE_ELEM_0_Range_End LSM_LRE_ELEM_0_Range_Start LSM_LRE_ELEM_1_Availability_State LSM_LRE_ELEM_1_C0 LSM_LRE_ELEM_1_C1 LSM_LRE_ELEM_1_C2 LSM_LRE_ELEM_1_C3 LSM_LRE_ELEM_1_Confidence LSM_LRE_ELEM_1_Line_Side LSM_LRE_ELEM_1_Range_End LSM_LRE_ELEM_1_Range_Start LSM_VisLineUpdate /end REF_MEASUREMENT
/end GROUP
/begin GROUP S4_Simulink_Function "PubIfDecisionLSM_MDL/Subsystem1/TargetLineCalc_20ms/Simulink Function" /begin REF_CHARACTERISTIC P_LSM_IFV2CenterAxis P_LSM_IFV2RearAxis /end REF_CHARACTERISTIC /end GROUP
/begin GROUP S4_TargetLineCalc "PubIfDecisionLSM_MDL/Subsystem1/TargetLineCalc_20ms/TargetLineCalc" /begin SUB_GROUP S17_Subsystem2 S17_Subsystem4 S17_Subsystem51 S17_TypeConf /end SUB_GROUP
 /begin REF_CHARACTERISTIC P_LSM_ALC_Enable P_LSM_LineSTD_Limit P_LSM_NOH_Switch P_LSM_Pre_t /end REF_CHARACTERISTIC
 /begin REF_MEASUREMENT LSM_A0K1 LSM_A1K1 LSM_A2K1 LSM_A3K1 LSM_CentLineA0 LSM_CentLineA1 LSM_CentLineA2 LSM_CentLineA3 LSM_CentLineRange LSM_CentLineValid LSM_CentQ LSM_CosOfPsi LSM_EN_C0 LSM_EN_C1 LSM_EN_C2 LSM_EN_C3 LSM_EN_Front LSM_EN_Start LSM_EN_Valid LSM_Exit_C0 LSM_Exit_C1 LSM_Exit_C2 LSM_Exit_C3 LSM_Exit_Front LSM_Exit_Start LSM_Exit_Valid LSM_HWALineC0K1 LSM_HWASts LSM_L1_A0 LSM_L1_AvaliDis LSM_L1_AvaliTime LSM_L2_A0 LSM_L2_AvaliDis LSM_L2_AvaliTime LSM_L3_A0 LSM_L3_AvaliDis LSM_L3_AvaliTime LSM_L4_A0 LSM_L4_AvaliDis LSM_L4_AvaliTime LSM_LH1Valid LSM_LH2Valid LSM_LeftMostLane LSM_LeftOffset_b LSM_LineValidK1 LSM_Line_State LSM_LockCounter LSM_LockID LSM_MoveID LSM_PathLaneAvail LSM_QualityK1 LSM_RangeK1 LSM_RightOffset_b LSM_RoadWidth1 LSM_SinOfsi LSM_TJA_Line_State1 LSM_Wij_State LSM_dDeltaX LSM_dDeltaY LSM_tLostK1 /end REF_MEASUREMENT
/end GROUP
/begin GROUP S17_Subsystem2 "PubIfDecisionLSM_MDL/Subsystem1/TargetLineCalc_20ms/TargetLineCalc/Subsystem2"
 /begin REF_CHARACTERISTIC P_LSM_DOPValid_CheckTime P_LSM_DOP_C0_EN_Limit P_LSM_DOP_C0_out_Limit P_LSM_DOP_C1AndC2_Lim_X P_LSM_DOP_C1_EN_Limit P_LSM_DOP_C1_out_Limit P_LSM_DOP_C2_EN_Limit P_LSM_DOP_C2_out_Limit P_LSM_DOP_In_Pre2Dop_Dis P_LSM_DOP_Out_Pre2Dop_Dis P_LSM_DOP_PreDis_X P_LSM_DOP_PreDis_Y P_LSM_DoubleLine_Curr2Cent_Dislimit P_LSM_DoubleLine_DOPOut_C1 P_LSM_DoubleLine_Dop2Cent_Dislimit P_LSM_DoubleLine_Pre2Cent_Dislimit P_LSM_SingleLine_Cent2Edge_Dislimit P_LSM_SingleLine_Curr2Cent_Dislimit P_LSM_SingleLine_DOPOut_C1 P_LSM_SingleLine_Dop2Cent_Dislimit P_LSM_SingleLine_Pre2Cent_Dislimit /end REF_CHARACTERISTIC
 /begin REF_MEASUREMENT LSM_DOP_EN LSM_DOP_Out LSM_TJA_Line_State /end REF_MEASUREMENT
/end GROUP
/begin GROUP S17_Subsystem4 "PubIfDecisionLSM_MDL/Subsystem1/TargetLineCalc_20ms/TargetLineCalc/Subsystem4" /begin SUB_GROUP S49_If_Action_Subsystem5 /end SUB_GROUP /begin REF_CHARACTERISTIC P_LSM_LineWijCal_C12 P_LSM_LineWijCal_C13 /end REF_CHARACTERISTIC
 /begin REF_MEASUREMENT LSM_CurDis2 LSM_CurDis3 LSM_DeltaDis2 LSM_DeltaDis3 LSM_LH1Wij LSM_LH21 LSM_LH22 LSM_LH23 LSM_LH2Wij LSM_LH31 LSM_LH32 LSM_LH33 LSM_LeftLineConf LSM_RightLineConf /end REF_MEASUREMENT
/end GROUP
/begin GROUP S17_Subsystem51 "PubIfDecisionLSM_MDL/Subsystem1/TargetLineCalc_20ms/TargetLineCalc/Subsystem5" /begin SUB_GROUP S50_If_Action_Subsystem5 /end SUB_GROUP /begin REF_CHARACTERISTIC P_LSM_LineWijCal_C12 P_LSM_LineWijCal_C13 /end REF_CHARACTERISTIC /end GROUP
/begin GROUP S17_TypeConf "PubIfDecisionLSM_MDL/Subsystem1/TargetLineCalc_20ms/TargetLineCalc/TypeConf" /begin REF_MEASUREMENT LSM_LeftLineTypeEN LSM_RightLineTypeEN /end REF_MEASUREMENT /end GROUP
/begin GROUP S49_If_Action_Subsystem5 "PubIfDecisionLSM_MDL/Subsystem1/TargetLineCalc_20ms/TargetLineCalc/Subsystem4/If Action Subsystem5" /begin REF_CHARACTERISTIC P_LSM_PosLineLcFac /end REF_CHARACTERISTIC /end GROUP
/begin GROUP S50_If_Action_Subsystem5 "PubIfDecisionLSM_MDL/Subsystem1/TargetLineCalc_20ms/TargetLineCalc/Subsystem5/If Action Subsystem5" /begin REF_CHARACTERISTIC P_LSM_PosLineLcFac /end REF_CHARACTERISTIC /end GROUP
/begin GROUP PubIfControlLONC_MDL "PubIfControlLONC_MDL" /begin SUB_GROUP Root_Subsystem2 /end SUB_GROUP /end GROUP
/begin GROUP Root_Subsystem2 "PubIfControlLONC_MDL/Subsystem" /begin SUB_GROUP S1_VLC /end SUB_GROUP
 /begin REF_MEASUREMENT LongCtrl_Counter LongCtrl_SubModel_Number LongCtrl_SubModel_VERSION /end REF_MEASUREMENT
/end GROUP
/begin GROUP S1_VLC "PubIfControlLONC_MDL/Subsystem/VLC" /begin SUB_GROUP S3_Vlc /end SUB_GROUP /end GROUP
/begin GROUP S3_Vlc "PubIfControlLONC_MDL/Subsystem/VLC/Vlc"
 /begin SUB_GROUP S6_DC S6_EC S6_FF_Control S6_PI_Control S6_SlidJudge S6_SwitchToBrakeMode S6_SwitchToDriveMode S6_UpdateFlagCalc S6_axvClosedLoopControlCalc S6_axvModelResidualCalc S6_axvTracActMean_calc S6_axvTracMin_calc /end SUB_GROUP
 /begin REF_CHARACTERISTIC P_Global_TireRadius_m P_LongCtrl_VLCMaRatioCharMaYAxis P_LongCtrl_VLCTrRatioCharMaXAxis P_LongCtrl_VLCTrTatioMax P_LongCtrl_VLCTrTatioMin P_LongCtrl_VLCaXCDeadZoneProp_Y P_LongCtrl_VLCaxCtrlDevDeadZoneChar_Y P_LongCtrl_VLCaxCtrlDevEC2DCMax P_LongCtrl_VLCaxCtrlDevFastQuitDCMode P_LongCtrl_VLCaxCtrlDevThresAddEC2DCCharYAxis P_LongCtrl_VLCaxCtrlDevTresAddDC2ECYAxis P_LongCtrl_VLCcoefKiEnlargeADiffYAxis P_LongCtrl_VLCdaxTarEC2DCMax P_LongCtrl_VLCdriveOffAxUpLimXAxix P_LongCtrl_VLCdriveOffAxUpLimYAxix P_LongCtrl_VLCki P_LongCtrl_VLCkp P_LongCtrl_VLCks /end REF_CHARACTERISTIC
 /begin REF_MEASUREMENT LongCtrl_DCEnable LongCtrl_ECEnable LongCtrl_FF_NetEngTorq LongCtrl_FLWheelDriveDirection LongCtrl_FRWheelDriveDirection LongCtrl_OverrideToDC LongCtrl_PI_NetEngTorq LongCtrl_RLWheelDriveDirection LongCtrl_RRWheelDriveDirection LongCtrl_Sw2DC LongCtrl_Sw2EC LongCtrl_Tr_Ratio LongCtrl_VLCState LongCtrl_VLC_DriveOffConditonFulfilled LongCtrl_axvRoadSlopeMs2 LongCtrl_tEC LongCtrl_tECDC LongCtrl_vxvRefMs Longctrl_ACCSts Longctrl_ACC_AccelerateJerk Longctrl_ACC_BrakePrefer Longctrl_ACC_DecelToStopReq Longctrl_ACC_DecelerateJerk Longctrl_ACC_DrvOFF_Req Longctrl_ACC_axvCvAim Longctrl_ACC_axv_ComfortBandLowerValue Longctrl_ACC_axv_ComfortBandUpperValue Longctrl_CurrentGear Longctrl_EngSpd Longctrl_EngTqMaxActSpd Longctrl_EngTqMinAct Longctrl_NetEngTorqNorm Longctrl_NetEngTrq Longctrl_NoBrakeForce Longctrl_ShiftinProgress Longctrl_VIE_AxRefDt Longctrl_VIE_alpSideSlipAngle Longctrl_VIE_axRefMs2 Longctrl_VehicleStandStill Longctrl_tCycleVLC /end REF_MEASUREMENT
/end GROUP
/begin GROUP S6_EC "PubIfControlLONC_MDL/Subsystem/VLC/Vlc/EC" /begin REF_CHARACTERISTIC P_Global_TireRadius_m /end REF_CHARACTERISTIC /end GROUP
/begin GROUP S6_FF_Control "PubIfControlLONC_MDL/Subsystem/VLC/Vlc/FF_Control" /begin REF_CHARACTERISTIC P_Global_TireRadius_m /end REF_CHARACTERISTIC /end GROUP
/begin GROUP S6_PI_Control "PubIfControlLONC_MDL/Subsystem/VLC/Vlc/PI_Control" /begin REF_CHARACTERISTIC P_Global_TireRadius_m /end REF_CHARACTERISTIC /end GROUP
/begin GROUP S6_SlidJudge "PubIfControlLONC_MDL/Subsystem/VLC/Vlc/SlidJudge" /begin REF_CHARACTERISTIC P_Global_TireRadius_m /end REF_CHARACTERISTIC /end GROUP
/begin GROUP S6_axvTracActMean_calc "PubIfControlLONC_MDL/Subsystem/VLC/Vlc/axvTracActMean_calc" /begin REF_CHARACTERISTIC P_Global_TireRadius_m /end REF_CHARACTERISTIC /end GROUP
/begin GROUP S6_axvTracMin_calc "PubIfControlLONC_MDL/Subsystem/VLC/Vlc/axvTracMin_calc" /begin REF_CHARACTERISTIC P_Global_TireRadius_m /end REF_CHARACTERISTIC /end GROUP
/begin GROUP S5_DPCLock "PubIfDecisionPLAN_MDL/Subsystem Reference/Subsystem Reference2/DPCLock" /begin REF_CHARACTERISTIC P_Global_DxvFrontBumper_m /end REF_CHARACTERISTIC /end GROUP
/begin GROUP S5_DangerPlausCalc "PubIfDecisionPLAN_MDL/Subsystem Reference/Subsystem Reference2/DangerPlausCalc" /begin REF_CHARACTERISTIC P_Global_DxvFrontBumper_m /end REF_CHARACTERISTIC /end GROUP
/begin GROUP S184_Subsystem3 "PubIfDecisionPLAN_MDL/Subsystem Reference/Subsystem Reference1/LcCancelFinishCalc1/Subsystem3" /begin REF_CHARACTERISTIC P_Global_WheelBase_m P_Global_WheelTrack_m /end REF_CHARACTERISTIC /end GROUP
/begin GROUP S491_ESS_StateMachine "PubIfStateVSM_MDL/Subsystem Reference/Subsystem/StateManage/ESS/ESS/Subsystem1/ESS_StateMachine" /begin REF_CHARACTERISTIC P_Global_WheelBase_m /end REF_CHARACTERISTIC /end GROUP
/end MODULE
/end PROJECT
/* EOF Noa_Nofusion.a2l*/
