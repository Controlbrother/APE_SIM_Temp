ASAP2_VERSION 1 61
/begin PROJECT Noa_Nofusion ""
/begin HEADER "" VERSION "1.579" PROJECT_NO Noa_Nofusion /end HEADER
/begin MODULE Noa_Nofusion ""
/begin RECORD_LAYOUT Scalar_UBYTE FNC_VALUES 1 UBYTE ROW_DIR DIRECT /end RECORD_LAYOUT
/begin RECORD_LAYOUT Scalar_FLOAT32_IEEE FNC_VALUES 1 FLOAT32_IEEE ROW_DIR DIRECT /end RECORD_LAYOUT
/begin RECORD_LAYOUT Scalar_FLOAT64_IEEE FNC_VALUES 1 FLOAT64_IEEE ROW_DIR DIRECT /end RECORD_LAYOUT
/begin RECORD_LAYOUT Lookup1D_FLOAT32_IEEE FNC_VALUES 1 FLOAT32_IEEE ROW_DIR DIRECT /end RECORD_LAYOUT
/begin RECORD_LAYOUT Lookup1D_X_FLOAT32_IEEE AXIS_PTS_X 1 FLOAT32_IEEE INDEX_INCR DIRECT /end RECORD_LAYOUT
/begin RECORD_LAYOUT Lookup2D_X_WORD AXIS_PTS_X 1 SWORD INDEX_INCR DIRECT /end RECORD_LAYOUT
/begin RECORD_LAYOUT Lookup2D_X_ULONG AXIS_PTS_X 1 ULONG INDEX_INCR DIRECT /end RECORD_LAYOUT
/begin RECORD_LAYOUT Lookup2D_X_LONG AXIS_PTS_X 1 SLONG INDEX_INCR DIRECT /end RECORD_LAYOUT
/begin CHARACTERISTIC P_VSM_LCKIE_LATC_LimitDis "" CURVE 0x0 /* @MemoryAddress@P_VSM_LCKIE_LATC_LimitDis@ */ Lookup1D_FLOAT32_IEEE 0 PubIfStateVSM_MDL_CM_single -3.4E+38 3.4E+38
 /begin AXIS_DESCR COM_AXIS VSM_LCKIE_LatC_DetaDis PubIfStateVSM_MDL_CM_single 5 -3.4E+38 3.4E+38 AXIS_PTS_REF P_VSM_LCKIE_LATC_LimitDis_BP /end AXIS_DESCR
/end CHARACTERISTIC
/begin CHARACTERISTIC P_VSM_LCKIE_LatC_DisOffofLanWidth "" CURVE 0x0 /* @MemoryAddress@P_VSM_LCKIE_LatC_DisOffofLanWidth@ */ Lookup1D_FLOAT32_IEEE 0 PubIfStateVSM_MDL_CM_single -3.4E+38 3.4E+38
 /begin AXIS_DESCR COM_AXIS VSM_LCKIE_OS_RoadWidth PubIfStateVSM_MDL_CM_single 4 -3.4E+38 3.4E+38 AXIS_PTS_REF P_VSM_LCKIE_LatC_LanWidth /end AXIS_DESCR
/end CHARACTERISTIC
/begin CHARACTERISTIC P_VSM_LCKIE_LatC_DisOffofSpd "" CURVE 0x0 /* @MemoryAddress@P_VSM_LCKIE_LatC_DisOffofSpd@ */ Lookup1D_FLOAT32_IEEE 0 PubIfStateVSM_MDL_CM_single -3.4E+38 3.4E+38
 /begin AXIS_DESCR COM_AXIS NO_INPUT_QUANTITY PubIfStateVSM_MDL_CM_single 6 -3.4E+38 3.4E+38 AXIS_PTS_REF P_VSM_LCKIE_LatC_Spd /end AXIS_DESCR
/end CHARACTERISTIC
/begin CHARACTERISTIC P_VSM_LCKIE_LatC_SafeDisofLanWidth "" CURVE 0x0 /* @MemoryAddress@P_VSM_LCKIE_LatC_SafeDisofLanWidth@ */ Lookup1D_FLOAT32_IEEE 0 PubIfStateVSM_MDL_CM_single -3.4E+38 3.4E+38
 /begin AXIS_DESCR COM_AXIS VSM_LCKIE_OS_RoadWidth PubIfStateVSM_MDL_CM_single 4 -3.4E+38 3.4E+38 AXIS_PTS_REF P_VSM_LCKIE_LatC_LanWidth /end AXIS_DESCR
/end CHARACTERISTIC
/begin CHARACTERISTIC P_VSM_LCKIE_LongC_d1 "" CURVE 0x0 /* @MemoryAddress@P_VSM_LCKIE_LongC_d1@ */ Lookup1D_FLOAT32_IEEE 0 PubIfStateVSM_MDL_CM_single -3.4E+38 3.4E+38
 /begin AXIS_DESCR COM_AXIS NO_INPUT_QUANTITY PubIfStateVSM_MDL_CM_single 6 -3.4E+38 3.4E+38 AXIS_PTS_REF P_VSM_LCKIE_LongC_Spd /end AXIS_DESCR
/end CHARACTERISTIC
/begin CHARACTERISTIC P_VSM_LCKIE_LongC_d2 "" CURVE 0x0 /* @MemoryAddress@P_VSM_LCKIE_LongC_d2@ */ Lookup1D_FLOAT32_IEEE 0 PubIfStateVSM_MDL_CM_single -3.4E+38 3.4E+38
 /begin AXIS_DESCR COM_AXIS VSM_LCKIE_OS_DetaSpdSelect PubIfStateVSM_MDL_CM_single 3 -3.4E+38 3.4E+38 AXIS_PTS_REF P_VSM_LCKIE_LongC_DetaSpd /end AXIS_DESCR
/end CHARACTERISTIC
/begin CHARACTERISTIC P_VSM_LCK_AbsEspInTime "" VALUE 0x0 /* @MemoryAddress@P_VSM_LCK_AbsEspInTime@ */ Scalar_FLOAT64_IEEE 0 PubIfStateVSM_MDL_CM_double -1.7E+308 1.7E+308 /end CHARACTERISTIC
/begin CHARACTERISTIC P_VSM_LCK_AccRateInTime "" VALUE 0x0 /* @MemoryAddress@P_VSM_LCK_AccRateInTime@ */ Scalar_FLOAT64_IEEE 0 PubIfStateVSM_MDL_CM_double -1.7E+308 1.7E+308 /end CHARACTERISTIC
/begin CHARACTERISTIC P_VSM_LCK_AccrPelRateOut "" VALUE 0x0 /* @MemoryAddress@P_VSM_LCK_AccrPelRateOut@ */ Scalar_FLOAT64_IEEE 0 PubIfStateVSM_MDL_CM_double -1.7E+308 1.7E+308 /end CHARACTERISTIC
/begin CHARACTERISTIC P_VSM_LCK_BrakePressInTime "" VALUE 0x0 /* @MemoryAddress@P_VSM_LCK_BrakePressInTime@ */ Scalar_FLOAT64_IEEE 0 PubIfStateVSM_MDL_CM_double -1.7E+308 1.7E+308 /end CHARACTERISTIC
/begin CHARACTERISTIC P_VSM_LCK_C0 "" VALUE 0x0 /* @MemoryAddress@P_VSM_LCK_C0@ */ Scalar_FLOAT64_IEEE 0 PubIfStateVSM_MDL_CM_double -1.7E+308 1.7E+308 /end CHARACTERISTIC
/begin CHARACTERISTIC P_VSM_LCK_DrvInputTrqValueInTime "" VALUE 0x0 /* @MemoryAddress@P_VSM_LCK_DrvInputTrqValueInTime@ */ Scalar_FLOAT64_IEEE 0 PubIfStateVSM_MDL_CM_double -1.7E+308 1.7E+308 /end CHARACTERISTIC
/begin CHARACTERISTIC P_VSM_LCK_LCOverrideTime "" VALUE 0x0 /* @MemoryAddress@P_VSM_LCK_LCOverrideTime@ */ Scalar_FLOAT64_IEEE 0 PubIfStateVSM_MDL_CM_double -1.7E+308 1.7E+308 /end CHARACTERISTIC
/begin CHARACTERISTIC P_VSM_LCK_LanechangeSwitch "" VALUE 0x0 /* @MemoryAddress@P_VSM_LCK_LanechangeSwitch@ */ Scalar_FLOAT64_IEEE 0 PubIfStateVSM_MDL_CM_double -1.7E+308 1.7E+308 /end CHARACTERISTIC
/begin CHARACTERISTIC P_VSM_LCK_Lanewidthswitch "" VALUE 0x0 /* @MemoryAddress@P_VSM_LCK_Lanewidthswitch@ */ Scalar_FLOAT64_IEEE 0 PubIfStateVSM_MDL_CM_double -1.7E+308 1.7E+308 /end CHARACTERISTIC
/begin CHARACTERISTIC P_VSM_LCK_LateralAcceInTime "" VALUE 0x0 /* @MemoryAddress@P_VSM_LCK_LateralAcceInTime@ */ Scalar_FLOAT64_IEEE 0 PubIfStateVSM_MDL_CM_double -1.7E+308 1.7E+308 /end CHARACTERISTIC
/begin CHARACTERISTIC P_VSM_LCK_LongitudeAccInTime "" VALUE 0x0 /* @MemoryAddress@P_VSM_LCK_LongitudeAccInTime@ */ Scalar_FLOAT64_IEEE 0 PubIfStateVSM_MDL_CM_double -1.7E+308 1.7E+308 /end CHARACTERISTIC
/begin CHARACTERISTIC P_VSM_LCK_OverrideInTime "" VALUE 0x0 /* @MemoryAddress@P_VSM_LCK_OverrideInTime@ */ Scalar_FLOAT64_IEEE 0 PubIfStateVSM_MDL_CM_double -1.7E+308 1.7E+308 /end CHARACTERISTIC
/begin CHARACTERISTIC P_VSM_LCK_OverrideTime "" VALUE 0x0 /* @MemoryAddress@P_VSM_LCK_OverrideTime@ */ Scalar_FLOAT64_IEEE 0 PubIfStateVSM_MDL_CM_double -1.7E+308 1.7E+308 /end CHARACTERISTIC
/begin CHARACTERISTIC P_VSM_LCK_ParamA1 "" VAL_BLK 0x0 /* @MemoryAddress@P_VSM_LCK_ParamA1@ */ Scalar_FLOAT64_IEEE 0 PubIfStateVSM_MDL_CM_double -1.7E+308 1.7E+308 MATRIX_DIM 1 4 1 /end CHARACTERISTIC
/begin CHARACTERISTIC P_VSM_LCK_State_ESSSts_enable "" VALUE 0x0 /* @MemoryAddress@P_VSM_LCK_State_ESSSts_enable@ */ Scalar_FLOAT64_IEEE 0 PubIfStateVSM_MDL_CM_double -1.7E+308 1.7E+308 /end CHARACTERISTIC
/begin CHARACTERISTIC P_VSM_LCK_State_LaneChange_enable "" VALUE 0x0 /* @MemoryAddress@P_VSM_LCK_State_LaneChange_enable@ */ Scalar_FLOAT64_IEEE 0 PubIfStateVSM_MDL_CM_double -1.7E+308 1.7E+308 /end CHARACTERISTIC
/begin CHARACTERISTIC P_VSM_LCK_State_Param_LaneCurve "" VAL_BLK 0x0 /* @MemoryAddress@P_VSM_LCK_State_Param_LaneCurve@ */ Scalar_FLOAT64_IEEE 0 PubIfStateVSM_MDL_CM_double -1.7E+308 1.7E+308 MATRIX_DIM 1 4 1 /end CHARACTERISTIC
/begin CHARACTERISTIC P_VSM_LCK_State_Param_LaneCurve_Offset "" VAL_BLK 0x0 /* @MemoryAddress@P_VSM_LCK_State_Param_LaneCurve_Offset@ */ Scalar_FLOAT64_IEEE 0 PubIfStateVSM_MDL_CM_double -1.7E+308 1.7E+308 MATRIX_DIM 1 4 1 /end CHARACTERISTIC
/begin CHARACTERISTIC P_VSM_LCK_State_Param_LaneWidth "" VAL_BLK 0x0 /* @MemoryAddress@P_VSM_LCK_State_Param_LaneWidth@ */ Scalar_FLOAT64_IEEE 0 PubIfStateVSM_MDL_CM_double -1.7E+308 1.7E+308 MATRIX_DIM 1 7 1 /end CHARACTERISTIC
/begin CHARACTERISTIC P_VSM_LCK_State_Param_LaneWidth_Offset "" VAL_BLK 0x0 /* @MemoryAddress@P_VSM_LCK_State_Param_LaneWidth_Offset@ */ Scalar_FLOAT64_IEEE 0 PubIfStateVSM_MDL_CM_double -1.7E+308 1.7E+308 MATRIX_DIM 1 7 1 /end CHARACTERISTIC
/begin CHARACTERISTIC P_VSM_LCK_SteerAngleSpdInTime "" VALUE 0x0 /* @MemoryAddress@P_VSM_LCK_SteerAngleSpdInTime@ */ Scalar_FLOAT64_IEEE 0 PubIfStateVSM_MDL_CM_double -1.7E+308 1.7E+308 /end CHARACTERISTIC
/begin CHARACTERISTIC P_VSM_LCK_SteerWheelAngleInTime "" VALUE 0x0 /* @MemoryAddress@P_VSM_LCK_SteerWheelAngleInTime@ */ Scalar_FLOAT64_IEEE 0 PubIfStateVSM_MDL_CM_double -1.7E+308 1.7E+308 /end CHARACTERISTIC
/begin CHARACTERISTIC P_VSM_LCK_T0 "" VALUE 0x0 /* @MemoryAddress@P_VSM_LCK_T0@ */ Scalar_FLOAT64_IEEE 0 PubIfStateVSM_MDL_CM_double -1.7E+308 1.7E+308 /end CHARACTERISTIC
/begin CHARACTERISTIC P_VSM_LCK_TargetInSwitch "" VALUE 0x0 /* @MemoryAddress@P_VSM_LCK_TargetInSwitch@ */ Scalar_FLOAT64_IEEE 0 PubIfStateVSM_MDL_CM_double -1.7E+308 1.7E+308 /end CHARACTERISTIC
/begin CHARACTERISTIC P_VSM_LCK_YawRateInTime "" VALUE 0x0 /* @MemoryAddress@P_VSM_LCK_YawRateInTime@ */ Scalar_FLOAT64_IEEE 0 PubIfStateVSM_MDL_CM_double -1.7E+308 1.7E+308 /end CHARACTERISTIC
/begin CHARACTERISTIC P_VSM_LCK_dypreFactor "" VALUE 0x0 /* @MemoryAddress@P_VSM_LCK_dypreFactor@ */ Scalar_FLOAT64_IEEE 0 PubIfStateVSM_MDL_CM_double -1.7E+308 1.7E+308 /end CHARACTERISTIC
/begin CHARACTERISTIC P_VSM_LDW_AbsEspInTime "" VALUE 0x0 /* @MemoryAddress@P_VSM_LDW_AbsEspInTime@ */ Scalar_FLOAT64_IEEE 0 PubIfStateVSM_MDL_CM_double -1.7E+308 1.7E+308 /end CHARACTERISTIC
/begin CHARACTERISTIC P_VSM_LDW_AccRateInTime "" VALUE 0x0 /* @MemoryAddress@P_VSM_LDW_AccRateInTime@ */ Scalar_FLOAT64_IEEE 0 PubIfStateVSM_MDL_CM_double -1.7E+308 1.7E+308 /end CHARACTERISTIC
/begin CHARACTERISTIC P_VSM_LDW_BrakePressInTime "" VALUE 0x0 /* @MemoryAddress@P_VSM_LDW_BrakePressInTime@ */ Scalar_FLOAT64_IEEE 0 PubIfStateVSM_MDL_CM_double -1.7E+308 1.7E+308 /end CHARACTERISTIC
/begin CHARACTERISTIC P_VSM_LDW_LaneChangeOffset "" VALUE 0x0 /* @MemoryAddress@P_VSM_LDW_LaneChangeOffset@ */ Scalar_FLOAT64_IEEE 0 PubIfStateVSM_MDL_CM_double -1.7E+308 1.7E+308 /end CHARACTERISTIC
/begin CHARACTERISTIC P_VSM_LDW_LateralAcceInTime "" VALUE 0x0 /* @MemoryAddress@P_VSM_LDW_LateralAcceInTime@ */ Scalar_FLOAT64_IEEE 0 PubIfStateVSM_MDL_CM_double -1.7E+308 1.7E+308 /end CHARACTERISTIC
/begin CHARACTERISTIC P_VSM_LDW_LongitudeAccInTime "" VALUE 0x0 /* @MemoryAddress@P_VSM_LDW_LongitudeAccInTime@ */ Scalar_FLOAT64_IEEE 0 PubIfStateVSM_MDL_CM_double -1.7E+308 1.7E+308 /end CHARACTERISTIC
/begin CHARACTERISTIC P_VSM_LDW_State_ESSSts_enable "" VALUE 0x0 /* @MemoryAddress@P_VSM_LDW_State_ESSSts_enable@ */ Scalar_FLOAT64_IEEE 0 PubIfStateVSM_MDL_CM_double -1.7E+308 1.7E+308 /end CHARACTERISTIC
/begin CHARACTERISTIC P_VSM_LDW_SteerWheelAngleInTime "" VALUE 0x0 /* @MemoryAddress@P_VSM_LDW_SteerWheelAngleInTime@ */ Scalar_FLOAT64_IEEE 0 PubIfStateVSM_MDL_CM_double -1.7E+308 1.7E+308 /end CHARACTERISTIC
/begin CHARACTERISTIC P_VSM_LDW_SteerWheelSpdInTime "" VALUE 0x0 /* @MemoryAddress@P_VSM_LDW_SteerWheelSpdInTime@ */ Scalar_FLOAT64_IEEE 0 PubIfStateVSM_MDL_CM_double -1.7E+308 1.7E+308 /end CHARACTERISTIC
/begin CHARACTERISTIC P_VSM_LDW_TurnLightInTime "" VALUE 0x0 /* @MemoryAddress@P_VSM_LDW_TurnLightInTime@ */ Scalar_FLOAT64_IEEE 0 PubIfStateVSM_MDL_CM_double -1.7E+308 1.7E+308 /end CHARACTERISTIC
/begin CHARACTERISTIC P_VSM_LDW_YawRateInTime "" VALUE 0x0 /* @MemoryAddress@P_VSM_LDW_YawRateInTime@ */ Scalar_FLOAT64_IEEE 0 PubIfStateVSM_MDL_CM_double -1.7E+308 1.7E+308 /end CHARACTERISTIC
/begin CHARACTERISTIC P_VSM_LKA_AbsEspInTime "" VALUE 0x0 /* @MemoryAddress@P_VSM_LKA_AbsEspInTime@ */ Scalar_FLOAT64_IEEE 0 PubIfStateVSM_MDL_CM_double -1.7E+308 1.7E+308 /end CHARACTERISTIC
/begin CHARACTERISTIC P_VSM_LKA_AccPedalRateOutTime "" VALUE 0x0 /* @MemoryAddress@P_VSM_LKA_AccPedalRateOutTime@ */ Scalar_FLOAT64_IEEE 0 PubIfStateVSM_MDL_CM_double -1.7E+308 1.7E+308 /end CHARACTERISTIC
/begin CHARACTERISTIC P_VSM_LKA_AccRateInTime "" VALUE 0x0 /* @MemoryAddress@P_VSM_LKA_AccRateInTime@ */ Scalar_FLOAT64_IEEE 0 PubIfStateVSM_MDL_CM_double -1.7E+308 1.7E+308 /end CHARACTERISTIC
/begin CHARACTERISTIC P_VSM_LKA_BrakePressInTime "" VALUE 0x0 /* @MemoryAddress@P_VSM_LKA_BrakePressInTime@ */ Scalar_FLOAT64_IEEE 0 PubIfStateVSM_MDL_CM_double -1.7E+308 1.7E+308 /end CHARACTERISTIC
/begin CHARACTERISTIC P_VSM_LKA_CurveFactor "" VALUE 0x0 /* @MemoryAddress@P_VSM_LKA_CurveFactor@ */ Scalar_FLOAT64_IEEE 0 PubIfStateVSM_MDL_CM_double -1.7E+308 1.7E+308 /end CHARACTERISTIC
/begin CHARACTERISTIC P_VSM_LKA_DriverInputTrqValueInTime "" VALUE 0x0 /* @MemoryAddress@P_VSM_LKA_DriverInputTrqValueInTime@ */ Scalar_FLOAT64_IEEE 0 PubIfStateVSM_MDL_CM_double -1.7E+308 1.7E+308 /end CHARACTERISTIC
/begin CHARACTERISTIC P_VSM_LKA_EndSwitch "" VALUE 0x0 /* @MemoryAddress@P_VSM_LKA_EndSwitch@ */ Scalar_FLOAT64_IEEE 0 PubIfStateVSM_MDL_CM_double -1.7E+308 1.7E+308 /end CHARACTERISTIC
/begin CHARACTERISTIC P_VSM_LKA_LaneChangeOffset "" VALUE 0x0 /* @MemoryAddress@P_VSM_LKA_LaneChangeOffset@ */ Scalar_FLOAT64_IEEE 0 PubIfStateVSM_MDL_CM_double -1.7E+308 1.7E+308 /end CHARACTERISTIC
/begin CHARACTERISTIC P_VSM_LKA_LateralAcceInTime "" VALUE 0x0 /* @MemoryAddress@P_VSM_LKA_LateralAcceInTime@ */ Scalar_FLOAT64_IEEE 0 PubIfStateVSM_MDL_CM_double -1.7E+308 1.7E+308 /end CHARACTERISTIC
/begin CHARACTERISTIC P_VSM_LKA_OverrideInTime "" VALUE 0x0 /* @MemoryAddress@P_VSM_LKA_OverrideInTime@ */ Scalar_FLOAT64_IEEE 0 PubIfStateVSM_MDL_CM_double -1.7E+308 1.7E+308 /end CHARACTERISTIC
/begin CHARACTERISTIC P_VSM_LKA_OverrideTime "" VALUE 0x0 /* @MemoryAddress@P_VSM_LKA_OverrideTime@ */ Scalar_FLOAT64_IEEE 0 PubIfStateVSM_MDL_CM_double -1.7E+308 1.7E+308 /end CHARACTERISTIC
/begin CHARACTERISTIC P_VSM_LKA_State_ESSSts_enable "" VALUE 0x0 /* @MemoryAddress@P_VSM_LKA_State_ESSSts_enable@ */ Scalar_FLOAT64_IEEE 0 PubIfStateVSM_MDL_CM_double -1.7E+308 1.7E+308 /end CHARACTERISTIC
/begin CHARACTERISTIC P_VSM_LKA_SteerWheelAngleInTime "" VALUE 0x0 /* @MemoryAddress@P_VSM_LKA_SteerWheelAngleInTime@ */ Scalar_FLOAT64_IEEE 0 PubIfStateVSM_MDL_CM_double -1.7E+308 1.7E+308 /end CHARACTERISTIC
/begin CHARACTERISTIC P_VSM_LKA_SteerWheelSpdInTime "" VALUE 0x0 /* @MemoryAddress@P_VSM_LKA_SteerWheelSpdInTime@ */ Scalar_FLOAT64_IEEE 0 PubIfStateVSM_MDL_CM_double -1.7E+308 1.7E+308 /end CHARACTERISTIC
/begin CHARACTERISTIC P_VSM_LKA_TurnLightInTime "" VALUE 0x0 /* @MemoryAddress@P_VSM_LKA_TurnLightInTime@ */ Scalar_FLOAT64_IEEE 0 PubIfStateVSM_MDL_CM_double -1.7E+308 1.7E+308 /end CHARACTERISTIC
/begin CHARACTERISTIC P_VSM_LKA_WarnInTime "" VALUE 0x0 /* @MemoryAddress@P_VSM_LKA_WarnInTime@ */ Scalar_FLOAT64_IEEE 0 PubIfStateVSM_MDL_CM_double -1.7E+308 1.7E+308 /end CHARACTERISTIC
/begin CHARACTERISTIC P_VSM_LKA_YawRateInTime "" VALUE 0x0 /* @MemoryAddress@P_VSM_LKA_YawRateInTime@ */ Scalar_FLOAT64_IEEE 0 PubIfStateVSM_MDL_CM_double -1.7E+308 1.7E+308 /end CHARACTERISTIC
/begin CHARACTERISTIC P_VSM_LKA_absLongitudeAcceInTime "" VALUE 0x0 /* @MemoryAddress@P_VSM_LKA_absLongitudeAcceInTime@ */ Scalar_FLOAT64_IEEE 0 PubIfStateVSM_MDL_CM_double -1.7E+308 1.7E+308 /end CHARACTERISTIC
/begin CHARACTERISTIC P_Global_IEnvironment_RefPX_Front_Bumper "摄像头到前保险杠的X向距离偏移量" VALUE 0x0 /* @MemoryAddress@P_Global_IEnvironment_RefPX_Front_Bumper@ */ Scalar_FLOAT32_IEEE 0 PubIfStateVSM_MDL_CM_single_m -3.4E+38 3.4E+38 /end CHARACTERISTIC
/begin CHARACTERISTIC P_Global_Vehicle_Length_m "车长" VALUE 0x0 /* @MemoryAddress@P_Global_Vehicle_Length_m@ */ Scalar_FLOAT32_IEEE 0 PubIfStateVSM_MDL_CM_single_m -3.4E+38 3.4E+38 /end CHARACTERISTIC
/begin CHARACTERISTIC P_VSM_ELK_OnComing_Lateral "" VALUE 0x0 /* @MemoryAddress@P_VSM_ELK_OnComing_Lateral@ */ Scalar_FLOAT32_IEEE 0 PubIfStateVSM_MDL_CM_single -3.4E+38 3.4E+38 /end CHARACTERISTIC
/begin CHARACTERISTIC P_VSM_ELK_OnComing_TTC "" VALUE 0x0 /* @MemoryAddress@P_VSM_ELK_OnComing_TTC@ */ Scalar_FLOAT32_IEEE 0 PubIfStateVSM_MDL_CM_single -3.4E+38 3.4E+38 /end CHARACTERISTIC
/begin CHARACTERISTIC P_VSM_ELK_OverTaking_Lateral "" VALUE 0x0 /* @MemoryAddress@P_VSM_ELK_OverTaking_Lateral@ */ Scalar_FLOAT32_IEEE 0 PubIfStateVSM_MDL_CM_single -3.4E+38 3.4E+38 /end CHARACTERISTIC
/begin CHARACTERISTIC P_VSM_ELK_OverTaking_TTC "" VALUE 0x0 /* @MemoryAddress@P_VSM_ELK_OverTaking_TTC@ */ Scalar_FLOAT32_IEEE 0 PubIfStateVSM_MDL_CM_single -3.4E+38 3.4E+38 /end CHARACTERISTIC
/begin CHARACTERISTIC P_VSM_LCKIE_ClassInput "" VALUE 0x0 /* @MemoryAddress@P_VSM_LCKIE_ClassInput@ */ Scalar_FLOAT32_IEEE 0 PubIfStateVSM_MDL_CM_single -3.4E+38 3.4E+38 /end CHARACTERISTIC
/begin CHARACTERISTIC P_VSM_LCKIE_LatC_DisSW "" VALUE 0x0 /* @MemoryAddress@P_VSM_LCKIE_LatC_DisSW@ */ Scalar_FLOAT32_IEEE 0 PubIfStateVSM_MDL_CM_single -3.4E+38 3.4E+38 /end CHARACTERISTIC
/begin CHARACTERISTIC P_VSM_LCKIE_LatC_LimitDisEgoToObjSelt "" VALUE 0x0 /* @MemoryAddress@P_VSM_LCKIE_LatC_LimitDisEgoToObjSelt@ */ Scalar_FLOAT32_IEEE 0 PubIfStateVSM_MDL_CM_single -3.4E+38 3.4E+38 /end CHARACTERISTIC
/begin CHARACTERISTIC P_VSM_LCKIE_LatC_LimitEgoToOppLane "" VALUE 0x0 /* @MemoryAddress@P_VSM_LCKIE_LatC_LimitEgoToOppLane@ */ Scalar_FLOAT32_IEEE 0 PubIfStateVSM_MDL_CM_single -3.4E+38 3.4E+38 /end CHARACTERISTIC
/begin CHARACTERISTIC P_VSM_LCKIE_LatC_MoveEnableDis "" VALUE 0x0 /* @MemoryAddress@P_VSM_LCKIE_LatC_MoveEnableDis@ */ Scalar_FLOAT32_IEEE 0 PubIfStateVSM_MDL_CM_single -3.4E+38 3.4E+38 /end CHARACTERISTIC
/begin CHARACTERISTIC P_VSM_LCKIE_LatC_RESafDis "" VALUE 0x0 /* @MemoryAddress@P_VSM_LCKIE_LatC_RESafDis@ */ Scalar_FLOAT32_IEEE 0 PubIfStateVSM_MDL_CM_single -3.4E+38 3.4E+38 /end CHARACTERISTIC
/begin CHARACTERISTIC P_VSM_LCKIE_LatC_maxLimitDisREToLane "" VALUE 0x0 /* @MemoryAddress@P_VSM_LCKIE_LatC_maxLimitDisREToLane@ */ Scalar_FLOAT32_IEEE 0 PubIfStateVSM_MDL_CM_single -3.4E+38 3.4E+38 /end CHARACTERISTIC
/begin CHARACTERISTIC P_VSM_LCKIE_LatC_minLimitDisREToLane "" VALUE 0x0 /* @MemoryAddress@P_VSM_LCKIE_LatC_minLimitDisREToLane@ */ Scalar_FLOAT32_IEEE 0 PubIfStateVSM_MDL_CM_single -3.4E+38 3.4E+38 /end CHARACTERISTIC
/begin CHARACTERISTIC P_VSM_LCKIE_LongC_DirecChangeDis "" VALUE 0x0 /* @MemoryAddress@P_VSM_LCKIE_LongC_DirecChangeDis@ */ Scalar_FLOAT32_IEEE 0 PubIfStateVSM_MDL_CM_single -3.4E+38 3.4E+38 /end CHARACTERISTIC
/begin CHARACTERISTIC P_VSM_LCKIE_LongC_FleetOff "" VALUE 0x0 /* @MemoryAddress@P_VSM_LCKIE_LongC_FleetOff@ */ Scalar_FLOAT32_IEEE 0 PubIfStateVSM_MDL_CM_single -3.4E+38 3.4E+38 /end CHARACTERISTIC
/begin CHARACTERISTIC P_VSM_LCKIE_LongC_ShutDownLongDis "" VALUE 0x0 /* @MemoryAddress@P_VSM_LCKIE_LongC_ShutDownLongDis@ */ Scalar_FLOAT32_IEEE 0 PubIfStateVSM_MDL_CM_single -3.4E+38 3.4E+38 /end CHARACTERISTIC
/begin CHARACTERISTIC P_VSM_LCKIE_LongC_ShutDownTTC "" VALUE 0x0 /* @MemoryAddress@P_VSM_LCKIE_LongC_ShutDownTTC@ */ Scalar_FLOAT32_IEEE 0 PubIfStateVSM_MDL_CM_single -3.4E+38 3.4E+38 /end CHARACTERISTIC
/begin CHARACTERISTIC P_VSM_LCKIE_LongC_maxDis "" VALUE 0x0 /* @MemoryAddress@P_VSM_LCKIE_LongC_maxDis@ */ Scalar_FLOAT32_IEEE 0 PubIfStateVSM_MDL_CM_single -3.4E+38 3.4E+38 /end CHARACTERISTIC
/begin CHARACTERISTIC P_VSM_LCKIE_LongC_minDis "" VALUE 0x0 /* @MemoryAddress@P_VSM_LCKIE_LongC_minDis@ */ Scalar_FLOAT32_IEEE 0 PubIfStateVSM_MDL_CM_single -3.4E+38 3.4E+38 /end CHARACTERISTIC
/begin CHARACTERISTIC P_VSM_LCKIE_LongC_toff "" VALUE 0x0 /* @MemoryAddress@P_VSM_LCKIE_LongC_toff@ */ Scalar_FLOAT32_IEEE 0 PubIfStateVSM_MDL_CM_single -3.4E+38 3.4E+38 /end CHARACTERISTIC
/begin CHARACTERISTIC P_VSM_LCKIE_OFC_ActDis "" VALUE 0x0 /* @MemoryAddress@P_VSM_LCKIE_OFC_ActDis@ */ Scalar_FLOAT32_IEEE 0 PubIfStateVSM_MDL_CM_single -3.4E+38 3.4E+38 /end CHARACTERISTIC
/begin CHARACTERISTIC P_VSM_LCKIE_OFC_DownDis "" VALUE 0x0 /* @MemoryAddress@P_VSM_LCKIE_OFC_DownDis@ */ Scalar_FLOAT32_IEEE 0 PubIfStateVSM_MDL_CM_single -3.4E+38 3.4E+38 /end CHARACTERISTIC
/begin CHARACTERISTIC P_VSM_LCKIE_OFC_DownTTC "" VALUE 0x0 /* @MemoryAddress@P_VSM_LCKIE_OFC_DownTTC@ */ Scalar_FLOAT32_IEEE 0 PubIfStateVSM_MDL_CM_single -3.4E+38 3.4E+38 /end CHARACTERISTIC
/begin CHARACTERISTIC P_VSM_LCKIE_OFC_SafDis "" VALUE 0x0 /* @MemoryAddress@P_VSM_LCKIE_OFC_SafDis@ */ Scalar_FLOAT32_IEEE 0 PubIfStateVSM_MDL_CM_single -3.4E+38 3.4E+38 /end CHARACTERISTIC
/begin CHARACTERISTIC P_VSM_LCKIE_OFC_Toff "" VALUE 0x0 /* @MemoryAddress@P_VSM_LCKIE_OFC_Toff@ */ Scalar_FLOAT32_IEEE 0 PubIfStateVSM_MDL_CM_single -3.4E+38 3.4E+38 /end CHARACTERISTIC
/begin CHARACTERISTIC P_VSM_LCKIE_ORC_LatDis "" VALUE 0x0 /* @MemoryAddress@P_VSM_LCKIE_ORC_LatDis@ */ Scalar_FLOAT32_IEEE 0 PubIfStateVSM_MDL_CM_single -3.4E+38 3.4E+38 /end CHARACTERISTIC
/begin CHARACTERISTIC P_VSM_LCKIE_ORC_LimitDis1 "" VALUE 0x0 /* @MemoryAddress@P_VSM_LCKIE_ORC_LimitDis1@ */ Scalar_FLOAT32_IEEE 0 PubIfStateVSM_MDL_CM_single -3.4E+38 3.4E+38 /end CHARACTERISTIC
/begin CHARACTERISTIC P_VSM_LCKIE_ORC_LimitDis2 "" VALUE 0x0 /* @MemoryAddress@P_VSM_LCKIE_ORC_LimitDis2@ */ Scalar_FLOAT32_IEEE 0 PubIfStateVSM_MDL_CM_single -3.4E+38 3.4E+38 /end CHARACTERISTIC
/begin CHARACTERISTIC P_VSM_LCKIE_ORC_LimitTTC "" VALUE 0x0 /* @MemoryAddress@P_VSM_LCKIE_ORC_LimitTTC@ */ Scalar_FLOAT32_IEEE 0 PubIfStateVSM_MDL_CM_single -3.4E+38 3.4E+38 /end CHARACTERISTIC
/begin CHARACTERISTIC P_VSM_LCKIE_ORC_LowSpd "" VALUE 0x0 /* @MemoryAddress@P_VSM_LCKIE_ORC_LowSpd@ */ Scalar_FLOAT32_IEEE 0 PubIfStateVSM_MDL_CM_single -3.4E+38 3.4E+38 /end CHARACTERISTIC
/begin CHARACTERISTIC P_VSM_LCKIE_POC_Delaytime "" VAL_BLK 0x0 /* @MemoryAddress@P_VSM_LCKIE_POC_Delaytime@ */ Scalar_FLOAT32_IEEE 0 PubIfStateVSM_MDL_CM_single -3.4E+38 3.4E+38 MATRIX_DIM 1 6 1 /end CHARACTERISTIC
/begin CHARACTERISTIC P_VSM_LCKIE_POC_LimitDis "" VALUE 0x0 /* @MemoryAddress@P_VSM_LCKIE_POC_LimitDis@ */ Scalar_FLOAT32_IEEE 0 PubIfStateVSM_MDL_CM_single -3.4E+38 3.4E+38 /end CHARACTERISTIC
/begin CHARACTERISTIC P_VSM_LCKIE_POC_LimitTTC "" VALUE 0x0 /* @MemoryAddress@P_VSM_LCKIE_POC_LimitTTC@ */ Scalar_FLOAT32_IEEE 0 PubIfStateVSM_MDL_CM_single -3.4E+38 3.4E+38 /end CHARACTERISTIC
/begin CHARACTERISTIC P_VSM_LCKIE_POC_detaSpd "" VAL_BLK 0x0 /* @MemoryAddress@P_VSM_LCKIE_POC_detaSpd@ */ Scalar_FLOAT32_IEEE 0 PubIfStateVSM_MDL_CM_single -3.4E+38 3.4E+38 MATRIX_DIM 1 6 1 /end CHARACTERISTIC
/begin CHARACTERISTIC P_VSM_LCKIE_STATE_ORCObjenable "" VALUE 0x0 /* @MemoryAddress@P_VSM_LCKIE_STATE_ORCObjenable@ */ Scalar_FLOAT32_IEEE 0 PubIfStateVSM_MDL_CM_single -3.4E+38 3.4E+38 /end CHARACTERISTIC
/begin CHARACTERISTIC P_VSM_LCKIE_State_CurveMax "" VALUE 0x0 /* @MemoryAddress@P_VSM_LCKIE_State_CurveMax@ */ Scalar_FLOAT32_IEEE 0 PubIfStateVSM_MDL_CM_single -3.4E+38 3.4E+38 /end CHARACTERISTIC
/begin CHARACTERISTIC P_VSM_LCKIE_State_CurveMin "" VALUE 0x0 /* @MemoryAddress@P_VSM_LCKIE_State_CurveMin@ */ Scalar_FLOAT32_IEEE 0 PubIfStateVSM_MDL_CM_single -3.4E+38 3.4E+38 /end CHARACTERISTIC
/begin CHARACTERISTIC P_VSM_LCKIE_State_DriverInputTrqValue_enable "" VALUE 0x0 /* @MemoryAddress@P_VSM_LCKIE_State_DriverInputTrqValue_enable@ */ Scalar_FLOAT32_IEEE 0 PubIfStateVSM_MDL_CM_single -3.4E+38 3.4E+38 /end CHARACTERISTIC
/begin CHARACTERISTIC P_VSM_LCKIE_State_ELKObjClc "" VALUE 0x0 /* @MemoryAddress@P_VSM_LCKIE_State_ELKObjClc@ */ Scalar_FLOAT32_IEEE 0 PubIfStateVSM_MDL_CM_single -3.4E+38 3.4E+38 /end CHARACTERISTIC
/begin CHARACTERISTIC P_VSM_LCKIE_State_HWASts_disable "" VALUE 0x0 /* @MemoryAddress@P_VSM_LCKIE_State_HWASts_disable@ */ Scalar_FLOAT32_IEEE 0 PubIfStateVSM_MDL_CM_single -3.4E+38 3.4E+38 /end CHARACTERISTIC
/begin CHARACTERISTIC P_VSM_LCKIE_State_IEObjClc "" VALUE 0x0 /* @MemoryAddress@P_VSM_LCKIE_State_IEObjClc@ */ Scalar_FLOAT32_IEEE 0 PubIfStateVSM_MDL_CM_single -3.4E+38 3.4E+38 /end CHARACTERISTIC
/begin CHARACTERISTIC P_VSM_LCKIE_State_IFVReady "" VALUE 0x0 /* @MemoryAddress@P_VSM_LCKIE_State_IFVReady@ */ Scalar_FLOAT32_IEEE 0 PubIfStateVSM_MDL_CM_single -3.4E+38 3.4E+38 /end CHARACTERISTIC
/begin CHARACTERISTIC P_VSM_LCKIE_State_LaneWidth_enable "" VALUE 0x0 /* @MemoryAddress@P_VSM_LCKIE_State_LaneWidth_enable@ */ Scalar_FLOAT32_IEEE 0 PubIfStateVSM_MDL_CM_single -3.4E+38 3.4E+38 /end CHARACTERISTIC
/begin CHARACTERISTIC P_VSM_LCKIE_State_Lanecurve_enable "" VALUE 0x0 /* @MemoryAddress@P_VSM_LCKIE_State_Lanecurve_enable@ */ Scalar_FLOAT32_IEEE 0 PubIfStateVSM_MDL_CM_single -3.4E+38 3.4E+38 /end CHARACTERISTIC
/begin CHARACTERISTIC P_VSM_LCKIE_State_Off2on "" VALUE 0x0 /* @MemoryAddress@P_VSM_LCKIE_State_Off2on@ */ Scalar_FLOAT32_IEEE 0 PubIfStateVSM_MDL_CM_single -3.4E+38 3.4E+38 /end CHARACTERISTIC
/begin CHARACTERISTIC P_VSM_LCKIE_State_OppObjClc "" VALUE 0x0 /* @MemoryAddress@P_VSM_LCKIE_State_OppObjClc@ */ Scalar_FLOAT32_IEEE 0 PubIfStateVSM_MDL_CM_single -3.4E+38 3.4E+38 /end CHARACTERISTIC
/begin CHARACTERISTIC P_VSM_LCKIE_State_Vehspeed_enable "" VALUE 0x0 /* @MemoryAddress@P_VSM_LCKIE_State_Vehspeed_enable@ */ Scalar_FLOAT32_IEEE 0 PubIfStateVSM_MDL_CM_single -3.4E+38 3.4E+38 /end CHARACTERISTIC
/begin CHARACTERISTIC P_VSM_LCKIE_State_detaspd "" VALUE 0x0 /* @MemoryAddress@P_VSM_LCKIE_State_detaspd@ */ Scalar_FLOAT32_IEEE 0 PubIfStateVSM_MDL_CM_single -3.4E+38 3.4E+38 /end CHARACTERISTIC
/begin CHARACTERISTIC P_VSM_LCKIE_State_detaspd_enable "" VALUE 0x0 /* @MemoryAddress@P_VSM_LCKIE_State_detaspd_enable@ */ Scalar_FLOAT32_IEEE 0 PubIfStateVSM_MDL_CM_single -3.4E+38 3.4E+38 /end CHARACTERISTIC
/begin CHARACTERISTIC P_VSM_LCKIE_State_lamb_enable "" VALUE 0x0 /* @MemoryAddress@P_VSM_LCKIE_State_lamb_enable@ */ Scalar_FLOAT32_IEEE 0 PubIfStateVSM_MDL_CM_single -3.4E+38 3.4E+38 /end CHARACTERISTIC
/begin CHARACTERISTIC P_VSM_LCKIE_State_wiper_enable "" VALUE 0x0 /* @MemoryAddress@P_VSM_LCKIE_State_wiper_enable@ */ Scalar_FLOAT32_IEEE 0 PubIfStateVSM_MDL_CM_single -3.4E+38 3.4E+38 /end CHARACTERISTIC
/begin CHARACTERISTIC P_VSM_LCKIE_tcycle "" VALUE 0x0 /* @MemoryAddress@P_VSM_LCKIE_tcycle@ */ Scalar_FLOAT32_IEEE 0 PubIfStateVSM_MDL_CM_single -3.4E+38 3.4E+38 /end CHARACTERISTIC
/begin CHARACTERISTIC P_VSM_LCK_AccRateIn "" VALUE 0x0 /* @MemoryAddress@P_VSM_LCK_AccRateIn@ */ Scalar_FLOAT32_IEEE 0 PubIfStateVSM_MDL_CM_single -3.4E+38 3.4E+38 /end CHARACTERISTIC
/begin CHARACTERISTIC P_VSM_LCK_AccRateOut "" VALUE 0x0 /* @MemoryAddress@P_VSM_LCK_AccRateOut@ */ Scalar_FLOAT32_IEEE 0 PubIfStateVSM_MDL_CM_single -3.4E+38 3.4E+38 /end CHARACTERISTIC
/begin CHARACTERISTIC P_VSM_LCK_AccrPelOut "" VALUE 0x0 /* @MemoryAddress@P_VSM_LCK_AccrPelOut@ */ Scalar_FLOAT32_IEEE 0 PubIfStateVSM_MDL_CM_single -3.4E+38 3.4E+38 /end CHARACTERISTIC
/begin CHARACTERISTIC P_VSM_LCK_BrakePressIn "" VALUE 0x0 /* @MemoryAddress@P_VSM_LCK_BrakePressIn@ */ Scalar_FLOAT32_IEEE 0 PubIfStateVSM_MDL_CM_single -3.4E+38 3.4E+38 /end CHARACTERISTIC
/begin CHARACTERISTIC P_VSM_LCK_BrakePressOut "" VALUE 0x0 /* @MemoryAddress@P_VSM_LCK_BrakePressOut@ */ Scalar_FLOAT32_IEEE 0 PubIfStateVSM_MDL_CM_single -3.4E+38 3.4E+38 /end CHARACTERISTIC
/begin CHARACTERISTIC P_VSM_LCK_DrvInputTrqValueIn "" VALUE 0x0 /* @MemoryAddress@P_VSM_LCK_DrvInputTrqValueIn@ */ Scalar_FLOAT32_IEEE 0 PubIfStateVSM_MDL_CM_single -3.4E+38 3.4E+38 /end CHARACTERISTIC
/begin CHARACTERISTIC P_VSM_LCK_DrvInputTrqValueOut "" VALUE 0x0 /* @MemoryAddress@P_VSM_LCK_DrvInputTrqValueOut@ */ Scalar_FLOAT32_IEEE 0 PubIfStateVSM_MDL_CM_single -3.4E+38 3.4E+38 /end CHARACTERISTIC
/begin CHARACTERISTIC P_VSM_LCK_IdleInTime "" VALUE 0x0 /* @MemoryAddress@P_VSM_LCK_IdleInTime@ */ Scalar_FLOAT32_IEEE 0 PubIfStateVSM_MDL_CM_single -3.4E+38 3.4E+38 /end CHARACTERISTIC
/begin CHARACTERISTIC P_VSM_LCK_LCDrvInputTrqValueOut "" VALUE 0x0 /* @MemoryAddress@P_VSM_LCK_LCDrvInputTrqValueOut@ */ Scalar_FLOAT32_IEEE 0 PubIfStateVSM_MDL_CM_single -3.4E+38 3.4E+38 /end CHARACTERISTIC
/begin CHARACTERISTIC P_VSM_LCK_LCOverrideValue "" VALUE 0x0 /* @MemoryAddress@P_VSM_LCK_LCOverrideValue@ */ Scalar_FLOAT32_IEEE 0 PubIfStateVSM_MDL_CM_single -3.4E+38 3.4E+38 /end CHARACTERISTIC
/begin CHARACTERISTIC P_VSM_LCK_LateralAcceIn "" VALUE 0x0 /* @MemoryAddress@P_VSM_LCK_LateralAcceIn@ */ Scalar_FLOAT32_IEEE 0 PubIfStateVSM_MDL_CM_single -3.4E+38 3.4E+38 /end CHARACTERISTIC
/begin CHARACTERISTIC P_VSM_LCK_LateralAcceOut "" VALUE 0x0 /* @MemoryAddress@P_VSM_LCK_LateralAcceOut@ */ Scalar_FLOAT32_IEEE 0 PubIfStateVSM_MDL_CM_single -3.4E+38 3.4E+38 /end CHARACTERISTIC
/begin CHARACTERISTIC P_VSM_LCK_LongitudeAccIn "" VALUE 0x0 /* @MemoryAddress@P_VSM_LCK_LongitudeAccIn@ */ Scalar_FLOAT32_IEEE 0 PubIfStateVSM_MDL_CM_single -3.4E+38 3.4E+38 /end CHARACTERISTIC
/begin CHARACTERISTIC P_VSM_LCK_LongitudeAccOut "" VALUE 0x0 /* @MemoryAddress@P_VSM_LCK_LongitudeAccOut@ */ Scalar_FLOAT32_IEEE 0 PubIfStateVSM_MDL_CM_single -3.4E+38 3.4E+38 /end CHARACTERISTIC
/begin CHARACTERISTIC P_VSM_LCK_OverrideValue "" VALUE 0x0 /* @MemoryAddress@P_VSM_LCK_OverrideValue@ */ Scalar_FLOAT32_IEEE 0 PubIfStateVSM_MDL_CM_single -3.4E+38 3.4E+38 /end CHARACTERISTIC
/begin CHARACTERISTIC P_VSM_LCK_State_Absesp_enable "" VALUE 0x0 /* @MemoryAddress@P_VSM_LCK_State_Absesp_enable@ */ Scalar_FLOAT32_IEEE 0 PubIfStateVSM_MDL_CM_single -3.4E+38 3.4E+38 /end CHARACTERISTIC
/begin CHARACTERISTIC P_VSM_LCK_State_Accpedalrate_enable "" VALUE 0x0 /* @MemoryAddress@P_VSM_LCK_State_Accpedalrate_enable@ */ Scalar_FLOAT32_IEEE 0 PubIfStateVSM_MDL_CM_single -3.4E+38 3.4E+38 /end CHARACTERISTIC
/begin CHARACTERISTIC P_VSM_LCK_State_Breakpressure_enable "" VALUE 0x0 /* @MemoryAddress@P_VSM_LCK_State_Breakpressure_enable@ */ Scalar_FLOAT32_IEEE 0 PubIfStateVSM_MDL_CM_single -3.4E+38 3.4E+38 /end CHARACTERISTIC
/begin CHARACTERISTIC P_VSM_LCK_State_DriverInputTrqValue_enable "" VALUE 0x0 /* @MemoryAddress@P_VSM_LCK_State_DriverInputTrqValue_enable@ */ Scalar_FLOAT32_IEEE 0 PubIfStateVSM_MDL_CM_single -3.4E+38 3.4E+38 /end CHARACTERISTIC
/begin CHARACTERISTIC P_VSM_LCK_State_Eps_enable "" VALUE 0x0 /* @MemoryAddress@P_VSM_LCK_State_Eps_enable@ */ Scalar_FLOAT32_IEEE 0 PubIfStateVSM_MDL_CM_single -3.4E+38 3.4E+38 /end CHARACTERISTIC
/begin CHARACTERISTIC P_VSM_LCK_State_GEAR_enable "" VALUE 0x0 /* @MemoryAddress@P_VSM_LCK_State_GEAR_enable@ */ Scalar_FLOAT32_IEEE 0 PubIfStateVSM_MDL_CM_single -3.4E+38 3.4E+38 /end CHARACTERISTIC
/begin CHARACTERISTIC P_VSM_LCK_State_Handson_enable "" VALUE 0x0 /* @MemoryAddress@P_VSM_LCK_State_Handson_enable@ */ Scalar_FLOAT32_IEEE 0 PubIfStateVSM_MDL_CM_single -3.4E+38 3.4E+38 /end CHARACTERISTIC
/begin CHARACTERISTIC P_VSM_LCK_State_IdleInTime_enable "" VALUE 0x0 /* @MemoryAddress@P_VSM_LCK_State_IdleInTime_enable@ */ Scalar_FLOAT32_IEEE 0 PubIfStateVSM_MDL_CM_single -3.4E+38 3.4E+38 /end CHARACTERISTIC
/begin CHARACTERISTIC P_VSM_LCK_State_LSMLine_enable "" VALUE 0x0 /* @MemoryAddress@P_VSM_LCK_State_LSMLine_enable@ */ Scalar_FLOAT32_IEEE 0 PubIfStateVSM_MDL_CM_single -3.4E+38 3.4E+38 /end CHARACTERISTIC
/begin CHARACTERISTIC P_VSM_LCK_State_LaneCurve_enable "" VALUE 0x0 /* @MemoryAddress@P_VSM_LCK_State_LaneCurve_enable@ */ Scalar_FLOAT32_IEEE 0 PubIfStateVSM_MDL_CM_single -3.4E+38 3.4E+38 /end CHARACTERISTIC
/begin CHARACTERISTIC P_VSM_LCK_State_Lane_enable "" VALUE 0x0 /* @MemoryAddress@P_VSM_LCK_State_Lane_enable@ */ Scalar_FLOAT32_IEEE 0 PubIfStateVSM_MDL_CM_single -3.4E+38 3.4E+38 /end CHARACTERISTIC
/begin CHARACTERISTIC P_VSM_LCK_State_LateralAcce_enable "" VALUE 0x0 /* @MemoryAddress@P_VSM_LCK_State_LateralAcce_enable@ */ Scalar_FLOAT32_IEEE 0 PubIfStateVSM_MDL_CM_single -3.4E+38 3.4E+38 /end CHARACTERISTIC
/begin CHARACTERISTIC P_VSM_LCK_State_LongitudeAcc_enable "" VALUE 0x0 /* @MemoryAddress@P_VSM_LCK_State_LongitudeAcc_enable@ */ Scalar_FLOAT32_IEEE 0 PubIfStateVSM_MDL_CM_single -3.4E+38 3.4E+38 /end CHARACTERISTIC
/begin CHARACTERISTIC P_VSM_LCK_State_Overide_enable "" VALUE 0x0 /* @MemoryAddress@P_VSM_LCK_State_Overide_enable@ */ Scalar_FLOAT32_IEEE 0 PubIfStateVSM_MDL_CM_single -3.4E+38 3.4E+38 /end CHARACTERISTIC
/begin CHARACTERISTIC P_VSM_LCK_State_SteerWheelAngle_enable "" VALUE 0x0 /* @MemoryAddress@P_VSM_LCK_State_SteerWheelAngle_enable@ */ Scalar_FLOAT32_IEEE 0 PubIfStateVSM_MDL_CM_single -3.4E+38 3.4E+38 /end CHARACTERISTIC
/begin CHARACTERISTIC P_VSM_LCK_State_SteerWheelSpd_enable "" VALUE 0x0 /* @MemoryAddress@P_VSM_LCK_State_SteerWheelSpd_enable@ */ Scalar_FLOAT32_IEEE 0 PubIfStateVSM_MDL_CM_single -3.4E+38 3.4E+38 /end CHARACTERISTIC
/begin CHARACTERISTIC P_VSM_LCK_State_TargetLaneIn_enable "" VALUE 0x0 /* @MemoryAddress@P_VSM_LCK_State_TargetLaneIn_enable@ */ Scalar_FLOAT32_IEEE 0 PubIfStateVSM_MDL_CM_single -3.4E+38 3.4E+38 /end CHARACTERISTIC
/begin CHARACTERISTIC P_VSM_LCK_State_TurnLight_enable "" VALUE 0x0 /* @MemoryAddress@P_VSM_LCK_State_TurnLight_enable@ */ Scalar_FLOAT32_IEEE 0 PubIfStateVSM_MDL_CM_single -3.4E+38 3.4E+38 /end CHARACTERISTIC
/begin CHARACTERISTIC P_VSM_LCK_State_Vehspeed_enable "" VALUE 0x0 /* @MemoryAddress@P_VSM_LCK_State_Vehspeed_enable@ */ Scalar_FLOAT32_IEEE 0 PubIfStateVSM_MDL_CM_single -3.4E+38 3.4E+38 /end CHARACTERISTIC
/begin CHARACTERISTIC P_VSM_LCK_State_Yawsup_enable "" VALUE 0x0 /* @MemoryAddress@P_VSM_LCK_State_Yawsup_enable@ */ Scalar_FLOAT32_IEEE 0 PubIfStateVSM_MDL_CM_single -3.4E+38 3.4E+38 /end CHARACTERISTIC
/begin CHARACTERISTIC P_VSM_LCK_SteerAngleSpdIn "" VALUE 0x0 /* @MemoryAddress@P_VSM_LCK_SteerAngleSpdIn@ */ Scalar_FLOAT32_IEEE 0 PubIfStateVSM_MDL_CM_single -3.4E+38 3.4E+38 /end CHARACTERISTIC
/begin CHARACTERISTIC P_VSM_LCK_SteerAngleSpdOut "" VALUE 0x0 /* @MemoryAddress@P_VSM_LCK_SteerAngleSpdOut@ */ Scalar_FLOAT32_IEEE 0 PubIfStateVSM_MDL_CM_single -3.4E+38 3.4E+38 /end CHARACTERISTIC
/begin CHARACTERISTIC P_VSM_LCK_SteerWheelAngleIn "" VALUE 0x0 /* @MemoryAddress@P_VSM_LCK_SteerWheelAngleIn@ */ Scalar_FLOAT32_IEEE 0 PubIfStateVSM_MDL_CM_single -3.4E+38 3.4E+38 /end CHARACTERISTIC
/begin CHARACTERISTIC P_VSM_LCK_SteerWheelAngleOut "" VALUE 0x0 /* @MemoryAddress@P_VSM_LCK_SteerWheelAngleOut@ */ Scalar_FLOAT32_IEEE 0 PubIfStateVSM_MDL_CM_single -3.4E+38 3.4E+38 /end CHARACTERISTIC
/begin CHARACTERISTIC P_VSM_LCK_Warnarea1 "" VALUE 0x0 /* @MemoryAddress@P_VSM_LCK_Warnarea1@ */ Scalar_FLOAT32_IEEE 0 PubIfStateVSM_MDL_CM_single -3.4E+38 3.4E+38 /end CHARACTERISTIC
/begin CHARACTERISTIC P_VSM_LCK_Warnarea2 "" VALUE 0x0 /* @MemoryAddress@P_VSM_LCK_Warnarea2@ */ Scalar_FLOAT32_IEEE 0 PubIfStateVSM_MDL_CM_single -3.4E+38 3.4E+38 /end CHARACTERISTIC
/begin CHARACTERISTIC P_VSM_LCK_YawRateIn "" VALUE 0x0 /* @MemoryAddress@P_VSM_LCK_YawRateIn@ */ Scalar_FLOAT32_IEEE 0 PubIfStateVSM_MDL_CM_single -3.4E+38 3.4E+38 /end CHARACTERISTIC
/begin CHARACTERISTIC P_VSM_LCK_YawRateOut "" VALUE 0x0 /* @MemoryAddress@P_VSM_LCK_YawRateOut@ */ Scalar_FLOAT32_IEEE 0 PubIfStateVSM_MDL_CM_single -3.4E+38 3.4E+38 /end CHARACTERISTIC
/begin CHARACTERISTIC P_VSM_LCK_absLongitudeAccIn "" VALUE 0x0 /* @MemoryAddress@P_VSM_LCK_absLongitudeAccIn@ */ Scalar_FLOAT32_IEEE 0 PubIfStateVSM_MDL_CM_single -3.4E+38 3.4E+38 /end CHARACTERISTIC
/begin CHARACTERISTIC P_VSM_LCK_absLongitudeAccOut "" VALUE 0x0 /* @MemoryAddress@P_VSM_LCK_absLongitudeAccOut@ */ Scalar_FLOAT32_IEEE 0 PubIfStateVSM_MDL_CM_single -3.4E+38 3.4E+38 /end CHARACTERISTIC
/begin CHARACTERISTIC P_VSM_LDW_AccPedalOut "" VALUE 0x0 /* @MemoryAddress@P_VSM_LDW_AccPedalOut@ */ Scalar_FLOAT32_IEEE 0 PubIfStateVSM_MDL_CM_single -3.4E+38 3.4E+38 /end CHARACTERISTIC
/begin CHARACTERISTIC P_VSM_LDW_AccRateIn "" VALUE 0x0 /* @MemoryAddress@P_VSM_LDW_AccRateIn@ */ Scalar_FLOAT32_IEEE 0 PubIfStateVSM_MDL_CM_single -3.4E+38 3.4E+38 /end CHARACTERISTIC
/begin CHARACTERISTIC P_VSM_LDW_AccRateOut "" VALUE 0x0 /* @MemoryAddress@P_VSM_LDW_AccRateOut@ */ Scalar_FLOAT32_IEEE 0 PubIfStateVSM_MDL_CM_single -3.4E+38 3.4E+38 /end CHARACTERISTIC
/begin CHARACTERISTIC P_VSM_LDW_BrakePressIn "" VALUE 0x0 /* @MemoryAddress@P_VSM_LDW_BrakePressIn@ */ Scalar_FLOAT32_IEEE 0 PubIfStateVSM_MDL_CM_single -3.4E+38 3.4E+38 /end CHARACTERISTIC
/begin CHARACTERISTIC P_VSM_LDW_BrakePressOut "" VALUE 0x0 /* @MemoryAddress@P_VSM_LDW_BrakePressOut@ */ Scalar_FLOAT32_IEEE 0 PubIfStateVSM_MDL_CM_single -3.4E+38 3.4E+38 /end CHARACTERISTIC
/begin CHARACTERISTIC P_VSM_LDW_LaneCurveIn "" VALUE 0x0 /* @MemoryAddress@P_VSM_LDW_LaneCurveIn@ */ Scalar_FLOAT32_IEEE 0 PubIfStateVSM_MDL_CM_single -3.4E+38 3.4E+38 /end CHARACTERISTIC
/begin CHARACTERISTIC P_VSM_LDW_LaneCurveOut "" VALUE 0x0 /* @MemoryAddress@P_VSM_LDW_LaneCurveOut@ */ Scalar_FLOAT32_IEEE 0 PubIfStateVSM_MDL_CM_single -3.4E+38 3.4E+38 /end CHARACTERISTIC
/begin CHARACTERISTIC P_VSM_LDW_LateralAcceIn "" VALUE 0x0 /* @MemoryAddress@P_VSM_LDW_LateralAcceIn@ */ Scalar_FLOAT32_IEEE 0 PubIfStateVSM_MDL_CM_single -3.4E+38 3.4E+38 /end CHARACTERISTIC
/begin CHARACTERISTIC P_VSM_LDW_LateralAcceOut "" VALUE 0x0 /* @MemoryAddress@P_VSM_LDW_LateralAcceOut@ */ Scalar_FLOAT32_IEEE 0 PubIfStateVSM_MDL_CM_single -3.4E+38 3.4E+38 /end CHARACTERISTIC
/begin CHARACTERISTIC P_VSM_LDW_LongitudeAccIn "" VALUE 0x0 /* @MemoryAddress@P_VSM_LDW_LongitudeAccIn@ */ Scalar_FLOAT32_IEEE 0 PubIfStateVSM_MDL_CM_single -3.4E+38 3.4E+38 /end CHARACTERISTIC
/begin CHARACTERISTIC P_VSM_LDW_LongitudeAccOut "" VALUE 0x0 /* @MemoryAddress@P_VSM_LDW_LongitudeAccOut@ */ Scalar_FLOAT32_IEEE 0 PubIfStateVSM_MDL_CM_single -3.4E+38 3.4E+38 /end CHARACTERISTIC
/begin CHARACTERISTIC P_VSM_LDW_State_Absesp_enable "" VALUE 0x0 /* @MemoryAddress@P_VSM_LDW_State_Absesp_enable@ */ Scalar_FLOAT32_IEEE 0 PubIfStateVSM_MDL_CM_single -3.4E+38 3.4E+38 /end CHARACTERISTIC
/begin CHARACTERISTIC P_VSM_LDW_State_Accpedalrate_enable "" VALUE 0x0 /* @MemoryAddress@P_VSM_LDW_State_Accpedalrate_enable@ */ Scalar_FLOAT32_IEEE 0 PubIfStateVSM_MDL_CM_single -3.4E+38 3.4E+38 /end CHARACTERISTIC
/begin CHARACTERISTIC P_VSM_LDW_State_Breakpressure_enable "" VALUE 0x0 /* @MemoryAddress@P_VSM_LDW_State_Breakpressure_enable@ */ Scalar_FLOAT32_IEEE 0 PubIfStateVSM_MDL_CM_single -3.4E+38 3.4E+38 /end CHARACTERISTIC
/begin CHARACTERISTIC P_VSM_LDW_State_Failsafe_enable "" VALUE 0x0 /* @MemoryAddress@P_VSM_LDW_State_Failsafe_enable@ */ Scalar_FLOAT32_IEEE 0 PubIfStateVSM_MDL_CM_single -3.4E+38 3.4E+38 /end CHARACTERISTIC
/begin CHARACTERISTIC P_VSM_LDW_State_GEAR_enable "" VALUE 0x0 /* @MemoryAddress@P_VSM_LDW_State_GEAR_enable@ */ Scalar_FLOAT32_IEEE 0 PubIfStateVSM_MDL_CM_single -3.4E+38 3.4E+38 /end CHARACTERISTIC
/begin CHARACTERISTIC P_VSM_LDW_State_Headingangle_enable "" VALUE 0x0 /* @MemoryAddress@P_VSM_LDW_State_Headingangle_enable@ */ Scalar_FLOAT32_IEEE 0 PubIfStateVSM_MDL_CM_single -3.4E+38 3.4E+38 /end CHARACTERISTIC
/begin CHARACTERISTIC P_VSM_LDW_State_LaneChange_enable "" VALUE 0x0 /* @MemoryAddress@P_VSM_LDW_State_LaneChange_enable@ */ Scalar_FLOAT32_IEEE 0 PubIfStateVSM_MDL_CM_single -3.4E+38 3.4E+38 /end CHARACTERISTIC
/begin CHARACTERISTIC P_VSM_LDW_State_Lane_enable "" VALUE 0x0 /* @MemoryAddress@P_VSM_LDW_State_Lane_enable@ */ Scalar_FLOAT32_IEEE 0 PubIfStateVSM_MDL_CM_single -3.4E+38 3.4E+38 /end CHARACTERISTIC
/begin CHARACTERISTIC P_VSM_LDW_State_Lanecurve_enable "" VALUE 0x0 /* @MemoryAddress@P_VSM_LDW_State_Lanecurve_enable@ */ Scalar_FLOAT32_IEEE 0 PubIfStateVSM_MDL_CM_single -3.4E+38 3.4E+38 /end CHARACTERISTIC
/begin CHARACTERISTIC P_VSM_LDW_State_LateralAcce_enable "" VALUE 0x0 /* @MemoryAddress@P_VSM_LDW_State_LateralAcce_enable@ */ Scalar_FLOAT32_IEEE 0 PubIfStateVSM_MDL_CM_single -3.4E+38 3.4E+38 /end CHARACTERISTIC
/begin CHARACTERISTIC P_VSM_LDW_State_LongitudeAcc_enable "" VALUE 0x0 /* @MemoryAddress@P_VSM_LDW_State_LongitudeAcc_enable@ */ Scalar_FLOAT32_IEEE 0 PubIfStateVSM_MDL_CM_single -3.4E+38 3.4E+38 /end CHARACTERISTIC
/begin CHARACTERISTIC P_VSM_LDW_State_Param_REWarningZoneIn "" VALUE 0x0 /* @MemoryAddress@P_VSM_LDW_State_Param_REWarningZoneIn@ */ Scalar_FLOAT32_IEEE 0 PubIfStateVSM_MDL_CM_single -3.4E+38 3.4E+38 /end CHARACTERISTIC
/begin CHARACTERISTIC P_VSM_LDW_State_Param_WarningZoneIn "" VALUE 0x0 /* @MemoryAddress@P_VSM_LDW_State_Param_WarningZoneIn@ */ Scalar_FLOAT32_IEEE 0 PubIfStateVSM_MDL_CM_single -3.4E+38 3.4E+38 /end CHARACTERISTIC
/begin CHARACTERISTIC P_VSM_LDW_State_Param_WarningZoneOut "" VALUE 0x0 /* @MemoryAddress@P_VSM_LDW_State_Param_WarningZoneOut@ */ Scalar_FLOAT32_IEEE 0 PubIfStateVSM_MDL_CM_single -3.4E+38 3.4E+38 /end CHARACTERISTIC
/begin CHARACTERISTIC P_VSM_LDW_State_SteerWheelAngle_enable "" VALUE 0x0 /* @MemoryAddress@P_VSM_LDW_State_SteerWheelAngle_enable@ */ Scalar_FLOAT32_IEEE 0 PubIfStateVSM_MDL_CM_single -3.4E+38 3.4E+38 /end CHARACTERISTIC
/begin CHARACTERISTIC P_VSM_LDW_State_SteerWheelSpd_enable "" VALUE 0x0 /* @MemoryAddress@P_VSM_LDW_State_SteerWheelSpd_enable@ */ Scalar_FLOAT32_IEEE 0 PubIfStateVSM_MDL_CM_single -3.4E+38 3.4E+38 /end CHARACTERISTIC
/begin CHARACTERISTIC P_VSM_LDW_State_TurnLight_enable "" VALUE 0x0 /* @MemoryAddress@P_VSM_LDW_State_TurnLight_enable@ */ Scalar_FLOAT32_IEEE 0 PubIfStateVSM_MDL_CM_single -3.4E+38 3.4E+38 /end CHARACTERISTIC
/begin CHARACTERISTIC P_VSM_LDW_State_Vehspeed_enable "" VALUE 0x0 /* @MemoryAddress@P_VSM_LDW_State_Vehspeed_enable@ */ Scalar_FLOAT32_IEEE 0 PubIfStateVSM_MDL_CM_single -3.4E+38 3.4E+38 /end CHARACTERISTIC
/begin CHARACTERISTIC P_VSM_LDW_State_Yawsup_enable "" VALUE 0x0 /* @MemoryAddress@P_VSM_LDW_State_Yawsup_enable@ */ Scalar_FLOAT32_IEEE 0 PubIfStateVSM_MDL_CM_single -3.4E+38 3.4E+38 /end CHARACTERISTIC
/begin CHARACTERISTIC P_VSM_LDW_SteerWheelAngleIn "" VALUE 0x0 /* @MemoryAddress@P_VSM_LDW_SteerWheelAngleIn@ */ Scalar_FLOAT32_IEEE 0 PubIfStateVSM_MDL_CM_single -3.4E+38 3.4E+38 /end CHARACTERISTIC
/begin CHARACTERISTIC P_VSM_LDW_SteerWheelAngleOut "" VALUE 0x0 /* @MemoryAddress@P_VSM_LDW_SteerWheelAngleOut@ */ Scalar_FLOAT32_IEEE 0 PubIfStateVSM_MDL_CM_single -3.4E+38 3.4E+38 /end CHARACTERISTIC
/begin CHARACTERISTIC P_VSM_LDW_SteerWheelSpdIn "" VALUE 0x0 /* @MemoryAddress@P_VSM_LDW_SteerWheelSpdIn@ */ Scalar_FLOAT32_IEEE 0 PubIfStateVSM_MDL_CM_single -3.4E+38 3.4E+38 /end CHARACTERISTIC
/begin CHARACTERISTIC P_VSM_LDW_SteerWheelSpdOut "" VALUE 0x0 /* @MemoryAddress@P_VSM_LDW_SteerWheelSpdOut@ */ Scalar_FLOAT32_IEEE 0 PubIfStateVSM_MDL_CM_single -3.4E+38 3.4E+38 /end CHARACTERISTIC
/begin CHARACTERISTIC P_VSM_LDW_WhelDy "" VALUE 0x0 /* @MemoryAddress@P_VSM_LDW_WhelDy@ */ Scalar_FLOAT32_IEEE 0 PubIfStateVSM_MDL_CM_single -3.4E+38 3.4E+38 /end CHARACTERISTIC
/begin CHARACTERISTIC P_VSM_LDW_YawRateIn "" VALUE 0x0 /* @MemoryAddress@P_VSM_LDW_YawRateIn@ */ Scalar_FLOAT32_IEEE 0 PubIfStateVSM_MDL_CM_single -3.4E+38 3.4E+38 /end CHARACTERISTIC
/begin CHARACTERISTIC P_VSM_LDW_YawRateOut "" VALUE 0x0 /* @MemoryAddress@P_VSM_LDW_YawRateOut@ */ Scalar_FLOAT32_IEEE 0 PubIfStateVSM_MDL_CM_single -3.4E+38 3.4E+38 /end CHARACTERISTIC
/begin CHARACTERISTIC P_VSM_LDW_absLongitudeAccIn "" VALUE 0x0 /* @MemoryAddress@P_VSM_LDW_absLongitudeAccIn@ */ Scalar_FLOAT32_IEEE 0 PubIfStateVSM_MDL_CM_single -3.4E+38 3.4E+38 /end CHARACTERISTIC
/begin CHARACTERISTIC P_VSM_LDW_absLongitudeAccOut "" VALUE 0x0 /* @MemoryAddress@P_VSM_LDW_absLongitudeAccOut@ */ Scalar_FLOAT32_IEEE 0 PubIfStateVSM_MDL_CM_single -3.4E+38 3.4E+38 /end CHARACTERISTIC
/begin CHARACTERISTIC P_VSM_LKA_AccPedalPosnOut "" VALUE 0x0 /* @MemoryAddress@P_VSM_LKA_AccPedalPosnOut@ */ Scalar_FLOAT32_IEEE 0 PubIfStateVSM_MDL_CM_single -3.4E+38 3.4E+38 /end CHARACTERISTIC
/begin CHARACTERISTIC P_VSM_LKA_AccRateIn "" VALUE 0x0 /* @MemoryAddress@P_VSM_LKA_AccRateIn@ */ Scalar_FLOAT32_IEEE 0 PubIfStateVSM_MDL_CM_single -3.4E+38 3.4E+38 /end CHARACTERISTIC
/begin CHARACTERISTIC P_VSM_LKA_AccRateOut "" VALUE 0x0 /* @MemoryAddress@P_VSM_LKA_AccRateOut@ */ Scalar_FLOAT32_IEEE 0 PubIfStateVSM_MDL_CM_single -3.4E+38 3.4E+38 /end CHARACTERISTIC
/begin CHARACTERISTIC P_VSM_LKA_BrakePressIn "" VALUE 0x0 /* @MemoryAddress@P_VSM_LKA_BrakePressIn@ */ Scalar_FLOAT32_IEEE 0 PubIfStateVSM_MDL_CM_single -3.4E+38 3.4E+38 /end CHARACTERISTIC
/begin CHARACTERISTIC P_VSM_LKA_BrakePressOut "" VALUE 0x0 /* @MemoryAddress@P_VSM_LKA_BrakePressOut@ */ Scalar_FLOAT32_IEEE 0 PubIfStateVSM_MDL_CM_single -3.4E+38 3.4E+38 /end CHARACTERISTIC
/begin CHARACTERISTIC P_VSM_LKA_DriverInputTrqValueIn "" VALUE 0x0 /* @MemoryAddress@P_VSM_LKA_DriverInputTrqValueIn@ */ Scalar_FLOAT32_IEEE 0 PubIfStateVSM_MDL_CM_single -3.4E+38 3.4E+38 /end CHARACTERISTIC
/begin CHARACTERISTIC P_VSM_LKA_DriverInputTrqValueOut "" VALUE 0x0 /* @MemoryAddress@P_VSM_LKA_DriverInputTrqValueOut@ */ Scalar_FLOAT32_IEEE 0 PubIfStateVSM_MDL_CM_single -3.4E+38 3.4E+38 /end CHARACTERISTIC
/begin CHARACTERISTIC P_VSM_LKA_LaneCurveIn "" VALUE 0x0 /* @MemoryAddress@P_VSM_LKA_LaneCurveIn@ */ Scalar_FLOAT32_IEEE 0 PubIfStateVSM_MDL_CM_single -3.4E+38 3.4E+38 /end CHARACTERISTIC
/begin CHARACTERISTIC P_VSM_LKA_LaneCurveOut "" VALUE 0x0 /* @MemoryAddress@P_VSM_LKA_LaneCurveOut@ */ Scalar_FLOAT32_IEEE 0 PubIfStateVSM_MDL_CM_single -3.4E+38 3.4E+38 /end CHARACTERISTIC
/begin CHARACTERISTIC P_VSM_LKA_LateralAcceIn "" VALUE 0x0 /* @MemoryAddress@P_VSM_LKA_LateralAcceIn@ */ Scalar_FLOAT32_IEEE 0 PubIfStateVSM_MDL_CM_single -3.4E+38 3.4E+38 /end CHARACTERISTIC
/begin CHARACTERISTIC P_VSM_LKA_LateralAcceOut "" VALUE 0x0 /* @MemoryAddress@P_VSM_LKA_LateralAcceOut@ */ Scalar_FLOAT32_IEEE 0 PubIfStateVSM_MDL_CM_single -3.4E+38 3.4E+38 /end CHARACTERISTIC
/begin CHARACTERISTIC P_VSM_LKA_LongitudeAcceIn "" VALUE 0x0 /* @MemoryAddress@P_VSM_LKA_LongitudeAcceIn@ */ Scalar_FLOAT32_IEEE 0 PubIfStateVSM_MDL_CM_single -3.4E+38 3.4E+38 /end CHARACTERISTIC
/begin CHARACTERISTIC P_VSM_LKA_LongitudeAcceOut "" VALUE 0x0 /* @MemoryAddress@P_VSM_LKA_LongitudeAcceOut@ */ Scalar_FLOAT32_IEEE 0 PubIfStateVSM_MDL_CM_single -3.4E+38 3.4E+38 /end CHARACTERISTIC
/begin CHARACTERISTIC P_VSM_LKA_OverrideValue "" VALUE 0x0 /* @MemoryAddress@P_VSM_LKA_OverrideValue@ */ Scalar_FLOAT32_IEEE 0 PubIfStateVSM_MDL_CM_single -3.4E+38 3.4E+38 /end CHARACTERISTIC
/begin CHARACTERISTIC P_VSM_LKA_State_Absesp_enable "" VALUE 0x0 /* @MemoryAddress@P_VSM_LKA_State_Absesp_enable@ */ Scalar_FLOAT32_IEEE 0 PubIfStateVSM_MDL_CM_single -3.4E+38 3.4E+38 /end CHARACTERISTIC
/begin CHARACTERISTIC P_VSM_LKA_State_Accpedalrate_enable "" VALUE 0x0 /* @MemoryAddress@P_VSM_LKA_State_Accpedalrate_enable@ */ Scalar_FLOAT32_IEEE 0 PubIfStateVSM_MDL_CM_single -3.4E+38 3.4E+38 /end CHARACTERISTIC
/begin CHARACTERISTIC P_VSM_LKA_State_Breakpressure_enable "" VALUE 0x0 /* @MemoryAddress@P_VSM_LKA_State_Breakpressure_enable@ */ Scalar_FLOAT32_IEEE 0 PubIfStateVSM_MDL_CM_single -3.4E+38 3.4E+38 /end CHARACTERISTIC
/begin CHARACTERISTIC P_VSM_LKA_State_DriverInputTrqValue_enable "" VALUE 0x0 /* @MemoryAddress@P_VSM_LKA_State_DriverInputTrqValue_enable@ */ Scalar_FLOAT32_IEEE 0 PubIfStateVSM_MDL_CM_single -3.4E+38 3.4E+38 /end CHARACTERISTIC
/begin CHARACTERISTIC P_VSM_LKA_State_Eps_enable "" VALUE 0x0 /* @MemoryAddress@P_VSM_LKA_State_Eps_enable@ */ Scalar_FLOAT32_IEEE 0 PubIfStateVSM_MDL_CM_single -3.4E+38 3.4E+38 /end CHARACTERISTIC
/begin CHARACTERISTIC P_VSM_LKA_State_Failsafe_enable "" VALUE 0x0 /* @MemoryAddress@P_VSM_LKA_State_Failsafe_enable@ */ Scalar_FLOAT32_IEEE 0 PubIfStateVSM_MDL_CM_single -3.4E+38 3.4E+38 /end CHARACTERISTIC
/begin CHARACTERISTIC P_VSM_LKA_State_GEAR_enable "" VALUE 0x0 /* @MemoryAddress@P_VSM_LKA_State_GEAR_enable@ */ Scalar_FLOAT32_IEEE 0 PubIfStateVSM_MDL_CM_single -3.4E+38 3.4E+38 /end CHARACTERISTIC
/begin CHARACTERISTIC P_VSM_LKA_State_Headingangle_enable "" VALUE 0x0 /* @MemoryAddress@P_VSM_LKA_State_Headingangle_enable@ */ Scalar_FLOAT32_IEEE 0 PubIfStateVSM_MDL_CM_single -3.4E+38 3.4E+38 /end CHARACTERISTIC
/begin CHARACTERISTIC P_VSM_LKA_State_LaneChange_enable "" VALUE 0x0 /* @MemoryAddress@P_VSM_LKA_State_LaneChange_enable@ */ Scalar_FLOAT32_IEEE 0 PubIfStateVSM_MDL_CM_single -3.4E+38 3.4E+38 /end CHARACTERISTIC
/begin CHARACTERISTIC P_VSM_LKA_State_Lane_enable "" VALUE 0x0 /* @MemoryAddress@P_VSM_LKA_State_Lane_enable@ */ Scalar_FLOAT32_IEEE 0 PubIfStateVSM_MDL_CM_single -3.4E+38 3.4E+38 /end CHARACTERISTIC
/begin CHARACTERISTIC P_VSM_LKA_State_Lanecurve_enable "" VALUE 0x0 /* @MemoryAddress@P_VSM_LKA_State_Lanecurve_enable@ */ Scalar_FLOAT32_IEEE 0 PubIfStateVSM_MDL_CM_single -3.4E+38 3.4E+38 /end CHARACTERISTIC
/begin CHARACTERISTIC P_VSM_LKA_State_LateralAcce_enable "" VALUE 0x0 /* @MemoryAddress@P_VSM_LKA_State_LateralAcce_enable@ */ Scalar_FLOAT32_IEEE 0 PubIfStateVSM_MDL_CM_single -3.4E+38 3.4E+38 /end CHARACTERISTIC
/begin CHARACTERISTIC P_VSM_LKA_State_LongitudeAcc_enable "" VALUE 0x0 /* @MemoryAddress@P_VSM_LKA_State_LongitudeAcc_enable@ */ Scalar_FLOAT32_IEEE 0 PubIfStateVSM_MDL_CM_single -3.4E+38 3.4E+38 /end CHARACTERISTIC
/begin CHARACTERISTIC P_VSM_LKA_State_Overide_enable "" VALUE 0x0 /* @MemoryAddress@P_VSM_LKA_State_Overide_enable@ */ Scalar_FLOAT32_IEEE 0 PubIfStateVSM_MDL_CM_single -3.4E+38 3.4E+38 /end CHARACTERISTIC
/begin CHARACTERISTIC P_VSM_LKA_State_Param_AngleOffset "" VALUE 0x0 /* @MemoryAddress@P_VSM_LKA_State_Param_AngleOffset@ */ Scalar_FLOAT32_IEEE 0 PubIfStateVSM_MDL_CM_single -3.4E+38 3.4E+38 /end CHARACTERISTIC
/begin CHARACTERISTIC P_VSM_LKA_State_Param_InterventionZoneIn "" VALUE 0x0 /* @MemoryAddress@P_VSM_LKA_State_Param_InterventionZoneIn@ */ Scalar_FLOAT32_IEEE 0 PubIfStateVSM_MDL_CM_single -3.4E+38 3.4E+38 /end CHARACTERISTIC
/begin CHARACTERISTIC P_VSM_LKA_State_Param_InterventionZoneOut "" VALUE 0x0 /* @MemoryAddress@P_VSM_LKA_State_Param_InterventionZoneOut@ */ Scalar_FLOAT32_IEEE 0 PubIfStateVSM_MDL_CM_single -3.4E+38 3.4E+38 /end CHARACTERISTIC
/begin CHARACTERISTIC P_VSM_LKA_State_Param_Offset "" VALUE 0x0 /* @MemoryAddress@P_VSM_LKA_State_Param_Offset@ */ Scalar_FLOAT32_IEEE 0 PubIfStateVSM_MDL_CM_single -3.4E+38 3.4E+38 /end CHARACTERISTIC
/begin CHARACTERISTIC P_VSM_LKA_State_Param_OutOffset "" VALUE 0x0 /* @MemoryAddress@P_VSM_LKA_State_Param_OutOffset@ */ Scalar_FLOAT32_IEEE 0 PubIfStateVSM_MDL_CM_single -3.4E+38 3.4E+38 /end CHARACTERISTIC
/begin CHARACTERISTIC P_VSM_LKA_State_Param_REInterventionZoneIn "" VALUE 0x0 /* @MemoryAddress@P_VSM_LKA_State_Param_REInterventionZoneIn@ */ Scalar_FLOAT32_IEEE 0 PubIfStateVSM_MDL_CM_single -3.4E+38 3.4E+38 /end CHARACTERISTIC
/begin CHARACTERISTIC P_VSM_LKA_State_SteerWheelAngle_enable "" VALUE 0x0 /* @MemoryAddress@P_VSM_LKA_State_SteerWheelAngle_enable@ */ Scalar_FLOAT32_IEEE 0 PubIfStateVSM_MDL_CM_single -3.4E+38 3.4E+38 /end CHARACTERISTIC
/begin CHARACTERISTIC P_VSM_LKA_State_SteerWheelSpd_enable "" VALUE 0x0 /* @MemoryAddress@P_VSM_LKA_State_SteerWheelSpd_enable@ */ Scalar_FLOAT32_IEEE 0 PubIfStateVSM_MDL_CM_single -3.4E+38 3.4E+38 /end CHARACTERISTIC
/begin CHARACTERISTIC P_VSM_LKA_State_TJASts_enable "" VALUE 0x0 /* @MemoryAddress@P_VSM_LKA_State_TJASts_enable@ */ Scalar_FLOAT32_IEEE 0 PubIfStateVSM_MDL_CM_single -3.4E+38 3.4E+38 /end CHARACTERISTIC
/begin CHARACTERISTIC P_VSM_LKA_State_TurnLight_enable "" VALUE 0x0 /* @MemoryAddress@P_VSM_LKA_State_TurnLight_enable@ */ Scalar_FLOAT32_IEEE 0 PubIfStateVSM_MDL_CM_single -3.4E+38 3.4E+38 /end CHARACTERISTIC
/begin CHARACTERISTIC P_VSM_LKA_State_Vehspeed_enable "" VALUE 0x0 /* @MemoryAddress@P_VSM_LKA_State_Vehspeed_enable@ */ Scalar_FLOAT32_IEEE 0 PubIfStateVSM_MDL_CM_single -3.4E+38 3.4E+38 /end CHARACTERISTIC
/begin CHARACTERISTIC P_VSM_LKA_State_Yawsup_enable "" VALUE 0x0 /* @MemoryAddress@P_VSM_LKA_State_Yawsup_enable@ */ Scalar_FLOAT32_IEEE 0 PubIfStateVSM_MDL_CM_single -3.4E+38 3.4E+38 /end CHARACTERISTIC
/begin CHARACTERISTIC P_VSM_LKA_SteerWheelAngleIn "" VALUE 0x0 /* @MemoryAddress@P_VSM_LKA_SteerWheelAngleIn@ */ Scalar_FLOAT32_IEEE 0 PubIfStateVSM_MDL_CM_single -3.4E+38 3.4E+38 /end CHARACTERISTIC
/begin CHARACTERISTIC P_VSM_LKA_SteerWheelAngleOut "" VALUE 0x0 /* @MemoryAddress@P_VSM_LKA_SteerWheelAngleOut@ */ Scalar_FLOAT32_IEEE 0 PubIfStateVSM_MDL_CM_single -3.4E+38 3.4E+38 /end CHARACTERISTIC
/begin CHARACTERISTIC P_VSM_LKA_SteerWheelSpdIn "" VALUE 0x0 /* @MemoryAddress@P_VSM_LKA_SteerWheelSpdIn@ */ Scalar_FLOAT32_IEEE 0 PubIfStateVSM_MDL_CM_single -3.4E+38 3.4E+38 /end CHARACTERISTIC
/begin CHARACTERISTIC P_VSM_LKA_SteerWheelSpdOut "" VALUE 0x0 /* @MemoryAddress@P_VSM_LKA_SteerWheelSpdOut@ */ Scalar_FLOAT32_IEEE 0 PubIfStateVSM_MDL_CM_single -3.4E+38 3.4E+38 /end CHARACTERISTIC
/begin CHARACTERISTIC P_VSM_LKA_Warnarea1 "" VALUE 0x0 /* @MemoryAddress@P_VSM_LKA_Warnarea1@ */ Scalar_FLOAT32_IEEE 0 PubIfStateVSM_MDL_CM_single -3.4E+38 3.4E+38 /end CHARACTERISTIC
/begin CHARACTERISTIC P_VSM_LKA_Warnarea2 "" VALUE 0x0 /* @MemoryAddress@P_VSM_LKA_Warnarea2@ */ Scalar_FLOAT32_IEEE 0 PubIfStateVSM_MDL_CM_single -3.4E+38 3.4E+38 /end CHARACTERISTIC
/begin CHARACTERISTIC P_VSM_LKA_WhelDy "" VALUE 0x0 /* @MemoryAddress@P_VSM_LKA_WhelDy@ */ Scalar_FLOAT32_IEEE 0 PubIfStateVSM_MDL_CM_single -3.4E+38 3.4E+38 /end CHARACTERISTIC
/begin CHARACTERISTIC P_VSM_LKA_YawRateIn "" VALUE 0x0 /* @MemoryAddress@P_VSM_LKA_YawRateIn@ */ Scalar_FLOAT32_IEEE 0 PubIfStateVSM_MDL_CM_single -3.4E+38 3.4E+38 /end CHARACTERISTIC
/begin CHARACTERISTIC P_VSM_LKA_YawRateOut "" VALUE 0x0 /* @MemoryAddress@P_VSM_LKA_YawRateOut@ */ Scalar_FLOAT32_IEEE 0 PubIfStateVSM_MDL_CM_single -3.4E+38 3.4E+38 /end CHARACTERISTIC
/begin CHARACTERISTIC P_VSM_LKA_absLongitudeAcceIn "" VALUE 0x0 /* @MemoryAddress@P_VSM_LKA_absLongitudeAcceIn@ */ Scalar_FLOAT32_IEEE 0 PubIfStateVSM_MDL_CM_single -3.4E+38 3.4E+38 /end CHARACTERISTIC
/begin CHARACTERISTIC P_VSM_LKA_absLongitudeAcceOut "" VALUE 0x0 /* @MemoryAddress@P_VSM_LKA_absLongitudeAcceOut@ */ Scalar_FLOAT32_IEEE 0 PubIfStateVSM_MDL_CM_single -3.4E+38 3.4E+38 /end CHARACTERISTIC
/begin CHARACTERISTIC P_VSM_LCK_A1 "" VALUE 0x0 /* @MemoryAddress@P_VSM_LCK_A1@ */ Scalar_UBYTE 0 PubIfStateVSM_MDL_CM_uint8 0 255 /end CHARACTERISTIC
/begin AXIS_PTS P_VSM_LCKIE_LATC_LimitDis_BP "" 0x0 /* @MemoryAddress@P_VSM_LCKIE_LATC_LimitDis_BP@ */ VSM_LCKIE_LatC_DetaDis Lookup1D_X_FLOAT32_IEEE 0 PubIfStateVSM_MDL_CM_single 5 -3.4E+38 3.4E+38 /end AXIS_PTS
/begin AXIS_PTS P_VSM_LCKIE_LatC_LanWidth "" 0x0 /* @MemoryAddress@P_VSM_LCKIE_LatC_LanWidth@ */ VSM_LCKIE_OS_RoadWidth Lookup1D_X_FLOAT32_IEEE 0 PubIfStateVSM_MDL_CM_single 4 -3.4E+38 3.4E+38 /end AXIS_PTS
/begin AXIS_PTS P_VSM_LCKIE_LatC_Spd "" 0x0 /* @MemoryAddress@P_VSM_LCKIE_LatC_Spd@ */ NO_INPUT_QUANTITY Lookup1D_X_FLOAT32_IEEE 0 PubIfStateVSM_MDL_CM_single 6 -3.4E+38 3.4E+38 /end AXIS_PTS
/begin AXIS_PTS P_VSM_LCKIE_LongC_Spd "" 0x0 /* @MemoryAddress@P_VSM_LCKIE_LongC_Spd@ */ NO_INPUT_QUANTITY Lookup1D_X_FLOAT32_IEEE 0 PubIfStateVSM_MDL_CM_single 6 -3.4E+38 3.4E+38 /end AXIS_PTS
/begin AXIS_PTS P_VSM_LCKIE_LongC_DetaSpd "" 0x0 /* @MemoryAddress@P_VSM_LCKIE_LongC_DetaSpd@ */ VSM_LCKIE_OS_DetaSpdSelect Lookup1D_X_FLOAT32_IEEE 0 PubIfStateVSM_MDL_CM_single 3 -3.4E+38 3.4E+38 /end AXIS_PTS
/begin MEASUREMENT VSM_LCK_Warning "" FLOAT64_IEEE PubIfStateVSM_MDL_CM_double 0 0 -1.7E+308 1.7E+308 ECU_ADDRESS 0x0 /* @MemoryAddress@VSM_LCK_Warning@ */ /end MEASUREMENT
/begin MEASUREMENT VSM_LCK_d0 "" FLOAT64_IEEE PubIfStateVSM_MDL_CM_double 0 0 -1.7E+308 1.7E+308 ECU_ADDRESS 0x0 /* @MemoryAddress@VSM_LCK_d0@ */ /end MEASUREMENT
/begin MEASUREMENT VSM_LCK_LaneWidth_offset "" FLOAT64_IEEE PubIfStateVSM_MDL_CM_double 0 0 -1.7E+308 1.7E+308 ECU_ADDRESS 0x0 /* @MemoryAddress@VSM_LCK_LaneWidth_offset@ */ /end MEASUREMENT
/begin MEASUREMENT VSM_LCK_LaneCure_Offset "" FLOAT64_IEEE PubIfStateVSM_MDL_CM_double 0 0 -1.7E+308 1.7E+308 ECU_ADDRESS 0x0 /* @MemoryAddress@VSM_LCK_LaneCure_Offset@ */ /end MEASUREMENT
/begin MEASUREMENT VSM_LCK_LaneCure "" FLOAT32_IEEE PubIfStateVSM_MDL_CM_single 0 0 -3.4E+38 3.4E+38 ECU_ADDRESS 0x0 /* @MemoryAddress@VSM_LCK_LaneCure@ */ /end MEASUREMENT
/begin MEASUREMENT VSM_LCKIE_LatC_SafeDisToLaneEdge "" FLOAT32_IEEE PubIfStateVSM_MDL_CM_single 0 0 -3.4E+38 3.4E+38 ECU_ADDRESS 0x0 /* @MemoryAddress@VSM_LCKIE_LatC_SafeDisToLaneEdge@ */ /end MEASUREMENT
/begin MEASUREMENT VSM_LCKIE_LatC_DisEgo2ObjOff "" FLOAT32_IEEE PubIfStateVSM_MDL_CM_single 0 0 -3.4E+38 3.4E+38 ECU_ADDRESS 0x0 /* @MemoryAddress@VSM_LCKIE_LatC_DisEgo2ObjOff@ */ /end MEASUREMENT
/begin MEASUREMENT VSM_LCKIE_POC_delay_time "" FLOAT32_IEEE PubIfStateVSM_MDL_CM_single 0 0 -3.4E+38 3.4E+38 ECU_ADDRESS 0x0 /* @MemoryAddress@VSM_LCKIE_POC_delay_time@ */ /end MEASUREMENT
/begin MEASUREMENT VSM_LCKIE_LongC_d2 "" FLOAT32_IEEE PubIfStateVSM_MDL_CM_single 0 0 -3.4E+38 3.4E+38 ECU_ADDRESS 0x0 /* @MemoryAddress@VSM_LCKIE_LongC_d2@ */ /end MEASUREMENT
/begin MEASUREMENT VSM_LCKIE_LongC_d1 "" FLOAT32_IEEE PubIfStateVSM_MDL_CM_single 0 0 -3.4E+38 3.4E+38 ECU_ADDRESS 0x0 /* @MemoryAddress@VSM_LCKIE_LongC_d1@ */ /end MEASUREMENT
/begin MEASUREMENT VSM_LCKIE_LongC_LongDis "" FLOAT32_IEEE PubIfStateVSM_MDL_CM_single 0 0 -3.4E+38 3.4E+38 ECU_ADDRESS 0x0 /* @MemoryAddress@VSM_LCKIE_LongC_LongDis@ */ /end MEASUREMENT
/begin MEASUREMENT VSM_LCKIE_LatC_DetaDis "" FLOAT32_IEEE PubIfStateVSM_MDL_CM_single 0 0 -3.4E+38 3.4E+38 ECU_ADDRESS 0x0 /* @MemoryAddress@VSM_LCKIE_LatC_DetaDis@ */ /end MEASUREMENT
/begin MEASUREMENT VSM_LCK_preDis "" FLOAT32_IEEE PubIfStateVSM_MDL_CM_single 0 0 -3.4E+38 3.4E+38 ECU_ADDRESS 0x0 /* @MemoryAddress@VSM_LCK_preDis@ */ /end MEASUREMENT
/begin MEASUREMENT VSM_LCK_Lanewidth "" FLOAT32_IEEE PubIfStateVSM_MDL_CM_single 0 0 -3.4E+38 3.4E+38 ECU_ADDRESS 0x0 /* @MemoryAddress@VSM_LCK_Lanewidth@ */ /end MEASUREMENT
/begin MEASUREMENT VSM_LDW_Count "" FLOAT32_IEEE PubIfStateVSM_MDL_CM_single 0 0 -3.4E+38 3.4E+38 ECU_ADDRESS 0x0 /* @MemoryAddress@VSM_LDW_Count@ */ /end MEASUREMENT
/begin MEASUREMENT VSM_LDW_wCount "" FLOAT32_IEEE PubIfStateVSM_MDL_CM_single 0 0 -3.4E+38 3.4E+38 ECU_ADDRESS 0x0 /* @MemoryAddress@VSM_LDW_wCount@ */ /end MEASUREMENT
/begin MEASUREMENT VSM_ERROR_RIGHT "" FLOAT32_IEEE PubIfStateVSM_MDL_CM_single 0 0 -3.4E+38 3.4E+38 ECU_ADDRESS 0x0 /* @MemoryAddress@VSM_ERROR_RIGHT@ */ /end MEASUREMENT
/begin MEASUREMENT VSM_ERROR_LEFT "" FLOAT32_IEEE PubIfStateVSM_MDL_CM_single 0 0 -3.4E+38 3.4E+38 ECU_ADDRESS 0x0 /* @MemoryAddress@VSM_ERROR_LEFT@ */ /end MEASUREMENT
/begin MEASUREMENT VSM_LKA_LKAactive "" FLOAT32_IEEE PubIfStateVSM_MDL_CM_single 0 0 -3.4E+38 3.4E+38 ECU_ADDRESS 0x0 /* @MemoryAddress@VSM_LKA_LKAactive@ */ /end MEASUREMENT
/begin MEASUREMENT VSM_LKA_LKAout "" FLOAT32_IEEE PubIfStateVSM_MDL_CM_single 0 0 -3.4E+38 3.4E+38 ECU_ADDRESS 0x0 /* @MemoryAddress@VSM_LKA_LKAout@ */ /end MEASUREMENT
/begin MEASUREMENT VSM_LDW_Leftwarnflag "" FLOAT32_IEEE PubIfStateVSM_MDL_CM_single 0 0 -3.4E+38 3.4E+38 ECU_ADDRESS 0x0 /* @MemoryAddress@VSM_LDW_Leftwarnflag@ */ /end MEASUREMENT
/begin MEASUREMENT VSM_LDW_Rightwarnflag "" FLOAT32_IEEE PubIfStateVSM_MDL_CM_single 0 0 -3.4E+38 3.4E+38 ECU_ADDRESS 0x0 /* @MemoryAddress@VSM_LDW_Rightwarnflag@ */ /end MEASUREMENT
/begin MEASUREMENT VSM_LCKIE_POC_OvertakeSpd "" FLOAT32_IEEE PubIfStateVSM_MDL_CM_single 0 0 -3.4E+38 3.4E+38 ECU_ADDRESS 0x0 /* @MemoryAddress@VSM_LCKIE_POC_OvertakeSpd@ */ /end MEASUREMENT
/begin MEASUREMENT VSM_LCKIE_POC_POCObjLong "" FLOAT32_IEEE PubIfStateVSM_MDL_CM_single 0 0 -3.4E+38 3.4E+38 ECU_ADDRESS 0x0 /* @MemoryAddress@VSM_LCKIE_POC_POCObjLong@ */ /end MEASUREMENT
/begin MEASUREMENT VSM_LCKIE_POC_POCObjTTC "" FLOAT32_IEEE PubIfStateVSM_MDL_CM_single 0 0 -3.4E+38 3.4E+38 ECU_ADDRESS 0x0 /* @MemoryAddress@VSM_LCKIE_POC_POCObjTTC@ */ /end MEASUREMENT
/begin MEASUREMENT VSM_LCKIE_OS_RoadWidth "" FLOAT32_IEEE PubIfStateVSM_MDL_CM_single 0 0 -3.4E+38 3.4E+38 ECU_ADDRESS 0x0 /* @MemoryAddress@VSM_LCKIE_OS_RoadWidth@ */ /end MEASUREMENT
/begin MEASUREMENT VSM_LCKIE_OS_DisEgo2ObjSelect "" FLOAT32_IEEE PubIfStateVSM_MDL_CM_single 0 0 -3.4E+38 3.4E+38 ECU_ADDRESS 0x0 /* @MemoryAddress@VSM_LCKIE_OS_DisEgo2ObjSelect@ */ /end MEASUREMENT
/begin MEASUREMENT VSM_LCKIE_OS_DisEgo2Obj "" FLOAT32_IEEE PubIfStateVSM_MDL_CM_single 0 0 -3.4E+38 3.4E+38 LAYOUT ROW_DIR MATRIX_DIM 9 1 1 ECU_ADDRESS 0x0 /* @MemoryAddress@VSM_LCKIE_OS_DisEgo2Obj@ */ /end MEASUREMENT
/begin MEASUREMENT VSM_LCKIE_OS_DetaSpdSelect "" FLOAT32_IEEE PubIfStateVSM_MDL_CM_single 0 0 -3.4E+38 3.4E+38 ECU_ADDRESS 0x0 /* @MemoryAddress@VSM_LCKIE_OS_DetaSpdSelect@ */ /end MEASUREMENT
/begin MEASUREMENT VSM_LCKIE_OS_DisEgo2OppLane "" FLOAT32_IEEE PubIfStateVSM_MDL_CM_single 0 0 -3.4E+38 3.4E+38 ECU_ADDRESS 0x0 /* @MemoryAddress@VSM_LCKIE_OS_DisEgo2OppLane@ */ /end MEASUREMENT
/begin MEASUREMENT VSM_LCKIE_OS_DetaSpd "" FLOAT32_IEEE PubIfStateVSM_MDL_CM_single 0 0 -3.4E+38 3.4E+38 LAYOUT ROW_DIR MATRIX_DIM 9 1 1 ECU_ADDRESS 0x0 /* @MemoryAddress@VSM_LCKIE_OS_DetaSpd@ */ /end MEASUREMENT
/begin MEASUREMENT VSM_LCKIE_OS_TTC "" FLOAT32_IEEE PubIfStateVSM_MDL_CM_single 0 0 -3.4E+38 3.4E+38 LAYOUT ROW_DIR MATRIX_DIM 9 1 1 ECU_ADDRESS 0x0 /* @MemoryAddress@VSM_LCKIE_OS_TTC@ */ /end MEASUREMENT
/begin MEASUREMENT VSM_LCKIE_ORC_ObjTTC "" FLOAT32_IEEE PubIfStateVSM_MDL_CM_single 0 0 -3.4E+38 3.4E+38 ECU_ADDRESS 0x0 /* @MemoryAddress@VSM_LCKIE_ORC_ObjTTC@ */ /end MEASUREMENT
/begin MEASUREMENT VSM_LCKIE_ORC_ObjLong "" FLOAT32_IEEE PubIfStateVSM_MDL_CM_single 0 0 -3.4E+38 3.4E+38 ECU_ADDRESS 0x0 /* @MemoryAddress@VSM_LCKIE_ORC_ObjLong@ */ /end MEASUREMENT
/begin MEASUREMENT VSM_LCKIE_ORC_ObjLatPos "" FLOAT32_IEEE PubIfStateVSM_MDL_CM_single 0 0 -3.4E+38 3.4E+38 ECU_ADDRESS 0x0 /* @MemoryAddress@VSM_LCKIE_ORC_ObjLatPos@ */ /end MEASUREMENT
/begin MEASUREMENT VSM_LCKIE_ORC_ObjDetaSpd "" FLOAT32_IEEE PubIfStateVSM_MDL_CM_single 0 0 -3.4E+38 3.4E+38 ECU_ADDRESS 0x0 /* @MemoryAddress@VSM_LCKIE_ORC_ObjDetaSpd@ */ /end MEASUREMENT
/begin MEASUREMENT VSM_LCKIE_OFC_Long "" FLOAT32_IEEE PubIfStateVSM_MDL_CM_single 0 0 -3.4E+38 3.4E+38 ECU_ADDRESS 0x0 /* @MemoryAddress@VSM_LCKIE_OFC_Long@ */ /end MEASUREMENT
/begin MEASUREMENT VSM_LCKIE_OFC_OppObjDetaSpd "" FLOAT32_IEEE PubIfStateVSM_MDL_CM_single 0 0 -3.4E+38 3.4E+38 ECU_ADDRESS 0x0 /* @MemoryAddress@VSM_LCKIE_OFC_OppObjDetaSpd@ */ /end MEASUREMENT
/begin MEASUREMENT VSM_LCKIE_OFC_ObjTTC "" FLOAT32_IEEE PubIfStateVSM_MDL_CM_single 0 0 -3.4E+38 3.4E+38 ECU_ADDRESS 0x0 /* @MemoryAddress@VSM_LCKIE_OFC_ObjTTC@ */ /end MEASUREMENT
/begin MEASUREMENT VSM_LCKIE_OFC_Tset "" FLOAT32_IEEE PubIfStateVSM_MDL_CM_single 0 0 -3.4E+38 3.4E+38 ECU_ADDRESS 0x0 /* @MemoryAddress@VSM_LCKIE_OFC_Tset@ */ /end MEASUREMENT
/begin MEASUREMENT VSM_LCKIE_LongC_LongDisfinal "" FLOAT32_IEEE PubIfStateVSM_MDL_CM_single 0 0 -3.4E+38 3.4E+38 ECU_ADDRESS 0x0 /* @MemoryAddress@VSM_LCKIE_LongC_LongDisfinal@ */ /end MEASUREMENT
/begin MEASUREMENT VSM_LCKIE_LongC_ObjLong "" FLOAT32_IEEE PubIfStateVSM_MDL_CM_single 0 0 -3.4E+38 3.4E+38 ECU_ADDRESS 0x0 /* @MemoryAddress@VSM_LCKIE_LongC_ObjLong@ */ /end MEASUREMENT
/begin MEASUREMENT VSM_LCKIE_LatC_LatMovDis "" FLOAT32_IEEE PubIfStateVSM_MDL_CM_single 0 0 -3.4E+38 3.4E+38 ECU_ADDRESS 0x0 /* @MemoryAddress@VSM_LCKIE_LatC_LatMovDis@ */ /end MEASUREMENT
/begin MEASUREMENT VSM_LCKIE_LatC_ts "" FLOAT32_IEEE PubIfStateVSM_MDL_CM_single 0 0 -3.4E+38 3.4E+38 ECU_ADDRESS 0x0 /* @MemoryAddress@VSM_LCKIE_LatC_ts@ */ /end MEASUREMENT
/begin MEASUREMENT VSM_LCKIE_LatC_MoveDis "" FLOAT32_IEEE PubIfStateVSM_MDL_CM_single 0 0 -3.4E+38 3.4E+38 ECU_ADDRESS 0x0 /* @MemoryAddress@VSM_LCKIE_LatC_MoveDis@ */ /end MEASUREMENT
/begin MEASUREMENT VSM_LCKIE_LatC_DisREToLane "" FLOAT32_IEEE PubIfStateVSM_MDL_CM_single 0 0 -3.4E+38 3.4E+38 ECU_ADDRESS 0x0 /* @MemoryAddress@VSM_LCKIE_LatC_DisREToLane@ */ /end MEASUREMENT
/begin MEASUREMENT VSM_LCKIE_LatC_SafDis "" FLOAT32_IEEE PubIfStateVSM_MDL_CM_single 0 0 -3.4E+38 3.4E+38 ECU_ADDRESS 0x0 /* @MemoryAddress@VSM_LCKIE_LatC_SafDis@ */ /end MEASUREMENT
/begin MEASUREMENT VSM_LCKIE_LatC_latmovori "" FLOAT32_IEEE PubIfStateVSM_MDL_CM_single 0 0 -3.4E+38 3.4E+38 ECU_ADDRESS 0x0 /* @MemoryAddress@VSM_LCKIE_LatC_latmovori@ */ /end MEASUREMENT
/begin MEASUREMENT VSM_LCKIE_Laneoffset "" FLOAT32_IEEE PubIfStateVSM_MDL_CM_single 0 0 -3.4E+38 3.4E+38 ECU_ADDRESS 0x0 /* @MemoryAddress@VSM_LCKIE_Laneoffset@ */ /end MEASUREMENT
/begin MEASUREMENT VSM_LCK_dy0 "" FLOAT32_IEEE PubIfStateVSM_MDL_CM_single 0 0 -3.4E+38 3.4E+38 ECU_ADDRESS 0x0 /* @MemoryAddress@VSM_LCK_dy0@ */ /end MEASUREMENT
/begin MEASUREMENT VSM_LCK_dypreoffset "" FLOAT32_IEEE PubIfStateVSM_MDL_CM_single 0 0 -3.4E+38 3.4E+38 ECU_ADDRESS 0x0 /* @MemoryAddress@VSM_LCK_dypreoffset@ */ /end MEASUREMENT
/begin MEASUREMENT VSM_LCK_dypre "" FLOAT32_IEEE PubIfStateVSM_MDL_CM_single 0 0 -3.4E+38 3.4E+38 ECU_ADDRESS 0x0 /* @MemoryAddress@VSM_LCK_dypre@ */ /end MEASUREMENT
/begin MEASUREMENT VSM_ELK_OnComing_Rv_re "" FLOAT32_IEEE PubIfStateVSM_MDL_CM_single 0 0 -3.4E+38 3.4E+38 ECU_ADDRESS 0x0 /* @MemoryAddress@VSM_ELK_OnComing_Rv_re@ */ /end MEASUREMENT
/begin MEASUREMENT VSM_ELK_OnComing_Rlateral "" FLOAT32_IEEE PubIfStateVSM_MDL_CM_single 0 0 -3.4E+38 3.4E+38 ECU_ADDRESS 0x0 /* @MemoryAddress@VSM_ELK_OnComing_Rlateral@ */ /end MEASUREMENT
/begin MEASUREMENT VSM_ELK_OnComing_Lv_re "" FLOAT32_IEEE PubIfStateVSM_MDL_CM_single 0 0 -3.4E+38 3.4E+38 ECU_ADDRESS 0x0 /* @MemoryAddress@VSM_ELK_OnComing_Lv_re@ */ /end MEASUREMENT
/begin MEASUREMENT VSM_ELK_OnComing_Llateral "" FLOAT32_IEEE PubIfStateVSM_MDL_CM_single 0 0 -3.4E+38 3.4E+38 ECU_ADDRESS 0x0 /* @MemoryAddress@VSM_ELK_OnComing_Llateral@ */ /end MEASUREMENT
/begin MEASUREMENT VSM_LCKIE_POC_Couter1 "" UWORD PubIfStateVSM_MDL_CM_uint16 0 0 0 65535 ECU_ADDRESS 0x0 /* @MemoryAddress@VSM_LCKIE_POC_Couter1@ */ /end MEASUREMENT
/begin MEASUREMENT VSM_LCKIE_LongC_CouterOff "" UWORD PubIfStateVSM_MDL_CM_uint16 0 0 0 65535 ECU_ADDRESS 0x0 /* @MemoryAddress@VSM_LCKIE_LongC_CouterOff@ */ /end MEASUREMENT
/begin MEASUREMENT VSM_LCKIE_LongC_Couter1 "" UWORD PubIfStateVSM_MDL_CM_uint16 0 0 0 65535 ECU_ADDRESS 0x0 /* @MemoryAddress@VSM_LCKIE_LongC_Couter1@ */ /end MEASUREMENT
/begin MEASUREMENT VSM_LCKIE_LongC_Couter2 "" UWORD PubIfStateVSM_MDL_CM_uint16 0 0 0 65535 ECU_ADDRESS 0x0 /* @MemoryAddress@VSM_LCKIE_LongC_Couter2@ */ /end MEASUREMENT
/begin MEASUREMENT VSM_LCKIE_LongC_Couter3 "" UWORD PubIfStateVSM_MDL_CM_uint16 0 0 0 65535 ECU_ADDRESS 0x0 /* @MemoryAddress@VSM_LCKIE_LongC_Couter3@ */ /end MEASUREMENT
/begin MEASUREMENT VSM_LKA_Warning "" UBYTE PubIfStateVSM_MDL_CM_uint8 0 0 0 255 ECU_ADDRESS 0x0 /* @MemoryAddress@VSM_LKA_Warning@ */ /end MEASUREMENT
/begin MEASUREMENT VSM_LKA_Error "" UBYTE PubIfStateVSM_MDL_CM_uint8 0 0 0 255 ECU_ADDRESS 0x0 /* @MemoryAddress@VSM_LKA_Error@ */ /end MEASUREMENT
/begin MEASUREMENT VSM_LCKIE_POC_OvertakeFlg "" UBYTE PubIfStateVSM_MDL_CM_uint8 0 0 0 255 ECU_ADDRESS 0x0 /* @MemoryAddress@VSM_LCKIE_POC_OvertakeFlg@ */ /end MEASUREMENT
/begin MEASUREMENT VSM_LCKIE_POC_LongDown "" UBYTE PubIfStateVSM_MDL_CM_uint8 0 0 0 255 ECU_ADDRESS 0x0 /* @MemoryAddress@VSM_LCKIE_POC_LongDown@ */ /end MEASUREMENT
/begin MEASUREMENT VSM_LCKIE_POC_POSID "" UBYTE PubIfStateVSM_MDL_CM_uint8 0 0 0 255 ECU_ADDRESS 0x0 /* @MemoryAddress@VSM_LCKIE_POC_POSID@ */ /end MEASUREMENT
/begin MEASUREMENT VSM_LCKIE_POC_POSObjID "" UBYTE PubIfStateVSM_MDL_CM_uint8 0 0 0 255 ECU_ADDRESS 0x0 /* @MemoryAddress@VSM_LCKIE_POC_POSObjID@ */ /end MEASUREMENT
/begin MEASUREMENT VSM_LCKIE_POC_Counter "" UBYTE PubIfStateVSM_MDL_CM_uint8 0 0 0 255 ECU_ADDRESS 0x0 /* @MemoryAddress@VSM_LCKIE_POC_Counter@ */ /end MEASUREMENT
/begin MEASUREMENT VSM_LCKIE_POC_Couter2 "" UBYTE PubIfStateVSM_MDL_CM_uint8 0 0 0 255 ECU_ADDRESS 0x0 /* @MemoryAddress@VSM_LCKIE_POC_Couter2@ */ /end MEASUREMENT
/begin MEASUREMENT VSM_LCKIE_OS_OppFObjID "" UBYTE PubIfStateVSM_MDL_CM_uint8 0 0 0 255 ECU_ADDRESS 0x0 /* @MemoryAddress@VSM_LCKIE_OS_OppFObjID@ */ /end MEASUREMENT
/begin MEASUREMENT VSM_LCKIE_OS_OppRObjID "" UBYTE PubIfStateVSM_MDL_CM_uint8 0 0 0 255 ECU_ADDRESS 0x0 /* @MemoryAddress@VSM_LCKIE_OS_OppRObjID@ */ /end MEASUREMENT
/begin MEASUREMENT VSM_LCKIE_OS_POSRObjID "" UBYTE PubIfStateVSM_MDL_CM_uint8 0 0 0 255 ECU_ADDRESS 0x0 /* @MemoryAddress@VSM_LCKIE_OS_POSRObjID@ */ /end MEASUREMENT
/begin MEASUREMENT VSM_LCKIE_OS_ObjLane "" UBYTE PubIfStateVSM_MDL_CM_uint8 0 0 0 255 LAYOUT ROW_DIR MATRIX_DIM 9 1 1 ECU_ADDRESS 0x0 /* @MemoryAddress@VSM_LCKIE_OS_ObjLane@ */ /end MEASUREMENT
/begin MEASUREMENT VSM_LCKIE_OS_ObjSelectID "" UBYTE PubIfStateVSM_MDL_CM_uint8 0 0 0 255 ECU_ADDRESS 0x0 /* @MemoryAddress@VSM_LCKIE_OS_ObjSelectID@ */ /end MEASUREMENT
/begin MEASUREMENT VSM_LCKIE_OS_ObjIDSelect "" UBYTE PubIfStateVSM_MDL_CM_uint8 0 0 0 255 ECU_ADDRESS 0x0 /* @MemoryAddress@VSM_LCKIE_OS_ObjIDSelect@ */ /end MEASUREMENT
/begin MEASUREMENT VSM_LCKIE_OS_Couter "" UBYTE PubIfStateVSM_MDL_CM_uint8 0 0 0 255 ECU_ADDRESS 0x0 /* @MemoryAddress@VSM_LCKIE_OS_Couter@ */ /end MEASUREMENT
/begin MEASUREMENT VSM_LCKIE_OS_Couter1 "" UBYTE PubIfStateVSM_MDL_CM_uint8 0 0 0 255 ECU_ADDRESS 0x0 /* @MemoryAddress@VSM_LCKIE_OS_Couter1@ */ /end MEASUREMENT
/begin MEASUREMENT VSM_LCKIE_ORC_OppREARObjReady "" UBYTE PubIfStateVSM_MDL_CM_uint8 0 0 0 255 ECU_ADDRESS 0x0 /* @MemoryAddress@VSM_LCKIE_ORC_OppREARObjReady@ */ /end MEASUREMENT
/begin MEASUREMENT VSM_LCKIE_ORC_Counter "" UBYTE PubIfStateVSM_MDL_CM_uint8 0 0 0 255 ECU_ADDRESS 0x0 /* @MemoryAddress@VSM_LCKIE_ORC_Counter@ */ /end MEASUREMENT
/begin MEASUREMENT VSM_LCKIE_OFC_OppObjReady "" UBYTE PubIfStateVSM_MDL_CM_uint8 0 0 0 255 ECU_ADDRESS 0x0 /* @MemoryAddress@VSM_LCKIE_OFC_OppObjReady@ */ /end MEASUREMENT
/begin MEASUREMENT VSM_LCKIE_OFC_OppObjFail "" UBYTE PubIfStateVSM_MDL_CM_uint8 0 0 0 255 ECU_ADDRESS 0x0 /* @MemoryAddress@VSM_LCKIE_OFC_OppObjFail@ */ /end MEASUREMENT
/begin MEASUREMENT VSM_LCKIE_OFC_Counter "" UBYTE PubIfStateVSM_MDL_CM_uint8 0 0 0 255 ECU_ADDRESS 0x0 /* @MemoryAddress@VSM_LCKIE_OFC_Counter@ */ /end MEASUREMENT
/begin MEASUREMENT VSM_LCKIE_OFC_Counter1 "" UBYTE PubIfStateVSM_MDL_CM_uint8 0 0 0 255 ECU_ADDRESS 0x0 /* @MemoryAddress@VSM_LCKIE_OFC_Counter1@ */ /end MEASUREMENT
/begin MEASUREMENT VSM_LCKIE_LongC_PocFlg "" UBYTE PubIfStateVSM_MDL_CM_uint8 0 0 0 255 ECU_ADDRESS 0x0 /* @MemoryAddress@VSM_LCKIE_LongC_PocFlg@ */ /end MEASUREMENT
/begin MEASUREMENT VSM_LCKIE_LongC_IEReady "" UBYTE PubIfStateVSM_MDL_CM_uint8 0 0 0 255 ECU_ADDRESS 0x0 /* @MemoryAddress@VSM_LCKIE_LongC_IEReady@ */ /end MEASUREMENT
/begin MEASUREMENT VSM_LCKIE_LongC_LongFlg "" UBYTE PubIfStateVSM_MDL_CM_uint8 0 0 0 255 ECU_ADDRESS 0x0 /* @MemoryAddress@VSM_LCKIE_LongC_LongFlg@ */ /end MEASUREMENT
/begin MEASUREMENT VSM_LCKIE_LatC_Flg "" UBYTE PubIfStateVSM_MDL_CM_uint8 0 0 0 255 ECU_ADDRESS 0x0 /* @MemoryAddress@VSM_LCKIE_LatC_Flg@ */ /end MEASUREMENT
/begin MEASUREMENT VSM_LCKIE_LatC_MovDirct1 "" UBYTE PubIfStateVSM_MDL_CM_uint8 0 0 0 255 ECU_ADDRESS 0x0 /* @MemoryAddress@VSM_LCKIE_LatC_MovDirct1@ */ /end MEASUREMENT
/begin MEASUREMENT VSM_LCKIE_LatC_LatWarning "" UBYTE PubIfStateVSM_MDL_CM_uint8 0 0 0 255 ECU_ADDRESS 0x0 /* @MemoryAddress@VSM_LCKIE_LatC_LatWarning@ */ /end MEASUREMENT
/begin MEASUREMENT VSM_LCKIE_LatC_DirectChange "" UBYTE PubIfStateVSM_MDL_CM_uint8 0 0 0 255 ECU_ADDRESS 0x0 /* @MemoryAddress@VSM_LCKIE_LatC_DirectChange@ */ /end MEASUREMENT
/begin MEASUREMENT VSM_LCKIE_LatC_ObjLatFailFlg "" UBYTE PubIfStateVSM_MDL_CM_uint8 0 0 0 255 ECU_ADDRESS 0x0 /* @MemoryAddress@VSM_LCKIE_LatC_ObjLatFailFlg@ */ /end MEASUREMENT
/begin MEASUREMENT VSM_LCKIE_LatC_MovDirct "" UBYTE PubIfStateVSM_MDL_CM_uint8 0 0 0 255 ECU_ADDRESS 0x0 /* @MemoryAddress@VSM_LCKIE_LatC_MovDirct@ */ /end MEASUREMENT
/begin MEASUREMENT VSM_LCKIE_LatC_LatFLg "" UBYTE PubIfStateVSM_MDL_CM_uint8 0 0 0 255 ECU_ADDRESS 0x0 /* @MemoryAddress@VSM_LCKIE_LatC_LatFLg@ */ /end MEASUREMENT
/begin MEASUREMENT VSM_LCKIE_LatC_Counter "" UBYTE PubIfStateVSM_MDL_CM_uint8 0 0 0 255 ECU_ADDRESS 0x0 /* @MemoryAddress@VSM_LCKIE_LatC_Counter@ */ /end MEASUREMENT
/begin MEASUREMENT VSM_LCKIE_LatC_Counter1 "" UBYTE PubIfStateVSM_MDL_CM_uint8 0 0 0 255 ECU_ADDRESS 0x0 /* @MemoryAddress@VSM_LCKIE_LatC_Counter1@ */ /end MEASUREMENT
/begin MEASUREMENT VSM_LCKIE_LatC_Counter2 "" UBYTE PubIfStateVSM_MDL_CM_uint8 0 0 0 255 ECU_ADDRESS 0x0 /* @MemoryAddress@VSM_LCKIE_LatC_Counter2@ */ /end MEASUREMENT
/begin MEASUREMENT VSM_LCKIE_LatC_Counter3 "" UBYTE PubIfStateVSM_MDL_CM_uint8 0 0 0 255 ECU_ADDRESS 0x0 /* @MemoryAddress@VSM_LCKIE_LatC_Counter3@ */ /end MEASUREMENT
/begin MEASUREMENT VSM_LCKIE_LatC_Counter4 "" UBYTE PubIfStateVSM_MDL_CM_uint8 0 0 0 255 ECU_ADDRESS 0x0 /* @MemoryAddress@VSM_LCKIE_LatC_Counter4@ */ /end MEASUREMENT
/begin MEASUREMENT VSM_LCKIE_LatC_Counter5 "" UBYTE PubIfStateVSM_MDL_CM_uint8 0 0 0 255 ECU_ADDRESS 0x0 /* @MemoryAddress@VSM_LCKIE_LatC_Counter5@ */ /end MEASUREMENT
/begin MEASUREMENT VSM_LCKIE_DelayReady "" UBYTE PubIfStateVSM_MDL_CM_uint8 0 0 0 255 ECU_ADDRESS 0x0 /* @MemoryAddress@VSM_LCKIE_DelayReady@ */ /end MEASUREMENT
/begin MEASUREMENT VSM_ACCFastExitCons_StandstillNoBrakeForce "" UBYTE PubIfStateVSM_MDL_CM_boolean 0 0 0 1 ECU_ADDRESS 0x0 /* @MemoryAddress@VSM_ACCFastExitCons_StandstillNoBrakeForce@ */ BIT_MASK 0x01 /end MEASUREMENT
/begin MEASUREMENT VSM_LCK_Con_SteerAngleSpd_Active2Ready "" UBYTE PubIfStateVSM_MDL_CM_boolean 0 0 0 1 ECU_ADDRESS 0x0 /* @MemoryAddress@VSM_LCK_Con_SteerAngleSpd_Active2Ready@ */ BIT_MASK 0x01 /end MEASUREMENT
/begin MEASUREMENT VSM_LCK_Con_OverRide_Active2Ready "" UBYTE PubIfStateVSM_MDL_CM_boolean 0 0 0 1 ECU_ADDRESS 0x0 /* @MemoryAddress@VSM_LCK_Con_OverRide_Active2Ready@ */ BIT_MASK 0x01 /end MEASUREMENT
/begin MEASUREMENT VSM_LCK_Con_SteerWheelAngle_Active2Ready "" UBYTE PubIfStateVSM_MDL_CM_boolean 0 0 0 1 ECU_ADDRESS 0x0 /* @MemoryAddress@VSM_LCK_Con_SteerWheelAngle_Active2Ready@ */ BIT_MASK 0x01 /end MEASUREMENT
/begin MEASUREMENT VSM_LCK_Con_DriverInput_Active2Ready "" UBYTE PubIfStateVSM_MDL_CM_boolean 0 0 0 1 ECU_ADDRESS 0x0 /* @MemoryAddress@VSM_LCK_Con_DriverInput_Active2Ready@ */ BIT_MASK 0x01 /end MEASUREMENT
/begin MEASUREMENT VSM_LDW_Con_AccPedalRate_Active2Ready "" UBYTE PubIfStateVSM_MDL_CM_boolean 0 0 0 1 ECU_ADDRESS 0x0 /* @MemoryAddress@VSM_LDW_Con_AccPedalRate_Active2Ready@ */ BIT_MASK 0x01 /end MEASUREMENT
/begin MEASUREMENT VSM_LDW_Con_BrakePressure_Active2Ready "" UBYTE PubIfStateVSM_MDL_CM_boolean 0 0 0 1 ECU_ADDRESS 0x0 /* @MemoryAddress@VSM_LDW_Con_BrakePressure_Active2Ready@ */ BIT_MASK 0x01 /end MEASUREMENT
/begin MEASUREMENT VSM_LDW_Con_SteerWheelAngle_Active2Ready "" UBYTE PubIfStateVSM_MDL_CM_boolean 0 0 0 1 ECU_ADDRESS 0x0 /* @MemoryAddress@VSM_LDW_Con_SteerWheelAngle_Active2Ready@ */ BIT_MASK 0x01 /end MEASUREMENT
/begin MEASUREMENT VSM_LDW_Con_SteerWheelSpd_Active2Ready "" UBYTE PubIfStateVSM_MDL_CM_boolean 0 0 0 1 ECU_ADDRESS 0x0 /* @MemoryAddress@VSM_LDW_Con_SteerWheelSpd_Active2Ready@ */ BIT_MASK 0x01 /end MEASUREMENT
/begin MEASUREMENT VSM_LKA_Con_AccPedalRate_Active2Ready "" UBYTE PubIfStateVSM_MDL_CM_boolean 0 0 0 1 ECU_ADDRESS 0x0 /* @MemoryAddress@VSM_LKA_Con_AccPedalRate_Active2Ready@ */ BIT_MASK 0x01 /end MEASUREMENT
/begin MEASUREMENT VSM_LKA_Con_BrakePressure_Active2Ready "" UBYTE PubIfStateVSM_MDL_CM_boolean 0 0 0 1 ECU_ADDRESS 0x0 /* @MemoryAddress@VSM_LKA_Con_BrakePressure_Active2Ready@ */ BIT_MASK 0x01 /end MEASUREMENT
/begin MEASUREMENT VSM_LKA_Con_SteerWheelAngle_Active2Ready "" UBYTE PubIfStateVSM_MDL_CM_boolean 0 0 0 1 ECU_ADDRESS 0x0 /* @MemoryAddress@VSM_LKA_Con_SteerWheelAngle_Active2Ready@ */ BIT_MASK 0x01 /end MEASUREMENT
/begin MEASUREMENT VSM_LKA_Con_DriverInput_Active2Ready "" UBYTE PubIfStateVSM_MDL_CM_boolean 0 0 0 1 ECU_ADDRESS 0x0 /* @MemoryAddress@VSM_LKA_Con_DriverInput_Active2Ready@ */ BIT_MASK 0x01 /end MEASUREMENT
/begin MEASUREMENT VSM_LKA_Con_SteerWheelSpd_Active2Ready "" UBYTE PubIfStateVSM_MDL_CM_boolean 0 0 0 1 ECU_ADDRESS 0x0 /* @MemoryAddress@VSM_LKA_Con_SteerWheelSpd_Active2Ready@ */ BIT_MASK 0x01 /end MEASUREMENT
/begin MEASUREMENT VSM_LKA_Con_OverRide_Active2Ready "" UBYTE PubIfStateVSM_MDL_CM_boolean 0 0 0 1 ECU_ADDRESS 0x0 /* @MemoryAddress@VSM_LKA_Con_OverRide_Active2Ready@ */ BIT_MASK 0x01 /end MEASUREMENT
/begin MEASUREMENT VSM_LCK_Con_AccPedalRate_Active2Ready "" UBYTE PubIfStateVSM_MDL_CM_boolean 0 0 0 1 ECU_ADDRESS 0x0 /* @MemoryAddress@VSM_LCK_Con_AccPedalRate_Active2Ready@ */ BIT_MASK 0x01 /end MEASUREMENT
/begin MEASUREMENT VSM_LCK_Con_BrakePress_Active2Ready "" UBYTE PubIfStateVSM_MDL_CM_boolean 0 0 0 1 ECU_ADDRESS 0x0 /* @MemoryAddress@VSM_LCK_Con_BrakePress_Active2Ready@ */ BIT_MASK 0x01 /end MEASUREMENT
/begin MEASUREMENT VSM_ACC_DrvOffReq "" UBYTE PubIfStateVSM_MDL_CM_boolean 0 0 0 1 ECU_ADDRESS 0x0 /* @MemoryAddress@VSM_ACC_DrvOffReq@ */ BIT_MASK 0x01 /end MEASUREMENT
/begin MEASUREMENT VSM_ELK_Lane_valid "" UBYTE PubIfStateVSM_MDL_CM_boolean 0 0 0 1 ECU_ADDRESS 0x0 /* @MemoryAddress@VSM_ELK_Lane_valid@ */ BIT_MASK 0x01 /end MEASUREMENT
/begin MEASUREMENT VSM_ELK_Lwidth_Valid "" UBYTE PubIfStateVSM_MDL_CM_boolean 0 0 0 1 ECU_ADDRESS 0x0 /* @MemoryAddress@VSM_ELK_Lwidth_Valid@ */ BIT_MASK 0x01 /end MEASUREMENT
/begin MEASUREMENT VSM_LeftChange_old "" UBYTE PubIfStateVSM_MDL_CM_boolean 0 0 0 1 ECU_ADDRESS 0x0 /* @MemoryAddress@VSM_LeftChange_old@ */ BIT_MASK 0x01 /end MEASUREMENT
/begin MEASUREMENT VSM_LeftChange_new "" UBYTE PubIfStateVSM_MDL_CM_boolean 0 0 0 1 ECU_ADDRESS 0x0 /* @MemoryAddress@VSM_LeftChange_new@ */ BIT_MASK 0x01 /end MEASUREMENT
/begin MEASUREMENT VSM_RightChange_old "" UBYTE PubIfStateVSM_MDL_CM_boolean 0 0 0 1 ECU_ADDRESS 0x0 /* @MemoryAddress@VSM_RightChange_old@ */ BIT_MASK 0x01 /end MEASUREMENT
/begin MEASUREMENT VSM_RightChange_new "" UBYTE PubIfStateVSM_MDL_CM_boolean 0 0 0 1 ECU_ADDRESS 0x0 /* @MemoryAddress@VSM_RightChange_new@ */ BIT_MASK 0x01 /end MEASUREMENT
/begin MEASUREMENT VSM_LKA_Con_YawRate_Idle2Ready "" UBYTE PubIfStateVSM_MDL_CM_boolean 0 0 0 1 ECU_ADDRESS 0x0 /* @MemoryAddress@VSM_LKA_Con_YawRate_Idle2Ready@ */ BIT_MASK 0x01 /end MEASUREMENT
/begin MEASUREMENT VSM_LKA_Con_AbsEsp_Idle2Ready "" UBYTE PubIfStateVSM_MDL_CM_boolean 0 0 0 1 ECU_ADDRESS 0x0 /* @MemoryAddress@VSM_LKA_Con_AbsEsp_Idle2Ready@ */ BIT_MASK 0x01 /end MEASUREMENT
/begin MEASUREMENT VSM_LKA_Con_Headingangle_Idle2Ready "" UBYTE PubIfStateVSM_MDL_CM_boolean 0 0 0 1 ECU_ADDRESS 0x0 /* @MemoryAddress@VSM_LKA_Con_Headingangle_Idle2Ready@ */ BIT_MASK 0x01 /end MEASUREMENT
/begin MEASUREMENT VSM_LKA_Con_Failsafe_Idle2Ready "" UBYTE PubIfStateVSM_MDL_CM_boolean 0 0 0 1 ECU_ADDRESS 0x0 /* @MemoryAddress@VSM_LKA_Con_Failsafe_Idle2Ready@ */ BIT_MASK 0x01 /end MEASUREMENT
/begin MEASUREMENT VSM_LKA_Con_ESSSts_Idle2Ready "" UBYTE PubIfStateVSM_MDL_CM_boolean 0 0 0 1 ECU_ADDRESS 0x0 /* @MemoryAddress@VSM_LKA_Con_ESSSts_Idle2Ready@ */ BIT_MASK 0x01 /end MEASUREMENT
/begin MEASUREMENT VSM_LKA_Con_LaneCurve_Idle2Ready "" UBYTE PubIfStateVSM_MDL_CM_boolean 0 0 0 1 ECU_ADDRESS 0x0 /* @MemoryAddress@VSM_LKA_Con_LaneCurve_Idle2Ready@ */ BIT_MASK 0x01 /end MEASUREMENT
/begin MEASUREMENT VSM_LKA_Con_Lane_Idle2Ready "" UBYTE PubIfStateVSM_MDL_CM_boolean 0 0 0 1 ECU_ADDRESS 0x0 /* @MemoryAddress@VSM_LKA_Con_Lane_Idle2Ready@ */ BIT_MASK 0x01 /end MEASUREMENT
/begin MEASUREMENT VSM_LKA_Con_VehicleSpeed_Idle2Ready "" UBYTE PubIfStateVSM_MDL_CM_boolean 0 0 0 1 ECU_ADDRESS 0x0 /* @MemoryAddress@VSM_LKA_Con_VehicleSpeed_Idle2Ready@ */ BIT_MASK 0x01 /end MEASUREMENT
/begin MEASUREMENT VSM_LKA_Idle2Ready "" UBYTE PubIfStateVSM_MDL_CM_boolean 0 0 0 1 ECU_ADDRESS 0x0 /* @MemoryAddress@VSM_LKA_Idle2Ready@ */ BIT_MASK 0x01 /end MEASUREMENT
/begin MEASUREMENT VSM_LKA_Con_YawRate_Ready2Idle "" UBYTE PubIfStateVSM_MDL_CM_boolean 0 0 0 1 ECU_ADDRESS 0x0 /* @MemoryAddress@VSM_LKA_Con_YawRate_Ready2Idle@ */ BIT_MASK 0x01 /end MEASUREMENT
/begin MEASUREMENT VSM_LKA_Con_AbsEsp_Ready2Idle "" UBYTE PubIfStateVSM_MDL_CM_boolean 0 0 0 1 ECU_ADDRESS 0x0 /* @MemoryAddress@VSM_LKA_Con_AbsEsp_Ready2Idle@ */ BIT_MASK 0x01 /end MEASUREMENT
/begin MEASUREMENT VSM_LKA_Con_Failsafe_Ready2Idle "" UBYTE PubIfStateVSM_MDL_CM_boolean 0 0 0 1 ECU_ADDRESS 0x0 /* @MemoryAddress@VSM_LKA_Con_Failsafe_Ready2Idle@ */ BIT_MASK 0x01 /end MEASUREMENT
/begin MEASUREMENT VSM_LKA_Con_LaneCurve_Ready2Idle "" UBYTE PubIfStateVSM_MDL_CM_boolean 0 0 0 1 ECU_ADDRESS 0x0 /* @MemoryAddress@VSM_LKA_Con_LaneCurve_Ready2Idle@ */ BIT_MASK 0x01 /end MEASUREMENT
/begin MEASUREMENT VSM_LKA_Con_Headingangle_Ready2Idle "" UBYTE PubIfStateVSM_MDL_CM_boolean 0 0 0 1 ECU_ADDRESS 0x0 /* @MemoryAddress@VSM_LKA_Con_Headingangle_Ready2Idle@ */ BIT_MASK 0x01 /end MEASUREMENT
/begin MEASUREMENT VSM_LKA_Con_ESSSts_Ready2Idle "" UBYTE PubIfStateVSM_MDL_CM_boolean 0 0 0 1 ECU_ADDRESS 0x0 /* @MemoryAddress@VSM_LKA_Con_ESSSts_Ready2Idle@ */ BIT_MASK 0x01 /end MEASUREMENT
/begin MEASUREMENT VSM_LKA_Con_Lane_Ready2Idle "" UBYTE PubIfStateVSM_MDL_CM_boolean 0 0 0 1 ECU_ADDRESS 0x0 /* @MemoryAddress@VSM_LKA_Con_Lane_Ready2Idle@ */ BIT_MASK 0x01 /end MEASUREMENT
/begin MEASUREMENT VSM_LKA_Con_VehicleSpeed_Ready2Idle "" UBYTE PubIfStateVSM_MDL_CM_boolean 0 0 0 1 ECU_ADDRESS 0x0 /* @MemoryAddress@VSM_LKA_Con_VehicleSpeed_Ready2Idle@ */ BIT_MASK 0x01 /end MEASUREMENT
/begin MEASUREMENT VSM_LKA_Other2Idle "" UBYTE PubIfStateVSM_MDL_CM_boolean 0 0 0 1 ECU_ADDRESS 0x0 /* @MemoryAddress@VSM_LKA_Other2Idle@ */ BIT_MASK 0x01 /end MEASUREMENT
/begin MEASUREMENT VSM_LKA_Con_SteerWheelAngle_Ready2Active "" UBYTE PubIfStateVSM_MDL_CM_boolean 0 0 0 1 ECU_ADDRESS 0x0 /* @MemoryAddress@VSM_LKA_Con_SteerWheelAngle_Ready2Active@ */ BIT_MASK 0x01 /end MEASUREMENT
/begin MEASUREMENT VSM_LKA_Con_DriverInput_Ready2Active "" UBYTE PubIfStateVSM_MDL_CM_boolean 0 0 0 1 ECU_ADDRESS 0x0 /* @MemoryAddress@VSM_LKA_Con_DriverInput_Ready2Active@ */ BIT_MASK 0x01 /end MEASUREMENT
/begin MEASUREMENT VSM_LKA_Con_SteerWheelSpd_Ready2Active "" UBYTE PubIfStateVSM_MDL_CM_boolean 0 0 0 1 ECU_ADDRESS 0x0 /* @MemoryAddress@VSM_LKA_Con_SteerWheelSpd_Ready2Active@ */ BIT_MASK 0x01 /end MEASUREMENT
/begin MEASUREMENT VSM_LKA_Con_LateralAcc_Ready2Active "" UBYTE PubIfStateVSM_MDL_CM_boolean 0 0 0 1 ECU_ADDRESS 0x0 /* @MemoryAddress@VSM_LKA_Con_LateralAcc_Ready2Active@ */ BIT_MASK 0x01 /end MEASUREMENT
/begin MEASUREMENT VSM_LKA_Con_LongitudeAcc_Ready2Active "" UBYTE PubIfStateVSM_MDL_CM_boolean 0 0 0 1 ECU_ADDRESS 0x0 /* @MemoryAddress@VSM_LKA_Con_LongitudeAcc_Ready2Active@ */ BIT_MASK 0x01 /end MEASUREMENT
/begin MEASUREMENT VSM_LKA_Con_BrakePressure_Ready2Active "" UBYTE PubIfStateVSM_MDL_CM_boolean 0 0 0 1 ECU_ADDRESS 0x0 /* @MemoryAddress@VSM_LKA_Con_BrakePressure_Ready2Active@ */ BIT_MASK 0x01 /end MEASUREMENT
/begin MEASUREMENT VSM_LKA_Con_AccPedalRate_Ready2Active "" UBYTE PubIfStateVSM_MDL_CM_boolean 0 0 0 1 ECU_ADDRESS 0x0 /* @MemoryAddress@VSM_LKA_Con_AccPedalRate_Ready2Active@ */ BIT_MASK 0x01 /end MEASUREMENT
/begin MEASUREMENT VSM_LKA_Con_EpsSta_Ready2Active "" UBYTE PubIfStateVSM_MDL_CM_boolean 0 0 0 1 ECU_ADDRESS 0x0 /* @MemoryAddress@VSM_LKA_Con_EpsSta_Ready2Active@ */ BIT_MASK 0x01 /end MEASUREMENT
/begin MEASUREMENT VSM_LKA_Con_CURRENT_GEAR_Ready2Active "" UBYTE PubIfStateVSM_MDL_CM_boolean 0 0 0 1 ECU_ADDRESS 0x0 /* @MemoryAddress@VSM_LKA_Con_CURRENT_GEAR_Ready2Active@ */ BIT_MASK 0x01 /end MEASUREMENT
/begin MEASUREMENT VSM_LKA_Con_TurnLight_Ready2Active "" UBYTE PubIfStateVSM_MDL_CM_boolean 0 0 0 1 ECU_ADDRESS 0x0 /* @MemoryAddress@VSM_LKA_Con_TurnLight_Ready2Active@ */ BIT_MASK 0x01 /end MEASUREMENT
/begin MEASUREMENT VSM_LKA_Con_Override_Ready2Active "" UBYTE PubIfStateVSM_MDL_CM_boolean 0 0 0 1 ECU_ADDRESS 0x0 /* @MemoryAddress@VSM_LKA_Con_Override_Ready2Active@ */ BIT_MASK 0x01 /end MEASUREMENT
/begin MEASUREMENT VSM_LKA_Con_LaneChange_Ready2Active "" UBYTE PubIfStateVSM_MDL_CM_boolean 0 0 0 1 ECU_ADDRESS 0x0 /* @MemoryAddress@VSM_LKA_Con_LaneChange_Ready2Active@ */ BIT_MASK 0x01 /end MEASUREMENT
/begin MEASUREMENT VSM_LKA_Con_TJASts_Ready2Active "" UBYTE PubIfStateVSM_MDL_CM_boolean 0 0 0 1 ECU_ADDRESS 0x0 /* @MemoryAddress@VSM_LKA_Con_TJASts_Ready2Active@ */ BIT_MASK 0x01 /end MEASUREMENT
/begin MEASUREMENT VSM_LKA_Ready2Active "" UBYTE PubIfStateVSM_MDL_CM_boolean 0 0 0 1 ECU_ADDRESS 0x0 /* @MemoryAddress@VSM_LKA_Ready2Active@ */ BIT_MASK 0x01 /end MEASUREMENT
/begin MEASUREMENT VSM_LKAWarnflag "" UBYTE PubIfStateVSM_MDL_CM_boolean 0 0 0 1 ECU_ADDRESS 0x0 /* @MemoryAddress@VSM_LKAWarnflag@ */ BIT_MASK 0x01 /end MEASUREMENT
/begin MEASUREMENT VSM_LKA_Con_LateralAcc_Active2Ready "" UBYTE PubIfStateVSM_MDL_CM_boolean 0 0 0 1 ECU_ADDRESS 0x0 /* @MemoryAddress@VSM_LKA_Con_LateralAcc_Active2Ready@ */ BIT_MASK 0x01 /end MEASUREMENT
/begin MEASUREMENT VSM_LKA_Con_LongitudeAcc_Active2Ready "" UBYTE PubIfStateVSM_MDL_CM_boolean 0 0 0 1 ECU_ADDRESS 0x0 /* @MemoryAddress@VSM_LKA_Con_LongitudeAcc_Active2Ready@ */ BIT_MASK 0x01 /end MEASUREMENT
/begin MEASUREMENT VSM_LKA_Con_EpsSta_Active2Ready "" UBYTE PubIfStateVSM_MDL_CM_boolean 0 0 0 1 ECU_ADDRESS 0x0 /* @MemoryAddress@VSM_LKA_Con_EpsSta_Active2Ready@ */ BIT_MASK 0x01 /end MEASUREMENT
/begin MEASUREMENT VSM_LKA_Con_CURRENT_GEAR_Active2Ready "" UBYTE PubIfStateVSM_MDL_CM_boolean 0 0 0 1 ECU_ADDRESS 0x0 /* @MemoryAddress@VSM_LKA_Con_CURRENT_GEAR_Active2Ready@ */ BIT_MASK 0x01 /end MEASUREMENT
/begin MEASUREMENT VSM_LKA_Con_TurnLight_Active2Ready "" UBYTE PubIfStateVSM_MDL_CM_boolean 0 0 0 1 ECU_ADDRESS 0x0 /* @MemoryAddress@VSM_LKA_Con_TurnLight_Active2Ready@ */ BIT_MASK 0x01 /end MEASUREMENT
/begin MEASUREMENT VSM_LKA_Con_LaneChange_Active2Ready "" UBYTE PubIfStateVSM_MDL_CM_boolean 0 0 0 1 ECU_ADDRESS 0x0 /* @MemoryAddress@VSM_LKA_Con_LaneChange_Active2Ready@ */ BIT_MASK 0x01 /end MEASUREMENT
/begin MEASUREMENT VSM_LKA_Con_ESSSts_Active2Ready "" UBYTE PubIfStateVSM_MDL_CM_boolean 0 0 0 1 ECU_ADDRESS 0x0 /* @MemoryAddress@VSM_LKA_Con_ESSSts_Active2Ready@ */ BIT_MASK 0x01 /end MEASUREMENT
/begin MEASUREMENT VSM_LKA_Con_TJASts_Active2Ready "" UBYTE PubIfStateVSM_MDL_CM_boolean 0 0 0 1 ECU_ADDRESS 0x0 /* @MemoryAddress@VSM_LKA_Con_TJASts_Active2Ready@ */ BIT_MASK 0x01 /end MEASUREMENT
/begin MEASUREMENT VSM_LKA_Active2Ready "" UBYTE PubIfStateVSM_MDL_CM_boolean 0 0 0 1 ECU_ADDRESS 0x0 /* @MemoryAddress@VSM_LKA_Active2Ready@ */ BIT_MASK 0x01 /end MEASUREMENT
/begin MEASUREMENT VSM_LKA_End "" UBYTE PubIfStateVSM_MDL_CM_boolean 0 0 0 1 ECU_ADDRESS 0x0 /* @MemoryAddress@VSM_LKA_End@ */ BIT_MASK 0x01 /end MEASUREMENT
/begin MEASUREMENT VSM_LKA_LeftWarning "" UBYTE PubIfStateVSM_MDL_CM_boolean 0 0 0 1 ECU_ADDRESS 0x0 /* @MemoryAddress@VSM_LKA_LeftWarning@ */ BIT_MASK 0x01 /end MEASUREMENT
/begin MEASUREMENT VSM_LKA_RightWarning "" UBYTE PubIfStateVSM_MDL_CM_boolean 0 0 0 1 ECU_ADDRESS 0x0 /* @MemoryAddress@VSM_LKA_RightWarning@ */ BIT_MASK 0x01 /end MEASUREMENT
/begin MEASUREMENT VSM_ELK_OnComing_LOnComing "" UBYTE PubIfStateVSM_MDL_CM_boolean 0 0 0 1 ECU_ADDRESS 0x0 /* @MemoryAddress@VSM_ELK_OnComing_LOnComing@ */ BIT_MASK 0x01 /end MEASUREMENT
/begin MEASUREMENT VSM_ELK_OnComing_Lttc "" UBYTE PubIfStateVSM_MDL_CM_boolean 0 0 0 1 ECU_ADDRESS 0x0 /* @MemoryAddress@VSM_ELK_OnComing_Lttc@ */ BIT_MASK 0x01 /end MEASUREMENT
/begin MEASUREMENT VSM_ELK_OnComing_ROnComing "" UBYTE PubIfStateVSM_MDL_CM_boolean 0 0 0 1 ECU_ADDRESS 0x0 /* @MemoryAddress@VSM_ELK_OnComing_ROnComing@ */ BIT_MASK 0x01 /end MEASUREMENT
/begin MEASUREMENT VSM_ELK_OnComing_Rttc "" UBYTE PubIfStateVSM_MDL_CM_boolean 0 0 0 1 ECU_ADDRESS 0x0 /* @MemoryAddress@VSM_ELK_OnComing_Rttc@ */ BIT_MASK 0x01 /end MEASUREMENT
/begin MEASUREMENT VSM_ELK_OnComing_LetfCondition "" UBYTE PubIfStateVSM_MDL_CM_boolean 0 0 0 1 ECU_ADDRESS 0x0 /* @MemoryAddress@VSM_ELK_OnComing_LetfCondition@ */ BIT_MASK 0x01 /end MEASUREMENT
/begin MEASUREMENT VSM_ELK_OnComing_RightCondition "" UBYTE PubIfStateVSM_MDL_CM_boolean 0 0 0 1 ECU_ADDRESS 0x0 /* @MemoryAddress@VSM_ELK_OnComing_RightCondition@ */ BIT_MASK 0x01 /end MEASUREMENT
/begin MEASUREMENT VSM_ELK_OverTaking_LLateral "" UBYTE PubIfStateVSM_MDL_CM_boolean 0 0 0 1 ECU_ADDRESS 0x0 /* @MemoryAddress@VSM_ELK_OverTaking_LLateral@ */ BIT_MASK 0x01 /end MEASUREMENT
/begin MEASUREMENT VSM_ELK_OverTaking_RLateral "" UBYTE PubIfStateVSM_MDL_CM_boolean 0 0 0 1 ECU_ADDRESS 0x0 /* @MemoryAddress@VSM_ELK_OverTaking_RLateral@ */ BIT_MASK 0x01 /end MEASUREMENT
/begin MEASUREMENT VSM_ELK_OverTaking_LeftCondition "" UBYTE PubIfStateVSM_MDL_CM_boolean 0 0 0 1 ECU_ADDRESS 0x0 /* @MemoryAddress@VSM_ELK_OverTaking_LeftCondition@ */ BIT_MASK 0x01 /end MEASUREMENT
/begin MEASUREMENT VSM_ELK_OverTaking_RightCondition "" UBYTE PubIfStateVSM_MDL_CM_boolean 0 0 0 1 ECU_ADDRESS 0x0 /* @MemoryAddress@VSM_ELK_OverTaking_RightCondition@ */ BIT_MASK 0x01 /end MEASUREMENT
/begin MEASUREMENT VSM_LCK_Con_ESSSts_Idle2Ready "" UBYTE PubIfStateVSM_MDL_CM_boolean 0 0 0 1 ECU_ADDRESS 0x0 /* @MemoryAddress@VSM_LCK_Con_ESSSts_Idle2Ready@ */ BIT_MASK 0x01 /end MEASUREMENT
/begin MEASUREMENT VSM_LCK_Con_YawRate_Idle2Ready "" UBYTE PubIfStateVSM_MDL_CM_boolean 0 0 0 1 ECU_ADDRESS 0x0 /* @MemoryAddress@VSM_LCK_Con_YawRate_Idle2Ready@ */ BIT_MASK 0x01 /end MEASUREMENT
/begin MEASUREMENT VSM_LCK_Con_VehicleSpd_Idle2Ready "" UBYTE PubIfStateVSM_MDL_CM_boolean 0 0 0 1 ECU_ADDRESS 0x0 /* @MemoryAddress@VSM_LCK_Con_VehicleSpd_Idle2Ready@ */ BIT_MASK 0x01 /end MEASUREMENT
/begin MEASUREMENT VSM_LCK_Con_HandsOff_Ready2Idle "" UBYTE PubIfStateVSM_MDL_CM_boolean 0 0 0 1 ECU_ADDRESS 0x0 /* @MemoryAddress@VSM_LCK_Con_HandsOff_Ready2Idle@ */ BIT_MASK 0x01 /end MEASUREMENT
/begin MEASUREMENT VSM_LCK_Con_Handson_Idle2Ready "" UBYTE PubIfStateVSM_MDL_CM_boolean 0 0 0 1 ECU_ADDRESS 0x0 /* @MemoryAddress@VSM_LCK_Con_Handson_Idle2Ready@ */ BIT_MASK 0x01 /end MEASUREMENT
/begin MEASUREMENT VSM_LCK_Con_AbsEsp_Idle2Ready "" UBYTE PubIfStateVSM_MDL_CM_boolean 0 0 0 1 ECU_ADDRESS 0x0 /* @MemoryAddress@VSM_LCK_Con_AbsEsp_Idle2Ready@ */ BIT_MASK 0x01 /end MEASUREMENT
/begin MEASUREMENT VSM_LCK_Con_ESSSts_Ready2Idle "" UBYTE PubIfStateVSM_MDL_CM_boolean 0 0 0 1 ECU_ADDRESS 0x0 /* @MemoryAddress@VSM_LCK_Con_ESSSts_Ready2Idle@ */ BIT_MASK 0x01 /end MEASUREMENT
/begin MEASUREMENT VSM_LCK_Con_YawRate_Ready2Idle "" UBYTE PubIfStateVSM_MDL_CM_boolean 0 0 0 1 ECU_ADDRESS 0x0 /* @MemoryAddress@VSM_LCK_Con_YawRate_Ready2Idle@ */ BIT_MASK 0x01 /end MEASUREMENT
/begin MEASUREMENT VSM_LCK_Con_VehicleSpd_Ready2Idle "" UBYTE PubIfStateVSM_MDL_CM_boolean 0 0 0 1 ECU_ADDRESS 0x0 /* @MemoryAddress@VSM_LCK_Con_VehicleSpd_Ready2Idle@ */ BIT_MASK 0x01 /end MEASUREMENT
/begin MEASUREMENT VSM_LCK_Con_LSMLine_Ready2Idle "" UBYTE PubIfStateVSM_MDL_CM_boolean 0 0 0 1 ECU_ADDRESS 0x0 /* @MemoryAddress@VSM_LCK_Con_LSMLine_Ready2Idle@ */ BIT_MASK 0x01 /end MEASUREMENT
/begin MEASUREMENT VSM_LCK_Con_AbsEsp_Ready2Idle "" UBYTE PubIfStateVSM_MDL_CM_boolean 0 0 0 1 ECU_ADDRESS 0x0 /* @MemoryAddress@VSM_LCK_Con_AbsEsp_Ready2Idle@ */ BIT_MASK 0x01 /end MEASUREMENT
/begin MEASUREMENT VSM_LCK_Con_LaneCurve_Ready2Idle "" UBYTE PubIfStateVSM_MDL_CM_boolean 0 0 0 1 ECU_ADDRESS 0x0 /* @MemoryAddress@VSM_LCK_Con_LaneCurve_Ready2Idle@ */ BIT_MASK 0x01 /end MEASUREMENT
/begin MEASUREMENT VSM_LCK_Ready2Idle "" UBYTE PubIfStateVSM_MDL_CM_boolean 0 0 0 1 ECU_ADDRESS 0x0 /* @MemoryAddress@VSM_LCK_Ready2Idle@ */ BIT_MASK 0x01 /end MEASUREMENT
/begin MEASUREMENT VSM_LCK_Con_InTime_Idle2Ready "" UBYTE PubIfStateVSM_MDL_CM_boolean 0 0 0 1 ECU_ADDRESS 0x0 /* @MemoryAddress@VSM_LCK_Con_InTime_Idle2Ready@ */ BIT_MASK 0x01 /end MEASUREMENT
/begin MEASUREMENT VSM_LCK_Con_LaneCurve_Idle2Ready "" UBYTE PubIfStateVSM_MDL_CM_boolean 0 0 0 1 ECU_ADDRESS 0x0 /* @MemoryAddress@VSM_LCK_Con_LaneCurve_Idle2Ready@ */ BIT_MASK 0x01 /end MEASUREMENT
/begin MEASUREMENT VSM_LCK_Con_LSMLine_Idle2Ready "" UBYTE PubIfStateVSM_MDL_CM_boolean 0 0 0 1 ECU_ADDRESS 0x0 /* @MemoryAddress@VSM_LCK_Con_LSMLine_Idle2Ready@ */ BIT_MASK 0x01 /end MEASUREMENT
/begin MEASUREMENT VSM_LCK_Idle2Ready "" UBYTE PubIfStateVSM_MDL_CM_boolean 0 0 0 1 ECU_ADDRESS 0x0 /* @MemoryAddress@VSM_LCK_Idle2Ready@ */ BIT_MASK 0x01 /end MEASUREMENT
/begin MEASUREMENT VSM_LCK_Con_TurnLight_Ready2Active "" UBYTE PubIfStateVSM_MDL_CM_boolean 0 0 0 1 ECU_ADDRESS 0x0 /* @MemoryAddress@VSM_LCK_Con_TurnLight_Ready2Active@ */ BIT_MASK 0x01 /end MEASUREMENT
/begin MEASUREMENT VSM_LCK_Con_SteerAngleSpd_Ready2Active "" UBYTE PubIfStateVSM_MDL_CM_boolean 0 0 0 1 ECU_ADDRESS 0x0 /* @MemoryAddress@VSM_LCK_Con_SteerAngleSpd_Ready2Active@ */ BIT_MASK 0x01 /end MEASUREMENT
/begin MEASUREMENT VSM_LCK_Con_BrakePress_Ready2Active "" UBYTE PubIfStateVSM_MDL_CM_boolean 0 0 0 1 ECU_ADDRESS 0x0 /* @MemoryAddress@VSM_LCK_Con_BrakePress_Ready2Active@ */ BIT_MASK 0x01 /end MEASUREMENT
/begin MEASUREMENT VSM_LCK_Con_AccPedalRate_Ready2Active "" UBYTE PubIfStateVSM_MDL_CM_boolean 0 0 0 1 ECU_ADDRESS 0x0 /* @MemoryAddress@VSM_LCK_Con_AccPedalRate_Ready2Active@ */ BIT_MASK 0x01 /end MEASUREMENT
/begin MEASUREMENT VSM_LCK_Con_SteerWheelAngle_Ready2Active "" UBYTE PubIfStateVSM_MDL_CM_boolean 0 0 0 1 ECU_ADDRESS 0x0 /* @MemoryAddress@VSM_LCK_Con_SteerWheelAngle_Ready2Active@ */ BIT_MASK 0x01 /end MEASUREMENT
/begin MEASUREMENT VSM_LCK_Con_DrvInputTrqValue_Ready2Active "" UBYTE PubIfStateVSM_MDL_CM_boolean 0 0 0 1 ECU_ADDRESS 0x0 /* @MemoryAddress@VSM_LCK_Con_DrvInputTrqValue_Ready2Active@ */ BIT_MASK 0x01 /end MEASUREMENT
/begin MEASUREMENT VSM_LCK_Con_LateralAcc_Ready2Active "" UBYTE PubIfStateVSM_MDL_CM_boolean 0 0 0 1 ECU_ADDRESS 0x0 /* @MemoryAddress@VSM_LCK_Con_LateralAcc_Ready2Active@ */ BIT_MASK 0x01 /end MEASUREMENT
/begin MEASUREMENT VSM_LCK_Con_LongitudeAcc_Ready2Active "" UBYTE PubIfStateVSM_MDL_CM_boolean 0 0 0 1 ECU_ADDRESS 0x0 /* @MemoryAddress@VSM_LCK_Con_LongitudeAcc_Ready2Active@ */ BIT_MASK 0x01 /end MEASUREMENT
/begin MEASUREMENT VSM_LCK_Con_CURRENT_GEAR_Ready2Active "" UBYTE PubIfStateVSM_MDL_CM_boolean 0 0 0 1 ECU_ADDRESS 0x0 /* @MemoryAddress@VSM_LCK_Con_CURRENT_GEAR_Ready2Active@ */ BIT_MASK 0x01 /end MEASUREMENT
/begin MEASUREMENT VSM_LCK_Con_OverRide_Ready2Active "" UBYTE PubIfStateVSM_MDL_CM_boolean 0 0 0 1 ECU_ADDRESS 0x0 /* @MemoryAddress@VSM_LCK_Con_OverRide_Ready2Active@ */ BIT_MASK 0x01 /end MEASUREMENT
/begin MEASUREMENT VSM_LCK_Con_EpsSts_Ready2Active "" UBYTE PubIfStateVSM_MDL_CM_boolean 0 0 0 1 ECU_ADDRESS 0x0 /* @MemoryAddress@VSM_LCK_Con_EpsSts_Ready2Active@ */ BIT_MASK 0x01 /end MEASUREMENT
/begin MEASUREMENT VSM_LCK_Con_LaneChange_Ready2Active "" UBYTE PubIfStateVSM_MDL_CM_boolean 0 0 0 1 ECU_ADDRESS 0x0 /* @MemoryAddress@VSM_LCK_Con_LaneChange_Ready2Active@ */ BIT_MASK 0x01 /end MEASUREMENT
/begin MEASUREMENT VSM_LCK_Ready2Active "" UBYTE PubIfStateVSM_MDL_CM_boolean 0 0 0 1 ECU_ADDRESS 0x0 /* @MemoryAddress@VSM_LCK_Ready2Active@ */ BIT_MASK 0x01 /end MEASUREMENT
/begin MEASUREMENT VSM_LCK_Con_TurnLight_Active2Ready "" UBYTE PubIfStateVSM_MDL_CM_boolean 0 0 0 1 ECU_ADDRESS 0x0 /* @MemoryAddress@VSM_LCK_Con_TurnLight_Active2Ready@ */ BIT_MASK 0x01 /end MEASUREMENT
/begin MEASUREMENT VSM_LCK_Con_EpsSta_Active2Ready "" UBYTE PubIfStateVSM_MDL_CM_boolean 0 0 0 1 ECU_ADDRESS 0x0 /* @MemoryAddress@VSM_LCK_Con_EpsSta_Active2Ready@ */ BIT_MASK 0x01 /end MEASUREMENT
/begin MEASUREMENT VSM_LCK_Con_LateralAcc_Active2Ready "" UBYTE PubIfStateVSM_MDL_CM_boolean 0 0 0 1 ECU_ADDRESS 0x0 /* @MemoryAddress@VSM_LCK_Con_LateralAcc_Active2Ready@ */ BIT_MASK 0x01 /end MEASUREMENT
/begin MEASUREMENT VSM_LCK_Con_LongitudeAcc_Active2Ready "" UBYTE PubIfStateVSM_MDL_CM_boolean 0 0 0 1 ECU_ADDRESS 0x0 /* @MemoryAddress@VSM_LCK_Con_LongitudeAcc_Active2Ready@ */ BIT_MASK 0x01 /end MEASUREMENT
/begin MEASUREMENT VSM_LCK_Con_CURRENT_GEAR_Active2Ready "" UBYTE PubIfStateVSM_MDL_CM_boolean 0 0 0 1 ECU_ADDRESS 0x0 /* @MemoryAddress@VSM_LCK_Con_CURRENT_GEAR_Active2Ready@ */ BIT_MASK 0x01 /end MEASUREMENT
/begin MEASUREMENT VSM_LCK_Con_LaneChange_Active2Ready "" UBYTE PubIfStateVSM_MDL_CM_boolean 0 0 0 1 ECU_ADDRESS 0x0 /* @MemoryAddress@VSM_LCK_Con_LaneChange_Active2Ready@ */ BIT_MASK 0x01 /end MEASUREMENT
/begin MEASUREMENT VSM_LCK_Active2Ready "" UBYTE PubIfStateVSM_MDL_CM_boolean 0 0 0 1 ECU_ADDRESS 0x0 /* @MemoryAddress@VSM_LCK_Active2Ready@ */ BIT_MASK 0x01 /end MEASUREMENT
/begin MEASUREMENT VSM_LCKIE_State_Vehspeed_Idel2Ready "" UBYTE PubIfStateVSM_MDL_CM_boolean 0 0 0 1 ECU_ADDRESS 0x0 /* @MemoryAddress@VSM_LCKIE_State_Vehspeed_Idel2Ready@ */ BIT_MASK 0x01 /end MEASUREMENT
/begin MEASUREMENT VSM_LCKIE_State_Lanecurve_Idel2Ready "" UBYTE PubIfStateVSM_MDL_CM_boolean 0 0 0 1 ECU_ADDRESS 0x0 /* @MemoryAddress@VSM_LCKIE_State_Lanecurve_Idel2Ready@ */ BIT_MASK 0x01 /end MEASUREMENT
/begin MEASUREMENT VSM_LCKIE_State_LaneWidth_Idel2Ready "" UBYTE PubIfStateVSM_MDL_CM_boolean 0 0 0 1 ECU_ADDRESS 0x0 /* @MemoryAddress@VSM_LCKIE_State_LaneWidth_Idel2Ready@ */ BIT_MASK 0x01 /end MEASUREMENT
/begin MEASUREMENT VSM_LCKIE_State_wiper_Idel2Ready "" UBYTE PubIfStateVSM_MDL_CM_boolean 0 0 0 1 ECU_ADDRESS 0x0 /* @MemoryAddress@VSM_LCKIE_State_wiper_Idel2Ready@ */ BIT_MASK 0x01 /end MEASUREMENT
/begin MEASUREMENT VSM_LCKIE_State_lamb_Idel2Ready "" UBYTE PubIfStateVSM_MDL_CM_boolean 0 0 0 1 ECU_ADDRESS 0x0 /* @MemoryAddress@VSM_LCKIE_State_lamb_Idel2Ready@ */ BIT_MASK 0x01 /end MEASUREMENT
/begin MEASUREMENT VSM_LCKIE_State_detaspd_Idel2Ready "" UBYTE PubIfStateVSM_MDL_CM_boolean 0 0 0 1 ECU_ADDRESS 0x0 /* @MemoryAddress@VSM_LCKIE_State_detaspd_Idel2Ready@ */ BIT_MASK 0x01 /end MEASUREMENT
/begin MEASUREMENT VSM_LCKIE_State_Idel2Ready "" UBYTE PubIfStateVSM_MDL_CM_boolean 0 0 0 1 ECU_ADDRESS 0x0 /* @MemoryAddress@VSM_LCKIE_State_Idel2Ready@ */ BIT_MASK 0x01 /end MEASUREMENT
/begin MEASUREMENT VSM_LCKIE_State_DrvInputTrqValue_Ready2Active "" UBYTE PubIfStateVSM_MDL_CM_boolean 0 0 0 1 ECU_ADDRESS 0x0 /* @MemoryAddress@VSM_LCKIE_State_DrvInputTrqValue_Ready2Active@ */ BIT_MASK 0x01 /end MEASUREMENT
/begin MEASUREMENT VSM_LCKIE_State_ELKObj_Ready2Active "" UBYTE PubIfStateVSM_MDL_CM_boolean 0 0 0 1 ECU_ADDRESS 0x0 /* @MemoryAddress@VSM_LCKIE_State_ELKObj_Ready2Active@ */ BIT_MASK 0x01 /end MEASUREMENT
/begin MEASUREMENT VSM_LCKIE_State_OppFrontObj_Ready2Active "" UBYTE PubIfStateVSM_MDL_CM_boolean 0 0 0 1 ECU_ADDRESS 0x0 /* @MemoryAddress@VSM_LCKIE_State_OppFrontObj_Ready2Active@ */ BIT_MASK 0x01 /end MEASUREMENT
/begin MEASUREMENT VSM_LCKIE_State_IEObj_Ready2Active "" UBYTE PubIfStateVSM_MDL_CM_boolean 0 0 0 1 ECU_ADDRESS 0x0 /* @MemoryAddress@VSM_LCKIE_State_IEObj_Ready2Active@ */ BIT_MASK 0x01 /end MEASUREMENT
/begin MEASUREMENT VSM_LCKIE_State_Ready2Active "" UBYTE PubIfStateVSM_MDL_CM_boolean 0 0 0 1 ECU_ADDRESS 0x0 /* @MemoryAddress@VSM_LCKIE_State_Ready2Active@ */ BIT_MASK 0x01 /end MEASUREMENT
/begin MEASUREMENT VSM_LCKIE_State_Vehspeed_Ready2Idel "" UBYTE PubIfStateVSM_MDL_CM_boolean 0 0 0 1 ECU_ADDRESS 0x0 /* @MemoryAddress@VSM_LCKIE_State_Vehspeed_Ready2Idel@ */ BIT_MASK 0x01 /end MEASUREMENT
/begin MEASUREMENT VSM_LCKIE_State_Lanecurve_Ready2Idel "" UBYTE PubIfStateVSM_MDL_CM_boolean 0 0 0 1 ECU_ADDRESS 0x0 /* @MemoryAddress@VSM_LCKIE_State_Lanecurve_Ready2Idel@ */ BIT_MASK 0x01 /end MEASUREMENT
/begin MEASUREMENT VSM_LCKIE_State_LaneWidth_Ready2Idel "" UBYTE PubIfStateVSM_MDL_CM_boolean 0 0 0 1 ECU_ADDRESS 0x0 /* @MemoryAddress@VSM_LCKIE_State_LaneWidth_Ready2Idel@ */ BIT_MASK 0x01 /end MEASUREMENT
/begin MEASUREMENT VSM_LCKIE_State_wiper_Ready2Idel "" UBYTE PubIfStateVSM_MDL_CM_boolean 0 0 0 1 ECU_ADDRESS 0x0 /* @MemoryAddress@VSM_LCKIE_State_wiper_Ready2Idel@ */ BIT_MASK 0x01 /end MEASUREMENT
/begin MEASUREMENT VSM_LCKIE_State_lamb_Ready2Idel "" UBYTE PubIfStateVSM_MDL_CM_boolean 0 0 0 1 ECU_ADDRESS 0x0 /* @MemoryAddress@VSM_LCKIE_State_lamb_Ready2Idel@ */ BIT_MASK 0x01 /end MEASUREMENT
/begin MEASUREMENT VSM_LCKIE_State_detaspd_Ready2Idel "" UBYTE PubIfStateVSM_MDL_CM_boolean 0 0 0 1 ECU_ADDRESS 0x0 /* @MemoryAddress@VSM_LCKIE_State_detaspd_Ready2Idel@ */ BIT_MASK 0x01 /end MEASUREMENT
/begin MEASUREMENT VSM_LCKIE_State_Ready2Idel "" UBYTE PubIfStateVSM_MDL_CM_boolean 0 0 0 1 ECU_ADDRESS 0x0 /* @MemoryAddress@VSM_LCKIE_State_Ready2Idel@ */ BIT_MASK 0x01 /end MEASUREMENT
/begin MEASUREMENT VSM_LCKIE_State_DrvInputTrqValue_Active2Ready "" UBYTE PubIfStateVSM_MDL_CM_boolean 0 0 0 1 ECU_ADDRESS 0x0 /* @MemoryAddress@VSM_LCKIE_State_DrvInputTrqValue_Active2Ready@ */ BIT_MASK 0x01 /end MEASUREMENT
/begin MEASUREMENT VSM_LCKIE_State_ELKObj_Active2Ready "" UBYTE PubIfStateVSM_MDL_CM_boolean 0 0 0 1 ECU_ADDRESS 0x0 /* @MemoryAddress@VSM_LCKIE_State_ELKObj_Active2Ready@ */ BIT_MASK 0x01 /end MEASUREMENT
/begin MEASUREMENT VSM_LCKIE_State_OppFrontObj_Active2Ready "" UBYTE PubIfStateVSM_MDL_CM_boolean 0 0 0 1 ECU_ADDRESS 0x0 /* @MemoryAddress@VSM_LCKIE_State_OppFrontObj_Active2Ready@ */ BIT_MASK 0x01 /end MEASUREMENT
/begin MEASUREMENT VSM_LCKIE_State_IEObj_Active2Ready "" UBYTE PubIfStateVSM_MDL_CM_boolean 0 0 0 1 ECU_ADDRESS 0x0 /* @MemoryAddress@VSM_LCKIE_State_IEObj_Active2Ready@ */ BIT_MASK 0x01 /end MEASUREMENT
/begin MEASUREMENT VSM_LCKIE_State_Active2Ready "" UBYTE PubIfStateVSM_MDL_CM_boolean 0 0 0 1 ECU_ADDRESS 0x0 /* @MemoryAddress@VSM_LCKIE_State_Active2Ready@ */ BIT_MASK 0x01 /end MEASUREMENT
/begin MEASUREMENT VSM_LCKIE_State_HWASts_Ready2Active "" UBYTE PubIfStateVSM_MDL_CM_boolean 0 0 0 1 ECU_ADDRESS 0x0 /* @MemoryAddress@VSM_LCKIE_State_HWASts_Ready2Active@ */ BIT_MASK 0x01 /end MEASUREMENT
/begin MEASUREMENT VSM_LCKIE_State_IFVReady "" UBYTE PubIfStateVSM_MDL_CM_boolean 0 0 0 1 ECU_ADDRESS 0x0 /* @MemoryAddress@VSM_LCKIE_State_IFVReady@ */ BIT_MASK 0x01 /end MEASUREMENT
/begin MEASUREMENT VSM_LCKIE_State_IFVFail "" UBYTE PubIfStateVSM_MDL_CM_boolean 0 0 0 1 ECU_ADDRESS 0x0 /* @MemoryAddress@VSM_LCKIE_State_IFVFail@ */ BIT_MASK 0x01 /end MEASUREMENT
/begin MEASUREMENT VSM_LDW_Con_YawRate_Idle2Ready "" UBYTE PubIfStateVSM_MDL_CM_boolean 0 0 0 1 ECU_ADDRESS 0x0 /* @MemoryAddress@VSM_LDW_Con_YawRate_Idle2Ready@ */ BIT_MASK 0x01 /end MEASUREMENT
/begin MEASUREMENT VSM_LDW_Con_AbsEsp_Idle2Ready "" UBYTE PubIfStateVSM_MDL_CM_boolean 0 0 0 1 ECU_ADDRESS 0x0 /* @MemoryAddress@VSM_LDW_Con_AbsEsp_Idle2Ready@ */ BIT_MASK 0x01 /end MEASUREMENT
/begin MEASUREMENT VSM_LDW_Con_Headingangle_Idle2Ready "" UBYTE PubIfStateVSM_MDL_CM_boolean 0 0 0 1 ECU_ADDRESS 0x0 /* @MemoryAddress@VSM_LDW_Con_Headingangle_Idle2Ready@ */ BIT_MASK 0x01 /end MEASUREMENT
/begin MEASUREMENT VSM_LDW_Con_Failsafe_Idle2Ready "" UBYTE PubIfStateVSM_MDL_CM_boolean 0 0 0 1 ECU_ADDRESS 0x0 /* @MemoryAddress@VSM_LDW_Con_Failsafe_Idle2Ready@ */ BIT_MASK 0x01 /end MEASUREMENT
/begin MEASUREMENT VSM_LDW_Con_LaneCurve_Idle2Ready "" UBYTE PubIfStateVSM_MDL_CM_boolean 0 0 0 1 ECU_ADDRESS 0x0 /* @MemoryAddress@VSM_LDW_Con_LaneCurve_Idle2Ready@ */ BIT_MASK 0x01 /end MEASUREMENT
/begin MEASUREMENT VSM_LDW_Con_Lane_Idle2Ready "" UBYTE PubIfStateVSM_MDL_CM_boolean 0 0 0 1 ECU_ADDRESS 0x0 /* @MemoryAddress@VSM_LDW_Con_Lane_Idle2Ready@ */ BIT_MASK 0x01 /end MEASUREMENT
/begin MEASUREMENT VSM_LDW_Con_VehicleSpeed_Idle2Ready "" UBYTE PubIfStateVSM_MDL_CM_boolean 0 0 0 1 ECU_ADDRESS 0x0 /* @MemoryAddress@VSM_LDW_Con_VehicleSpeed_Idle2Ready@ */ BIT_MASK 0x01 /end MEASUREMENT
/begin MEASUREMENT VSM_LDW_Con_ESSSts_Idle2Ready "" UBYTE PubIfStateVSM_MDL_CM_boolean 0 0 0 1 ECU_ADDRESS 0x0 /* @MemoryAddress@VSM_LDW_Con_ESSSts_Idle2Ready@ */ BIT_MASK 0x01 /end MEASUREMENT
/begin MEASUREMENT VSM_LDW_Idle2Ready "" UBYTE PubIfStateVSM_MDL_CM_boolean 0 0 0 1 ECU_ADDRESS 0x0 /* @MemoryAddress@VSM_LDW_Idle2Ready@ */ BIT_MASK 0x01 /end MEASUREMENT
/begin MEASUREMENT VSM_LDW_Con_YawRate_Ready2Idle "" UBYTE PubIfStateVSM_MDL_CM_boolean 0 0 0 1 ECU_ADDRESS 0x0 /* @MemoryAddress@VSM_LDW_Con_YawRate_Ready2Idle@ */ BIT_MASK 0x01 /end MEASUREMENT
/begin MEASUREMENT VSM_LDW_Con_AbsEsp_Ready2Idle "" UBYTE PubIfStateVSM_MDL_CM_boolean 0 0 0 1 ECU_ADDRESS 0x0 /* @MemoryAddress@VSM_LDW_Con_AbsEsp_Ready2Idle@ */ BIT_MASK 0x01 /end MEASUREMENT
/begin MEASUREMENT VSM_LDW_Con_Failsafe_Ready2Idle "" UBYTE PubIfStateVSM_MDL_CM_boolean 0 0 0 1 ECU_ADDRESS 0x0 /* @MemoryAddress@VSM_LDW_Con_Failsafe_Ready2Idle@ */ BIT_MASK 0x01 /end MEASUREMENT
/begin MEASUREMENT VSM_LDW_Con_LaneCurve_Ready2Idle "" UBYTE PubIfStateVSM_MDL_CM_boolean 0 0 0 1 ECU_ADDRESS 0x0 /* @MemoryAddress@VSM_LDW_Con_LaneCurve_Ready2Idle@ */ BIT_MASK 0x01 /end MEASUREMENT
/begin MEASUREMENT VSM_LDW_Con_Headingangle_Ready2Idle "" UBYTE PubIfStateVSM_MDL_CM_boolean 0 0 0 1 ECU_ADDRESS 0x0 /* @MemoryAddress@VSM_LDW_Con_Headingangle_Ready2Idle@ */ BIT_MASK 0x01 /end MEASUREMENT
/begin MEASUREMENT VSM_LDW_Con_VehicleSpeed_Ready2Idle "" UBYTE PubIfStateVSM_MDL_CM_boolean 0 0 0 1 ECU_ADDRESS 0x0 /* @MemoryAddress@VSM_LDW_Con_VehicleSpeed_Ready2Idle@ */ BIT_MASK 0x01 /end MEASUREMENT
/begin MEASUREMENT VSM_LDW_Con_Lane_Ready2Idle "" UBYTE PubIfStateVSM_MDL_CM_boolean 0 0 0 1 ECU_ADDRESS 0x0 /* @MemoryAddress@VSM_LDW_Con_Lane_Ready2Idle@ */ BIT_MASK 0x01 /end MEASUREMENT
/begin MEASUREMENT VSM_LDW_Con_ESSSts_Ready2Idle "" UBYTE PubIfStateVSM_MDL_CM_boolean 0 0 0 1 ECU_ADDRESS 0x0 /* @MemoryAddress@VSM_LDW_Con_ESSSts_Ready2Idle@ */ BIT_MASK 0x01 /end MEASUREMENT
/begin MEASUREMENT VSM_LDW_Other2Idle "" UBYTE PubIfStateVSM_MDL_CM_boolean 0 0 0 1 ECU_ADDRESS 0x0 /* @MemoryAddress@VSM_LDW_Other2Idle@ */ BIT_MASK 0x01 /end MEASUREMENT
/begin MEASUREMENT VSM_LDW_Con_SteerWheelAngle_Ready2Active "" UBYTE PubIfStateVSM_MDL_CM_boolean 0 0 0 1 ECU_ADDRESS 0x0 /* @MemoryAddress@VSM_LDW_Con_SteerWheelAngle_Ready2Active@ */ BIT_MASK 0x01 /end MEASUREMENT
/begin MEASUREMENT VSM_LDW_Con_SteerWheelSpd_Ready2Active "" UBYTE PubIfStateVSM_MDL_CM_boolean 0 0 0 1 ECU_ADDRESS 0x0 /* @MemoryAddress@VSM_LDW_Con_SteerWheelSpd_Ready2Active@ */ BIT_MASK 0x01 /end MEASUREMENT
/begin MEASUREMENT VSM_LDW_Con_LateralAcc_Ready2Active "" UBYTE PubIfStateVSM_MDL_CM_boolean 0 0 0 1 ECU_ADDRESS 0x0 /* @MemoryAddress@VSM_LDW_Con_LateralAcc_Ready2Active@ */ BIT_MASK 0x01 /end MEASUREMENT
/begin MEASUREMENT VSM_LDW_Con_LongitudeAcc_Ready2Active "" UBYTE PubIfStateVSM_MDL_CM_boolean 0 0 0 1 ECU_ADDRESS 0x0 /* @MemoryAddress@VSM_LDW_Con_LongitudeAcc_Ready2Active@ */ BIT_MASK 0x01 /end MEASUREMENT
/begin MEASUREMENT VSM_LDW_Con_BrakePressure_Ready2Active "" UBYTE PubIfStateVSM_MDL_CM_boolean 0 0 0 1 ECU_ADDRESS 0x0 /* @MemoryAddress@VSM_LDW_Con_BrakePressure_Ready2Active@ */ BIT_MASK 0x01 /end MEASUREMENT
/begin MEASUREMENT VSM_LDW_Con_AccPedalRate_Ready2Active "" UBYTE PubIfStateVSM_MDL_CM_boolean 0 0 0 1 ECU_ADDRESS 0x0 /* @MemoryAddress@VSM_LDW_Con_AccPedalRate_Ready2Active@ */ BIT_MASK 0x01 /end MEASUREMENT
/begin MEASUREMENT VSM_LDW_Con_CURRENT_GEAR_Ready2Active "" UBYTE PubIfStateVSM_MDL_CM_boolean 0 0 0 1 ECU_ADDRESS 0x0 /* @MemoryAddress@VSM_LDW_Con_CURRENT_GEAR_Ready2Active@ */ BIT_MASK 0x01 /end MEASUREMENT
/begin MEASUREMENT VSM_LDW_Con_TurnLight_Ready2Active "" UBYTE PubIfStateVSM_MDL_CM_boolean 0 0 0 1 ECU_ADDRESS 0x0 /* @MemoryAddress@VSM_LDW_Con_TurnLight_Ready2Active@ */ BIT_MASK 0x01 /end MEASUREMENT
/begin MEASUREMENT VSM_LDW_Con_LaneChange_Ready2Active "" UBYTE PubIfStateVSM_MDL_CM_boolean 0 0 0 1 ECU_ADDRESS 0x0 /* @MemoryAddress@VSM_LDW_Con_LaneChange_Ready2Active@ */ BIT_MASK 0x01 /end MEASUREMENT
/begin MEASUREMENT VSM_LDW_Ready2Active "" UBYTE PubIfStateVSM_MDL_CM_boolean 0 0 0 1 ECU_ADDRESS 0x0 /* @MemoryAddress@VSM_LDW_Ready2Active@ */ BIT_MASK 0x01 /end MEASUREMENT
/begin MEASUREMENT VSM_LDW_Con_CURRENT_GEAR_Active2Ready "" UBYTE PubIfStateVSM_MDL_CM_boolean 0 0 0 1 ECU_ADDRESS 0x0 /* @MemoryAddress@VSM_LDW_Con_CURRENT_GEAR_Active2Ready@ */ BIT_MASK 0x01 /end MEASUREMENT
/begin MEASUREMENT VSM_LDW_Con_LateralAcc_Active2Ready "" UBYTE PubIfStateVSM_MDL_CM_boolean 0 0 0 1 ECU_ADDRESS 0x0 /* @MemoryAddress@VSM_LDW_Con_LateralAcc_Active2Ready@ */ BIT_MASK 0x01 /end MEASUREMENT
/begin MEASUREMENT VSM_LDW_Con_LongitudeAcc_Active2Ready "" UBYTE PubIfStateVSM_MDL_CM_boolean 0 0 0 1 ECU_ADDRESS 0x0 /* @MemoryAddress@VSM_LDW_Con_LongitudeAcc_Active2Ready@ */ BIT_MASK 0x01 /end MEASUREMENT
/begin MEASUREMENT VSM_LDW_Con_LaneChange_Active2Ready "" UBYTE PubIfStateVSM_MDL_CM_boolean 0 0 0 1 ECU_ADDRESS 0x0 /* @MemoryAddress@VSM_LDW_Con_LaneChange_Active2Ready@ */ BIT_MASK 0x01 /end MEASUREMENT
/begin MEASUREMENT VSM_LDW_Con_TurnLight_Active2Ready "" UBYTE PubIfStateVSM_MDL_CM_boolean 0 0 0 1 ECU_ADDRESS 0x0 /* @MemoryAddress@VSM_LDW_Con_TurnLight_Active2Ready@ */ BIT_MASK 0x01 /end MEASUREMENT
/begin MEASUREMENT VSM_LDW_Active2Ready "" UBYTE PubIfStateVSM_MDL_CM_boolean 0 0 0 1 ECU_ADDRESS 0x0 /* @MemoryAddress@VSM_LDW_Active2Ready@ */ BIT_MASK 0x01 /end MEASUREMENT
/begin MEASUREMENT VSM_LCK_TargetLaneIn2 "" UBYTE PubIfStateVSM_MDL_CM_boolean 0 0 0 1 ECU_ADDRESS 0x0 /* @MemoryAddress@VSM_LCK_TargetLaneIn2@ */ BIT_MASK 0x01 /end MEASUREMENT
/begin MEASUREMENT VSM_LCK_TargetLaneIn "" UBYTE PubIfStateVSM_MDL_CM_boolean 0 0 0 1 ECU_ADDRESS 0x0 /* @MemoryAddress@VSM_LCK_TargetLaneIn@ */ BIT_MASK 0x01 /end MEASUREMENT
/begin MEASUREMENT VSM_LCK_Con_TJAVehicleSpd_Idle2Ready "" UBYTE PubIfStateVSM_MDL_CM_boolean 0 0 0 1 ECU_ADDRESS 0x0 /* @MemoryAddress@VSM_LCK_Con_TJAVehicleSpd_Idle2Ready@ */ BIT_MASK 0x01 /end MEASUREMENT
/begin MEASUREMENT VSM_LCK_Con_TJAVehicleSpd_Ready2Idle "" UBYTE PubIfStateVSM_MDL_CM_boolean 0 0 0 1 ECU_ADDRESS 0x0 /* @MemoryAddress@VSM_LCK_Con_TJAVehicleSpd_Ready2Idle@ */ BIT_MASK 0x01 /end MEASUREMENT
/begin MEASUREMENT VSM_LCK_Con_Lane_Idle2Ready "" UBYTE PubIfStateVSM_MDL_CM_boolean 0 0 0 1 ECU_ADDRESS 0x0 /* @MemoryAddress@VSM_LCK_Con_Lane_Idle2Ready@ */ BIT_MASK 0x01 /end MEASUREMENT
/begin MEASUREMENT VSM_LCK_Con_TargetLaneIn_Idle2Ready "" UBYTE PubIfStateVSM_MDL_CM_boolean 0 0 0 1 ECU_ADDRESS 0x0 /* @MemoryAddress@VSM_LCK_Con_TargetLaneIn_Idle2Ready@ */ BIT_MASK 0x01 /end MEASUREMENT
/begin MEASUREMENT VSM_LCK_TJAReady2Active "" UBYTE PubIfStateVSM_MDL_CM_boolean 0 0 0 1 ECU_ADDRESS 0x0 /* @MemoryAddress@VSM_LCK_TJAReady2Active@ */ BIT_MASK 0x01 /end MEASUREMENT
/begin MEASUREMENT VSM_LCK_Con_TJALane_Ready2Idle "" UBYTE PubIfStateVSM_MDL_CM_boolean 0 0 0 1 ECU_ADDRESS 0x0 /* @MemoryAddress@VSM_LCK_Con_TJALane_Ready2Idle@ */ BIT_MASK 0x01 /end MEASUREMENT
/begin MEASUREMENT VSM_LCK_Con_Lane_Ready2Idle "" UBYTE PubIfStateVSM_MDL_CM_boolean 0 0 0 1 ECU_ADDRESS 0x0 /* @MemoryAddress@VSM_LCK_Con_Lane_Ready2Idle@ */ BIT_MASK 0x01 /end MEASUREMENT
/begin MEASUREMENT VSM_LCK_Con_TJALane_Idle2Ready "" UBYTE PubIfStateVSM_MDL_CM_boolean 0 0 0 1 ECU_ADDRESS 0x0 /* @MemoryAddress@VSM_LCK_Con_TJALane_Idle2Ready@ */ BIT_MASK 0x01 /end MEASUREMENT
/begin MEASUREMENT VSM_LCK_TJAIdle2Ready "" UBYTE PubIfStateVSM_MDL_CM_boolean 0 0 0 1 ECU_ADDRESS 0x0 /* @MemoryAddress@VSM_LCK_TJAIdle2Ready@ */ BIT_MASK 0x01 /end MEASUREMENT
/begin MEASUREMENT VSM_LCK_TJAReady2Idle "" UBYTE PubIfStateVSM_MDL_CM_boolean 0 0 0 1 ECU_ADDRESS 0x0 /* @MemoryAddress@VSM_LCK_TJAReady2Idle@ */ BIT_MASK 0x01 /end MEASUREMENT
/begin MEASUREMENT VSM_ELK_OverTaking_LOut "" UBYTE PubIfStateVSM_MDL_CM_boolean 0 0 0 1 ECU_ADDRESS 0x0 /* @MemoryAddress@VSM_ELK_OverTaking_LOut@ */ BIT_MASK 0x01 /end MEASUREMENT
/begin MEASUREMENT VSM_ELK_OverTaking_ROut "" UBYTE PubIfStateVSM_MDL_CM_boolean 0 0 0 1 ECU_ADDRESS 0x0 /* @MemoryAddress@VSM_ELK_OverTaking_ROut@ */ BIT_MASK 0x01 /end MEASUREMENT
/begin MEASUREMENT VSM_ELK_OverTaking_rightcar "" UBYTE PubIfStateVSM_MDL_CM_boolean 0 0 0 1 ECU_ADDRESS 0x0 /* @MemoryAddress@VSM_ELK_OverTaking_rightcar@ */ BIT_MASK 0x01 /end MEASUREMENT
/begin MEASUREMENT VSM_ELK_OverTaking_leftcar "" UBYTE PubIfStateVSM_MDL_CM_boolean 0 0 0 1 ECU_ADDRESS 0x0 /* @MemoryAddress@VSM_ELK_OverTaking_leftcar@ */ BIT_MASK 0x01 /end MEASUREMENT
/begin MEASUREMENT VSM_ELK_OnComing_LOut "" UBYTE PubIfStateVSM_MDL_CM_boolean 0 0 0 1 ECU_ADDRESS 0x0 /* @MemoryAddress@VSM_ELK_OnComing_LOut@ */ BIT_MASK 0x01 /end MEASUREMENT
/begin MEASUREMENT VSM_ELK_OnComing_ROut "" UBYTE PubIfStateVSM_MDL_CM_boolean 0 0 0 1 ECU_ADDRESS 0x0 /* @MemoryAddress@VSM_ELK_OnComing_ROut@ */ BIT_MASK 0x01 /end MEASUREMENT
/begin COMPU_METHOD PubIfControlLATC_MDL_CM_single_m_s "Q = V" RAT_FUNC "%8.6" "m/s" COEFFS 0 1 0 0 0 1 /end COMPU_METHOD
/begin COMPU_METHOD PubIfControlLATC_MDL_CM_single_m "Q = V" RAT_FUNC "%8.6" "m" COEFFS 0 1 0 0 0 1 /end COMPU_METHOD
/begin COMPU_METHOD PubIfStateVSM_MDL_CM_single "Q = V" RAT_FUNC "%8.6" "" COEFFS 0 1 0 0 0 1 /end COMPU_METHOD
/begin COMPU_METHOD PubIfStateVSM_MDL_CM_double "Q = V" RAT_FUNC "%15.10" "" COEFFS 0 1 0 0 0 1 /end COMPU_METHOD
/begin COMPU_METHOD PubIfStateVSM_MDL_CM_single_m "Q = V" RAT_FUNC "%8.6" "m" COEFFS 0 1 0 0 0 1 /end COMPU_METHOD
/begin COMPU_METHOD PubIfStateVSM_MDL_CM_uint16 "Q = V" RAT_FUNC "%5.0" "" COEFFS 0 1 0 0 0 1 /end COMPU_METHOD
/begin COMPU_METHOD PubIfStateVSM_MDL_CM_boolean "Q = V" RAT_FUNC "%1.0" "" COEFFS 0 1 0 0 0 1 /end COMPU_METHOD
/begin COMPU_METHOD PubIfStateVSM_MDL_CM_uint8 "Q = V" RAT_FUNC "%3.0" "" COEFFS 0 1 0 0 0 1 /end COMPU_METHOD
/begin GROUP S1544_LaneRage_Handle "PubIfStateVSM_MDL/Subsystem Reference/Subsystem/StateManage/LSS/LCK_LKA_LDW_ELKStateMachine3/Signal_calculate/LaneAndRe_SignalProcess/LaneRage_Handle" /begin SUB_GROUP S1548_Subsystem4 S1548_Subsystem6 /end SUB_GROUP /begin REF_CHARACTERISTIC P_VSM_LKA_State_Param_Offset /end REF_CHARACTERISTIC
 /begin REF_MEASUREMENT VSM_ERROR_LEFT VSM_ERROR_RIGHT VSM_LCK_LaneCure VSM_LeftChange_new VSM_LeftChange_old VSM_RightChange_new VSM_RightChange_old /end REF_MEASUREMENT
/end GROUP
/begin GROUP S37_Subsystem "PubIfStateVSM_MDL/Subsystem Reference/Subsystem/StateManage/Cruise/Cruise/ACC/Subsystem/ACCTJA_SM/Subsystem" /begin REF_MEASUREMENT VSM_ACC_DrvOffReq /end REF_MEASUREMENT /end GROUP
/begin GROUP S38_StandstillNoBrakeForce "PubIfStateVSM_MDL/Subsystem Reference/Subsystem/StateManage/Cruise/Cruise/ACC/Subsystem/ACC_Condotion/StandstillNoBrakeForce" /begin REF_MEASUREMENT VSM_ACCFastExitCons_StandstillNoBrakeForce /end REF_MEASUREMENT /end GROUP
/begin GROUP S654_OnComing "PubIfStateVSM_MDL/Subsystem Reference/Subsystem/StateManage/LSS/LCK_LKA_LDW_ELKStateMachine3/ELKState_Machine/ELK/ELK_OnComing_OverTaking/OnComing"
 /begin REF_CHARACTERISTIC P_Global_IEnvironment_RefPX_Front_Bumper P_VSM_ELK_OnComing_Lateral P_VSM_ELK_OnComing_TTC /end REF_CHARACTERISTIC
 /begin REF_MEASUREMENT VSM_ELK_OnComing_LOnComing VSM_ELK_OnComing_LOut VSM_ELK_OnComing_LetfCondition VSM_ELK_OnComing_Llateral VSM_ELK_OnComing_Lttc VSM_ELK_OnComing_Lv_re VSM_ELK_OnComing_ROnComing VSM_ELK_OnComing_ROut VSM_ELK_OnComing_RightCondition VSM_ELK_OnComing_Rlateral VSM_ELK_OnComing_Rttc VSM_ELK_OnComing_Rv_re /end REF_MEASUREMENT
/end GROUP
/begin GROUP S654_OverTaking "PubIfStateVSM_MDL/Subsystem Reference/Subsystem/StateManage/LSS/LCK_LKA_LDW_ELKStateMachine3/ELKState_Machine/ELK/ELK_OnComing_OverTaking/OverTaking"
 /begin REF_CHARACTERISTIC P_Global_IEnvironment_RefPX_Front_Bumper P_Global_Vehicle_Length_m P_VSM_ELK_OverTaking_Lateral P_VSM_ELK_OverTaking_TTC /end REF_CHARACTERISTIC
 /begin REF_MEASUREMENT VSM_ELK_OverTaking_LLateral VSM_ELK_OverTaking_LOut VSM_ELK_OverTaking_LeftCondition VSM_ELK_OverTaking_RLateral VSM_ELK_OverTaking_ROut VSM_ELK_OverTaking_RightCondition VSM_ELK_OverTaking_leftcar VSM_ELK_OverTaking_rightcar /end REF_MEASUREMENT
/end GROUP
/begin GROUP S654_Subsystem "PubIfStateVSM_MDL/Subsystem Reference/Subsystem/StateManage/LSS/LCK_LKA_LDW_ELKStateMachine3/ELKState_Machine/ELK/ELK_OnComing_OverTaking/Subsystem" /begin SUB_GROUP S782_Subsystem1 S782_Subsystem4 S782_Subsystem7 /end SUB_GROUP /begin REF_CHARACTERISTIC P_Global_IEnvironment_RefPX_Front_Bumper /end REF_CHARACTERISTIC /begin REF_MEASUREMENT VSM_ELK_Lane_valid VSM_ELK_Lwidth_Valid /end REF_MEASUREMENT /end GROUP
/begin GROUP S845_LCK "PubIfStateVSM_MDL/Subsystem Reference/Subsystem/StateManage/LSS/LCK_LKA_LDW_ELKStateMachine3/LCK/LCK/LCK2/LCK" /begin SUB_GROUP S847_Subsystem2 S847_Subsystem3 /end SUB_GROUP
 /begin REF_CHARACTERISTIC P_VSM_LCK_A1 P_VSM_LCK_C0 P_VSM_LCK_Lanewidthswitch P_VSM_LCK_ParamA1 P_VSM_LCK_State_Param_LaneCurve P_VSM_LCK_State_Param_LaneCurve_Offset P_VSM_LCK_State_Param_LaneWidth P_VSM_LCK_State_Param_LaneWidth_Offset P_VSM_LCK_T0 P_VSM_LCK_TargetInSwitch P_VSM_LCK_Warnarea1 P_VSM_LCK_Warnarea2 P_VSM_LCK_dypreFactor /end REF_CHARACTERISTIC
 /begin REF_MEASUREMENT VSM_LCK_LaneCure_Offset VSM_LCK_LaneWidth_offset VSM_LCK_Lanewidth VSM_LCK_TargetLaneIn VSM_LCK_TargetLaneIn2 VSM_LCK_Warning VSM_LCK_d0 VSM_LCK_dy0 VSM_LCK_dypre VSM_LCK_dypreoffset VSM_LCK_preDis /end REF_MEASUREMENT
/end GROUP
/begin GROUP S845_LCK_Condition1 "PubIfStateVSM_MDL/Subsystem Reference/Subsystem/StateManage/LSS/LCK_LKA_LDW_ELKStateMachine3/LCK/LCK/LCK2/LCK_Condition1"
 /begin SUB_GROUP S848_Subsystem1 S848_Subsystem10 S848_Subsystem11 S848_Subsystem12 S848_Subsystem13 S848_Subsystem14 S848_Subsystem15 S848_Subsystem16 S848_Subsystem17 S848_Subsystem18 S848_Subsystem19 S848_Subsystem2 S848_Subsystem20 S848_Subsystem21 S848_Subsystem3 S848_Subsystem4 S848_Subsystem5 S848_Subsystem7 S848_Subsystem8 S848_Subsystem9 /end SUB_GROUP
 /begin REF_CHARACTERISTIC P_VSM_LCK_AbsEspInTime P_VSM_LCK_AccRateIn P_VSM_LCK_AccRateInTime P_VSM_LCK_AccRateOut P_VSM_LCK_AccrPelOut P_VSM_LCK_AccrPelRateOut P_VSM_LCK_BrakePressIn P_VSM_LCK_BrakePressInTime P_VSM_LCK_BrakePressOut P_VSM_LCK_DrvInputTrqValueIn P_VSM_LCK_DrvInputTrqValueInTime P_VSM_LCK_DrvInputTrqValueOut P_VSM_LCK_IdleInTime P_VSM_LCK_LCDrvInputTrqValueOut P_VSM_LCK_LCOverrideTime P_VSM_LCK_LCOverrideValue P_VSM_LCK_LanechangeSwitch P_VSM_LCK_LateralAcceIn P_VSM_LCK_LateralAcceInTime P_VSM_LCK_LateralAcceOut P_VSM_LCK_LongitudeAccIn P_VSM_LCK_LongitudeAccInTime P_VSM_LCK_LongitudeAccOut P_VSM_LCK_OverrideInTime P_VSM_LCK_OverrideTime P_VSM_LCK_OverrideValue P_VSM_LCK_State_Absesp_enable P_VSM_LCK_State_Accpedalrate_enable P_VSM_LCK_State_Breakpressure_enable P_VSM_LCK_State_DriverInputTrqValue_enable P_VSM_LCK_State_ESSSts_enable P_VSM_LCK_State_Eps_enable P_VSM_LCK_State_GEAR_enable P_VSM_LCK_State_Handson_enable P_VSM_LCK_State_IdleInTime_enable P_VSM_LCK_State_LSMLine_enable P_VSM_LCK_State_LaneChange_enable P_VSM_LCK_State_LaneCurve_enable P_VSM_LCK_State_Lane_enable P_VSM_LCK_State_LateralAcce_enable P_VSM_LCK_State_LongitudeAcc_enable P_VSM_LCK_State_Overide_enable P_VSM_LCK_State_SteerWheelAngle_enable P_VSM_LCK_State_SteerWheelSpd_enable P_VSM_LCK_State_TargetLaneIn_enable P_VSM_LCK_State_TurnLight_enable P_VSM_LCK_State_Vehspeed_enable P_VSM_LCK_State_Yawsup_enable P_VSM_LCK_SteerAngleSpdIn P_VSM_LCK_SteerAngleSpdInTime P_VSM_LCK_SteerAngleSpdOut P_VSM_LCK_SteerWheelAngleIn P_VSM_LCK_SteerWheelAngleInTime P_VSM_LCK_SteerWheelAngleOut P_VSM_LCK_YawRateIn P_VSM_LCK_YawRateInTime P_VSM_LCK_YawRateOut P_VSM_LCK_absLongitudeAccIn P_VSM_LCK_absLongitudeAccOut /end REF_CHARACTERISTIC
 /begin REF_MEASUREMENT VSM_LCK_Active2Ready VSM_LCK_Con_AbsEsp_Idle2Ready VSM_LCK_Con_AbsEsp_Ready2Idle VSM_LCK_Con_AccPedalRate_Active2Ready VSM_LCK_Con_AccPedalRate_Ready2Active VSM_LCK_Con_BrakePress_Active2Ready VSM_LCK_Con_BrakePress_Ready2Active VSM_LCK_Con_CURRENT_GEAR_Active2Ready VSM_LCK_Con_CURRENT_GEAR_Ready2Active VSM_LCK_Con_DriverInput_Active2Ready VSM_LCK_Con_DrvInputTrqValue_Ready2Active VSM_LCK_Con_ESSSts_Idle2Ready VSM_LCK_Con_ESSSts_Ready2Idle VSM_LCK_Con_EpsSta_Active2Ready VSM_LCK_Con_EpsSts_Ready2Active VSM_LCK_Con_HandsOff_Ready2Idle VSM_LCK_Con_Handson_Idle2Ready VSM_LCK_Con_InTime_Idle2Ready VSM_LCK_Con_LSMLine_Idle2Ready VSM_LCK_Con_LSMLine_Ready2Idle VSM_LCK_Con_LaneChange_Active2Ready VSM_LCK_Con_LaneChange_Ready2Active VSM_LCK_Con_LaneCurve_Idle2Ready VSM_LCK_Con_LaneCurve_Ready2Idle VSM_LCK_Con_Lane_Idle2Ready VSM_LCK_Con_Lane_Ready2Idle VSM_LCK_Con_LateralAcc_Active2Ready VSM_LCK_Con_LateralAcc_Ready2Active VSM_LCK_Con_LongitudeAcc_Active2Ready VSM_LCK_Con_LongitudeAcc_Ready2Active VSM_LCK_Con_OverRide_Active2Ready VSM_LCK_Con_OverRide_Ready2Active VSM_LCK_Con_SteerAngleSpd_Active2Ready VSM_LCK_Con_SteerAngleSpd_Ready2Active VSM_LCK_Con_SteerWheelAngle_Active2Ready VSM_LCK_Con_SteerWheelAngle_Ready2Active VSM_LCK_Con_TJALane_Idle2Ready VSM_LCK_Con_TJALane_Ready2Idle VSM_LCK_Con_TJAVehicleSpd_Idle2Ready VSM_LCK_Con_TJAVehicleSpd_Ready2Idle VSM_LCK_Con_TargetLaneIn_Idle2Ready VSM_LCK_Con_TurnLight_Active2Ready VSM_LCK_Con_TurnLight_Ready2Active VSM_LCK_Con_VehicleSpd_Idle2Ready VSM_LCK_Con_VehicleSpd_Ready2Idle VSM_LCK_Con_YawRate_Idle2Ready VSM_LCK_Con_YawRate_Ready2Idle VSM_LCK_Idle2Ready VSM_LCK_Ready2Active VSM_LCK_Ready2Idle VSM_LCK_TJAIdle2Ready VSM_LCK_TJAReady2Active VSM_LCK_TJAReady2Idle /end REF_MEASUREMENT
/end GROUP
/begin GROUP S1134_Subsystem "PubIfStateVSM_MDL/Subsystem Reference/Subsystem/StateManage/LSS/LCK_LKA_LDW_ELKStateMachine3/LCKIE/LCKIE/LCKIE_StateMachine/Subsystem" /begin REF_CHARACTERISTIC P_VSM_LCKIE_State_Off2on P_VSM_LCKIE_tcycle /end REF_CHARACTERISTIC /begin REF_MEASUREMENT VSM_LCKIE_DelayReady /end REF_MEASUREMENT /end GROUP
/begin GROUP S1134_Subsystem1 "PubIfStateVSM_MDL/Subsystem Reference/Subsystem/StateManage/LSS/LCK_LKA_LDW_ELKStateMachine3/LCKIE/LCKIE/LCKIE_StateMachine/Subsystem1" /begin REF_MEASUREMENT VSM_LCKIE_Laneoffset /end REF_MEASUREMENT /end GROUP
/begin GROUP S1135_IEStateClc "PubIfStateVSM_MDL/Subsystem Reference/Subsystem/StateManage/LSS/LCK_LKA_LDW_ELKStateMachine3/LCKIE/LCKIE/Subsystem1/IEStateClc" /begin SUB_GROUP S1146_Subsystem1 S1146_Subsystem12 S1146_Subsystem4 /end SUB_GROUP
 /begin REF_CHARACTERISTIC P_VSM_LCKIE_STATE_ORCObjenable P_VSM_LCKIE_State_CurveMax P_VSM_LCKIE_State_CurveMin P_VSM_LCKIE_State_DriverInputTrqValue_enable P_VSM_LCKIE_State_ELKObjClc P_VSM_LCKIE_State_HWASts_disable P_VSM_LCKIE_State_IEObjClc P_VSM_LCKIE_State_IFVReady P_VSM_LCKIE_State_LaneWidth_enable P_VSM_LCKIE_State_Lanecurve_enable P_VSM_LCKIE_State_OppObjClc P_VSM_LCKIE_State_Vehspeed_enable P_VSM_LCKIE_State_detaspd P_VSM_LCKIE_State_detaspd_enable P_VSM_LCKIE_State_lamb_enable P_VSM_LCKIE_State_wiper_enable /end REF_CHARACTERISTIC
 /begin REF_MEASUREMENT VSM_LCKIE_State_Active2Ready VSM_LCKIE_State_DrvInputTrqValue_Active2Ready VSM_LCKIE_State_DrvInputTrqValue_Ready2Active VSM_LCKIE_State_ELKObj_Active2Ready VSM_LCKIE_State_ELKObj_Ready2Active VSM_LCKIE_State_HWASts_Ready2Active VSM_LCKIE_State_IEObj_Active2Ready VSM_LCKIE_State_IEObj_Ready2Active VSM_LCKIE_State_IFVFail VSM_LCKIE_State_IFVReady VSM_LCKIE_State_Idel2Ready VSM_LCKIE_State_LaneWidth_Idel2Ready VSM_LCKIE_State_LaneWidth_Ready2Idel VSM_LCKIE_State_Lanecurve_Idel2Ready VSM_LCKIE_State_Lanecurve_Ready2Idel VSM_LCKIE_State_OppFrontObj_Active2Ready VSM_LCKIE_State_OppFrontObj_Ready2Active VSM_LCKIE_State_Ready2Active VSM_LCKIE_State_Ready2Idel VSM_LCKIE_State_Vehspeed_Idel2Ready VSM_LCKIE_State_Vehspeed_Ready2Idel VSM_LCKIE_State_detaspd_Idel2Ready VSM_LCKIE_State_detaspd_Ready2Idel VSM_LCKIE_State_lamb_Idel2Ready VSM_LCKIE_State_lamb_Ready2Idel VSM_LCKIE_State_wiper_Idel2Ready VSM_LCKIE_State_wiper_Ready2Idel /end REF_MEASUREMENT
/end GROUP
/begin GROUP S1135_LCKIE_SignalProcess1 "PubIfStateVSM_MDL/Subsystem Reference/Subsystem/StateManage/LSS/LCK_LKA_LDW_ELKStateMachine3/LCKIE/LCKIE/Subsystem1/LCKIE_SignalProcess1"
 /begin SUB_GROUP S1147_IE_LATC S1147_IE_Long S1147_IE_OFC S1147_IE_ORC S1147_IE_OS S1147_IE_POC /end SUB_GROUP
/end GROUP
/begin GROUP S1226_LDWSignal_calculate "PubIfStateVSM_MDL/Subsystem Reference/Subsystem/StateManage/LSS/LCK_LKA_LDW_ELKStateMachine3/LDW/LDW/LDW2/LDWSignal_calculate" /begin SUB_GROUP S1228_Subsystem1 S1228_Subsystem4 S1228_Subsystem7 /end SUB_GROUP
 /begin REF_CHARACTERISTIC P_VSM_LDW_State_Param_REWarningZoneIn P_VSM_LDW_State_Param_WarningZoneIn P_VSM_LDW_State_Param_WarningZoneOut /end REF_CHARACTERISTIC
 /begin REF_MEASUREMENT VSM_LDW_Leftwarnflag VSM_LDW_Rightwarnflag /end REF_MEASUREMENT
/end GROUP
/begin GROUP S1226_LDW_Condition "PubIfStateVSM_MDL/Subsystem Reference/Subsystem/StateManage/LSS/LCK_LKA_LDW_ELKStateMachine3/LDW/LDW/LDW2/LDW_Condition"
 /begin SUB_GROUP S1229_Subsystem S1229_Subsystem1 S1229_Subsystem10 S1229_Subsystem17 S1229_Subsystem2 S1229_Subsystem3 S1229_Subsystem4 S1229_Subsystem5 S1229_Subsystem6 S1229_Subsystem7 S1229_Subsystem8 /end SUB_GROUP
 /begin REF_CHARACTERISTIC P_VSM_LDW_AbsEspInTime P_VSM_LDW_AccPedalOut P_VSM_LDW_AccRateIn P_VSM_LDW_AccRateInTime P_VSM_LDW_AccRateOut P_VSM_LDW_BrakePressIn P_VSM_LDW_BrakePressInTime P_VSM_LDW_BrakePressOut P_VSM_LDW_LaneChangeOffset P_VSM_LDW_LaneCurveIn P_VSM_LDW_LaneCurveOut P_VSM_LDW_LateralAcceIn P_VSM_LDW_LateralAcceInTime P_VSM_LDW_LateralAcceOut P_VSM_LDW_LongitudeAccIn P_VSM_LDW_LongitudeAccInTime P_VSM_LDW_LongitudeAccOut P_VSM_LDW_State_Absesp_enable P_VSM_LDW_State_Accpedalrate_enable P_VSM_LDW_State_Breakpressure_enable P_VSM_LDW_State_ESSSts_enable P_VSM_LDW_State_Failsafe_enable P_VSM_LDW_State_GEAR_enable P_VSM_LDW_State_Headingangle_enable P_VSM_LDW_State_LaneChange_enable P_VSM_LDW_State_Lane_enable P_VSM_LDW_State_Lanecurve_enable P_VSM_LDW_State_LateralAcce_enable P_VSM_LDW_State_LongitudeAcc_enable P_VSM_LDW_State_Param_REWarningZoneIn P_VSM_LDW_State_Param_WarningZoneIn P_VSM_LDW_State_SteerWheelAngle_enable P_VSM_LDW_State_SteerWheelSpd_enable P_VSM_LDW_State_TurnLight_enable P_VSM_LDW_State_Vehspeed_enable P_VSM_LDW_State_Yawsup_enable P_VSM_LDW_SteerWheelAngleIn P_VSM_LDW_SteerWheelAngleInTime P_VSM_LDW_SteerWheelAngleOut P_VSM_LDW_SteerWheelSpdIn P_VSM_LDW_SteerWheelSpdInTime P_VSM_LDW_SteerWheelSpdOut P_VSM_LDW_TurnLightInTime P_VSM_LDW_WhelDy P_VSM_LDW_YawRateIn P_VSM_LDW_YawRateInTime P_VSM_LDW_YawRateOut P_VSM_LDW_absLongitudeAccIn P_VSM_LDW_absLongitudeAccOut /end REF_CHARACTERISTIC
 /begin REF_MEASUREMENT VSM_LDW_Active2Ready VSM_LDW_Con_AbsEsp_Idle2Ready VSM_LDW_Con_AbsEsp_Ready2Idle VSM_LDW_Con_AccPedalRate_Active2Ready VSM_LDW_Con_AccPedalRate_Ready2Active VSM_LDW_Con_BrakePressure_Active2Ready VSM_LDW_Con_BrakePressure_Ready2Active VSM_LDW_Con_CURRENT_GEAR_Active2Ready VSM_LDW_Con_CURRENT_GEAR_Ready2Active VSM_LDW_Con_ESSSts_Idle2Ready VSM_LDW_Con_ESSSts_Ready2Idle VSM_LDW_Con_Failsafe_Idle2Ready VSM_LDW_Con_Failsafe_Ready2Idle VSM_LDW_Con_Headingangle_Idle2Ready VSM_LDW_Con_Headingangle_Ready2Idle VSM_LDW_Con_LaneChange_Active2Ready VSM_LDW_Con_LaneChange_Ready2Active VSM_LDW_Con_LaneCurve_Idle2Ready VSM_LDW_Con_LaneCurve_Ready2Idle VSM_LDW_Con_Lane_Idle2Ready VSM_LDW_Con_Lane_Ready2Idle VSM_LDW_Con_LateralAcc_Active2Ready VSM_LDW_Con_LateralAcc_Ready2Active VSM_LDW_Con_LongitudeAcc_Active2Ready VSM_LDW_Con_LongitudeAcc_Ready2Active VSM_LDW_Con_SteerWheelAngle_Active2Ready VSM_LDW_Con_SteerWheelAngle_Ready2Active VSM_LDW_Con_SteerWheelSpd_Active2Ready VSM_LDW_Con_SteerWheelSpd_Ready2Active VSM_LDW_Con_TurnLight_Active2Ready VSM_LDW_Con_TurnLight_Ready2Active VSM_LDW_Con_VehicleSpeed_Idle2Ready VSM_LDW_Con_VehicleSpeed_Ready2Idle VSM_LDW_Con_YawRate_Idle2Ready VSM_LDW_Con_YawRate_Ready2Idle VSM_LDW_Idle2Ready VSM_LDW_Other2Idle VSM_LDW_Ready2Active /end REF_MEASUREMENT
/end GROUP
/begin GROUP S1226_LDW_StateMachine "PubIfStateVSM_MDL/Subsystem Reference/Subsystem/StateManage/LSS/LCK_LKA_LDW_ELKStateMachine3/LDW/LDW/LDW2/LDW_StateMachine" /begin REF_MEASUREMENT VSM_LDW_Count VSM_LDW_wCount /end REF_MEASUREMENT /end GROUP
/begin GROUP S1355_LKA "PubIfStateVSM_MDL/Subsystem Reference/Subsystem/StateManage/LSS/LCK_LKA_LDW_ELKStateMachine3/LKA/LKA/LKA2/LKA"
 /begin SUB_GROUP S1357_Subsystem1 S1357_Subsystem10 S1357_Subsystem2 S1357_Subsystem3 S1357_Subsystem4 S1357_Subsystem7 /end SUB_GROUP
 /begin REF_CHARACTERISTIC P_VSM_LKA_CurveFactor P_VSM_LKA_EndSwitch P_VSM_LKA_State_Param_AngleOffset P_VSM_LKA_State_Param_InterventionZoneIn P_VSM_LKA_State_Param_InterventionZoneOut P_VSM_LKA_State_Param_OutOffset P_VSM_LKA_State_Param_REInterventionZoneIn P_VSM_LKA_WarnInTime P_VSM_LKA_Warnarea1 P_VSM_LKA_Warnarea2 /end REF_CHARACTERISTIC
 /begin REF_MEASUREMENT VSM_LKAWarnflag VSM_LKA_End VSM_LKA_LKAactive VSM_LKA_LKAout VSM_LKA_LeftWarning VSM_LKA_RightWarning /end REF_MEASUREMENT
/end GROUP
/begin GROUP S1355_LKA_Condition "PubIfStateVSM_MDL/Subsystem Reference/Subsystem/StateManage/LSS/LCK_LKA_LDW_ELKStateMachine3/LKA/LKA/LKA2/LKA_Condition"
 /begin SUB_GROUP S1358_Subsystem1 S1358_Subsystem10 S1358_Subsystem12 S1358_Subsystem13 S1358_Subsystem15 S1358_Subsystem18 S1358_Subsystem2 S1358_Subsystem3 S1358_Subsystem4 S1358_Subsystem5 S1358_Subsystem6 S1358_Subsystem7 S1358_Subsystem8 S1358_Subsystem9 /end SUB_GROUP
 /begin REF_CHARACTERISTIC P_VSM_LKA_AbsEspInTime P_VSM_LKA_AccPedalPosnOut P_VSM_LKA_AccPedalRateOutTime P_VSM_LKA_AccRateIn P_VSM_LKA_AccRateInTime P_VSM_LKA_AccRateOut P_VSM_LKA_BrakePressIn P_VSM_LKA_BrakePressInTime P_VSM_LKA_BrakePressOut P_VSM_LKA_DriverInputTrqValueIn P_VSM_LKA_DriverInputTrqValueInTime P_VSM_LKA_DriverInputTrqValueOut P_VSM_LKA_LaneChangeOffset P_VSM_LKA_LaneCurveIn P_VSM_LKA_LaneCurveOut P_VSM_LKA_LateralAcceIn P_VSM_LKA_LateralAcceInTime P_VSM_LKA_LateralAcceOut P_VSM_LKA_LongitudeAcceIn P_VSM_LKA_LongitudeAcceOut P_VSM_LKA_OverrideInTime P_VSM_LKA_OverrideTime P_VSM_LKA_OverrideValue P_VSM_LKA_State_Absesp_enable P_VSM_LKA_State_Accpedalrate_enable P_VSM_LKA_State_Breakpressure_enable P_VSM_LKA_State_DriverInputTrqValue_enable P_VSM_LKA_State_ESSSts_enable P_VSM_LKA_State_Eps_enable P_VSM_LKA_State_Failsafe_enable P_VSM_LKA_State_GEAR_enable P_VSM_LKA_State_Headingangle_enable P_VSM_LKA_State_LaneChange_enable P_VSM_LKA_State_Lane_enable P_VSM_LKA_State_Lanecurve_enable P_VSM_LKA_State_LateralAcce_enable P_VSM_LKA_State_LongitudeAcc_enable P_VSM_LKA_State_Overide_enable P_VSM_LKA_State_Param_InterventionZoneIn P_VSM_LKA_State_Param_REInterventionZoneIn P_VSM_LKA_State_SteerWheelAngle_enable P_VSM_LKA_State_SteerWheelSpd_enable P_VSM_LKA_State_TJASts_enable P_VSM_LKA_State_TurnLight_enable P_VSM_LKA_State_Vehspeed_enable P_VSM_LKA_State_Yawsup_enable P_VSM_LKA_SteerWheelAngleIn P_VSM_LKA_SteerWheelAngleInTime P_VSM_LKA_SteerWheelAngleOut P_VSM_LKA_SteerWheelSpdIn P_VSM_LKA_SteerWheelSpdInTime P_VSM_LKA_SteerWheelSpdOut P_VSM_LKA_TurnLightInTime P_VSM_LKA_WhelDy P_VSM_LKA_YawRateIn P_VSM_LKA_YawRateInTime P_VSM_LKA_YawRateOut P_VSM_LKA_absLongitudeAcceIn P_VSM_LKA_absLongitudeAcceInTime P_VSM_LKA_absLongitudeAcceOut /end REF_CHARACTERISTIC
 /begin REF_MEASUREMENT VSM_LKA_Active2Ready VSM_LKA_Con_AbsEsp_Idle2Ready VSM_LKA_Con_AbsEsp_Ready2Idle VSM_LKA_Con_AccPedalRate_Active2Ready VSM_LKA_Con_AccPedalRate_Ready2Active VSM_LKA_Con_BrakePressure_Active2Ready VSM_LKA_Con_BrakePressure_Ready2Active VSM_LKA_Con_CURRENT_GEAR_Active2Ready VSM_LKA_Con_CURRENT_GEAR_Ready2Active VSM_LKA_Con_DriverInput_Active2Ready VSM_LKA_Con_DriverInput_Ready2Active VSM_LKA_Con_ESSSts_Active2Ready VSM_LKA_Con_ESSSts_Idle2Ready VSM_LKA_Con_ESSSts_Ready2Idle VSM_LKA_Con_EpsSta_Active2Ready VSM_LKA_Con_EpsSta_Ready2Active VSM_LKA_Con_Failsafe_Idle2Ready VSM_LKA_Con_Failsafe_Ready2Idle VSM_LKA_Con_Headingangle_Idle2Ready VSM_LKA_Con_Headingangle_Ready2Idle VSM_LKA_Con_LaneChange_Active2Ready VSM_LKA_Con_LaneChange_Ready2Active VSM_LKA_Con_LaneCurve_Idle2Ready VSM_LKA_Con_LaneCurve_Ready2Idle VSM_LKA_Con_Lane_Idle2Ready VSM_LKA_Con_Lane_Ready2Idle VSM_LKA_Con_LateralAcc_Active2Ready VSM_LKA_Con_LateralAcc_Ready2Active VSM_LKA_Con_LongitudeAcc_Active2Ready VSM_LKA_Con_LongitudeAcc_Ready2Active VSM_LKA_Con_OverRide_Active2Ready VSM_LKA_Con_Override_Ready2Active VSM_LKA_Con_SteerWheelAngle_Active2Ready VSM_LKA_Con_SteerWheelAngle_Ready2Active VSM_LKA_Con_SteerWheelSpd_Active2Ready VSM_LKA_Con_SteerWheelSpd_Ready2Active VSM_LKA_Con_TJASts_Active2Ready VSM_LKA_Con_TJASts_Ready2Active VSM_LKA_Con_TurnLight_Active2Ready VSM_LKA_Con_TurnLight_Ready2Active VSM_LKA_Con_VehicleSpeed_Idle2Ready VSM_LKA_Con_VehicleSpeed_Ready2Idle VSM_LKA_Con_YawRate_Idle2Ready VSM_LKA_Con_YawRate_Ready2Idle VSM_LKA_Idle2Ready VSM_LKA_Other2Idle VSM_LKA_Ready2Active /end REF_MEASUREMENT
/end GROUP
/begin GROUP S1355_LKA_StateMachine "PubIfStateVSM_MDL/Subsystem Reference/Subsystem/StateManage/LSS/LCK_LKA_LDW_ELKStateMachine3/LKA/LKA/LKA2/LKA_StateMachine" /begin REF_MEASUREMENT VSM_LKA_Error VSM_LKA_Warning /end REF_MEASUREMENT /end GROUP
/begin GROUP S1147_IE_LATC "PubIfStateVSM_MDL/Subsystem Reference/Subsystem/StateManage/LSS/LCK_LKA_LDW_ELKStateMachine3/LCKIE/LCKIE/Subsystem1/LCKIE_SignalProcess1/IE_LATC"
 /begin REF_CHARACTERISTIC P_VSM_LCKIE_LATC_LimitDis P_VSM_LCKIE_LATC_LimitDis_BP P_VSM_LCKIE_LatC_DisOffofLanWidth P_VSM_LCKIE_LatC_DisOffofSpd P_VSM_LCKIE_LatC_DisSW P_VSM_LCKIE_LatC_LanWidth P_VSM_LCKIE_LatC_LimitDisEgoToObjSelt P_VSM_LCKIE_LatC_LimitEgoToOppLane P_VSM_LCKIE_LatC_MoveEnableDis P_VSM_LCKIE_LatC_RESafDis P_VSM_LCKIE_LatC_SafeDisofLanWidth P_VSM_LCKIE_LatC_Spd P_VSM_LCKIE_LatC_maxLimitDisREToLane P_VSM_LCKIE_LatC_minLimitDisREToLane /end REF_CHARACTERISTIC
 /begin REF_MEASUREMENT VSM_LCKIE_LatC_Counter VSM_LCKIE_LatC_Counter1 VSM_LCKIE_LatC_Counter2 VSM_LCKIE_LatC_Counter3 VSM_LCKIE_LatC_Counter4 VSM_LCKIE_LatC_Counter5 VSM_LCKIE_LatC_DetaDis VSM_LCKIE_LatC_DirectChange VSM_LCKIE_LatC_DisEgo2ObjOff VSM_LCKIE_LatC_DisREToLane VSM_LCKIE_LatC_Flg VSM_LCKIE_LatC_LatFLg VSM_LCKIE_LatC_LatMovDis VSM_LCKIE_LatC_LatWarning VSM_LCKIE_LatC_MovDirct VSM_LCKIE_LatC_MovDirct1 VSM_LCKIE_LatC_MoveDis VSM_LCKIE_LatC_ObjLatFailFlg VSM_LCKIE_LatC_SafDis VSM_LCKIE_LatC_SafeDisToLaneEdge VSM_LCKIE_LatC_latmovori VSM_LCKIE_LatC_ts /end REF_MEASUREMENT
/end GROUP
/begin GROUP S1147_IE_Long "PubIfStateVSM_MDL/Subsystem Reference/Subsystem/StateManage/LSS/LCK_LKA_LDW_ELKStateMachine3/LCKIE/LCKIE/Subsystem1/LCKIE_SignalProcess1/IE_Long"
 /begin REF_CHARACTERISTIC P_VSM_LCKIE_LongC_DetaSpd P_VSM_LCKIE_LongC_DirecChangeDis P_VSM_LCKIE_LongC_FleetOff P_VSM_LCKIE_LongC_ShutDownLongDis P_VSM_LCKIE_LongC_ShutDownTTC P_VSM_LCKIE_LongC_Spd P_VSM_LCKIE_LongC_d1 P_VSM_LCKIE_LongC_d2 P_VSM_LCKIE_LongC_maxDis P_VSM_LCKIE_LongC_minDis P_VSM_LCKIE_LongC_toff P_VSM_LCKIE_tcycle /end REF_CHARACTERISTIC
 /begin REF_MEASUREMENT VSM_LCKIE_LongC_Couter1 VSM_LCKIE_LongC_Couter2 VSM_LCKIE_LongC_Couter3 VSM_LCKIE_LongC_CouterOff VSM_LCKIE_LongC_IEReady VSM_LCKIE_LongC_LongDis VSM_LCKIE_LongC_LongDisfinal VSM_LCKIE_LongC_LongFlg VSM_LCKIE_LongC_ObjLong VSM_LCKIE_LongC_PocFlg VSM_LCKIE_LongC_d1 VSM_LCKIE_LongC_d2 /end REF_MEASUREMENT
/end GROUP
/begin GROUP S1147_IE_OFC "PubIfStateVSM_MDL/Subsystem Reference/Subsystem/StateManage/LSS/LCK_LKA_LDW_ELKStateMachine3/LCKIE/LCKIE/Subsystem1/LCKIE_SignalProcess1/IE_OFC"
 /begin REF_CHARACTERISTIC P_Global_Vehicle_Length_m P_VSM_LCKIE_OFC_ActDis P_VSM_LCKIE_OFC_DownDis P_VSM_LCKIE_OFC_DownTTC P_VSM_LCKIE_OFC_SafDis P_VSM_LCKIE_OFC_Toff /end REF_CHARACTERISTIC
 /begin REF_MEASUREMENT VSM_LCKIE_OFC_Counter VSM_LCKIE_OFC_Counter1 VSM_LCKIE_OFC_Long VSM_LCKIE_OFC_ObjTTC VSM_LCKIE_OFC_OppObjDetaSpd VSM_LCKIE_OFC_OppObjFail VSM_LCKIE_OFC_OppObjReady VSM_LCKIE_OFC_Tset /end REF_MEASUREMENT
/end GROUP
/begin GROUP S1147_IE_ORC "PubIfStateVSM_MDL/Subsystem Reference/Subsystem/StateManage/LSS/LCK_LKA_LDW_ELKStateMachine3/LCKIE/LCKIE/Subsystem1/LCKIE_SignalProcess1/IE_ORC"
 /begin REF_CHARACTERISTIC P_VSM_LCKIE_ORC_LatDis P_VSM_LCKIE_ORC_LimitDis1 P_VSM_LCKIE_ORC_LimitDis2 P_VSM_LCKIE_ORC_LimitTTC P_VSM_LCKIE_ORC_LowSpd /end REF_CHARACTERISTIC
 /begin REF_MEASUREMENT VSM_LCKIE_ORC_Counter VSM_LCKIE_ORC_ObjDetaSpd VSM_LCKIE_ORC_ObjLatPos VSM_LCKIE_ORC_ObjLong VSM_LCKIE_ORC_ObjTTC VSM_LCKIE_ORC_OppREARObjReady /end REF_MEASUREMENT
/end GROUP
/begin GROUP S1147_IE_OS "PubIfStateVSM_MDL/Subsystem Reference/Subsystem/StateManage/LSS/LCK_LKA_LDW_ELKStateMachine3/LCKIE/LCKIE/Subsystem1/LCKIE_SignalProcess1/IE_OS" /begin REF_CHARACTERISTIC P_VSM_LCKIE_ClassInput /end REF_CHARACTERISTIC
 /begin REF_MEASUREMENT VSM_LCKIE_OS_Couter VSM_LCKIE_OS_Couter1 VSM_LCKIE_OS_DetaSpd VSM_LCKIE_OS_DetaSpdSelect VSM_LCKIE_OS_DisEgo2Obj VSM_LCKIE_OS_DisEgo2ObjSelect VSM_LCKIE_OS_DisEgo2OppLane VSM_LCKIE_OS_ObjIDSelect VSM_LCKIE_OS_ObjLane VSM_LCKIE_OS_ObjSelectID VSM_LCKIE_OS_OppFObjID VSM_LCKIE_OS_OppRObjID VSM_LCKIE_OS_POSRObjID VSM_LCKIE_OS_RoadWidth VSM_LCKIE_OS_TTC /end REF_MEASUREMENT
/end GROUP
/begin GROUP S1147_IE_POC "PubIfStateVSM_MDL/Subsystem Reference/Subsystem/StateManage/LSS/LCK_LKA_LDW_ELKStateMachine3/LCKIE/LCKIE/Subsystem1/LCKIE_SignalProcess1/IE_POC"
 /begin REF_CHARACTERISTIC P_VSM_LCKIE_POC_Delaytime P_VSM_LCKIE_POC_LimitDis P_VSM_LCKIE_POC_LimitTTC P_VSM_LCKIE_POC_detaSpd P_VSM_LCKIE_tcycle /end REF_CHARACTERISTIC
 /begin REF_MEASUREMENT VSM_LCKIE_POC_Counter VSM_LCKIE_POC_Couter1 VSM_LCKIE_POC_Couter2 VSM_LCKIE_POC_LongDown VSM_LCKIE_POC_OvertakeFlg VSM_LCKIE_POC_OvertakeSpd VSM_LCKIE_POC_POCObjLong VSM_LCKIE_POC_POCObjTTC VSM_LCKIE_POC_POSID VSM_LCKIE_POC_POSObjID VSM_LCKIE_POC_delay_time /end REF_MEASUREMENT
/end GROUP
/end MODULE
/end PROJECT
