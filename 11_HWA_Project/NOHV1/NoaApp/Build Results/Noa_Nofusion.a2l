/****************************************************************************
* ASAP2 file: Noa_Nofusion.a2l
* Generated on 03/09/2022 12:20:48
* Generated by dSPACE VDFGenerator
* Copyright 2022, dSPACE GmbH. All rights reserved.
****************************************************************************/
/* Version 1 61 */
ASAP2_VERSION 1 61
/begin PROJECT Noa_Nofusion ""
/begin MODULE Noa_Nofusion ""
/* include A2ML description of ASAP1B interface(s) */
/begin MOD_PAR /* Comment */ "" /* User Information */ SUPPLIER "" CUSTOMER "" USER "" PHONE_NO "" ECU "DS1403" CPU_TYPE "Noa_Nofusion" /* EPK information */ ADDR_EPK 0x003C25D0 EPK "0af9c517-13ad-456e-aeeb-4cb02365aee5"
 /begin MEMORY_SEGMENT CalibrationData /* LongIdentifier */ "Memory page for CalibrationData" /* PrgType */ DATA /* MemoryType */ RAM /* Attribute */ INTERN 0x00000000003c2720 /* Size in Byte */ 0x34ff /* Offset */ -1 -1 -1 -1 -1
  /begin IF_DATA XCPplus 0x0101
   /begin SEGMENT /* Segment logical number */ 0 /* Number of pages (WP/RP) */ 1 /* Address extension */ 0 /* Compression method */ 0 /* Encryption method */ 0
    /begin PAGE /* Page ID */ 0x00 /* ECU access */ ECU_ACCESS_DONT_CARE /* XCP read access */ XCP_READ_ACCESS_DONT_CARE /* XCP write access */ XCP_WRITE_ACCESS_DONT_CARE /end PAGE
   /end SEGMENT
  /end IF_DATA
 /end MEMORY_SEGMENT
/end MOD_PAR
/begin MOD_COMMON /* Comment */ "" DEPOSIT ABSOLUTE BYTE_ORDER MSB_LAST ALIGNMENT_BYTE 0x01 ALIGNMENT_WORD 0x02 ALIGNMENT_LONG 0x04 ALIGNMENT_FLOAT32_IEEE 0x04 ALIGNMENT_FLOAT64_IEEE 0x08 /end MOD_COMMON
/begin IF_DATA XCPplus 0x0101
 /begin PROTOCOL_LAYER /* XCP protocol layer version */ 0x0101 /* T1 [ms] */ 0x01F4 /* T2 [ms] */ 0x07D0 /* T3 [ms] */ 0x01F4 /* T4 [ms] */ 0x01F4 /* T5 [ms] */ 0x01F4 /* T6 [ms] */ 0x01F4 /* T7 [ms] */ 0x01F4 /* MAX_CTO */ 252 /* MAX_DTO */ 1412 /* BYTE_ORDER */ BYTE_ORDER_MSB_LAST /* ADDRESS_GRANULARITY */ ADDRESS_GRANULARITY_BYTE /* optional commands */ OPTIONAL_CMD GET_COMM_MODE_INFO OPTIONAL_CMD SET_MTA OPTIONAL_CMD UPLOAD OPTIONAL_CMD SHORT_UPLOAD OPTIONAL_CMD BUILD_CHECKSUM OPTIONAL_CMD DOWNLOAD OPTIONAL_CMD DOWNLOAD_MAX OPTIONAL_CMD MODIFY_BITS OPTIONAL_CMD CLEAR_DAQ_LIST OPTIONAL_CMD SET_DAQ_PTR OPTIONAL_CMD WRITE_DAQ OPTIONAL_CMD SET_DAQ_LIST_MODE OPTIONAL_CMD GET_DAQ_LIST_MODE OPTIONAL_CMD START_STOP_DAQ_LIST OPTIONAL_CMD START_STOP_SYNCH OPTIONAL_CMD GET_DAQ_CLOCK OPTIONAL_CMD READ_DAQ OPTIONAL_CMD FREE_DAQ OPTIONAL_CMD ALLOC_DAQ OPTIONAL_CMD ALLOC_ODT OPTIONAL_CMD ALLOC_ODT_ENTRY OPTIONAL_CMD WRITE_DAQ_MULTIPLE COMMUNICATION_MODE_SUPPORTED /* optional modes supported */ BLOCK SLAVE /* Slave Block Mode supported */ /end PROTOCOL_LAYER
 /begin DAQ /* DAQ_CONFIG_TYPE */ DYNAMIC /* MAX_DAQ */ 0xFFFF /* MAX_EVENT_CHANNEL */ 0x0001 /* MIN_DAQ */ 0 /* OPTIMISATION_TYPE */ OPTIMISATION_TYPE_DEFAULT /* ADDRESS_EXTENSION */ ADDRESS_EXTENSION_FREE /* IDENTIFICATION_FIELD */ IDENTIFICATION_FIELD_TYPE_ABSOLUTE /* GRANULARITY_ODT_ENTRY_SIZE_DAQ */ GRANULARITY_ODT_ENTRY_SIZE_DAQ_BYTE /* MAX_ODT_ENTRY_SIZE_DAQ */ 255 /* OVERLOAD_INDICATION */ OVERLOAD_INDICATION_PID /* optional DAQ features */ PRESCALER_SUPPORTED
  /begin TIMESTAMP_SUPPORTED /* TIMESTAMP_TICKS */ 1 /* TIMESTAMP_SIZE */ SIZE_DWORD /* RESOLUTION OF TIMESTAMP */ UNIT_1US /end TIMESTAMP_SUPPORTED
  /begin EVENT /* EVENT_CHANNEL_NAME */ "Periodic Task 1" /* EVENT_CHANNEL_SHORT_NAME */ "Perio" /* EVENT_CHANNEL_NUMBER */ 0x0000 /* both kinds of DAQ_LISTs */ DAQ_STIM /* MAX_DAQ_LIST */ 0xFF /* TIME_CYCLE */ 0x01 /* TIME_UNIT */ 0x07 /* PRIORITY */ 0x00 /end EVENT
 /end DAQ
 /begin XCP_ON_TCP_IP /* XCP on TCP_IP version */ 0x0100 /* PORT */ 1236 ADDRESS "" /end XCP_ON_TCP_IP
/end IF_DATA
/begin RECORD_LAYOUT Scalar_BOOLEAN FNC_VALUES 1 UBYTE ROW_DIR DIRECT /end RECORD_LAYOUT
/begin RECORD_LAYOUT Scalar_UBYTE FNC_VALUES 1 UBYTE ROW_DIR DIRECT /end RECORD_LAYOUT
/begin RECORD_LAYOUT Scalar_BYTE FNC_VALUES 1 SBYTE ROW_DIR DIRECT /end RECORD_LAYOUT
/begin RECORD_LAYOUT Scalar_UWORD FNC_VALUES 1 UWORD ROW_DIR DIRECT /end RECORD_LAYOUT
/begin RECORD_LAYOUT Scalar_SWORD FNC_VALUES 1 SWORD ROW_DIR DIRECT /end RECORD_LAYOUT
/begin RECORD_LAYOUT Scalar_ULONG FNC_VALUES 1 ULONG ROW_DIR DIRECT /end RECORD_LAYOUT
/begin RECORD_LAYOUT Scalar_LONG FNC_VALUES 1 SLONG ROW_DIR DIRECT /end RECORD_LAYOUT
/begin RECORD_LAYOUT Scalar_FLOAT32_IEEE FNC_VALUES 1 FLOAT32_IEEE ROW_DIR DIRECT /end RECORD_LAYOUT
/begin RECORD_LAYOUT Scalar_FLOAT64_IEEE FNC_VALUES 1 FLOAT64_IEEE ROW_DIR DIRECT /end RECORD_LAYOUT
/begin RECORD_LAYOUT Lookup1D_BOOLEAN FNC_VALUES 1 UBYTE ROW_DIR DIRECT /end RECORD_LAYOUT
/begin RECORD_LAYOUT Lookup1D_BYTE FNC_VALUES 1 SBYTE ROW_DIR DIRECT /end RECORD_LAYOUT
/begin RECORD_LAYOUT Lookup1D_UBYTE FNC_VALUES 1 UBYTE ROW_DIR DIRECT /end RECORD_LAYOUT
/begin RECORD_LAYOUT Lookup1D_UWORD FNC_VALUES 1 UWORD ROW_DIR DIRECT /end RECORD_LAYOUT
/begin RECORD_LAYOUT Lookup1D_WORD FNC_VALUES 1 SWORD ROW_DIR DIRECT /end RECORD_LAYOUT
/begin RECORD_LAYOUT Lookup1D_ULONG FNC_VALUES 1 ULONG ROW_DIR DIRECT /end RECORD_LAYOUT
/begin RECORD_LAYOUT Lookup1D_LONG FNC_VALUES 1 SLONG ROW_DIR DIRECT /end RECORD_LAYOUT
/begin RECORD_LAYOUT Lookup1D_FLOAT32_IEEE FNC_VALUES 1 FLOAT32_IEEE ROW_DIR DIRECT /end RECORD_LAYOUT
/begin RECORD_LAYOUT Lookup1D_FLOAT64_IEEE FNC_VALUES 1 FLOAT64_IEEE ROW_DIR DIRECT /end RECORD_LAYOUT
/begin RECORD_LAYOUT Lookup1D_X_BOOLEAN AXIS_PTS_X 1 UBYTE INDEX_INCR DIRECT /end RECORD_LAYOUT
/begin RECORD_LAYOUT Lookup1D_X_BYTE AXIS_PTS_X 1 SBYTE INDEX_INCR DIRECT /end RECORD_LAYOUT
/begin RECORD_LAYOUT Lookup1D_X_UBYTE AXIS_PTS_X 1 UBYTE INDEX_INCR DIRECT /end RECORD_LAYOUT
/begin RECORD_LAYOUT Lookup1D_X_UWORD AXIS_PTS_X 1 UWORD INDEX_INCR DIRECT /end RECORD_LAYOUT
/begin RECORD_LAYOUT Lookup1D_X_WORD AXIS_PTS_X 1 SWORD INDEX_INCR DIRECT /end RECORD_LAYOUT
/begin RECORD_LAYOUT Lookup1D_X_ULONG AXIS_PTS_X 1 ULONG INDEX_INCR DIRECT /end RECORD_LAYOUT
/begin RECORD_LAYOUT Lookup1D_X_LONG AXIS_PTS_X 1 SLONG INDEX_INCR DIRECT /end RECORD_LAYOUT
/begin RECORD_LAYOUT Lookup1D_X_FLOAT32_IEEE AXIS_PTS_X 1 FLOAT32_IEEE INDEX_INCR DIRECT /end RECORD_LAYOUT
/begin RECORD_LAYOUT Lookup1D_X_FLOAT64_IEEE AXIS_PTS_X 1 FLOAT64_IEEE INDEX_INCR DIRECT /end RECORD_LAYOUT
/begin RECORD_LAYOUT Lookup2D_BOOLEAN FNC_VALUES 1 UBYTE ROW_DIR DIRECT /end RECORD_LAYOUT
/begin RECORD_LAYOUT Lookup2D_UBYTE FNC_VALUES 1 UBYTE ROW_DIR DIRECT /end RECORD_LAYOUT
/begin RECORD_LAYOUT Lookup2D_BYTE FNC_VALUES 1 SBYTE ROW_DIR DIRECT /end RECORD_LAYOUT
/begin RECORD_LAYOUT Lookup2D_UWORD FNC_VALUES 1 UWORD ROW_DIR DIRECT /end RECORD_LAYOUT
/begin RECORD_LAYOUT Lookup2D_WORD FNC_VALUES 1 SWORD ROW_DIR DIRECT /end RECORD_LAYOUT
/begin RECORD_LAYOUT Lookup2D_ULONG FNC_VALUES 1 ULONG ROW_DIR DIRECT /end RECORD_LAYOUT
/begin RECORD_LAYOUT Lookup2D_LONG FNC_VALUES 1 SLONG ROW_DIR DIRECT /end RECORD_LAYOUT
/begin RECORD_LAYOUT Lookup2D_FLOAT32_IEEE FNC_VALUES 1 FLOAT32_IEEE ROW_DIR DIRECT /end RECORD_LAYOUT
/begin RECORD_LAYOUT Lookup2D_X_UBYTE AXIS_PTS_X 1 UBYTE INDEX_INCR DIRECT /end RECORD_LAYOUT
/begin RECORD_LAYOUT Lookup2D_X_FLOAT32_IEEE AXIS_PTS_X 1 FLOAT32_IEEE INDEX_INCR DIRECT /end RECORD_LAYOUT
/begin RECORD_LAYOUT Lookup2D_X_FLOAT64_IEEE AXIS_PTS_X 1 FLOAT64_IEEE INDEX_INCR DIRECT /end RECORD_LAYOUT
/begin CHARACTERISTIC P_EQ4_BC0Gain "" VALUE 0x003C2720 Scalar_FLOAT64_IEEE 0 Noa_Nofusion_CM_double -1.7E+308 1.7E+308 /end CHARACTERISTIC
/begin CHARACTERISTIC P_HWA_TOS_P0HeadingAngle "" VALUE 0x003D6DB0 Scalar_FLOAT64_IEEE 0 Noa_Nofusion_CM_double -1.7E+308 1.7E+308 /end CHARACTERISTIC
/begin CHARACTERISTIC P_Global_DxvFrontBumper_m "后轴到前杠前边缘的X向位置" VALUE 0x003C2ABC Scalar_FLOAT32_IEEE 0 Noa_Nofusion_CM_single_m -3.4E+38 3.4E+38 /end CHARACTERISTIC
/begin CHARACTERISTIC P_Global_EQ2RearAxisX_m "后轴中心点到摄像头光心的X向位置" VALUE 0x003C2AC4 Scalar_FLOAT32_IEEE 0 Noa_Nofusion_CM_single_m -3.4E+38 3.4E+38 /end CHARACTERISTIC
/begin CHARACTERISTIC P_Global_EQ2RearAxisY_m "摄像头光心到后轴中心点的Y向位置" VALUE 0x003C2AC8 Scalar_FLOAT32_IEEE 0 Noa_Nofusion_CM_single_m -3.4E+38 3.4E+38 /end CHARACTERISTIC
/begin CHARACTERISTIC P_Global_SteeringAngleRatio "方向盘与前轮转角传动比" VALUE 0x003C2ADC Scalar_FLOAT32_IEEE 0 Noa_Nofusion_CM_single -3.4E+38 3.4E+38 /end CHARACTERISTIC
/begin CHARACTERISTIC P_TOSS_DxOffset "" VALUE 0x003C5438 Scalar_FLOAT32_IEEE 0 Noa_Nofusion_CM_single -3.4E+38 3.4E+38 /end CHARACTERISTIC
/begin CHARACTERISTIC P_RFM_RoadType "" VALUE 0x003C5C1B Scalar_UBYTE 0 Noa_Nofusion_CM_uint8 0 255 /end CHARACTERISTIC
/begin CHARACTERISTIC P_RFM_mapvalid "" VALUE 0x003C5C1C Scalar_UBYTE 0 Noa_Nofusion_CM_uint8 0 255 /end CHARACTERISTIC
/begin CHARACTERISTIC P_HMI_LDW_LKAWarnTime "" VALUE 0x003C2AF8 Scalar_FLOAT32_IEEE 0 PubIfChassisHMI_MDL_CM_single -3.4E+38 3.4E+38 /end CHARACTERISTIC
/begin CHARACTERISTIC P_HMI_ObjectTypeFilter "" VALUE 0x003C2AFC Scalar_FLOAT32_IEEE 0 PubIfChassisHMI_MDL_CM_single -3.4E+38 3.4E+38 /end CHARACTERISTIC
/begin CHARACTERISTIC P_Global_CharSpd_ms "车辆特征车速（过渡转向和转向不足的临界车速，ESP提供）" VALUE 0x003C2AB8 Scalar_FLOAT32_IEEE 0 PubIfCommonVIE_MDL_CM_single_m_s -3.4E+38 3.4E+38 /end CHARACTERISTIC
/begin CHARACTERISTIC P_Global_FrontAxleToCenter_m "前轴距到车辆质心距离" VALUE 0x003C2ACC Scalar_FLOAT32_IEEE 0 PubIfCommonVIE_MDL_CM_single_m -3.4E+38 3.4E+38 /end CHARACTERISTIC
/begin CHARACTERISTIC P_Global_RearAxleToCenter_m "后轴到车辆质心的X向位置" VALUE 0x003C2AD4 Scalar_FLOAT32_IEEE 0 PubIfCommonVIE_MDL_CM_single_m -3.4E+38 3.4E+38 /end CHARACTERISTIC
/begin CHARACTERISTIC P_Global_SideSlipAnglefactor "侧滑角系数" VALUE 0x003C2AD8 Scalar_FLOAT32_IEEE 0 PubIfCommonVIE_MDL_CM_single -3.4E+38 3.4E+38 /end CHARACTERISTIC
/begin CHARACTERISTIC P_Global_WheelBase_m "轴距" VALUE 0x003C2AF0 Scalar_FLOAT32_IEEE 0 PubIfCommonVIE_MDL_CM_single_m -3.4E+38 3.4E+38 /end CHARACTERISTIC
/begin CHARACTERISTIC P_Global_WheelTrack_m "轮距" VALUE 0x003C2AF4 Scalar_FLOAT32_IEEE 0 PubIfCommonVIE_MDL_CM_single_m -3.4E+38 3.4E+38 /end CHARACTERISTIC
/begin CHARACTERISTIC P_LCS_ESS_SteerAngleErr "" CURVE 0x003C2B10 Lookup1D_FLOAT32_IEEE 0 PubIfControlLATC_MDL_CM_single -3.4E+38 3.4E+38
 /begin AXIS_DESCR COM_AXIS NO_INPUT_QUANTITY PubIfControlLATC_MDL_CM_single 12 -3.4E+38 3.4E+38 AXIS_PTS_REF P_LCS_LATC_VehicleSpd_TabX_Kph /end AXIS_DESCR
/end CHARACTERISTIC
/begin CHARACTERISTIC P_LCS_LATC_MPCMatrixQ1_st "" CURVE 0x003C3024 Lookup1D_FLOAT32_IEEE 0 PubIfControlLATC_MDL_CM_single -3.4E+38 3.4E+38
 /begin AXIS_DESCR COM_AXIS LCS_IN_Spd_Kph PubIfControlLATC_MDL_CM_single 16 -3.4E+38 3.4E+38 AXIS_PTS_REF P_LCS_VehicleSpd_TabX_Kph /end AXIS_DESCR
/end CHARACTERISTIC
/begin CHARACTERISTIC P_LCS_LATC_MPCMatrixQ2_st "" CURVE 0x003C3064 Lookup1D_FLOAT32_IEEE 0 PubIfControlLATC_MDL_CM_single -3.4E+38 3.4E+38
 /begin AXIS_DESCR COM_AXIS LCS_IN_Spd_Kph PubIfControlLATC_MDL_CM_single 16 -3.4E+38 3.4E+38 AXIS_PTS_REF P_LCS_VehicleSpd_TabX_Kph /end AXIS_DESCR
/end CHARACTERISTIC
/begin CHARACTERISTIC P_LCS_LATC_MPCMatrixR_st "" CURVE 0x003C30A4 Lookup1D_FLOAT32_IEEE 0 PubIfControlLATC_MDL_CM_single -3.4E+38 3.4E+38
 /begin AXIS_DESCR COM_AXIS LCS_IN_Spd_Kph PubIfControlLATC_MDL_CM_single 16 -3.4E+38 3.4E+38 AXIS_PTS_REF P_LCS_VehicleSpd_TabX_Kph /end AXIS_DESCR
/end CHARACTERISTIC
/begin CHARACTERISTIC P_LCS_LATC_ELKAngleSlope_ratio "" CURVE 0x003C2BA0 Lookup1D_FLOAT32_IEEE 0 PubIfControlLATC_MDL_CM_single -3.4E+38 3.4E+38
 /begin AXIS_DESCR COM_AXIS LCS_IN_Spd_Kph PubIfControlLATC_MDL_CM_single 16 -3.4E+38 3.4E+38 AXIS_PTS_REF P_LCS_VehicleSpd_TabX_Kph /end AXIS_DESCR
/end CHARACTERISTIC
/begin CHARACTERISTIC P_LCS_LATC_ELKMaxLatAcc_ms2 "" CURVE 0x003C2BE0 Lookup1D_FLOAT32_IEEE 0 PubIfControlLATC_MDL_CM_single -3.4E+38 3.4E+38
 /begin AXIS_DESCR COM_AXIS LCS_IN_Spd_Kph PubIfControlLATC_MDL_CM_single 16 -3.4E+38 3.4E+38 AXIS_PTS_REF P_LCS_VehicleSpd_TabX_Kph /end AXIS_DESCR
/end CHARACTERISTIC
/begin CHARACTERISTIC P_LCS_LATC_ESSAngleSlope_ratio "" CURVE 0x003C2C20 Lookup1D_FLOAT32_IEEE 0 PubIfControlLATC_MDL_CM_single -3.4E+38 3.4E+38
 /begin AXIS_DESCR COM_AXIS LCS_IN_Spd_Kph PubIfControlLATC_MDL_CM_single 16 -3.4E+38 3.4E+38 AXIS_PTS_REF P_LCS_VehicleSpd_TabX_Kph /end AXIS_DESCR
/end CHARACTERISTIC
/begin CHARACTERISTIC P_LCS_LATC_ESSMaxLatAcc_ms2 "" CURVE 0x003C2C60 Lookup1D_FLOAT32_IEEE 0 PubIfControlLATC_MDL_CM_single -3.4E+38 3.4E+38
 /begin AXIS_DESCR COM_AXIS LCS_IN_Spd_Kph PubIfControlLATC_MDL_CM_single 16 -3.4E+38 3.4E+38 AXIS_PTS_REF P_LCS_VehicleSpd_TabX_Kph /end AXIS_DESCR
/end CHARACTERISTIC
/begin CHARACTERISTIC P_LCS_LATC_LCAngleSlope_ratio "" CURVE 0x003C2CA0 Lookup1D_FLOAT32_IEEE 0 PubIfControlLATC_MDL_CM_single -3.4E+38 3.4E+38
 /begin AXIS_DESCR COM_AXIS LCS_IN_Spd_Kph PubIfControlLATC_MDL_CM_single 16 -3.4E+38 3.4E+38 AXIS_PTS_REF P_LCS_VehicleSpd_TabX_Kph /end AXIS_DESCR
/end CHARACTERISTIC
/begin CHARACTERISTIC P_LCS_LATC_LCEcoAngleSlope_ratio "" CURVE 0x003C2D20 Lookup1D_FLOAT32_IEEE 0 PubIfControlLATC_MDL_CM_single -3.4E+38 3.4E+38
 /begin AXIS_DESCR COM_AXIS LCS_IN_Spd_Kph PubIfControlLATC_MDL_CM_single 16 -3.4E+38 3.4E+38 AXIS_PTS_REF P_LCS_VehicleSpd_TabX_Kph /end AXIS_DESCR
/end CHARACTERISTIC
/begin CHARACTERISTIC P_LCS_LATC_LCNormalAngleSlope_ratio "" CURVE 0x003C2EA0 Lookup1D_FLOAT32_IEEE 0 PubIfControlLATC_MDL_CM_single -3.4E+38 3.4E+38
 /begin AXIS_DESCR COM_AXIS LCS_IN_Spd_Kph PubIfControlLATC_MDL_CM_single 16 -3.4E+38 3.4E+38 AXIS_PTS_REF P_LCS_VehicleSpd_TabX_Kph /end AXIS_DESCR
/end CHARACTERISTIC
/begin CHARACTERISTIC P_LCS_LATC_LCSportAngleSlope_ratio "" CURVE 0x003C2F20 Lookup1D_FLOAT32_IEEE 0 PubIfControlLATC_MDL_CM_single -3.4E+38 3.4E+38
 /begin AXIS_DESCR COM_AXIS LCS_IN_Spd_Kph PubIfControlLATC_MDL_CM_single 16 -3.4E+38 3.4E+38 AXIS_PTS_REF P_LCS_VehicleSpd_TabX_Kph /end AXIS_DESCR
/end CHARACTERISTIC
/begin CHARACTERISTIC P_LCS_LATC_LCKIEMaxLatAcc_ms2 "" CURVE 0x003C2E20 Lookup1D_FLOAT32_IEEE 0 PubIfControlLATC_MDL_CM_single -3.4E+38 3.4E+38
 /begin AXIS_DESCR COM_AXIS LCS_IN_Spd_Kph PubIfControlLATC_MDL_CM_single 16 -3.4E+38 3.4E+38 AXIS_PTS_REF P_LCS_VehicleSpd_TabX_Kph /end AXIS_DESCR
/end CHARACTERISTIC
/begin CHARACTERISTIC P_LCS_LATC_LCKIEAngleSlope_ratio "" CURVE 0x003C2DE0 Lookup1D_FLOAT32_IEEE 0 PubIfControlLATC_MDL_CM_single -3.4E+38 3.4E+38
 /begin AXIS_DESCR COM_AXIS LCS_IN_Spd_Kph PubIfControlLATC_MDL_CM_single 16 -3.4E+38 3.4E+38 AXIS_PTS_REF P_LCS_VehicleSpd_TabX_Kph /end AXIS_DESCR
/end CHARACTERISTIC
/begin CHARACTERISTIC P_LCS_LATC_LCKMaxLatAcc_ms2 "" CURVE 0x003C2E60 Lookup1D_FLOAT32_IEEE 0 PubIfControlLATC_MDL_CM_single -3.4E+38 3.4E+38
 /begin AXIS_DESCR COM_AXIS LCS_IN_Spd_Kph PubIfControlLATC_MDL_CM_single 16 -3.4E+38 3.4E+38 AXIS_PTS_REF P_LCS_VehicleSpd_TabX_Kph /end AXIS_DESCR
/end CHARACTERISTIC
/begin CHARACTERISTIC P_LCS_LATC_LCNormalMaxLatAcc_ms2 "" CURVE 0x003C2EE0 Lookup1D_FLOAT32_IEEE 0 PubIfControlLATC_MDL_CM_single -3.4E+38 3.4E+38
 /begin AXIS_DESCR COM_AXIS LCS_IN_Spd_Kph PubIfControlLATC_MDL_CM_single 16 -3.4E+38 3.4E+38 AXIS_PTS_REF P_LCS_VehicleSpd_TabX_Kph /end AXIS_DESCR
/end CHARACTERISTIC
/begin CHARACTERISTIC P_LCS_LATC_LCCancleMaxLatAcc_ms2 "" CURVE 0x003C2CE0 Lookup1D_FLOAT32_IEEE 0 PubIfControlLATC_MDL_CM_single -3.4E+38 3.4E+38
 /begin AXIS_DESCR COM_AXIS LCS_IN_Spd_Kph PubIfControlLATC_MDL_CM_single 16 -3.4E+38 3.4E+38 AXIS_PTS_REF P_LCS_VehicleSpd_TabX_Kph /end AXIS_DESCR
/end CHARACTERISTIC
/begin CHARACTERISTIC P_LCS_LATC_LCEcoMaxLatAcc_ms2 "" CURVE 0x003C2D60 Lookup1D_FLOAT32_IEEE 0 PubIfControlLATC_MDL_CM_single -3.4E+38 3.4E+38
 /begin AXIS_DESCR COM_AXIS LCS_IN_Spd_Kph PubIfControlLATC_MDL_CM_single 16 -3.4E+38 3.4E+38 AXIS_PTS_REF P_LCS_VehicleSpd_TabX_Kph /end AXIS_DESCR
/end CHARACTERISTIC
/begin CHARACTERISTIC P_LCS_LATC_LCSportMaxLatAcc_ms2 "" CURVE 0x003C2F60 Lookup1D_FLOAT32_IEEE 0 PubIfControlLATC_MDL_CM_single -3.4E+38 3.4E+38
 /begin AXIS_DESCR COM_AXIS LCS_IN_Spd_Kph PubIfControlLATC_MDL_CM_single 16 -3.4E+38 3.4E+38 AXIS_PTS_REF P_LCS_VehicleSpd_TabX_Kph /end AXIS_DESCR
/end CHARACTERISTIC
/begin CHARACTERISTIC P_LCS_LATC_LKAAngleSlope_ratio "" CURVE 0x003C2FA0 Lookup1D_FLOAT32_IEEE 0 PubIfControlLATC_MDL_CM_single -3.4E+38 3.4E+38
 /begin AXIS_DESCR COM_AXIS LCS_IN_Spd_Kph PubIfControlLATC_MDL_CM_single 16 -3.4E+38 3.4E+38 AXIS_PTS_REF P_LCS_VehicleSpd_TabX_Kph /end AXIS_DESCR
/end CHARACTERISTIC
/begin CHARACTERISTIC P_LCS_LATC_LKAMaxLatAcc_ms2 "" CURVE 0x003C2FE0 Lookup1D_FLOAT32_IEEE 0 PubIfControlLATC_MDL_CM_single -3.4E+38 3.4E+38
 /begin AXIS_DESCR COM_AXIS LCS_IN_Spd_Kph PubIfControlLATC_MDL_CM_single 16 -3.4E+38 3.4E+38 AXIS_PTS_REF P_LCS_VehicleSpd_TabX_Kph /end AXIS_DESCR
/end CHARACTERISTIC
/begin CHARACTERISTIC P_LCS_LATC_LCKAngleSlope_ratio "" CURVE 0x003C2DA0 Lookup1D_FLOAT32_IEEE 0 PubIfControlLATC_MDL_CM_single -3.4E+38 3.4E+38
 /begin AXIS_DESCR COM_AXIS LCS_IN_Spd_Kph PubIfControlLATC_MDL_CM_single 16 -3.4E+38 3.4E+38 AXIS_PTS_REF P_LCS_VehicleSpd_TabX_Kph /end AXIS_DESCR
/end CHARACTERISTIC
/begin CHARACTERISTIC P_LCS_PLAN_LCPreDisFac_ratio "" MAP 0x003C3694 Lookup2D_FLOAT32_IEEE 0 PubIfControlLATC_MDL_CM_single -3.4E+38 3.4E+38
 /begin AXIS_DESCR COM_AXIS NO_INPUT_QUANTITY PubIfControlLATC_MDL_CM_single 3 -3.4E+38 3.4E+38 AXIS_PTS_REF P_LCS_PLAN_TarDangerlLevel_Tabx_st /end AXIS_DESCR
 /begin AXIS_DESCR COM_AXIS NO_INPUT_QUANTITY PubIfControlLATC_MDL_CM_single 7 -3.4E+38 3.4E+38 AXIS_PTS_REF P_LCS_PLAN_DesLineA0_TabY_m /end AXIS_DESCR
/end CHARACTERISTIC
/begin CHARACTERISTIC P_LCS_Plan_LCNomalAyDtLimit_Tab_ms3 "" MAP 0x003C44BC Lookup2D_FLOAT32_IEEE 0 PubIfControlLATC_MDL_CM_single -3.4E+38 3.4E+38
 /begin AXIS_DESCR COM_AXIS LCS_PreDisCurve_m PubIfControlLATC_MDL_CM_single 13 -3.4E+38 3.4E+38 AXIS_PTS_REF P_LCS_PLAN_PreDisCurve_TabX_m /end AXIS_DESCR
 /begin AXIS_DESCR COM_AXIS LCS_IN_Spd_Kph PubIfControlLATC_MDL_CM_single 16 -3.4E+38 3.4E+38 AXIS_PTS_REF P_LCS_PLAN_VehicleSpd_TabY_Kph /end AXIS_DESCR
/end CHARACTERISTIC
/begin CHARACTERISTIC P_LCS_PLAN_LCKAyDtLimit_Tab_ms3 "" MAP 0x003C3354 Lookup2D_FLOAT32_IEEE 0 PubIfControlLATC_MDL_CM_single -3.4E+38 3.4E+38
 /begin AXIS_DESCR COM_AXIS LCS_PreDisCurve_m PubIfControlLATC_MDL_CM_single 13 -3.4E+38 3.4E+38 AXIS_PTS_REF P_LCS_PLAN_PreDisCurve_TabX_m /end AXIS_DESCR
 /begin AXIS_DESCR COM_AXIS LCS_IN_Spd_Kph PubIfControlLATC_MDL_CM_single 16 -3.4E+38 3.4E+38 AXIS_PTS_REF P_LCS_PLAN_VehicleSpd_TabY_Kph /end AXIS_DESCR
/end CHARACTERISTIC
/begin CHARACTERISTIC P_LCS_Plan_LKAAyDtLimit_Tab_ms3 "" MAP 0x003C4B3C Lookup2D_FLOAT32_IEEE 0 PubIfControlLATC_MDL_CM_single -3.4E+38 3.4E+38
 /begin AXIS_DESCR COM_AXIS LCS_PreDisCurve_m PubIfControlLATC_MDL_CM_single 13 -3.4E+38 3.4E+38 AXIS_PTS_REF P_LCS_PLAN_PreDisCurve_TabX_m /end AXIS_DESCR
 /begin AXIS_DESCR COM_AXIS LCS_IN_Spd_Kph PubIfControlLATC_MDL_CM_single 16 -3.4E+38 3.4E+38 AXIS_PTS_REF P_LCS_PLAN_VehicleSpd_TabY_Kph /end AXIS_DESCR
/end CHARACTERISTIC
/begin CHARACTERISTIC P_LCS_Plan_ELKAyDtLimit_Tab_ms3 "" MAP 0x003C3AFC Lookup2D_FLOAT32_IEEE 0 PubIfControlLATC_MDL_CM_single -3.4E+38 3.4E+38
 /begin AXIS_DESCR COM_AXIS LCS_PreDisCurve_m PubIfControlLATC_MDL_CM_single 13 -3.4E+38 3.4E+38 AXIS_PTS_REF P_LCS_PLAN_PreDisCurve_TabX_m /end AXIS_DESCR
 /begin AXIS_DESCR COM_AXIS LCS_IN_Spd_Kph PubIfControlLATC_MDL_CM_single 16 -3.4E+38 3.4E+38 AXIS_PTS_REF P_LCS_PLAN_VehicleSpd_TabY_Kph /end AXIS_DESCR
/end CHARACTERISTIC
/begin CHARACTERISTIC P_LCS_Plan_LCSportAyDtLimit_Tab_ms3 "" MAP 0x003C47FC Lookup2D_FLOAT32_IEEE 0 PubIfControlLATC_MDL_CM_single -3.4E+38 3.4E+38
 /begin AXIS_DESCR COM_AXIS LCS_PreDisCurve_m PubIfControlLATC_MDL_CM_single 13 -3.4E+38 3.4E+38 AXIS_PTS_REF P_LCS_PLAN_PreDisCurve_TabX_m /end AXIS_DESCR
 /begin AXIS_DESCR COM_AXIS LCS_IN_Spd_Kph PubIfControlLATC_MDL_CM_single 16 -3.4E+38 3.4E+38 AXIS_PTS_REF P_LCS_PLAN_VehicleSpd_TabY_Kph /end AXIS_DESCR
/end CHARACTERISTIC
/begin CHARACTERISTIC P_LCS_Plan_LCAyDtLimit_Tab_ms3 "" MAP 0x003C3E3C Lookup2D_FLOAT32_IEEE 0 PubIfControlLATC_MDL_CM_single -3.4E+38 3.4E+38
 /begin AXIS_DESCR COM_AXIS LCS_PreDisCurve_m PubIfControlLATC_MDL_CM_single 13 -3.4E+38 3.4E+38 AXIS_PTS_REF P_LCS_PLAN_PreDisCurve_TabX_m /end AXIS_DESCR
 /begin AXIS_DESCR COM_AXIS LCS_IN_Spd_Kph PubIfControlLATC_MDL_CM_single 16 -3.4E+38 3.4E+38 AXIS_PTS_REF P_LCS_PLAN_VehicleSpd_TabY_Kph /end AXIS_DESCR
/end CHARACTERISTIC
/begin CHARACTERISTIC P_LCS_Plan_LCKIEAyDtLimit_Tab_ms3 "" MAP 0x003C417C Lookup2D_FLOAT32_IEEE 0 PubIfControlLATC_MDL_CM_single -3.4E+38 3.4E+38
 /begin AXIS_DESCR COM_AXIS LCS_PreDisCurve_m PubIfControlLATC_MDL_CM_single 13 -3.4E+38 3.4E+38 AXIS_PTS_REF P_LCS_PLAN_PreDisCurve_TabX_m /end AXIS_DESCR
 /begin AXIS_DESCR COM_AXIS LCS_IN_Spd_Kph PubIfControlLATC_MDL_CM_single 16 -3.4E+38 3.4E+38 AXIS_PTS_REF P_LCS_PLAN_VehicleSpd_TabY_Kph /end AXIS_DESCR
/end CHARACTERISTIC
/begin CHARACTERISTIC P_LCS_LATC_StateActivAngleSlopeLimit_ratio "" MAP 0x003C30EC Lookup2D_FLOAT32_IEEE 0 PubIfControlLATC_MDL_CM_single -3.4E+38 3.4E+38
 /begin AXIS_DESCR COM_AXIS LCS_LATC_AngleSlopeFlg_st PubIfControlLATC_MDL_CM_uint8 5 0 255 AXIS_PTS_REF P_LCS_LATC_StateActiveFlg_TabX_st /end AXIS_DESCR
 /begin AXIS_DESCR COM_AXIS LCS_LATC_HoldTime_s PubIfControlLATC_MDL_CM_double 15 -1.7E+308 1.7E+308 AXIS_PTS_REF P_LCS_LATC_StateActiveHoldTime_TabY_st /end AXIS_DESCR
/end CHARACTERISTIC
/begin CHARACTERISTIC P_LCS_LATC_CurOffsetCurveFliterTime_Tab_s "" CURVE 0x003C2B4C Lookup1D_FLOAT32_IEEE 0 PubIfControlLATC_MDL_CM_single -3.4E+38 3.4E+38
 /begin AXIS_DESCR COM_AXIS NO_INPUT_QUANTITY PubIfControlLATC_MDL_CM_single 10 -3.4E+38 3.4E+38 AXIS_PTS_REF P_LCS_LATC_CurOffsetCurve_TabX_m /end AXIS_DESCR
/end CHARACTERISTIC
/begin CHARACTERISTIC P_LCS_PLAN_StateActivAngleSlope_Tab_ratio "" MAP 0x003C3760 Lookup2D_FLOAT32_IEEE 0 PubIfControlLATC_MDL_CM_single -3.4E+38 3.4E+38
 /begin AXIS_DESCR COM_AXIS NO_INPUT_QUANTITY PubIfControlLATC_MDL_CM_uint8 5 0 255 AXIS_PTS_REF P_LCS_PLAN_StateActiveFlg_TabX_st /end AXIS_DESCR
 /begin AXIS_DESCR COM_AXIS NO_INPUT_QUANTITY PubIfControlLATC_MDL_CM_double 15 -1.7E+308 1.7E+308 AXIS_PTS_REF P_LCS_PLAN_StateActiveHoldTime_TabY_s /end AXIS_DESCR
/end CHARACTERISTIC
/begin CHARACTERISTIC P_LCS_PLAN_StateCompleteAngleSlope_Tab_ratio "" MAP 0x003C388C Lookup2D_FLOAT32_IEEE 0 PubIfControlLATC_MDL_CM_single -3.4E+38 3.4E+38
 /begin AXIS_DESCR COM_AXIS NO_INPUT_QUANTITY PubIfControlLATC_MDL_CM_uint8 3 0 255 AXIS_PTS_REF P_LCS_PLAN_StateCompleteFlg_TabX_st /end AXIS_DESCR
 /begin AXIS_DESCR COM_AXIS NO_INPUT_QUANTITY PubIfControlLATC_MDL_CM_double 15 -1.7E+308 1.7E+308 AXIS_PTS_REF P_LCS_PLAN_StateActiveHoldTime_TabY_s /end AXIS_DESCR
/end CHARACTERISTIC
/begin CHARACTERISTIC P_LCS_PLAN_LCCompletePreDisFac_Tab_ratio "" MAP 0x003C32A0 Lookup2D_FLOAT32_IEEE 0 PubIfControlLATC_MDL_CM_single -3.4E+38 3.4E+38
 /begin AXIS_DESCR COM_AXIS NO_INPUT_QUANTITY PubIfControlLATC_MDL_CM_uint8 3 0 255 AXIS_PTS_REF P_LCS_PLAN_StateCompleteFlg_TabX_st /end AXIS_DESCR
 /begin AXIS_DESCR COM_AXIS NO_INPUT_QUANTITY PubIfControlLATC_MDL_CM_double 15 -1.7E+308 1.7E+308 AXIS_PTS_REF P_LCS_PLAN_StateActiveHoldTime_TabY_s /end AXIS_DESCR
/end CHARACTERISTIC
/begin CHARACTERISTIC P_LCS_ESSOverrideTime1 "" VALUE 0x003C2728 Scalar_FLOAT64_IEEE 0 PubIfControlLATC_MDL_CM_double -1.7E+308 1.7E+308 /end CHARACTERISTIC
/begin CHARACTERISTIC P_LCS_ESSOverrideTime2 "" VALUE 0x003C2730 Scalar_FLOAT64_IEEE 0 PubIfControlLATC_MDL_CM_double -1.7E+308 1.7E+308 /end CHARACTERISTIC
/begin CHARACTERISTIC P_LCS_ESSOverrideTime3 "" VALUE 0x003C2738 Scalar_FLOAT64_IEEE 0 PubIfControlLATC_MDL_CM_double -1.7E+308 1.7E+308 /end CHARACTERISTIC
/begin CHARACTERISTIC P_LCS_LATC_TarAngleFliterWindowSize "" VALUE 0x003C27B8 Scalar_FLOAT64_IEEE 0 PubIfControlLATC_MDL_CM_double -1.7E+308 1.7E+308 /end CHARACTERISTIC
/begin CHARACTERISTIC P_LCS_NoOverRideTime_TH_s "" VALUE 0x003C27C0 Scalar_FLOAT64_IEEE 0 PubIfControlLATC_MDL_CM_double -1.7E+308 1.7E+308 /end CHARACTERISTIC
/begin CHARACTERISTIC P_LCS_OverRideDetect_b "" VALUE 0x003C27C8 Scalar_FLOAT64_IEEE 0 PubIfControlLATC_MDL_CM_double -1.7E+308 1.7E+308 /end CHARACTERISTIC
/begin CHARACTERISTIC P_LCS_OverRideTime_TH_s "" VALUE 0x003C27D0 Scalar_FLOAT64_IEEE 0 PubIfControlLATC_MDL_CM_double -1.7E+308 1.7E+308 /end CHARACTERISTIC
/begin CHARACTERISTIC P_LCS_DetNoOverRide_DrvTrq_TH "" VALUE 0x003C2B00 Scalar_FLOAT32_IEEE 0 PubIfControlLATC_MDL_CM_single -3.4E+38 3.4E+38 /end CHARACTERISTIC
/begin CHARACTERISTIC P_LCS_DetOverRide_DrvTrq_TH "" VALUE 0x003C2B04 Scalar_FLOAT32_IEEE 0 PubIfControlLATC_MDL_CM_single -3.4E+38 3.4E+38 /end CHARACTERISTIC
/begin CHARACTERISTIC P_LCS_ESSOverrideValue1 "" VALUE 0x003C2B08 Scalar_FLOAT32_IEEE 0 PubIfControlLATC_MDL_CM_single -3.4E+38 3.4E+38 /end CHARACTERISTIC
/begin CHARACTERISTIC P_LCS_ESSOverrideValue2 "" VALUE 0x003C2B0C Scalar_FLOAT32_IEEE 0 PubIfControlLATC_MDL_CM_single -3.4E+38 3.4E+38 /end CHARACTERISTIC
/begin CHARACTERISTIC P_LCS_ESS_NotActiveFlgDelayTime "" VALUE 0x003D6E18 Scalar_FLOAT32_IEEE 0 PubIfControlLATC_MDL_CM_single -3.4E+38 3.4E+38 /end CHARACTERISTIC
/begin CHARACTERISTIC P_LCS_ESS_NotActiveFlgDelayTimeSW "" VALUE 0x003D6E1C Scalar_FLOAT32_IEEE 0 PubIfControlLATC_MDL_CM_single -3.4E+38 3.4E+38 /end CHARACTERISTIC
/begin CHARACTERISTIC P_LCS_ESS_SteerAngleFilterTime "" VALUE 0x003C2B40 Scalar_FLOAT32_IEEE 0 PubIfControlLATC_MDL_CM_single -3.4E+38 3.4E+38 /end CHARACTERISTIC
/begin CHARACTERISTIC P_LCS_ESS_TarAngleFilterTime "" VALUE 0x003C2B44 Scalar_FLOAT32_IEEE 0 PubIfControlLATC_MDL_CM_single -3.4E+38 3.4E+38 /end CHARACTERISTIC
/begin CHARACTERISTIC P_LCS_IN_Offset_Test_Value "" VALUE 0x003D6E20 Scalar_FLOAT32_IEEE 0 PubIfControlLATC_MDL_CM_single -3.4E+38 3.4E+38 /end CHARACTERISTIC
/begin CHARACTERISTIC P_LCS_LATC_CurOffsetA2FliterT_s "" VALUE 0x003C2B48 Scalar_FLOAT32_IEEE 0 PubIfControlLATC_MDL_CM_single -3.4E+38 3.4E+38 /end CHARACTERISTIC
/begin CHARACTERISTIC P_LCS_LATC_CurOffsetVehicleSpdLimitValue_degs "" VALUE 0x003C2B9C Scalar_FLOAT32_IEEE 0 PubIfControlLATC_MDL_CM_single -3.4E+38 3.4E+38 /end CHARACTERISTIC
/begin CHARACTERISTIC P_LCS_LATC_MPCDeltaT_s "" VALUE 0x003C3020 Scalar_FLOAT32_IEEE 0 PubIfControlLATC_MDL_CM_single -3.4E+38 3.4E+38 /end CHARACTERISTIC
/begin CHARACTERISTIC P_LCS_LATC_MPCMaxSterAngleSpd_degs "" VALUE 0x003C30E4 Scalar_FLOAT32_IEEE 0 PubIfControlLATC_MDL_CM_single -3.4E+38 3.4E+38 /end CHARACTERISTIC
/begin CHARACTERISTIC P_LCS_LATC_MPCMaxSterAngle_deg "" VALUE 0x003C30E8 Scalar_FLOAT32_IEEE 0 PubIfControlLATC_MDL_CM_single -3.4E+38 3.4E+38 /end CHARACTERISTIC
/begin CHARACTERISTIC P_LCS_LCC_HeadingErRrateTime_s "" VALUE 0x003C3248 Scalar_FLOAT32_IEEE 0 PubIfControlLATC_MDL_CM_single -3.4E+38 3.4E+38 /end CHARACTERISTIC
/begin CHARACTERISTIC P_LCS_LCC_HeadingErrTime_s "" VALUE 0x003C324C Scalar_FLOAT32_IEEE 0 PubIfControlLATC_MDL_CM_single -3.4E+38 3.4E+38 /end CHARACTERISTIC
/begin CHARACTERISTIC P_LCS_LCC_LaterErrRateTime_s "" VALUE 0x003C3250 Scalar_FLOAT32_IEEE 0 PubIfControlLATC_MDL_CM_single -3.4E+38 3.4E+38 /end CHARACTERISTIC
/begin CHARACTERISTIC P_LCS_LCC_LaterErrTime_s "" VALUE 0x003C3254 Scalar_FLOAT32_IEEE 0 PubIfControlLATC_MDL_CM_single -3.4E+38 3.4E+38 /end CHARACTERISTIC
/begin CHARACTERISTIC P_LCS_LCC_RefThetaTime_s "" VALUE 0x003C3258 Scalar_FLOAT32_IEEE 0 PubIfControlLATC_MDL_CM_single -3.4E+38 3.4E+38 /end CHARACTERISTIC
/begin CHARACTERISTIC P_LCS_LCC_RefcurveTime_s "" VALUE 0x003C325C Scalar_FLOAT32_IEEE 0 PubIfControlLATC_MDL_CM_single -3.4E+38 3.4E+38 /end CHARACTERISTIC
/begin CHARACTERISTIC P_LCS_PLAN_A2FliterTime_s "" VALUE 0x003C3260 Scalar_FLOAT32_IEEE 0 PubIfControlLATC_MDL_CM_single -3.4E+38 3.4E+38 /end CHARACTERISTIC
/begin CHARACTERISTIC P_LCS_PLAN_DisFac_Tab_ratio "" VALUE 0x003C329C Scalar_FLOAT32_IEEE 0 PubIfControlLATC_MDL_CM_single -3.4E+38 3.4E+38 /end CHARACTERISTIC
/begin CHARACTERISTIC P_LCS_PLAN_MinDis_m "" VALUE 0x003C36E8 Scalar_FLOAT32_IEEE 0 PubIfControlLATC_MDL_CM_single -3.4E+38 3.4E+38 /end CHARACTERISTIC
/begin CHARACTERISTIC P_LCS_PLAN_PreDis_Tab_m "" VAL_BLK 0x003C3720 Scalar_FLOAT32_IEEE 0 PubIfControlLATC_MDL_CM_single -3.4E+38 3.4E+38 MATRIX_DIM 1 16 1 /end CHARACTERISTIC
/begin CHARACTERISTIC P_LCS_PlLAN_PreDisFac_Tab_ratio "" VAL_BLK 0x003C398C Scalar_FLOAT32_IEEE 0 PubIfControlLATC_MDL_CM_single -3.4E+38 3.4E+38 MATRIX_DIM 7 13 1 /end CHARACTERISTIC
/begin CHARACTERISTIC P_LCS_Plan_A2Pretime_s "" VALUE 0x003C3AF8 Scalar_FLOAT32_IEEE 0 PubIfControlLATC_MDL_CM_single -3.4E+38 3.4E+38 /end CHARACTERISTIC
/begin CHARACTERISTIC P_LCS_LATC_StateHoldTime_st "" VALUE 0x003C5BE0 Scalar_UWORD 0 PubIfControlLATC_MDL_CM_uint16 0 65535 /end CHARACTERISTIC
/begin CHARACTERISTIC P_LCS_PLAN_StateHoldTime_st "" VALUE 0x003C5BE2 Scalar_UWORD 0 PubIfControlLATC_MDL_CM_uint16 0 65535 /end CHARACTERISTIC
/begin CHARACTERISTIC P_LCS_ESS_LogicTest_Enable "" VALUE 0x003C5BF4 Scalar_BOOLEAN 0 PubIfControlLATC_MDL_CM_boolean 0 1 BIT_MASK 0x01 /end CHARACTERISTIC
/begin CHARACTERISTIC P_LCS_IN_Offset_Test_SW "" VALUE 0x003D6E98 Scalar_UBYTE 0 PubIfControlLATC_MDL_CM_uint8 0 255 /end CHARACTERISTIC
/begin CHARACTERISTIC P_LCS_Trq_Switch "" VALUE 0x003D6E99 Scalar_UBYTE 0 PubIfControlLATC_MDL_CM_uint8 0 255 /end CHARACTERISTIC
/begin AXIS_PTS P_LCS_LATC_VehicleSpd_TabX_Kph "" 0x003C3218 NO_INPUT_QUANTITY Lookup1D_X_FLOAT32_IEEE 0 PubIfControlLATC_MDL_CM_single 12 -3.4E+38 3.4E+38 /end AXIS_PTS
/begin AXIS_PTS P_LCS_VehicleSpd_TabX_Kph "" 0x003C4E7C LCS_IN_Spd_Kph Lookup1D_X_FLOAT32_IEEE 0 PubIfControlLATC_MDL_CM_single 16 -3.4E+38 3.4E+38 /end AXIS_PTS
/begin AXIS_PTS P_LCS_PLAN_TarDangerlLevel_Tabx_st "" 0x003C3940 NO_INPUT_QUANTITY Lookup2D_X_FLOAT32_IEEE 0 PubIfControlLATC_MDL_CM_single 3 -3.4E+38 3.4E+38 /end AXIS_PTS
/begin AXIS_PTS P_LCS_PLAN_DesLineA0_TabY_m "" 0x003C3280 NO_INPUT_QUANTITY Lookup2D_X_FLOAT32_IEEE 0 PubIfControlLATC_MDL_CM_single 7 -3.4E+38 3.4E+38 /end AXIS_PTS
/begin AXIS_PTS P_LCS_PLAN_PreDisCurve_TabX_m "" 0x003C36EC LCS_PreDisCurve_m Lookup2D_X_FLOAT32_IEEE 0 PubIfControlLATC_MDL_CM_single 13 -3.4E+38 3.4E+38 /end AXIS_PTS
/begin AXIS_PTS P_LCS_PLAN_VehicleSpd_TabY_Kph "" 0x003C394C LCS_IN_Spd_Kph Lookup2D_X_FLOAT32_IEEE 0 PubIfControlLATC_MDL_CM_single 16 -3.4E+38 3.4E+38 /end AXIS_PTS
/begin AXIS_PTS P_LCS_LATC_StateActiveFlg_TabX_st "" 0x003C5C08 LCS_LATC_AngleSlopeFlg_st Lookup2D_X_UBYTE 0 PubIfControlLATC_MDL_CM_uint8 5 0 255 /end AXIS_PTS
/begin AXIS_PTS P_LCS_LATC_StateActiveHoldTime_TabY_st "" 0x003C2740 LCS_LATC_HoldTime_s Lookup2D_X_FLOAT64_IEEE 0 PubIfControlLATC_MDL_CM_double 15 -1.7E+308 1.7E+308 /end AXIS_PTS
/begin AXIS_PTS P_LCS_LATC_CurOffsetCurve_TabX_m "" 0x003C2B74 NO_INPUT_QUANTITY Lookup1D_X_FLOAT32_IEEE 0 PubIfControlLATC_MDL_CM_single 10 -3.4E+38 3.4E+38 /end AXIS_PTS
/begin AXIS_PTS P_LCS_PLAN_StateActiveFlg_TabX_st "" 0x003C5C10 NO_INPUT_QUANTITY Lookup2D_X_UBYTE 0 PubIfControlLATC_MDL_CM_uint8 5 0 255 /end AXIS_PTS
/begin AXIS_PTS P_LCS_PLAN_StateActiveHoldTime_TabY_s "" 0x003C27D8 NO_INPUT_QUANTITY Lookup2D_X_FLOAT64_IEEE 0 PubIfControlLATC_MDL_CM_double 15 -1.7E+308 1.7E+308 /end AXIS_PTS
/begin AXIS_PTS P_LCS_PLAN_StateCompleteFlg_TabX_st "" 0x003C5C18 NO_INPUT_QUANTITY Lookup2D_X_UBYTE 0 PubIfControlLATC_MDL_CM_uint8 3 0 255 /end AXIS_PTS
/begin CHARACTERISTIC P_LSM_DOP_PreDis_Y "" CURVE 0x003C4F94 Lookup1D_FLOAT32_IEEE 0 PubIfDecisionLSM_MDL_CM_single -3.4E+38 3.4E+38
 /begin AXIS_DESCR COM_AXIS NO_INPUT_QUANTITY PubIfDecisionLSM_MDL_CM_single 16 -3.4E+38 3.4E+38 AXIS_PTS_REF P_LSM_DOP_PreDis_X /end AXIS_DESCR
/end CHARACTERISTIC
/begin CHARACTERISTIC P_LSM_DOP_C1_EN_Limit "" CURVE 0x003C4EDC Lookup1D_FLOAT32_IEEE 0 PubIfDecisionLSM_MDL_CM_single -3.4E+38 3.4E+38
 /begin AXIS_DESCR COM_AXIS NO_INPUT_QUANTITY PubIfDecisionLSM_MDL_CM_single 7 -3.4E+38 3.4E+38 AXIS_PTS_REF P_LSM_DOP_C1AndC2_Lim_X /end AXIS_DESCR
/end CHARACTERISTIC
/begin CHARACTERISTIC P_LSM_DOP_C2_EN_Limit "" CURVE 0x003C4F14 Lookup1D_FLOAT32_IEEE 0 PubIfDecisionLSM_MDL_CM_single -3.4E+38 3.4E+38
 /begin AXIS_DESCR COM_AXIS NO_INPUT_QUANTITY PubIfDecisionLSM_MDL_CM_single 7 -3.4E+38 3.4E+38 AXIS_PTS_REF P_LSM_DOP_C1AndC2_Lim_X /end AXIS_DESCR
/end CHARACTERISTIC
/begin CHARACTERISTIC P_LSM_DOP_C1_out_Limit "" CURVE 0x003C4EF8 Lookup1D_FLOAT32_IEEE 0 PubIfDecisionLSM_MDL_CM_single -3.4E+38 3.4E+38
 /begin AXIS_DESCR COM_AXIS NO_INPUT_QUANTITY PubIfDecisionLSM_MDL_CM_single 7 -3.4E+38 3.4E+38 AXIS_PTS_REF P_LSM_DOP_C1AndC2_Lim_X /end AXIS_DESCR
/end CHARACTERISTIC
/begin CHARACTERISTIC P_LSM_DOP_C2_out_Limit "" CURVE 0x003C4F30 Lookup1D_FLOAT32_IEEE 0 PubIfDecisionLSM_MDL_CM_single -3.4E+38 3.4E+38
 /begin AXIS_DESCR COM_AXIS NO_INPUT_QUANTITY PubIfDecisionLSM_MDL_CM_single 7 -3.4E+38 3.4E+38 AXIS_PTS_REF P_LSM_DOP_C1AndC2_Lim_X /end AXIS_DESCR
/end CHARACTERISTIC
/begin CHARACTERISTIC P_LSM_DoubleLine_DOPOut_C1 "" CURVE 0x003C4FD8 Lookup1D_FLOAT32_IEEE 0 PubIfDecisionLSM_MDL_CM_single -3.4E+38 3.4E+38
 /begin AXIS_DESCR COM_AXIS NO_INPUT_QUANTITY PubIfDecisionLSM_MDL_CM_single 7 -3.4E+38 3.4E+38 AXIS_PTS_REF P_LSM_DOP_C1AndC2_Lim_X /end AXIS_DESCR
/end CHARACTERISTIC
/begin CHARACTERISTIC P_LSM_SingleLine_DOPOut_C1 "" CURVE 0x003C5014 Lookup1D_FLOAT32_IEEE 0 PubIfDecisionLSM_MDL_CM_single -3.4E+38 3.4E+38
 /begin AXIS_DESCR COM_AXIS NO_INPUT_QUANTITY PubIfDecisionLSM_MDL_CM_single 7 -3.4E+38 3.4E+38 AXIS_PTS_REF P_LSM_DOP_C1AndC2_Lim_X /end AXIS_DESCR
/end CHARACTERISTIC
/begin CHARACTERISTIC P_LSM_DOP_C0_EN_Limit "" VALUE 0x003C2850 Scalar_FLOAT64_IEEE 0 PubIfDecisionLSM_MDL_CM_double -1.7E+308 1.7E+308 /end CHARACTERISTIC
/begin CHARACTERISTIC P_LSM_DOP_C0_out_Limit "" VALUE 0x003C2858 Scalar_FLOAT64_IEEE 0 PubIfDecisionLSM_MDL_CM_double -1.7E+308 1.7E+308 /end CHARACTERISTIC
/begin CHARACTERISTIC P_LSM_NOH_Switch "" VALUE 0x003D6DB8 Scalar_FLOAT64_IEEE 0 PubIfDecisionLSM_MDL_CM_double -1.7E+308 1.7E+308 /end CHARACTERISTIC
/begin CHARACTERISTIC P_LSM_DOPValid_CheckTime "" VALUE 0x003C4EBC Scalar_FLOAT32_IEEE 0 PubIfDecisionLSM_MDL_CM_single -3.4E+38 3.4E+38 /end CHARACTERISTIC
/begin CHARACTERISTIC P_LSM_DOP_In_Pre2Dop_Dis "" VALUE 0x003C4F4C Scalar_FLOAT32_IEEE 0 PubIfDecisionLSM_MDL_CM_single -3.4E+38 3.4E+38 /end CHARACTERISTIC
/begin CHARACTERISTIC P_LSM_DOP_Out_Pre2Dop_Dis "" VALUE 0x003C4F50 Scalar_FLOAT32_IEEE 0 PubIfDecisionLSM_MDL_CM_single -3.4E+38 3.4E+38 /end CHARACTERISTIC
/begin CHARACTERISTIC P_LSM_DoubleLine_Curr2Cent_Dislimit "" VALUE 0x003C4FD4 Scalar_FLOAT32_IEEE 0 PubIfDecisionLSM_MDL_CM_single -3.4E+38 3.4E+38 /end CHARACTERISTIC
/begin CHARACTERISTIC P_LSM_DoubleLine_Dop2Cent_Dislimit "" VALUE 0x003C4FF4 Scalar_FLOAT32_IEEE 0 PubIfDecisionLSM_MDL_CM_single -3.4E+38 3.4E+38 /end CHARACTERISTIC
/begin CHARACTERISTIC P_LSM_DoubleLine_Pre2Cent_Dislimit "" VALUE 0x003C4FF8 Scalar_FLOAT32_IEEE 0 PubIfDecisionLSM_MDL_CM_single -3.4E+38 3.4E+38 /end CHARACTERISTIC
/begin CHARACTERISTIC P_LSM_IFV2CenterAxis "" VALUE 0x003D6E24 Scalar_FLOAT32_IEEE 0 PubIfDecisionLSM_MDL_CM_single -3.4E+38 3.4E+38 /end CHARACTERISTIC
/begin CHARACTERISTIC P_LSM_IFV2RearAxis "" VALUE 0x003D6E28 Scalar_FLOAT32_IEEE 0 PubIfDecisionLSM_MDL_CM_single -3.4E+38 3.4E+38 /end CHARACTERISTIC
/begin CHARACTERISTIC P_LSM_LineSTD_Limit "" VALUE 0x003C4FFC Scalar_FLOAT32_IEEE 0 PubIfDecisionLSM_MDL_CM_single -3.4E+38 3.4E+38 /end CHARACTERISTIC
/begin CHARACTERISTIC P_LSM_LineWijCal_C12 "" VALUE 0x003C5000 Scalar_FLOAT32_IEEE 0 PubIfDecisionLSM_MDL_CM_single -3.4E+38 3.4E+38 /end CHARACTERISTIC
/begin CHARACTERISTIC P_LSM_LineWijCal_C13 "" VALUE 0x003C5004 Scalar_FLOAT32_IEEE 0 PubIfDecisionLSM_MDL_CM_single -3.4E+38 3.4E+38 /end CHARACTERISTIC
/begin CHARACTERISTIC P_LSM_PosLineLcFac "" VALUE 0x003C5008 Scalar_FLOAT32_IEEE 0 PubIfDecisionLSM_MDL_CM_single -3.4E+38 3.4E+38 /end CHARACTERISTIC
/begin CHARACTERISTIC P_LSM_Pre_t "" VALUE 0x003D6E2C Scalar_FLOAT32_IEEE 0 PubIfDecisionLSM_MDL_CM_single -3.4E+38 3.4E+38 /end CHARACTERISTIC
/begin CHARACTERISTIC P_LSM_SingleLine_Cent2Edge_Dislimit "" VALUE 0x003C500C Scalar_FLOAT32_IEEE 0 PubIfDecisionLSM_MDL_CM_single -3.4E+38 3.4E+38 /end CHARACTERISTIC
/begin CHARACTERISTIC P_LSM_SingleLine_Curr2Cent_Dislimit "" VALUE 0x003C5010 Scalar_FLOAT32_IEEE 0 PubIfDecisionLSM_MDL_CM_single -3.4E+38 3.4E+38 /end CHARACTERISTIC
/begin CHARACTERISTIC P_LSM_SingleLine_Dop2Cent_Dislimit "" VALUE 0x003C5030 Scalar_FLOAT32_IEEE 0 PubIfDecisionLSM_MDL_CM_single -3.4E+38 3.4E+38 /end CHARACTERISTIC
/begin CHARACTERISTIC P_LSM_SingleLine_Pre2Cent_Dislimit "" VALUE 0x003C5034 Scalar_FLOAT32_IEEE 0 PubIfDecisionLSM_MDL_CM_single -3.4E+38 3.4E+38 /end CHARACTERISTIC
/begin CHARACTERISTIC P_LSM_ALC_Enable "" VALUE 0x003D6E9A Scalar_UBYTE 0 PubIfDecisionLSM_MDL_CM_uint8 0 255 /end CHARACTERISTIC
/begin AXIS_PTS P_LSM_DOP_PreDis_X "" 0x003C4F54 NO_INPUT_QUANTITY Lookup1D_X_FLOAT32_IEEE 0 PubIfDecisionLSM_MDL_CM_single 16 -3.4E+38 3.4E+38 /end AXIS_PTS
/begin AXIS_PTS P_LSM_DOP_C1AndC2_Lim_X "" 0x003C4EC0 NO_INPUT_QUANTITY Lookup1D_X_FLOAT32_IEEE 0 PubIfDecisionLSM_MDL_CM_single 7 -3.4E+38 3.4E+38 /end AXIS_PTS
/begin CHARACTERISTIC P_LongCtrl_VLCMaRatioCharMaYAxis "" CURVE 0x003C506C Lookup1D_FLOAT32_IEEE 0 PubIfControlLONC_MDL_CM_single 0.0 3.0
 /begin AXIS_DESCR COM_AXIS LongCtrl_Tr_Ratio PubIfControlLONC_MDL_CM_single 18 1.0 30.0 AXIS_PTS_REF P_LongCtrl_VLCTrRatioCharMaXAxis /end AXIS_DESCR
/end CHARACTERISTIC
/begin CHARACTERISTIC P_LongCtrl_VLCaccelMinHoldYAxis "" CURVE 0x003C517C Lookup1D_FLOAT32_IEEE 0 PubIfControlLONC_MDL_CM_single_m_s_2 -6.0 0.0
 /begin AXIS_DESCR COM_AXIS LongCtrl_axvRoadSlopeMs2 PubIfControlLONC_MDL_CM_single_m_s_2 2 0.0 5.0 AXIS_PTS_REF P_LongCtrl_VLCaccelMinHoldXAxis /end AXIS_DESCR
/end CHARACTERISTIC
/begin CHARACTERISTIC P_LongCtrl_VLCjerkHoldYAxis "" CURVE 0x003C5398 Lookup1D_FLOAT32_IEEE 0 PubIfControlLONC_MDL_CM_single_m_s_3 -50.0 0.0
 /begin AXIS_DESCR COM_AXIS LongCtrl_axvRoadSlopeMs2 PubIfControlLONC_MDL_CM_single_m_s_2 2 0.0 4.0 AXIS_PTS_REF P_LongCtrl_VLCjerkHoldXAxis /end AXIS_DESCR
/end CHARACTERISTIC
/begin CHARACTERISTIC P_LongCtrl_VLCaccelMinSlidHoldYAxis "m/s^2" CURVE 0x003C51A0 Lookup1D_FLOAT32_IEEE 0 PubIfControlLONC_MDL_CM_single -3.4E+38 3.4E+38
 /begin AXIS_DESCR COM_AXIS LongCtrl_axvRoadSlopeMs2 PubIfControlLONC_MDL_CM_single 7 -3.4E+38 3.4E+38 AXIS_PTS_REF P_LongCtrl_VLCaccelMinSlidHoldXAxis /end AXIS_DESCR
/end CHARACTERISTIC
/begin CHARACTERISTIC P_LongCtrl_VLCjerkSlidHoldYAxis "m/s^3" CURVE 0x003C53BC Lookup1D_FLOAT32_IEEE 0 PubIfControlLONC_MDL_CM_single -3.4E+38 3.4E+38
 /begin AXIS_DESCR COM_AXIS LongCtrl_axvRoadSlopeMs2 PubIfControlLONC_MDL_CM_single 7 -3.4E+38 3.4E+38 AXIS_PTS_REF P_LongCtrl_VLCjerkSlidHoldXAxis /end AXIS_DESCR
/end CHARACTERISTIC
/begin CHARACTERISTIC P_LongCtrl_VLCcoefPIYAxis "" CURVE 0x003C5314 Lookup1D_FLOAT32_IEEE 0 PubIfControlLONC_MDL_CM_single 0.0 2.0
 /begin AXIS_DESCR COM_AXIS NO_INPUT_QUANTITY PubIfControlLONC_MDL_CM_single_km_h 4 0.0 30.0 AXIS_PTS_REF P_LongCtrl_VLCvelCharCoefPIXAxis /end AXIS_DESCR
/end CHARACTERISTIC
/begin CHARACTERISTIC P_LongCtrl_VLCengInverseEfficientYAxis "" CURVE 0x003C537C Lookup1D_FLOAT32_IEEE 0 PubIfControlLONC_MDL_CM_single__ -120.0 120.0
 /begin AXIS_DESCR COM_AXIS NO_INPUT_QUANTITY PubIfControlLONC_MDL_CM_single__ 5 -150.0 110.0 AXIS_PTS_REF P_LongCtrl_VLCtorqCharEngInverseEfficientXAxis /end AXIS_DESCR
/end CHARACTERISTIC
/begin CHARACTERISTIC P_LongCtrl_VLCcoefKiDiffDtEnlargeYAxis "" CURVE 0x003C52B8 Lookup1D_FLOAT32_IEEE 0 PubIfControlLONC_MDL_CM_single 0.0 3.0
 /begin AXIS_DESCR COM_AXIS NO_INPUT_QUANTITY PubIfControlLONC_MDL_CM_single_m_s_3 6 -10.0 20.0 AXIS_PTS_REF P_LongCtrl_VLCdiffDtCharCoefKiEnlargeXAxis /end AXIS_DESCR
/end CHARACTERISTIC
/begin CHARACTERISTIC P_LongCtrl_VLCcoefKiEnableYAxis "" CURVE 0x003C52D0 Lookup1D_FLOAT32_IEEE 0 PubIfControlLONC_MDL_CM_single 0.0 2.0
 /begin AXIS_DESCR COM_AXIS LongCtrl_axvDiff PubIfControlLONC_MDL_CM_single_m_s_2 6 -10.0 20.0 AXIS_PTS_REF P_LongCtrl_VLCaDiffCharCoefKiEnableXAxis /end AXIS_DESCR
/end CHARACTERISTIC
/begin CHARACTERISTIC P_LongCtrl_VLCAxvTracMinDC1FullFillYAxis "" CURVE 0x003D6E30 Lookup1D_FLOAT32_IEEE 0 PubIfControlLONC_MDL_CM_single_m_s_2 -1.0 1.0
 /begin AXIS_DESCR COM_AXIS LongCtrl_vxvRefMs PubIfControlLONC_MDL_CM_single_m_s 4 0.0 60.0 AXIS_PTS_REF P_LongCtrl_VLCAxvTracMinDC1FullFillXAxis /end AXIS_DESCR
/end CHARACTERISTIC
/begin CHARACTERISTIC P_LongCtrl_VLCengEfficientCharYAxis "" CURVE 0x003C5368 Lookup1D_FLOAT32_IEEE 0 PubIfControlLONC_MDL_CM_single 0.5 2.0
 /begin AXIS_DESCR COM_AXIS NO_INPUT_QUANTITY PubIfControlLONC_MDL_CM_single__ 5 -100.0 100.0 AXIS_PTS_REF P_LongCtrl_VLCtorqCharEngEfficientXAxis /end AXIS_DESCR
/end CHARACTERISTIC
/begin CHARACTERISTIC P_LongCtrl_VLCcoefFYAxis "" CURVE 0x003C5278 Lookup1D_FLOAT32_IEEE 0 PubIfControlLONC_MDL_CM_single 0.0 1.0
 /begin AXIS_DESCR COM_AXIS NO_INPUT_QUANTITY PubIfControlLONC_MDL_CM_single_km_h 10 0.0 250.0 AXIS_PTS_REF P_LongCtrl_VLCcoefFXAxis /end AXIS_DESCR
/end CHARACTERISTIC
/begin CHARACTERISTIC P_Global_TireRadius_m "轮胎半径" VALUE 0x003C2AE0 Scalar_FLOAT32_IEEE 0 PubIfControlLONC_MDL_CM_single_m -3.4E+38 3.4E+38 /end CHARACTERISTIC
/begin CHARACTERISTIC P_Global_Weight_N "车重" VALUE 0x003C2AEC Scalar_FLOAT32_IEEE 0 PubIfControlLONC_MDL_CM_single_N -3.4E+38 3.4E+38 /end CHARACTERISTIC
/begin CHARACTERISTIC P_LongCtrl_AxvRoadSlopeThrd "m/s^2" VALUE 0x003C5038 Scalar_FLOAT32_IEEE 0 PubIfControlLONC_MDL_CM_single -3.4E+38 3.4E+38 /end CHARACTERISTIC
/begin CHARACTERISTIC P_LongCtrl_TotWheelTrqRatio "" VALUE 0x003C503C Scalar_FLOAT32_IEEE 0 PubIfControlLONC_MDL_CM_single -3.4E+38 3.4E+38 /end CHARACTERISTIC
/begin CHARACTERISTIC P_LongCtrl_VLCAxTarDtThreEnableI "" VALUE 0x003C5040 Scalar_FLOAT32_IEEE 0 PubIfControlLONC_MDL_CM_single_m_s_3 0.0 5.0 /end CHARACTERISTIC
/begin CHARACTERISTIC P_LongCtrl_VLCCounterAxvTracMinTimeout "" VALUE 0x003C5054 Scalar_FLOAT32_IEEE 0 PubIfControlLONC_MDL_CM_single 0.0 100.0 /end CHARACTERISTIC
/begin CHARACTERISTIC P_LongCtrl_VLCCounterDC2ECTorqDelay "" VALUE 0x003C5058 Scalar_FLOAT32_IEEE 0 PubIfControlLONC_MDL_CM_single 0.0 100.0 /end CHARACTERISTIC
/begin CHARACTERISTIC P_LongCtrl_VLCCounterDrvOff2EC "" VALUE 0x003C505C Scalar_FLOAT32_IEEE 0 PubIfControlLONC_MDL_CM_single 0.0 100.0 /end CHARACTERISTIC
/begin CHARACTERISTIC P_LongCtrl_VLCDtAxvRef2UpperBandDC5 "" VALUE 0x003C5060 Scalar_FLOAT32_IEEE 0 PubIfControlLONC_MDL_CM_single -1.0 1.0 /end CHARACTERISTIC
/begin CHARACTERISTIC P_LongCtrl_VLCIACompensionNeg "" VALUE 0x003C5064 Scalar_FLOAT32_IEEE 0 PubIfControlLONC_MDL_CM_single_m_s_2 -3.0 0.0 /end CHARACTERISTIC
/begin CHARACTERISTIC P_LongCtrl_VLCIACompensionPos "" VALUE 0x003C5068 Scalar_FLOAT32_IEEE 0 PubIfControlLONC_MDL_CM_single_m_s_2 0.0 3.0 /end CHARACTERISTIC
/begin CHARACTERISTIC P_LongCtrl_VLCLowerJerkCounterDrvOff2EC "" VALUE 0x003D6E40 Scalar_FLOAT32_IEEE 0 PubIfControlLONC_MDL_CM_single_m_s_3 -4.0 4.0 /end CHARACTERISTIC
/begin CHARACTERISTIC P_LongCtrl_VLCTorqDiffThreAxvTracMinTimeout "" VALUE 0x003C50B4 Scalar_FLOAT32_IEEE 0 PubIfControlLONC_MDL_CM_single 0.0 20.0 /end CHARACTERISTIC
/begin CHARACTERISTIC P_LongCtrl_VLCTrTatioMax "" VALUE 0x003C5100 Scalar_FLOAT32_IEEE 0 PubIfControlLONC_MDL_CM_single 10.0 30.0 /end CHARACTERISTIC
/begin CHARACTERISTIC P_LongCtrl_VLCTrTatioMin "" VALUE 0x003C5104 Scalar_FLOAT32_IEEE 0 PubIfControlLONC_MDL_CM_single 0.1 1.0 /end CHARACTERISTIC
/begin CHARACTERISTIC P_LongCtrl_VLCUpperJerkCounterDrvOff2EC "" VALUE 0x003D6E44 Scalar_FLOAT32_IEEE 0 PubIfControlLONC_MDL_CM_single_m_s_3 -4.0 4.0 /end CHARACTERISTIC
/begin CHARACTERISTIC P_LongCtrl_VLCVlcAccThresAxvTracMinTimeout "" VALUE 0x003D6E48 Scalar_FLOAT32_IEEE 0 PubIfControlLONC_MDL_CM_single_m_s_2 -5.0 2.0 /end CHARACTERISTIC
/begin CHARACTERISTIC P_LongCtrl_VLC_WindArea "" VALUE 0x003C5108 Scalar_FLOAT32_IEEE 0 PubIfControlLONC_MDL_CM_single_m_2 -3.4E+38 3.4E+38 /end CHARACTERISTIC
/begin CHARACTERISTIC P_LongCtrl_VLC_fRollCoef "" VALUE 0x003C510C Scalar_FLOAT32_IEEE 0 PubIfControlLONC_MDL_CM_single -3.4E+38 3.4E+38 /end CHARACTERISTIC
/begin CHARACTERISTIC P_LongCtrl_VLCaDiffCharCoefKiXAxis "" VAL_BLK 0x003C5128 Scalar_FLOAT32_IEEE 0 PubIfControlLONC_MDL_CM_single_m_s_2 -5.0 5.0 MATRIX_DIM 1 11 1 /end CHARACTERISTIC
/begin CHARACTERISTIC P_LongCtrl_VLCaDtThresUpdateTorq "" VALUE 0x003C5154 Scalar_FLOAT32_IEEE 0 PubIfControlLONC_MDL_CM_single_m_s_3 0.0 10.0 /end CHARACTERISTIC
/begin CHARACTERISTIC P_LongCtrl_VLCaXCDeadZoneProp_Y "" VAL_BLK 0x003C5158 Scalar_FLOAT32_IEEE 0 PubIfControlLONC_MDL_CM_single -3.4E+38 3.4E+38 MATRIX_DIM 1 7 1 /end CHARACTERISTIC
/begin CHARACTERISTIC P_LongCtrl_VLCaxCtrlDevDeadZoneChar_Y "" VAL_BLK 0x003C51BC Scalar_FLOAT32_IEEE 0 PubIfControlLONC_MDL_CM_single -3.4E+38 3.4E+38 MATRIX_DIM 1 5 1 /end CHARACTERISTIC
/begin CHARACTERISTIC P_LongCtrl_VLCaxCtrlDevEC2DCMax "" VALUE 0x003C51D0 Scalar_FLOAT32_IEEE 0 PubIfControlLONC_MDL_CM_single -3.4E+38 3.4E+38 /end CHARACTERISTIC
/begin CHARACTERISTIC P_LongCtrl_VLCaxCtrlDevFastQuitDCMode "" VALUE 0x003C51D4 Scalar_FLOAT32_IEEE 0 PubIfControlLONC_MDL_CM_single -3.4E+38 3.4E+38 /end CHARACTERISTIC
/begin CHARACTERISTIC P_LongCtrl_VLCaxCtrlDevThresAddEC2DCCharYAxis "" VAL_BLK 0x003C51D8 Scalar_FLOAT32_IEEE 0 PubIfControlLONC_MDL_CM_single -3.4E+38 3.4E+38 MATRIX_DIM 1 5 1 /end CHARACTERISTIC
/begin CHARACTERISTIC P_LongCtrl_VLCaxCtrlDevTresAddDC2ECYAxis "" VAL_BLK 0x003C51EC Scalar_FLOAT32_IEEE 0 PubIfControlLONC_MDL_CM_single -3.4E+38 3.4E+38 MATRIX_DIM 1 5 1 /end CHARACTERISTIC
/begin CHARACTERISTIC P_LongCtrl_VLCaxDtCharAxCtrlDevTresAddDC2ECXAxis "" VAL_BLK 0x003C5200 Scalar_FLOAT32_IEEE 0 PubIfControlLONC_MDL_CM_single_m_s_3 0.0 2.0 MATRIX_DIM 1 5 1 /end CHARACTERISTIC
/begin CHARACTERISTIC P_LongCtrl_VLCaxDtCharAxCtrlDevTresAddEC2DCXAxis "" VAL_BLK 0x003C5214 Scalar_FLOAT32_IEEE 0 PubIfControlLONC_MDL_CM_single_m_s_2 -2.0 1.0 MATRIX_DIM 1 5 1 /end CHARACTERISTIC
/begin CHARACTERISTIC P_LongCtrl_VLCaxvRoadSlopeDC4CharXAxis "" VAL_BLK 0x003C5228 Scalar_FLOAT32_IEEE 0 PubIfControlLONC_MDL_CM_single_m_s_2 -4.0 1.0 MATRIX_DIM 1 5 1 /end CHARACTERISTIC
/begin CHARACTERISTIC P_LongCtrl_VLCaxvRoadSlopeDC4CharYAxis "" VAL_BLK 0x003C523C Scalar_FLOAT32_IEEE 0 PubIfControlLONC_MDL_CM_single 0.0 1.0 MATRIX_DIM 1 5 1 /end CHARACTERISTIC
/begin CHARACTERISTIC P_LongCtrl_VLCcoefIFadeOut1Calc "" VALUE 0x003C52A0 Scalar_FLOAT32_IEEE 0 PubIfControlLONC_MDL_CM_single 1.0 10.0 /end CHARACTERISTIC
/begin CHARACTERISTIC P_LongCtrl_VLCcoefIFadeOut1Condition "" VALUE 0x003C52A4 Scalar_FLOAT32_IEEE 0 PubIfControlLONC_MDL_CM_single 0.0 1.0 /end CHARACTERISTIC
/begin CHARACTERISTIC P_LongCtrl_VLCcoefIFadeOut2Calc "" VALUE 0x003C52A8 Scalar_FLOAT32_IEEE 0 PubIfControlLONC_MDL_CM_single 1.0 10.0 /end CHARACTERISTIC
/begin CHARACTERISTIC P_LongCtrl_VLCcoefIFadeOut2Condition "" VALUE 0x003C52AC Scalar_FLOAT32_IEEE 0 PubIfControlLONC_MDL_CM_single 0.0 1.0 /end CHARACTERISTIC
/begin CHARACTERISTIC P_LongCtrl_VLCcoefIFadeOut3Calc "" VALUE 0x003C52B0 Scalar_FLOAT32_IEEE 0 PubIfControlLONC_MDL_CM_single 1.0 10.0 /end CHARACTERISTIC
/begin CHARACTERISTIC P_LongCtrl_VLCcoefIFadeOut3Condition "" VALUE 0x003C52B4 Scalar_FLOAT32_IEEE 0 PubIfControlLONC_MDL_CM_single 0.0 1.0 /end CHARACTERISTIC
/begin CHARACTERISTIC P_LongCtrl_VLCcoefKiEnlargeADiffYAxis "" VAL_BLK 0x003C52E8 Scalar_FLOAT32_IEEE 0 PubIfControlLONC_MDL_CM_single -3.4E+38 3.4E+38 MATRIX_DIM 1 11 1 /end CHARACTERISTIC
/begin CHARACTERISTIC P_LongCtrl_VLCdaxTarEC2DCMax "" VALUE 0x003C5324 Scalar_FLOAT32_IEEE 0 PubIfControlLONC_MDL_CM_single -3.4E+38 3.4E+38 /end CHARACTERISTIC
/begin CHARACTERISTIC P_LongCtrl_VLCdriveOffAxUpLimXAxix "" VAL_BLK 0x003C5340 Scalar_FLOAT32_IEEE 0 PubIfControlLONC_MDL_CM_single -3.4E+38 3.4E+38 MATRIX_DIM 1 5 1 /end CHARACTERISTIC
/begin CHARACTERISTIC P_LongCtrl_VLCdriveOffAxUpLimYAxix "" VAL_BLK 0x003C5354 Scalar_FLOAT32_IEEE 0 PubIfControlLONC_MDL_CM_single -3.4E+38 3.4E+38 MATRIX_DIM 1 5 1 /end CHARACTERISTIC
/begin CHARACTERISTIC P_LongCtrl_VLCki "" VALUE 0x003C53D8 Scalar_FLOAT32_IEEE 0 PubIfControlLONC_MDL_CM_single -3.4E+38 3.4E+38 /end CHARACTERISTIC
/begin CHARACTERISTIC P_LongCtrl_VLCkp "" VALUE 0x003C53DC Scalar_FLOAT32_IEEE 0 PubIfControlLONC_MDL_CM_single -3.4E+38 3.4E+38 /end CHARACTERISTIC
/begin CHARACTERISTIC P_LongCtrl_VLCks "" VALUE 0x003C53E0 Scalar_FLOAT32_IEEE 0 PubIfControlLONC_MDL_CM_single -3.4E+38 3.4E+38 /end CHARACTERISTIC
/begin CHARACTERISTIC P_LongCtrl_VLCvelCharAxCtrlDevDeadZoneXAxis "" VAL_BLK 0x003C540C Scalar_FLOAT32_IEEE 0 PubIfControlLONC_MDL_CM_single_km_h 0.0 250.0 MATRIX_DIM 1 5 1 /end CHARACTERISTIC
/begin CHARACTERISTIC P_LongCtrl_VLCvelThresUpdateTorq "" VALUE 0x003C5430 Scalar_FLOAT32_IEEE 0 PubIfControlLONC_MDL_CM_single_km_h 0.0 30.0 /end CHARACTERISTIC
/begin CHARACTERISTIC P_LongCtrl_VxvRefThrd "m/s" VALUE 0x003C5434 Scalar_FLOAT32_IEEE 0 PubIfControlLONC_MDL_CM_single -3.4E+38 3.4E+38 /end CHARACTERISTIC
/begin CHARACTERISTIC P_LongCtrl_SlideFlagEnable "" VALUE 0x003D6E84 Scalar_BOOLEAN 0 PubIfControlLONC_MDL_CM_boolean 0 1 BIT_MASK 0x01 /end CHARACTERISTIC
/begin AXIS_PTS P_LongCtrl_VLCTrRatioCharMaXAxis "" 0x003C50B8 LongCtrl_Tr_Ratio Lookup1D_X_FLOAT32_IEEE 0 PubIfControlLONC_MDL_CM_single 18 1.0 30.0 /end AXIS_PTS
/begin AXIS_PTS P_LongCtrl_VLCaccelMinHoldXAxis "" 0x003C5174 LongCtrl_axvRoadSlopeMs2 Lookup1D_X_FLOAT32_IEEE 0 PubIfControlLONC_MDL_CM_single_m_s_2 2 0.0 5.0 /end AXIS_PTS
/begin AXIS_PTS P_LongCtrl_VLCjerkHoldXAxis "" 0x003C5390 LongCtrl_axvRoadSlopeMs2 Lookup1D_X_FLOAT32_IEEE 0 PubIfControlLONC_MDL_CM_single_m_s_2 2 0.0 4.0 /end AXIS_PTS
/begin AXIS_PTS P_LongCtrl_VLCaccelMinSlidHoldXAxis "m/s^2" 0x003C5184 LongCtrl_axvRoadSlopeMs2 Lookup1D_X_FLOAT32_IEEE 0 PubIfControlLONC_MDL_CM_single 7 -3.4E+38 3.4E+38 /end AXIS_PTS
/begin AXIS_PTS P_LongCtrl_VLCjerkSlidHoldXAxis "m/s^2" 0x003C53A0 LongCtrl_axvRoadSlopeMs2 Lookup1D_X_FLOAT32_IEEE 0 PubIfControlLONC_MDL_CM_single 7 -3.4E+38 3.4E+38 /end AXIS_PTS
/begin AXIS_PTS P_LongCtrl_VLCvelCharCoefPIXAxis "" 0x003C5420 NO_INPUT_QUANTITY Lookup1D_X_FLOAT32_IEEE 0 PubIfControlLONC_MDL_CM_single_km_h 4 0.0 30.0 /end AXIS_PTS
/begin AXIS_PTS P_LongCtrl_VLCtorqCharEngInverseEfficientXAxis "" 0x003C53F8 NO_INPUT_QUANTITY Lookup1D_X_FLOAT32_IEEE 0 PubIfControlLONC_MDL_CM_single__ 5 -150.0 110.0 /end AXIS_PTS
/begin AXIS_PTS P_LongCtrl_VLCdiffDtCharCoefKiEnlargeXAxis "" 0x003C5328 NO_INPUT_QUANTITY Lookup1D_X_FLOAT32_IEEE 0 PubIfControlLONC_MDL_CM_single_m_s_3 6 -10.0 20.0 /end AXIS_PTS
/begin AXIS_PTS P_LongCtrl_VLCaDiffCharCoefKiEnableXAxis "" 0x003C5110 LongCtrl_axvDiff Lookup1D_X_FLOAT32_IEEE 0 PubIfControlLONC_MDL_CM_single_m_s_2 6 -10.0 20.0 /end AXIS_PTS
/begin AXIS_PTS P_LongCtrl_VLCAxvTracMinDC1FullFillXAxis "" 0x003C5044 LongCtrl_vxvRefMs Lookup1D_X_FLOAT32_IEEE 0 PubIfControlLONC_MDL_CM_single_m_s 4 0.0 60.0 /end AXIS_PTS
/begin AXIS_PTS P_LongCtrl_VLCtorqCharEngEfficientXAxis "" 0x003C53E4 NO_INPUT_QUANTITY Lookup1D_X_FLOAT32_IEEE 0 PubIfControlLONC_MDL_CM_single__ 5 -100.0 100.0 /end AXIS_PTS
/begin AXIS_PTS P_LongCtrl_VLCcoefFXAxis "" 0x003C5250 NO_INPUT_QUANTITY Lookup1D_X_FLOAT32_IEEE 0 PubIfControlLONC_MDL_CM_single_km_h 10 0.0 250.0 /end AXIS_PTS
/begin CHARACTERISTIC P_Global_DxvRearBumper_m "后轴中心到后杠后边缘中心的X向位置" VALUE 0x003C2AC0 Scalar_FLOAT32_IEEE 0 PubIfDecisionPLAN_MDL_CM_single_m -3.4E+38 3.4E+38 /end CHARACTERISTIC
/begin CHARACTERISTIC P_VSM_HOD_Handson_TimeInsertPoint "" CURVE 0x003C56EC Lookup1D_FLOAT32_IEEE 0 PubIfStateVSM_MDL_CM_single -3.4E+38 3.4E+38
 /begin AXIS_DESCR COM_AXIS VSM_HOD_DrvTrqFilted PubIfStateVSM_MDL_CM_single 5 -3.4E+38 3.4E+38 AXIS_PTS_REF P_VSM_HOD_Handson_TrqInsertPoint /end AXIS_DESCR
/end CHARACTERISTIC
/begin CHARACTERISTIC P_VSM_ESS_SpdTime_s "" CURVE 0x003C567C Lookup1D_FLOAT32_IEEE 0 PubIfStateVSM_MDL_CM_single -3.4E+38 3.4E+38
 /begin AXIS_DESCR COM_AXIS NO_INPUT_QUANTITY PubIfStateVSM_MDL_CM_single 6 -3.4E+38 3.4E+38 AXIS_PTS_REF P_VSM_ESS_SpdPoint_kmh /end AXIS_DESCR
/end CHARACTERISTIC
/begin CHARACTERISTIC P_VSM_ESS_AngleSpdTable_deg "" CURVE 0x003C55B4 Lookup1D_FLOAT32_IEEE 0 PubIfStateVSM_MDL_CM_single -3.4E+38 3.4E+38
 /begin AXIS_DESCR COM_AXIS NO_INPUT_QUANTITY PubIfStateVSM_MDL_CM_single 6 -3.4E+38 3.4E+38 AXIS_PTS_REF P_VSM_ESS_SpdPoint_kmh /end AXIS_DESCR
/end CHARACTERISTIC
/begin CHARACTERISTIC P_VSM_SOSSpdLimit "" VALUE 0x003D6E10 Scalar_FLOAT64_IEEE 0 PubIfStateVSM_MDL_CM_double -1.7E+308 1.7E+308 /end CHARACTERISTIC
/begin CHARACTERISTIC P_Global_VehicleWidthMin_m "最小车宽" VALUE 0x003C2AE4 Scalar_FLOAT32_IEEE 0 PubIfStateVSM_MDL_CM_single_m -3.4E+38 3.4E+38 /end CHARACTERISTIC
/begin CHARACTERISTIC P_VSM_ESS_ACtiveTime "" VALUE 0x003C55AC Scalar_FLOAT32_IEEE 0 PubIfStateVSM_MDL_CM_single -3.4E+38 3.4E+38 /end CHARACTERISTIC
/begin CHARACTERISTIC P_VSM_ESS_SafeDistance_m "" VALUE 0x003C5660 Scalar_FLOAT32_IEEE 0 PubIfStateVSM_MDL_CM_single -3.4E+38 3.4E+38 /end CHARACTERISTIC
/begin CHARACTERISTIC P_VSM_HOD_DrvTrqFlterTIme "" VALUE 0x003C56D0 Scalar_FLOAT32_IEEE 0 PubIfStateVSM_MDL_CM_single -3.4E+38 3.4E+38 /end CHARACTERISTIC
/begin CHARACTERISTIC P_VSM_HOD_HWA_HandsOffLev1TimeCnt "" VALUE 0x003C56D4 Scalar_FLOAT32_IEEE 0 PubIfStateVSM_MDL_CM_single -3.4E+38 3.4E+38 /end CHARACTERISTIC
/begin CHARACTERISTIC P_VSM_HOD_HWA_HandsOffLev2TimeCnt "" VALUE 0x003C56D8 Scalar_FLOAT32_IEEE 0 PubIfStateVSM_MDL_CM_single -3.4E+38 3.4E+38 /end CHARACTERISTIC
/begin CHARACTERISTIC P_VSM_HOD_HWA_HandsOffLev3TimeCnt "" VALUE 0x003C56DC Scalar_FLOAT32_IEEE 0 PubIfStateVSM_MDL_CM_single -3.4E+38 3.4E+38 /end CHARACTERISTIC
/begin CHARACTERISTIC P_VSM_HOD_HWA_HandsOffLev4TimeCnt "" VALUE 0x003C56E0 Scalar_FLOAT32_IEEE 0 PubIfStateVSM_MDL_CM_single -3.4E+38 3.4E+38 /end CHARACTERISTIC
/begin CHARACTERISTIC P_VSM_HOD_HandsOff_Tr "" VALUE 0x003C56E4 Scalar_FLOAT32_IEEE 0 PubIfStateVSM_MDL_CM_single -3.4E+38 3.4E+38 /end CHARACTERISTIC
/begin CHARACTERISTIC P_VSM_HOD_HandsOn_Tr "" VALUE 0x003C56E8 Scalar_FLOAT32_IEEE 0 PubIfStateVSM_MDL_CM_single -3.4E+38 3.4E+38 /end CHARACTERISTIC
/begin CHARACTERISTIC P_VSM_HOD_LCKTJA_HandsOffLev1TimeCnt "" VALUE 0x003C5714 Scalar_FLOAT32_IEEE 0 PubIfStateVSM_MDL_CM_single -3.4E+38 3.4E+38 /end CHARACTERISTIC
/begin CHARACTERISTIC P_VSM_HOD_LCKTJA_HandsOffLev2TimeCnt "" VALUE 0x003C5718 Scalar_FLOAT32_IEEE 0 PubIfStateVSM_MDL_CM_single -3.4E+38 3.4E+38 /end CHARACTERISTIC
/begin CHARACTERISTIC P_VSM_HOD_LCKTJA_HandsOffLev3TimeCnt "" VALUE 0x003C571C Scalar_FLOAT32_IEEE 0 PubIfStateVSM_MDL_CM_single -3.4E+38 3.4E+38 /end CHARACTERISTIC
/begin CHARACTERISTIC P_VSM_HOD_LCKTJA_HandsOffLev4TimeCnt "" VALUE 0x003C5720 Scalar_FLOAT32_IEEE 0 PubIfStateVSM_MDL_CM_single -3.4E+38 3.4E+38 /end CHARACTERISTIC
/begin CHARACTERISTIC P_VSM_LDW_State_Param_LaneTime "" VAL_BLK 0x003C59FC Scalar_FLOAT32_IEEE 0 PubIfStateVSM_MDL_CM_single -3.4E+38 3.4E+38 MATRIX_DIM 1 16 1 /end CHARACTERISTIC
/begin CHARACTERISTIC P_VSM_LDW_State_Param_Speed "" VAL_BLK 0x003C5A68 Scalar_FLOAT32_IEEE 0 PubIfStateVSM_MDL_CM_single -3.4E+38 3.4E+38 MATRIX_DIM 1 16 1 /end CHARACTERISTIC
/begin CHARACTERISTIC P_VSM_ACC_BrakeOnlyNum "" VALUE 0x003C5BE8 Scalar_UWORD 0 PubIfStateVSM_MDL_CM_uint16_num 0.0 600.0 /end CHARACTERISTIC
/begin CHARACTERISTIC P_VSM_SOSContinueTime "" VALUE 0x003C5BEE Scalar_UWORD 0 PubIfStateVSM_MDL_CM_uint16 0 65535 /end CHARACTERISTIC
/begin CHARACTERISTIC P_VSM_TLS_LCCancelTime "" VALUE 0x003C5BF2 Scalar_UWORD 0 PubIfStateVSM_MDL_CM_uint16 0 65535 /end CHARACTERISTIC
/begin CHARACTERISTIC P_VSM_ACCSOS_SW "" VALUE 0x003C5BF5 Scalar_BOOLEAN 0 PubIfStateVSM_MDL_CM_boolean 0 1 BIT_MASK 0x01 /end CHARACTERISTIC
/begin CHARACTERISTIC P_VSM_AESSwtReq "" VALUE 0x003D6E85 Scalar_BOOLEAN 0 PubIfStateVSM_MDL_CM_boolean 0 1 BIT_MASK 0x01 /end CHARACTERISTIC
/begin CHARACTERISTIC P_VSM_ALCSwtReq "" VALUE 0x003D6E86 Scalar_BOOLEAN 0 PubIfStateVSM_MDL_CM_boolean 0 1 BIT_MASK 0x01 /end CHARACTERISTIC
/begin CHARACTERISTIC P_VSM_ELKSwtReq "" VALUE 0x003D6E87 Scalar_BOOLEAN 0 PubIfStateVSM_MDL_CM_boolean 0 1 BIT_MASK 0x01 /end CHARACTERISTIC
/begin CHARACTERISTIC P_VSM_ESS_VehSwtReq "" VALUE 0x003D6E89 Scalar_BOOLEAN 0 PubIfStateVSM_MDL_CM_boolean 0 1 BIT_MASK 0x01 /end CHARACTERISTIC
/begin CHARACTERISTIC P_VSM_HWA_ALCStsSW "" VALUE 0x003C5C06 Scalar_BOOLEAN 0 PubIfStateVSM_MDL_CM_boolean 0 1 BIT_MASK 0x01 /end CHARACTERISTIC
/begin CHARACTERISTIC P_VSM_ICA_HandsOffSwtReq "" VALUE 0x003D6E8B Scalar_BOOLEAN 0 PubIfStateVSM_MDL_CM_boolean 0 1 BIT_MASK 0x01 /end CHARACTERISTIC
/begin CHARACTERISTIC P_VSM_ISLSwtReq "" VALUE 0x003D6E8C Scalar_BOOLEAN 0 PubIfStateVSM_MDL_CM_boolean 0 1 BIT_MASK 0x01 /end CHARACTERISTIC
/begin CHARACTERISTIC P_VSM_IntelligentEvaSwtReq "" VALUE 0x003D6E8D Scalar_BOOLEAN 0 PubIfStateVSM_MDL_CM_boolean 0 1 BIT_MASK 0x01 /end CHARACTERISTIC
/begin CHARACTERISTIC P_VSM_LCKSwtReq "" VALUE 0x003D6E8E Scalar_BOOLEAN 0 PubIfStateVSM_MDL_CM_boolean 0 1 BIT_MASK 0x01 /end CHARACTERISTIC
/begin CHARACTERISTIC P_VSM_LDWSwtReq "" VALUE 0x003D6E8F Scalar_BOOLEAN 0 PubIfStateVSM_MDL_CM_boolean 0 1 BIT_MASK 0x01 /end CHARACTERISTIC
/begin CHARACTERISTIC P_VSM_LKASwtReq "" VALUE 0x003D6E90 Scalar_BOOLEAN 0 PubIfStateVSM_MDL_CM_boolean 0 1 BIT_MASK 0x01 /end CHARACTERISTIC
/begin CHARACTERISTIC P_VSM_LSSSwtReq "" VALUE 0x003D6E91 Scalar_BOOLEAN 0 PubIfStateVSM_MDL_CM_boolean 0 1 BIT_MASK 0x01 /end CHARACTERISTIC
/begin CHARACTERISTIC P_VSM_NOH_Act_Req "" VALUE 0x003D6E92 Scalar_BOOLEAN 0 PubIfStateVSM_MDL_CM_boolean 0 1 BIT_MASK 0x01 /end CHARACTERISTIC
/begin CHARACTERISTIC P_VSM_NOH_Swt_Req "" VALUE 0x003D6E93 Scalar_BOOLEAN 0 PubIfStateVSM_MDL_CM_boolean 0 1 BIT_MASK 0x01 /end CHARACTERISTIC
/begin CHARACTERISTIC P_VSM_TSRSwtReq "" VALUE 0x003D6E94 Scalar_BOOLEAN 0 PubIfStateVSM_MDL_CM_boolean 0 1 BIT_MASK 0x01 /end CHARACTERISTIC
/begin CHARACTERISTIC P_VSM_TSRWarnSwtReq "" VALUE 0x003D6E95 Scalar_BOOLEAN 0 PubIfStateVSM_MDL_CM_boolean 0 1 BIT_MASK 0x01 /end CHARACTERISTIC
/begin CHARACTERISTIC P_VSM_TimeGapHMI_SW "" VALUE 0x003D6E96 Scalar_BOOLEAN 0 PubIfStateVSM_MDL_CM_boolean 0 1 BIT_MASK 0x01 /end CHARACTERISTIC
/begin CHARACTERISTIC P_VSM_CruiseFunUserInputMappingWays "" VALUE 0x003D6E9B Scalar_UBYTE 0 PubIfStateVSM_MDL_CM_uint8 0 255 /end CHARACTERISTIC
/begin CHARACTERISTIC P_VSM_ISL_TimeInformDis "" VALUE 0x003C5C1D Scalar_UBYTE 0 PubIfStateVSM_MDL_CM_uint8_s 1.0 255.0 /end CHARACTERISTIC
/begin CHARACTERISTIC P_VSM_ISL_TimeTakeOver "" VALUE 0x003C5C1E Scalar_UBYTE 0 PubIfStateVSM_MDL_CM_uint8_s 0 255 /end CHARACTERISTIC
/begin AXIS_PTS P_VSM_HOD_Handson_TrqInsertPoint "" 0x003C5700 VSM_HOD_DrvTrqFilted Lookup1D_X_FLOAT32_IEEE 0 PubIfStateVSM_MDL_CM_single 5 -3.4E+38 3.4E+38 /end AXIS_PTS
/begin AXIS_PTS P_VSM_ESS_SpdPoint_kmh "" 0x003C5664 NO_INPUT_QUANTITY Lookup1D_X_FLOAT32_IEEE 0 PubIfStateVSM_MDL_CM_single 6 -3.4E+38 3.4E+38 /end AXIS_PTS
/begin MEASUREMENT RFM_R1_dDisFront "" FLOAT32_IEEE Noa_Nofusion_CM_single 0 0 0.0 200.0 ECU_ADDRESS 0x003D6C88 /end MEASUREMENT
/begin MEASUREMENT RFM_R1_dDisStart "" FLOAT32_IEEE Noa_Nofusion_CM_single 0 0 0.0 200.0 ECU_ADDRESS 0x003D6C8C /end MEASUREMENT
/begin MEASUREMENT RFM_R1_dC3V "" FLOAT32_IEEE Noa_Nofusion_CM_single 0 0 -0.004 0.004 ECU_ADDRESS 0x003D6C90 /end MEASUREMENT
/begin MEASUREMENT RFM_R1_dC2V "" FLOAT32_IEEE Noa_Nofusion_CM_single 0 0 -0.125 0.125 ECU_ADDRESS 0x003D6C94 /end MEASUREMENT
/begin MEASUREMENT RFM_R1_dC1V "" FLOAT32_IEEE Noa_Nofusion_CM_single 0 0 -2.0 2.0 ECU_ADDRESS 0x003D6C98 /end MEASUREMENT
/begin MEASUREMENT RFM_R1_dC0V "" FLOAT32_IEEE Noa_Nofusion_CM_single 0 0 -30.0 30.0 ECU_ADDRESS 0x003D6C9C /end MEASUREMENT
/begin MEASUREMENT RFM_L1_dDisFront "" FLOAT32_IEEE Noa_Nofusion_CM_single 0 0 0.0 200.0 ECU_ADDRESS 0x003D6CA0 /end MEASUREMENT
/begin MEASUREMENT RFM_L1_dDisStart "" FLOAT32_IEEE Noa_Nofusion_CM_single 0 0 0.0 200.0 ECU_ADDRESS 0x003D6CA4 /end MEASUREMENT
/begin MEASUREMENT RFM_L1_dC3V "" FLOAT32_IEEE Noa_Nofusion_CM_single 0 0 -0.004 0.004 ECU_ADDRESS 0x003D6CA8 /end MEASUREMENT
/begin MEASUREMENT RFM_L1_dC1V "" FLOAT32_IEEE Noa_Nofusion_CM_single 0 0 -2.0 2.0 ECU_ADDRESS 0x003D6CAC /end MEASUREMENT
/begin MEASUREMENT RFM_L1_dC0V "" FLOAT32_IEEE Noa_Nofusion_CM_single 0 0 -30.0 30.0 ECU_ADDRESS 0x003D6CB0 /end MEASUREMENT
/begin MEASUREMENT EQ4_DX "" FLOAT32_IEEE Noa_Nofusion_CM_single 0 0 -3.4E+38 3.4E+38 LAYOUT ROW_DIR MATRIX_DIM 20 1 1 ECU_ADDRESS 0x003D6CB4 /end MEASUREMENT
/begin MEASUREMENT LCKIE_DX "" FLOAT32_IEEE Noa_Nofusion_CM_single 0 0 -3.4E+38 3.4E+38 LAYOUT ROW_DIR MATRIX_DIM 9 1 1 ECU_ADDRESS 0x003D6D04 /end MEASUREMENT
/begin MEASUREMENT LCKIE_DY "" FLOAT32_IEEE Noa_Nofusion_CM_single 0 0 -3.4E+38 3.4E+38 LAYOUT ROW_DIR MATRIX_DIM 9 1 1 ECU_ADDRESS 0x003D6D28 /end MEASUREMENT
/begin MEASUREMENT LCKIE_VX "" FLOAT32_IEEE Noa_Nofusion_CM_single 0 0 -3.4E+38 3.4E+38 LAYOUT ROW_DIR MATRIX_DIM 9 1 1 ECU_ADDRESS 0x003D6D4C /end MEASUREMENT
/begin MEASUREMENT dxP0 "" FLOAT32_IEEE Noa_Nofusion_CM_single 0 0 -3.4E+38 3.4E+38 ECU_ADDRESS 0x003D6D70 /end MEASUREMENT
/begin MEASUREMENT LongCtrl_VlcInternalAcc "" FLOAT32_IEEE Noa_Nofusion_CM_single 0 0 -3.4E+38 3.4E+38 ECU_ADDRESS 0x003D6D74 /end MEASUREMENT
/begin MEASUREMENT LCKIE_ID "" UWORD Noa_Nofusion_CM_ufix16_En7 0 0 0 511.9921875 LAYOUT ROW_DIR MATRIX_DIM 9 1 1 ECU_ADDRESS 0x003D6D78 /end MEASUREMENT
/begin MEASUREMENT RFM_R1_eLineType "" UBYTE Noa_Nofusion_CM_uint8 0 0 0 255 ECU_ADDRESS 0x003D6D8A /end MEASUREMENT
/begin MEASUREMENT RFM_R1_bIsLineExist "" UBYTE Noa_Nofusion_CM_uint8 0 0 0 255 ECU_ADDRESS 0x003D6D8B /end MEASUREMENT
/begin MEASUREMENT RFM_L1_eLineType "" UBYTE Noa_Nofusion_CM_uint8 0 0 0 255 ECU_ADDRESS 0x003D6D8C /end MEASUREMENT
/begin MEASUREMENT RFM_L1_bIsLineExist "" UBYTE Noa_Nofusion_CM_uint8 0 0 0 255 ECU_ADDRESS 0x003D6D8D /end MEASUREMENT
/begin MEASUREMENT EQ4_Type "" UBYTE Noa_Nofusion_CM_uint8 0 0 0 255 LAYOUT ROW_DIR MATRIX_DIM 20 1 1 ECU_ADDRESS 0x003D6D90 /end MEASUREMENT
/begin MEASUREMENT Object_Type "" UBYTE Noa_Nofusion_CM_uint8 0 0 0 255 LAYOUT ROW_DIR MATRIX_DIM 9 1 1 ECU_ADDRESS 0x003D6DA4 /end MEASUREMENT
/begin MEASUREMENT LSM_Line_source "" UBYTE Noa_Nofusion_CM_uint8 0 0 0 255 ECU_ADDRESS 0x003D6DAD /end MEASUREMENT
/begin MEASUREMENT HMI_Counter "" UBYTE PubIfChassisHMI_MDL_CM_uint8 0 0 0 255 ECU_ADDRESS 0x00402EB8 /end MEASUREMENT
/begin MEASUREMENT VIE_SW_VERSION "" ULONG PubIfCommonVIE_MDL_CM_uint32 0 0 0 4294967295 ECU_ADDRESS 0x00403680 /end MEASUREMENT
/begin MEASUREMENT VSM_SteerAngOffsetInit "" FLOAT32_IEEE PubIfCommonVIE_MDL_CM_single 0 0 -3.4E+38 3.4E+38 ECU_ADDRESS 0x00403684 /end MEASUREMENT
/begin MEASUREMENT VSM_SteerAngleOffset_deg "" FLOAT32_IEEE PubIfCommonVIE_MDL_CM_single 0 0 -3.4E+38 3.4E+38 ECU_ADDRESS 0x00403688 /end MEASUREMENT
/begin MEASUREMENT LCS_LATC_HoldTime_s "" FLOAT64_IEEE PubIfControlLATC_MDL_CM_double 0 0 -1.7E+308 1.7E+308 ECU_ADDRESS 0x00403BF8 /end MEASUREMENT
/begin MEASUREMENT LCS_PLAN_Trajectory_NumTraj "" FLOAT64_IEEE PubIfControlLATC_MDL_CM_double 0 0 -1.7E+308 1.7E+308 ECU_ADDRESS 0x00403C00 /end MEASUREMENT
/begin MEASUREMENT LCS_SubModel_Number "" ULONG PubIfControlLATC_MDL_CM_uint32 0 0 0 4294967295 ECU_ADDRESS 0x00403C08 /end MEASUREMENT
/begin MEASUREMENT LCS_SubModel_VERSION "" ULONG PubIfControlLATC_MDL_CM_uint32 0 0 0 4294967295 ECU_ADDRESS 0x00403C0C /end MEASUREMENT
/begin MEASUREMENT LCS_IN_EPS_DrvInpTrqVal "" FLOAT32_IEEE PubIfControlLATC_MDL_CM_single 0 0 -3.4E+38 3.4E+38 ECU_ADDRESS 0x00403C10 /end MEASUREMENT
/begin MEASUREMENT LCS_IN_SteerWheelSpd "" FLOAT32_IEEE PubIfControlLATC_MDL_CM_single 0 0 -3.4E+38 3.4E+38 ECU_ADDRESS 0x00403C14 /end MEASUREMENT
/begin MEASUREMENT LCS_ESS_SteerWheelAngleSpd "" FLOAT32_IEEE PubIfControlLATC_MDL_CM_single 0 0 -3.4E+38 3.4E+38 ECU_ADDRESS 0x00403C18 /end MEASUREMENT
/begin MEASUREMENT LCS_ESS_SteerWheelAngleSpdFilter "" FLOAT32_IEEE PubIfControlLATC_MDL_CM_single 0 0 -3.4E+38 3.4E+38 ECU_ADDRESS 0x00403C1C /end MEASUREMENT
/begin MEASUREMENT LCS_ESS_TarAngleSpd "" FLOAT32_IEEE PubIfControlLATC_MDL_CM_single 0 0 -3.4E+38 3.4E+38 ECU_ADDRESS 0x00403C20 /end MEASUREMENT
/begin MEASUREMENT LCS_ESS_TarAngleSpdFilter "" FLOAT32_IEEE PubIfControlLATC_MDL_CM_single 0 0 -3.4E+38 3.4E+38 ECU_ADDRESS 0x00403C24 /end MEASUREMENT
/begin MEASUREMENT LCS_IN_vxvRefMs "" FLOAT32_IEEE PubIfControlLATC_MDL_CM_single 0 0 -3.4E+38 3.4E+38 ECU_ADDRESS 0x00403C28 /end MEASUREMENT
/begin MEASUREMENT LCS_IN_SteerWheelSpdSign "" FLOAT32_IEEE PubIfControlLATC_MDL_CM_single 0 0 -3.4E+38 3.4E+38 ECU_ADDRESS 0x00403C2C /end MEASUREMENT
/begin MEASUREMENT LCS_IN_SteerWheelAngleSign "" FLOAT32_IEEE PubIfControlLATC_MDL_CM_single 0 0 -3.4E+38 3.4E+38 ECU_ADDRESS 0x00403C30 /end MEASUREMENT
/begin MEASUREMENT LCS_IN_SteerWheelAng "" FLOAT32_IEEE PubIfControlLATC_MDL_CM_single 0 0 -3.4E+38 3.4E+38 ECU_ADDRESS 0x00403C34 /end MEASUREMENT
/begin MEASUREMENT LCS_IN_CurrentLaneWidth "" FLOAT32_IEEE PubIfControlLATC_MDL_CM_single 0 0 -3.4E+38 3.4E+38 ECU_ADDRESS 0x00403C38 /end MEASUREMENT
/begin MEASUREMENT LCS_IN_EPS_LKATorqOvrlDlvd "" FLOAT32_IEEE PubIfControlLATC_MDL_CM_single 0 0 -3.4E+38 3.4E+38 ECU_ADDRESS 0x00403C3C /end MEASUREMENT
/begin MEASUREMENT LCS_IN_EPS_LKATorqOvrlDlvdVld "" FLOAT32_IEEE PubIfControlLATC_MDL_CM_single 0 0 -3.4E+38 3.4E+38 ECU_ADDRESS 0x00403C40 /end MEASUREMENT
/begin MEASUREMENT LCS_IN_CurSteerAngle_deg "" FLOAT32_IEEE PubIfControlLATC_MDL_CM_single 0 0 -3.4E+38 3.4E+38 ECU_ADDRESS 0x00403C44 /end MEASUREMENT
/begin MEASUREMENT LCS_IN_SteerAngOffset_deg "" FLOAT32_IEEE PubIfControlLATC_MDL_CM_single 0 0 -3.4E+38 3.4E+38 ECU_ADDRESS 0x00403C48 /end MEASUREMENT
/begin MEASUREMENT LCS_LATC_CorrectSteerAngle_deg "" FLOAT32_IEEE PubIfControlLATC_MDL_CM_single 0 0 -3.4E+38 3.4E+38 ECU_ADDRESS 0x00403C4C /end MEASUREMENT
/begin MEASUREMENT LCS_IN_Spd_Kph "" FLOAT32_IEEE PubIfControlLATC_MDL_CM_single 0 0 -3.4E+38 3.4E+38 ECU_ADDRESS 0x00403C50 /end MEASUREMENT
/begin MEASUREMENT LCS_LATC_MaxAy_ms2 "" FLOAT32_IEEE PubIfControlLATC_MDL_CM_single 0 0 -3.4E+38 3.4E+38 ECU_ADDRESS 0x00403C54 /end MEASUREMENT
/begin MEASUREMENT LCS_LATC_StateActAngleSlope_degs "" FLOAT32_IEEE PubIfControlLATC_MDL_CM_single 0 0 -3.4E+38 3.4E+38 ECU_ADDRESS 0x00403C58 /end MEASUREMENT
/begin MEASUREMENT LCS_LATC_StateAngleSlope_degs "" FLOAT32_IEEE PubIfControlLATC_MDL_CM_single 0 0 -3.4E+38 3.4E+38 ECU_ADDRESS 0x00403C5C /end MEASUREMENT
/begin MEASUREMENT LCS_IN_psiDtOpt "" FLOAT32_IEEE PubIfControlLATC_MDL_CM_single 0 0 -3.4E+38 3.4E+38 ECU_ADDRESS 0x00403C60 /end MEASUREMENT
/begin MEASUREMENT LCS_IN_desLaneA2 "" FLOAT32_IEEE PubIfControlLATC_MDL_CM_single 0 0 -3.4E+38 3.4E+38 ECU_ADDRESS 0x00403C64 /end MEASUREMENT
/begin MEASUREMENT LCS_LATC_TarAngleFilter_deg "" FLOAT32_IEEE PubIfControlLATC_MDL_CM_single 0 0 -3.4E+38 3.4E+38 ECU_ADDRESS 0x00403C68 /end MEASUREMENT
/begin MEASUREMENT LCS_LATC_OutTrgSteerAngle "" FLOAT32_IEEE PubIfControlLATC_MDL_CM_single 0 0 -3.4E+38 3.4E+38 ECU_ADDRESS 0x00403C6C /end MEASUREMENT
/begin MEASUREMENT LCS_IN_kapTraj "" FLOAT32_IEEE PubIfControlLATC_MDL_CM_single 0 0 -3.4E+38 3.4E+38 ECU_ADDRESS 0x00403C70 /end MEASUREMENT
/begin MEASUREMENT LCS_IN_axvRefMs2 "" FLOAT32_IEEE PubIfControlLATC_MDL_CM_single 0 0 -3.4E+38 3.4E+38 ECU_ADDRESS 0x00403C74 /end MEASUREMENT
/begin MEASUREMENT LCS_IN_desLaneA3 "" FLOAT32_IEEE PubIfControlLATC_MDL_CM_single 0 0 -3.4E+38 3.4E+38 ECU_ADDRESS 0x00403C78 /end MEASUREMENT
/begin MEASUREMENT LCS_IN_desLaneA1 "" FLOAT32_IEEE PubIfControlLATC_MDL_CM_single 0 0 -3.4E+38 3.4E+38 ECU_ADDRESS 0x00403C7C /end MEASUREMENT
/begin MEASUREMENT LCS_IN_desLaneA0 "" FLOAT32_IEEE PubIfControlLATC_MDL_CM_single 0 0 -3.4E+38 3.4E+38 ECU_ADDRESS 0x00403C80 /end MEASUREMENT
/begin MEASUREMENT LCS_PreDisCurve_m "" FLOAT32_IEEE PubIfControlLATC_MDL_CM_single 0 0 -3.4E+38 3.4E+38 ECU_ADDRESS 0x00403C84 /end MEASUREMENT
/begin MEASUREMENT LCS_Plan_AyDtlimit "" FLOAT32_IEEE PubIfControlLATC_MDL_CM_single 0 0 -3.4E+38 3.4E+38 ECU_ADDRESS 0x00403C88 /end MEASUREMENT
/begin MEASUREMENT LCS_Plan_FinalpreDis "" FLOAT32_IEEE PubIfControlLATC_MDL_CM_single 0 0 -3.4E+38 3.4E+38 ECU_ADDRESS 0x00403C8C /end MEASUREMENT
/begin MEASUREMENT LCS_CurSteerAngle_deg "" FLOAT32_IEEE PubIfControlLATC_MDL_CM_single 0 0 -3.4E+38 3.4E+38 ECU_ADDRESS 0x00403C90 /end MEASUREMENT
/begin MEASUREMENT LCS_IN_SteerAngleSpd_degs "" FLOAT32_IEEE PubIfControlLATC_MDL_CM_single 0 0 -3.4E+38 3.4E+38 ECU_ADDRESS 0x00403C94 /end MEASUREMENT
/begin MEASUREMENT LCS_EqA0 "" FLOAT32_IEEE PubIfControlLATC_MDL_CM_single 0 0 -3.4E+38 3.4E+38 ECU_ADDRESS 0x00403C98 /end MEASUREMENT
/begin MEASUREMENT LCS_IN_ayvRefMs2 "" FLOAT32_IEEE PubIfControlLATC_MDL_CM_single 0 0 -3.4E+38 3.4E+38 ECU_ADDRESS 0x00403C9C /end MEASUREMENT
/begin MEASUREMENT LCS_IN_alpSideSlipAngle "" FLOAT32_IEEE PubIfControlLATC_MDL_CM_single 0 0 -3.4E+38 3.4E+38 ECU_ADDRESS 0x00403CA0 /end MEASUREMENT
/begin MEASUREMENT LCS_PLAN_TrajectoryX "" FLOAT32_IEEE PubIfControlLATC_MDL_CM_single 0 0 -3.4E+38 3.4E+38 LAYOUT ROW_DIR MATRIX_DIM 11 1 1 ECU_ADDRESS 0x00403CA4 /end MEASUREMENT
/begin MEASUREMENT LCS_PLAN_Trajectory_PlanY "" FLOAT32_IEEE PubIfControlLATC_MDL_CM_single 0 0 -3.4E+38 3.4E+38 LAYOUT ROW_DIR MATRIX_DIM 11 1 1 ECU_ADDRESS 0x00403CD0 /end MEASUREMENT
/begin MEASUREMENT LCS_LATC_PlanT "" FLOAT32_IEEE PubIfControlLATC_MDL_CM_single 0 0 -3.4E+38 3.4E+38 ECU_ADDRESS 0x00403CFC /end MEASUREMENT
/begin MEASUREMENT LCS_LATC_PlanLength "" FLOAT32_IEEE PubIfControlLATC_MDL_CM_single 0 0 -3.4E+38 3.4E+38 ECU_ADDRESS 0x00403D00 /end MEASUREMENT
/begin MEASUREMENT LCS_LATC_PlanAyDt "" FLOAT32_IEEE PubIfControlLATC_MDL_CM_single 0 0 -3.4E+38 3.4E+38 LAYOUT ROW_DIR MATRIX_DIM 11 1 1 ECU_ADDRESS 0x00403D04 /end MEASUREMENT
/begin MEASUREMENT LCS_LATC_CurrentSteerAngleOffset_deg "" FLOAT32_IEEE PubIfControlLATC_MDL_CM_single 0 0 -3.4E+38 3.4E+38 ECU_ADDRESS 0x00403D30 /end MEASUREMENT
/begin MEASUREMENT LCS_LATC_SteerAngleCmd_deg "" FLOAT32_IEEE PubIfControlLATC_MDL_CM_single 0 0 -3.4E+38 3.4E+38 ECU_ADDRESS 0x00403D34 /end MEASUREMENT
/begin MEASUREMENT LCS_LATC_Feedforward_deg "" FLOAT32_IEEE PubIfControlLATC_MDL_CM_single 0 0 -3.4E+38 3.4E+38 ECU_ADDRESS 0x00403D38 /end MEASUREMENT
/begin MEASUREMENT LCS_LATC_Feedback_deg "" FLOAT32_IEEE PubIfControlLATC_MDL_CM_single 0 0 -3.4E+38 3.4E+38 ECU_ADDRESS 0x00403D3C /end MEASUREMENT
/begin MEASUREMENT LCS_LATC_SteerAngleLimit_deg "" FLOAT32_IEEE PubIfControlLATC_MDL_CM_single 0 0 -3.4E+38 3.4E+38 ECU_ADDRESS 0x00403D40 /end MEASUREMENT
/begin MEASUREMENT LCS_LATC_MatrixResult_deg "" FLOAT32_IEEE PubIfControlLATC_MDL_CM_single 0 0 -3.4E+38 3.4E+38 LAYOUT ROW_DIR MATRIX_DIM 6 1 1 ECU_ADDRESS 0x00403D44 /end MEASUREMENT
/begin MEASUREMENT LCS_LATC_TarAngle_deg "" FLOAT32_IEEE PubIfControlLATC_MDL_CM_single 0 0 -3.4E+38 3.4E+38 ECU_ADDRESS 0x00403D5C /end MEASUREMENT
/begin MEASUREMENT LCS_LATC_MPCDeltaT_s "" FLOAT32_IEEE PubIfControlLATC_MDL_CM_single 0 0 -3.4E+38 3.4E+38 ECU_ADDRESS 0x00403D60 /end MEASUREMENT
/begin MEASUREMENT LCS_Trq_Switch "" UBYTE PubIfControlLATC_MDL_CM_uint8 0 0 0 255 ECU_ADDRESS 0x00403D64 /end MEASUREMENT
/begin MEASUREMENT LCS_IN_EPS_FailSts "" UBYTE PubIfControlLATC_MDL_CM_uint8 0 0 0 255 ECU_ADDRESS 0x00403D65 /end MEASUREMENT
/begin MEASUREMENT LCS_IN_EPS_LKATrqOvlDlvdSts "" UBYTE PubIfControlLATC_MDL_CM_uint8 0 0 0 255 ECU_ADDRESS 0x00403D66 /end MEASUREMENT
/begin MEASUREMENT LCS_IN_TarDangerlLevel_Delay2Frame "" UBYTE PubIfControlLATC_MDL_CM_uint8 0 0 0 255 ECU_ADDRESS 0x00403D67 /end MEASUREMENT
/begin MEASUREMENT LCS_IN_TarDangerlLevel "" UBYTE PubIfControlLATC_MDL_CM_uint8 0 0 0 255 ECU_ADDRESS 0x00403D68 /end MEASUREMENT
/begin MEASUREMENT LCS_OUT_AngCmdReqValVld "" UBYTE PubIfControlLATC_MDL_CM_uint8 0 0 0 255 ECU_ADDRESS 0x00403D69 /end MEASUREMENT
/begin MEASUREMENT LCS_Counter "" UBYTE PubIfControlLATC_MDL_CM_uint8 0 0 0 255 ECU_ADDRESS 0x00403D6A /end MEASUREMENT
/begin MEASUREMENT LCS_IN_EPS_LKAAngDlvdSts "" UBYTE PubIfControlLATC_MDL_CM_uint8 0 0 0 255 ECU_ADDRESS 0x00403D6B /end MEASUREMENT
/begin MEASUREMENT LCS_LATC_AngleSlopeFlg_st "" UBYTE PubIfControlLATC_MDL_CM_uint8 0 0 0 255 ECU_ADDRESS 0x00403D6C /end MEASUREMENT
/begin MEASUREMENT LCS_EPSFault "" UBYTE PubIfControlLATC_MDL_CM_uint8 0 0 0 255 ECU_ADDRESS 0x00403D6D /end MEASUREMENT
/begin MEASUREMENT LCS_ESS_NotActiveFlg1 "" UBYTE PubIfControlLATC_MDL_CM_boolean 0 0 0 1 ECU_ADDRESS 0x00403D6E BIT_MASK 0x01 /end MEASUREMENT
/begin MEASUREMENT LCS_ESS_NotActiveFlg2 "" UBYTE PubIfControlLATC_MDL_CM_boolean 0 0 0 1 ECU_ADDRESS 0x00403D6F BIT_MASK 0x01 /end MEASUREMENT
/begin MEASUREMENT LCS_ESS_NotActiveFlg3 "" UBYTE PubIfControlLATC_MDL_CM_boolean 0 0 0 1 ECU_ADDRESS 0x00403D70 BIT_MASK 0x01 /end MEASUREMENT
/begin MEASUREMENT LCS_ESS_NotActiveFlgOriginal "" UBYTE PubIfControlLATC_MDL_CM_boolean 0 0 0 1 ECU_ADDRESS 0x00403D71 BIT_MASK 0x01 /end MEASUREMENT
/begin MEASUREMENT LCS_ESS_NotActiveFlg "" UBYTE PubIfControlLATC_MDL_CM_boolean 0 0 0 1 ECU_ADDRESS 0x00403D72 BIT_MASK 0x01 /end MEASUREMENT
/begin MEASUREMENT LCS_IN_desLaneValid "" UBYTE PubIfControlLATC_MDL_CM_boolean 0 0 0 1 ECU_ADDRESS 0x00403D73 BIT_MASK 0x01 /end MEASUREMENT
/begin MEASUREMENT LCS_OffSetUpdate_Flg "" UBYTE PubIfControlLATC_MDL_CM_boolean 0 0 0 1 ECU_ADDRESS 0x00403D74 BIT_MASK 0x01 /end MEASUREMENT
/begin MEASUREMENT LCS_OverRideDetect_b "" UBYTE PubIfControlLATC_MDL_CM_boolean 0 0 0 1 ECU_ADDRESS 0x00403D75 BIT_MASK 0x01 /end MEASUREMENT
/begin MEASUREMENT LCS_ESS_NotActiveDelayFlg "" UBYTE PubIfControlLATC_MDL_CM_boolean 0 0 0 1 ECU_ADDRESS 0x00403D76 BIT_MASK 0x01 /end MEASUREMENT
/begin MEASUREMENT LSM_UpdateCnt "" ULONG PubIfDecisionLSM_MDL_CM_uint32 0 0 0 4294967295 ECU_ADDRESS 0x0040C118 /end MEASUREMENT
/begin MEASUREMENT LSM_QualityK1 "" FLOAT32_IEEE PubIfDecisionLSM_MDL_CM_single 0 0 -3.4E+38 3.4E+38 ECU_ADDRESS 0x0040C11C /end MEASUREMENT
/begin MEASUREMENT LSM_A3K1 "" FLOAT32_IEEE PubIfDecisionLSM_MDL_CM_single 0 0 -3.4E+38 3.4E+38 ECU_ADDRESS 0x0040C120 /end MEASUREMENT
/begin MEASUREMENT LSM_A2K1 "" FLOAT32_IEEE PubIfDecisionLSM_MDL_CM_single 0 0 -3.4E+38 3.4E+38 ECU_ADDRESS 0x0040C124 /end MEASUREMENT
/begin MEASUREMENT LSM_A1K1 "" FLOAT32_IEEE PubIfDecisionLSM_MDL_CM_single 0 0 -3.4E+38 3.4E+38 ECU_ADDRESS 0x0040C128 /end MEASUREMENT
/begin MEASUREMENT LSM_A0K1 "" FLOAT32_IEEE PubIfDecisionLSM_MDL_CM_single 0 0 -3.4E+38 3.4E+38 ECU_ADDRESS 0x0040C12C /end MEASUREMENT
/begin MEASUREMENT LSM_RangeK1 "" FLOAT32_IEEE PubIfDecisionLSM_MDL_CM_single 0 0 -3.4E+38 3.4E+38 ECU_ADDRESS 0x0040C130 /end MEASUREMENT
/begin MEASUREMENT LSM_tLostK1 "" FLOAT32_IEEE PubIfDecisionLSM_MDL_CM_single 0 0 -3.4E+38 3.4E+38 ECU_ADDRESS 0x0040C134 /end MEASUREMENT
/begin MEASUREMENT LSM_HWALineC0K1 "" FLOAT32_IEEE PubIfDecisionLSM_MDL_CM_single 0 0 -3.4E+38 3.4E+38 ECU_ADDRESS 0x0040C138 /end MEASUREMENT
/begin MEASUREMENT LSM_LH21 "" FLOAT32_IEEE PubIfDecisionLSM_MDL_CM_single 0 0 -3.4E+38 3.4E+38 ECU_ADDRESS 0x0040C13C /end MEASUREMENT
/begin MEASUREMENT LSM_LH22 "" FLOAT32_IEEE PubIfDecisionLSM_MDL_CM_single 0 0 -3.4E+38 3.4E+38 ECU_ADDRESS 0x0040C140 /end MEASUREMENT
/begin MEASUREMENT LSM_LH23 "" FLOAT32_IEEE PubIfDecisionLSM_MDL_CM_single 0 0 -3.4E+38 3.4E+38 ECU_ADDRESS 0x0040C144 /end MEASUREMENT
/begin MEASUREMENT LSM_LH1Wij "" FLOAT32_IEEE PubIfDecisionLSM_MDL_CM_single 0 0 -3.4E+38 3.4E+38 ECU_ADDRESS 0x0040C148 /end MEASUREMENT
/begin MEASUREMENT LSM_LH31 "" FLOAT32_IEEE PubIfDecisionLSM_MDL_CM_single 0 0 -3.4E+38 3.4E+38 ECU_ADDRESS 0x0040C14C /end MEASUREMENT
/begin MEASUREMENT LSM_LH32 "" FLOAT32_IEEE PubIfDecisionLSM_MDL_CM_single 0 0 -3.4E+38 3.4E+38 ECU_ADDRESS 0x0040C150 /end MEASUREMENT
/begin MEASUREMENT LSM_LH33 "" FLOAT32_IEEE PubIfDecisionLSM_MDL_CM_single 0 0 -3.4E+38 3.4E+38 ECU_ADDRESS 0x0040C154 /end MEASUREMENT
/begin MEASUREMENT LSM_LH2Wij "" FLOAT32_IEEE PubIfDecisionLSM_MDL_CM_single 0 0 -3.4E+38 3.4E+38 ECU_ADDRESS 0x0040C158 /end MEASUREMENT
/begin MEASUREMENT LSM_TJALineC3 "" FLOAT32_IEEE PubIfDecisionLSM_MDL_CM_single 0 0 -3.4E+38 3.4E+38 ECU_ADDRESS 0x0040C15C /end MEASUREMENT
/begin MEASUREMENT LSM_LCKLineC0 "" FLOAT32_IEEE PubIfDecisionLSM_MDL_CM_single 0 0 -3.4E+38 3.4E+38 ECU_ADDRESS 0x0040C160 /end MEASUREMENT
/begin MEASUREMENT LSM_LCKRange "" FLOAT32_IEEE PubIfDecisionLSM_MDL_CM_single 0 0 -3.4E+38 3.4E+38 ECU_ADDRESS 0x0040C164 /end MEASUREMENT
/begin MEASUREMENT LSM_HWALineC3 "" FLOAT32_IEEE PubIfDecisionLSM_MDL_CM_single 0 0 -3.4E+38 3.4E+38 ECU_ADDRESS 0x0040C168 /end MEASUREMENT
/begin MEASUREMENT LSM_HWALineC2 "" FLOAT32_IEEE PubIfDecisionLSM_MDL_CM_single 0 0 -3.4E+38 3.4E+38 ECU_ADDRESS 0x0040C16C /end MEASUREMENT
/begin MEASUREMENT LSM_HWALineC1 "" FLOAT32_IEEE PubIfDecisionLSM_MDL_CM_single 0 0 -3.4E+38 3.4E+38 ECU_ADDRESS 0x0040C170 /end MEASUREMENT
/begin MEASUREMENT LSM_HWALeLineC3 "" FLOAT32_IEEE PubIfDecisionLSM_MDL_CM_single 0 0 -3.4E+38 3.4E+38 ECU_ADDRESS 0x0040C174 /end MEASUREMENT
/begin MEASUREMENT LSM_HWALeLineC2 "" FLOAT32_IEEE PubIfDecisionLSM_MDL_CM_single 0 0 -3.4E+38 3.4E+38 ECU_ADDRESS 0x0040C178 /end MEASUREMENT
/begin MEASUREMENT LSM_HWALeLineC1 "" FLOAT32_IEEE PubIfDecisionLSM_MDL_CM_single 0 0 -3.4E+38 3.4E+38 ECU_ADDRESS 0x0040C17C /end MEASUREMENT
/begin MEASUREMENT LSM_HWALeLineC0 "" FLOAT32_IEEE PubIfDecisionLSM_MDL_CM_single 0 0 -3.4E+38 3.4E+38 ECU_ADDRESS 0x0040C180 /end MEASUREMENT
/begin MEASUREMENT LSM_TJALineC2 "" FLOAT32_IEEE PubIfDecisionLSM_MDL_CM_single 0 0 -3.4E+38 3.4E+38 ECU_ADDRESS 0x0040C184 /end MEASUREMENT
/begin MEASUREMENT LSM_HWALeRange "" FLOAT32_IEEE PubIfDecisionLSM_MDL_CM_single 0 0 -3.4E+38 3.4E+38 ECU_ADDRESS 0x0040C188 /end MEASUREMENT
/begin MEASUREMENT LSM_HWALineC0 "" FLOAT32_IEEE PubIfDecisionLSM_MDL_CM_single 0 0 -3.4E+38 3.4E+38 ECU_ADDRESS 0x0040C18C /end MEASUREMENT
/begin MEASUREMENT LSM_HWARange "" FLOAT32_IEEE PubIfDecisionLSM_MDL_CM_single 0 0 -3.4E+38 3.4E+38 ECU_ADDRESS 0x0040C190 /end MEASUREMENT
/begin MEASUREMENT LSM_HWARiLineC1 "" FLOAT32_IEEE PubIfDecisionLSM_MDL_CM_single 0 0 -3.4E+38 3.4E+38 ECU_ADDRESS 0x0040C194 /end MEASUREMENT
/begin MEASUREMENT LSM_HWARiLineC0 "" FLOAT32_IEEE PubIfDecisionLSM_MDL_CM_single 0 0 -3.4E+38 3.4E+38 ECU_ADDRESS 0x0040C198 /end MEASUREMENT
/begin MEASUREMENT LSM_HWARiRange "" FLOAT32_IEEE PubIfDecisionLSM_MDL_CM_single 0 0 -3.4E+38 3.4E+38 ECU_ADDRESS 0x0040C19C /end MEASUREMENT
/begin MEASUREMENT LSM_TJALineC1 "" FLOAT32_IEEE PubIfDecisionLSM_MDL_CM_single 0 0 -3.4E+38 3.4E+38 ECU_ADDRESS 0x0040C1A0 /end MEASUREMENT
/begin MEASUREMENT LSM_HeadAngDiff "" FLOAT32_IEEE PubIfDecisionLSM_MDL_CM_single 0 0 -3.4E+38 3.4E+38 ECU_ADDRESS 0x0040C1A4 /end MEASUREMENT
/begin MEASUREMENT LSM_HWARiLineC3 "" FLOAT32_IEEE PubIfDecisionLSM_MDL_CM_single 0 0 -3.4E+38 3.4E+38 ECU_ADDRESS 0x0040C1A8 /end MEASUREMENT
/begin MEASUREMENT LSM_HWARiLineC2 "" FLOAT32_IEEE PubIfDecisionLSM_MDL_CM_single 0 0 -3.4E+38 3.4E+38 ECU_ADDRESS 0x0040C1AC /end MEASUREMENT
/begin MEASUREMENT LSM_ESSLineC2 "" FLOAT32_IEEE PubIfDecisionLSM_MDL_CM_single 0 0 -3.4E+38 3.4E+38 ECU_ADDRESS 0x0040C1B0 /end MEASUREMENT
/begin MEASUREMENT LSM_ESSLineC1 "" FLOAT32_IEEE PubIfDecisionLSM_MDL_CM_single 0 0 -3.4E+38 3.4E+38 ECU_ADDRESS 0x0040C1B4 /end MEASUREMENT
/begin MEASUREMENT LSM_ESSLineC0 "" FLOAT32_IEEE PubIfDecisionLSM_MDL_CM_single 0 0 -3.4E+38 3.4E+38 ECU_ADDRESS 0x0040C1B8 /end MEASUREMENT
/begin MEASUREMENT LSM_ESSRange "" FLOAT32_IEEE PubIfDecisionLSM_MDL_CM_single 0 0 -3.4E+38 3.4E+38 ECU_ADDRESS 0x0040C1BC /end MEASUREMENT
/begin MEASUREMENT LSM_ESSLeLineC3 "" FLOAT32_IEEE PubIfDecisionLSM_MDL_CM_single 0 0 -3.4E+38 3.4E+38 ECU_ADDRESS 0x0040C1C0 /end MEASUREMENT
/begin MEASUREMENT LSM_TJALineC0 "" FLOAT32_IEEE PubIfDecisionLSM_MDL_CM_single 0 0 -3.4E+38 3.4E+38 ECU_ADDRESS 0x0040C1C4 /end MEASUREMENT
/begin MEASUREMENT LSM_ESSLineC3 "" FLOAT32_IEEE PubIfDecisionLSM_MDL_CM_single 0 0 -3.4E+38 3.4E+38 ECU_ADDRESS 0x0040C1C8 /end MEASUREMENT
/begin MEASUREMENT LSM_ESSLeLineC0 "" FLOAT32_IEEE PubIfDecisionLSM_MDL_CM_single 0 0 -3.4E+38 3.4E+38 ECU_ADDRESS 0x0040C1CC /end MEASUREMENT
/begin MEASUREMENT LSM_ESSLeRange "" FLOAT32_IEEE PubIfDecisionLSM_MDL_CM_single 0 0 -3.4E+38 3.4E+38 ECU_ADDRESS 0x0040C1D0 /end MEASUREMENT
/begin MEASUREMENT LSM_ESSRiLineC3 "" FLOAT32_IEEE PubIfDecisionLSM_MDL_CM_single 0 0 -3.4E+38 3.4E+38 ECU_ADDRESS 0x0040C1D4 /end MEASUREMENT
/begin MEASUREMENT LSM_ESSRiLineC2 "" FLOAT32_IEEE PubIfDecisionLSM_MDL_CM_single 0 0 -3.4E+38 3.4E+38 ECU_ADDRESS 0x0040C1D8 /end MEASUREMENT
/begin MEASUREMENT LSM_ESSRiLineC1 "" FLOAT32_IEEE PubIfDecisionLSM_MDL_CM_single 0 0 -3.4E+38 3.4E+38 ECU_ADDRESS 0x0040C1DC /end MEASUREMENT
/begin MEASUREMENT LSM_ESSLeLineC2 "" FLOAT32_IEEE PubIfDecisionLSM_MDL_CM_single 0 0 -3.4E+38 3.4E+38 ECU_ADDRESS 0x0040C1E0 /end MEASUREMENT
/begin MEASUREMENT LSM_ESSLeLineC1 "" FLOAT32_IEEE PubIfDecisionLSM_MDL_CM_single 0 0 -3.4E+38 3.4E+38 ECU_ADDRESS 0x0040C1E4 /end MEASUREMENT
/begin MEASUREMENT LSM_ESSRiLineC0 "" FLOAT32_IEEE PubIfDecisionLSM_MDL_CM_single 0 0 -3.4E+38 3.4E+38 ECU_ADDRESS 0x0040C1E8 /end MEASUREMENT
/begin MEASUREMENT LSM_TJARange "" FLOAT32_IEEE PubIfDecisionLSM_MDL_CM_single 0 0 -3.4E+38 3.4E+38 ECU_ADDRESS 0x0040C1EC /end MEASUREMENT
/begin MEASUREMENT LSM_ESSRiRange "" FLOAT32_IEEE PubIfDecisionLSM_MDL_CM_single 0 0 -3.4E+38 3.4E+38 ECU_ADDRESS 0x0040C1F0 /end MEASUREMENT
/begin MEASUREMENT LSM_dyDiff "" FLOAT32_IEEE PubIfDecisionLSM_MDL_CM_single 0 0 -3.4E+38 3.4E+38 ECU_ADDRESS 0x0040C1F4 /end MEASUREMENT
/begin MEASUREMENT LSM_RoadWidth "" FLOAT32_IEEE PubIfDecisionLSM_MDL_CM_single 0 0 -3.4E+38 3.4E+38 ECU_ADDRESS 0x0040C1F8 /end MEASUREMENT
/begin MEASUREMENT LSM_LCKLineC3 "" FLOAT32_IEEE PubIfDecisionLSM_MDL_CM_single 0 0 -3.4E+38 3.4E+38 ECU_ADDRESS 0x0040C1FC /end MEASUREMENT
/begin MEASUREMENT LSM_LCKLineC2 "" FLOAT32_IEEE PubIfDecisionLSM_MDL_CM_single 0 0 -3.4E+38 3.4E+38 ECU_ADDRESS 0x0040C200 /end MEASUREMENT
/begin MEASUREMENT LSM_LCKLineC1 "" FLOAT32_IEEE PubIfDecisionLSM_MDL_CM_single 0 0 -3.4E+38 3.4E+38 ECU_ADDRESS 0x0040C204 /end MEASUREMENT
/begin MEASUREMENT LSM_OTL_A3 "" FLOAT32_IEEE PubIfDecisionLSM_MDL_CM_single 0 0 -3.4E+38 3.4E+38 ECU_ADDRESS 0x0040C208 /end MEASUREMENT
/begin MEASUREMENT LSM_OTL_A2 "" FLOAT32_IEEE PubIfDecisionLSM_MDL_CM_single 0 0 -3.4E+38 3.4E+38 ECU_ADDRESS 0x0040C20C /end MEASUREMENT
/begin MEASUREMENT LSM_OTL_A1 "" FLOAT32_IEEE PubIfDecisionLSM_MDL_CM_single 0 0 -3.4E+38 3.4E+38 ECU_ADDRESS 0x0040C210 /end MEASUREMENT
/begin MEASUREMENT LSM_OTL_A0 "" FLOAT32_IEEE PubIfDecisionLSM_MDL_CM_single 0 0 -3.4E+38 3.4E+38 ECU_ADDRESS 0x0040C214 /end MEASUREMENT
/begin MEASUREMENT LSM_OTL_Range "" FLOAT32_IEEE PubIfDecisionLSM_MDL_CM_single 0 0 -3.4E+38 3.4E+38 ECU_ADDRESS 0x0040C218 /end MEASUREMENT
/begin MEASUREMENT LSM_RFM_LineCenter_C0 "" FLOAT32_IEEE PubIfDecisionLSM_MDL_CM_single 0 0 -3.4E+38 3.4E+38 ECU_ADDRESS 0x0040C21C /end MEASUREMENT
/begin MEASUREMENT LSM_RFM_LineL1_C2 "" FLOAT32_IEEE PubIfDecisionLSM_MDL_CM_single 0 0 -3.4E+38 3.4E+38 ECU_ADDRESS 0x0040C220 /end MEASUREMENT
/begin MEASUREMENT LSM_RFM_LineL1_C3 "" FLOAT32_IEEE PubIfDecisionLSM_MDL_CM_single 0 0 -3.4E+38 3.4E+38 ECU_ADDRESS 0x0040C224 /end MEASUREMENT
/begin MEASUREMENT LSM_RFM_LineL1_Start "" FLOAT32_IEEE PubIfDecisionLSM_MDL_CM_single 0 0 -3.4E+38 3.4E+38 ECU_ADDRESS 0x0040C228 /end MEASUREMENT
/begin MEASUREMENT LSM_RFM_LineL1_Front "" FLOAT32_IEEE PubIfDecisionLSM_MDL_CM_single 0 0 -3.4E+38 3.4E+38 ECU_ADDRESS 0x0040C22C /end MEASUREMENT
/begin MEASUREMENT LSM_RFM_LineR1_C2 "" FLOAT32_IEEE PubIfDecisionLSM_MDL_CM_single 0 0 -3.4E+38 3.4E+38 ECU_ADDRESS 0x0040C230 /end MEASUREMENT
/begin MEASUREMENT LSM_RFM_LineR1_C3 "" FLOAT32_IEEE PubIfDecisionLSM_MDL_CM_single 0 0 -3.4E+38 3.4E+38 ECU_ADDRESS 0x0040C234 /end MEASUREMENT
/begin MEASUREMENT LSM_RFM_LineR1_Start "" FLOAT32_IEEE PubIfDecisionLSM_MDL_CM_single 0 0 -3.4E+38 3.4E+38 ECU_ADDRESS 0x0040C238 /end MEASUREMENT
/begin MEASUREMENT LSM_RFM_LineR1_Front "" FLOAT32_IEEE PubIfDecisionLSM_MDL_CM_single 0 0 -3.4E+38 3.4E+38 ECU_ADDRESS 0x0040C23C /end MEASUREMENT
/begin MEASUREMENT LSM_RFM_LineR1_C0 "" FLOAT32_IEEE PubIfDecisionLSM_MDL_CM_single 0 0 -3.4E+38 3.4E+38 ECU_ADDRESS 0x0040C240 /end MEASUREMENT
/begin MEASUREMENT LSM_RFM_LineCenter_C1 "" FLOAT32_IEEE PubIfDecisionLSM_MDL_CM_single 0 0 -3.4E+38 3.4E+38 ECU_ADDRESS 0x0040C244 /end MEASUREMENT
/begin MEASUREMENT LSM_RFM_LineR1_C1 "" FLOAT32_IEEE PubIfDecisionLSM_MDL_CM_single 0 0 -3.4E+38 3.4E+38 ECU_ADDRESS 0x0040C248 /end MEASUREMENT
/begin MEASUREMENT LSM_RFM_LineCenter_C2 "" FLOAT32_IEEE PubIfDecisionLSM_MDL_CM_single 0 0 -3.4E+38 3.4E+38 ECU_ADDRESS 0x0040C24C /end MEASUREMENT
/begin MEASUREMENT LSM_RFM_LineCenter_C3 "" FLOAT32_IEEE PubIfDecisionLSM_MDL_CM_single 0 0 -3.4E+38 3.4E+38 ECU_ADDRESS 0x0040C250 /end MEASUREMENT
/begin MEASUREMENT LSM_RFM_LineCenter_Start "" FLOAT32_IEEE PubIfDecisionLSM_MDL_CM_single 0 0 -3.4E+38 3.4E+38 ECU_ADDRESS 0x0040C254 /end MEASUREMENT
/begin MEASUREMENT LSM_RFM_LineCenter_Front "" FLOAT32_IEEE PubIfDecisionLSM_MDL_CM_single 0 0 -3.4E+38 3.4E+38 ECU_ADDRESS 0x0040C258 /end MEASUREMENT
/begin MEASUREMENT LSM_RFM_LineL1_C0 "" FLOAT32_IEEE PubIfDecisionLSM_MDL_CM_single 0 0 -3.4E+38 3.4E+38 ECU_ADDRESS 0x0040C25C /end MEASUREMENT
/begin MEASUREMENT LSM_RFM_LineL1_C1 "" FLOAT32_IEEE PubIfDecisionLSM_MDL_CM_single 0 0 -3.4E+38 3.4E+38 ECU_ADDRESS 0x0040C260 /end MEASUREMENT
/begin MEASUREMENT LSM_L1_Range "" FLOAT32_IEEE PubIfDecisionLSM_MDL_CM_single 0 0 -3.4E+38 3.4E+38 ECU_ADDRESS 0x0040C264 /end MEASUREMENT
/begin MEASUREMENT LSM_LA_ELEM_0_C1 "" FLOAT32_IEEE PubIfDecisionLSM_MDL_CM_single 0 0 -3.4E+38 3.4E+38 ECU_ADDRESS 0x0040C268 /end MEASUREMENT
/begin MEASUREMENT LSM_LRE_ELEM_1_C0 "" FLOAT32_IEEE PubIfDecisionLSM_MDL_CM_single 0 0 -3.4E+38 3.4E+38 ECU_ADDRESS 0x0040C26C /end MEASUREMENT
/begin MEASUREMENT LSM_LRE_ELEM_1_Range_Start "" FLOAT32_IEEE PubIfDecisionLSM_MDL_CM_single 0 0 -3.4E+38 3.4E+38 ECU_ADDRESS 0x0040C270 /end MEASUREMENT
/begin MEASUREMENT LSM_LA_ELEM_0_C2 "" FLOAT32_IEEE PubIfDecisionLSM_MDL_CM_single 0 0 -3.4E+38 3.4E+38 ECU_ADDRESS 0x0040C274 /end MEASUREMENT
/begin MEASUREMENT LSM_LA_ELEM_0_C3 "" FLOAT32_IEEE PubIfDecisionLSM_MDL_CM_single 0 0 -3.4E+38 3.4E+38 ECU_ADDRESS 0x0040C278 /end MEASUREMENT
/begin MEASUREMENT LSM_LA_ELEM_0_Range_Start "" FLOAT32_IEEE PubIfDecisionLSM_MDL_CM_single 0 0 -3.4E+38 3.4E+38 ECU_ADDRESS 0x0040C27C /end MEASUREMENT
/begin MEASUREMENT LSM_LA_ELEM_0_Range_End "" FLOAT32_IEEE PubIfDecisionLSM_MDL_CM_single 0 0 -3.4E+38 3.4E+38 ECU_ADDRESS 0x0040C280 /end MEASUREMENT
/begin MEASUREMENT LSM_LA_ELEM_0_Marker_Width "" FLOAT32_IEEE PubIfDecisionLSM_MDL_CM_single 0 0 -3.4E+38 3.4E+38 ECU_ADDRESS 0x0040C284 /end MEASUREMENT
/begin MEASUREMENT LSM_LA_ELEM_0_Confidence "" FLOAT32_IEEE PubIfDecisionLSM_MDL_CM_single 0 0 -3.4E+38 3.4E+38 ECU_ADDRESS 0x0040C288 /end MEASUREMENT
/begin MEASUREMENT LSM_LA_ELEM_1_C0 "" FLOAT32_IEEE PubIfDecisionLSM_MDL_CM_single 0 0 -3.4E+38 3.4E+38 ECU_ADDRESS 0x0040C28C /end MEASUREMENT
/begin MEASUREMENT LSM_LA_ELEM_1_C1 "" FLOAT32_IEEE PubIfDecisionLSM_MDL_CM_single 0 0 -3.4E+38 3.4E+38 ECU_ADDRESS 0x0040C290 /end MEASUREMENT
/begin MEASUREMENT LSM_LA_ELEM_1_C2 "" FLOAT32_IEEE PubIfDecisionLSM_MDL_CM_single 0 0 -3.4E+38 3.4E+38 ECU_ADDRESS 0x0040C294 /end MEASUREMENT
/begin MEASUREMENT LSM_LA_ELEM_1_C3 "" FLOAT32_IEEE PubIfDecisionLSM_MDL_CM_single 0 0 -3.4E+38 3.4E+38 ECU_ADDRESS 0x0040C298 /end MEASUREMENT
/begin MEASUREMENT LSM_LA_ELEM_1_Range_Start "" FLOAT32_IEEE PubIfDecisionLSM_MDL_CM_single 0 0 -3.4E+38 3.4E+38 ECU_ADDRESS 0x0040C29C /end MEASUREMENT
/begin MEASUREMENT LSM_LA_ELEM_1_Range_End "" FLOAT32_IEEE PubIfDecisionLSM_MDL_CM_single 0 0 -3.4E+38 3.4E+38 ECU_ADDRESS 0x0040C2A0 /end MEASUREMENT
/begin MEASUREMENT LSM_L2_Range "" FLOAT32_IEEE PubIfDecisionLSM_MDL_CM_single 0 0 -3.4E+38 3.4E+38 ECU_ADDRESS 0x0040C2A4 /end MEASUREMENT
/begin MEASUREMENT LSM_LA_ELEM_1_Confidence "" FLOAT32_IEEE PubIfDecisionLSM_MDL_CM_single 0 0 -3.4E+38 3.4E+38 ECU_ADDRESS 0x0040C2A8 /end MEASUREMENT
/begin MEASUREMENT LSM_LA_ELEM_1_Marker_Width "" FLOAT32_IEEE PubIfDecisionLSM_MDL_CM_single 0 0 -3.4E+38 3.4E+38 ECU_ADDRESS 0x0040C2AC /end MEASUREMENT
/begin MEASUREMENT LSM_LA_ELEM_2_C0 "" FLOAT32_IEEE PubIfDecisionLSM_MDL_CM_single 0 0 -3.4E+38 3.4E+38 ECU_ADDRESS 0x0040C2B0 /end MEASUREMENT
/begin MEASUREMENT LSM_LA_ELEM_2_C1 "" FLOAT32_IEEE PubIfDecisionLSM_MDL_CM_single 0 0 -3.4E+38 3.4E+38 ECU_ADDRESS 0x0040C2B4 /end MEASUREMENT
/begin MEASUREMENT LSM_LA_ELEM_2_C2 "" FLOAT32_IEEE PubIfDecisionLSM_MDL_CM_single 0 0 -3.4E+38 3.4E+38 ECU_ADDRESS 0x0040C2B8 /end MEASUREMENT
/begin MEASUREMENT LSM_LA_ELEM_2_C3 "" FLOAT32_IEEE PubIfDecisionLSM_MDL_CM_single 0 0 -3.4E+38 3.4E+38 ECU_ADDRESS 0x0040C2BC /end MEASUREMENT
/begin MEASUREMENT LSM_LA_ELEM_2_Range_Start "" FLOAT32_IEEE PubIfDecisionLSM_MDL_CM_single 0 0 -3.4E+38 3.4E+38 ECU_ADDRESS 0x0040C2C0 /end MEASUREMENT
/begin MEASUREMENT LSM_LA_ELEM_2_Range_End "" FLOAT32_IEEE PubIfDecisionLSM_MDL_CM_single 0 0 -3.4E+38 3.4E+38 ECU_ADDRESS 0x0040C2C4 /end MEASUREMENT
/begin MEASUREMENT LSM_LA_ELEM_2_Confidence "" FLOAT32_IEEE PubIfDecisionLSM_MDL_CM_single 0 0 -3.4E+38 3.4E+38 ECU_ADDRESS 0x0040C2C8 /end MEASUREMENT
/begin MEASUREMENT LSM_LA_ELEM_2_Marker_Width "" FLOAT32_IEEE PubIfDecisionLSM_MDL_CM_single 0 0 -3.4E+38 3.4E+38 ECU_ADDRESS 0x0040C2CC /end MEASUREMENT
/begin MEASUREMENT LSM_LA_ELEM_3_C0 "" FLOAT32_IEEE PubIfDecisionLSM_MDL_CM_single 0 0 -3.4E+38 3.4E+38 ECU_ADDRESS 0x0040C2D0 /end MEASUREMENT
/begin MEASUREMENT LSM_LA_ELEM_3_C1 "" FLOAT32_IEEE PubIfDecisionLSM_MDL_CM_single 0 0 -3.4E+38 3.4E+38 ECU_ADDRESS 0x0040C2D4 /end MEASUREMENT
/begin MEASUREMENT LSM_LA_ELEM_3_C2 "" FLOAT32_IEEE PubIfDecisionLSM_MDL_CM_single 0 0 -3.4E+38 3.4E+38 ECU_ADDRESS 0x0040C2D8 /end MEASUREMENT
/begin MEASUREMENT LSM_LA_ELEM_3_C3 "" FLOAT32_IEEE PubIfDecisionLSM_MDL_CM_single 0 0 -3.4E+38 3.4E+38 ECU_ADDRESS 0x0040C2DC /end MEASUREMENT
/begin MEASUREMENT LSM_LA_ELEM_3_Range_Start "" FLOAT32_IEEE PubIfDecisionLSM_MDL_CM_single 0 0 -3.4E+38 3.4E+38 ECU_ADDRESS 0x0040C2E0 /end MEASUREMENT
/begin MEASUREMENT LSM_L3_Range "" FLOAT32_IEEE PubIfDecisionLSM_MDL_CM_single 0 0 -3.4E+38 3.4E+38 ECU_ADDRESS 0x0040C2E4 /end MEASUREMENT
/begin MEASUREMENT LSM_LA_ELEM_3_Range_End "" FLOAT32_IEEE PubIfDecisionLSM_MDL_CM_single 0 0 -3.4E+38 3.4E+38 ECU_ADDRESS 0x0040C2E8 /end MEASUREMENT
/begin MEASUREMENT LSM_LA_ELEM_3_Confidence "" FLOAT32_IEEE PubIfDecisionLSM_MDL_CM_single 0 0 -3.4E+38 3.4E+38 ECU_ADDRESS 0x0040C2EC /end MEASUREMENT
/begin MEASUREMENT LSM_LA_ELEM_3_Marker_Width "" FLOAT32_IEEE PubIfDecisionLSM_MDL_CM_single 0 0 -3.4E+38 3.4E+38 ECU_ADDRESS 0x0040C2F0 /end MEASUREMENT
/begin MEASUREMENT LSM_LH_ELEM_0_C0 "" FLOAT32_IEEE PubIfDecisionLSM_MDL_CM_single 0 0 -3.4E+38 3.4E+38 ECU_ADDRESS 0x0040C2F4 /end MEASUREMENT
/begin MEASUREMENT LSM_LH_ELEM_0_C1 "" FLOAT32_IEEE PubIfDecisionLSM_MDL_CM_single 0 0 -3.4E+38 3.4E+38 ECU_ADDRESS 0x0040C2F8 /end MEASUREMENT
/begin MEASUREMENT LSM_LH_ELEM_0_C2 "" FLOAT32_IEEE PubIfDecisionLSM_MDL_CM_single 0 0 -3.4E+38 3.4E+38 ECU_ADDRESS 0x0040C2FC /end MEASUREMENT
/begin MEASUREMENT LSM_LH_ELEM_0_Confidence "" FLOAT32_IEEE PubIfDecisionLSM_MDL_CM_single 0 0 -3.4E+38 3.4E+38 ECU_ADDRESS 0x0040C300 /end MEASUREMENT
/begin MEASUREMENT LSM_LH_ELEM_0_C3 "" FLOAT32_IEEE PubIfDecisionLSM_MDL_CM_single 0 0 -3.4E+38 3.4E+38 ECU_ADDRESS 0x0040C304 /end MEASUREMENT
/begin MEASUREMENT LSM_LH_ELEM_0_VR_End "" FLOAT32_IEEE PubIfDecisionLSM_MDL_CM_single 0 0 -3.4E+38 3.4E+38 ECU_ADDRESS 0x0040C308 /end MEASUREMENT
/begin MEASUREMENT LSM_LH_ELEM_0_Marker_Width "" FLOAT32_IEEE PubIfDecisionLSM_MDL_CM_single 0 0 -3.4E+38 3.4E+38 ECU_ADDRESS 0x0040C30C /end MEASUREMENT
/begin MEASUREMENT LSM_L4_Range "" FLOAT32_IEEE PubIfDecisionLSM_MDL_CM_single 0 0 -3.4E+38 3.4E+38 ECU_ADDRESS 0x0040C310 /end MEASUREMENT
/begin MEASUREMENT LSM_LH_ELEM_0_VR_Start "" FLOAT32_IEEE PubIfDecisionLSM_MDL_CM_single 0 0 -3.4E+38 3.4E+38 ECU_ADDRESS 0x0040C314 /end MEASUREMENT
/begin MEASUREMENT LSM_LH_ELEM_1_C0 "" FLOAT32_IEEE PubIfDecisionLSM_MDL_CM_single 0 0 -3.4E+38 3.4E+38 ECU_ADDRESS 0x0040C318 /end MEASUREMENT
/begin MEASUREMENT LSM_LH_ELEM_1_C1 "" FLOAT32_IEEE PubIfDecisionLSM_MDL_CM_single 0 0 -3.4E+38 3.4E+38 ECU_ADDRESS 0x0040C31C /end MEASUREMENT
/begin MEASUREMENT LSM_LH_ELEM_1_C2 "" FLOAT32_IEEE PubIfDecisionLSM_MDL_CM_single 0 0 -3.4E+38 3.4E+38 ECU_ADDRESS 0x0040C320 /end MEASUREMENT
/begin MEASUREMENT LSM_LH_ELEM_1_Confidence "" FLOAT32_IEEE PubIfDecisionLSM_MDL_CM_single 0 0 -3.4E+38 3.4E+38 ECU_ADDRESS 0x0040C324 /end MEASUREMENT
/begin MEASUREMENT LSM_LH_ELEM_1_C3 "" FLOAT32_IEEE PubIfDecisionLSM_MDL_CM_single 0 0 -3.4E+38 3.4E+38 ECU_ADDRESS 0x0040C328 /end MEASUREMENT
/begin MEASUREMENT LSM_LH_ELEM_1_VR_Start "" FLOAT32_IEEE PubIfDecisionLSM_MDL_CM_single 0 0 -3.4E+38 3.4E+38 ECU_ADDRESS 0x0040C32C /end MEASUREMENT
/begin MEASUREMENT LSM_LH_ELEM_1_Marker_Width "" FLOAT32_IEEE PubIfDecisionLSM_MDL_CM_single 0 0 -3.4E+38 3.4E+38 ECU_ADDRESS 0x0040C330 /end MEASUREMENT
/begin MEASUREMENT LSM_LH_ELEM_1_VR_End "" FLOAT32_IEEE PubIfDecisionLSM_MDL_CM_single 0 0 -3.4E+38 3.4E+38 ECU_ADDRESS 0x0040C334 /end MEASUREMENT
/begin MEASUREMENT LSM_LRE_ELEM_0_C1 "" FLOAT32_IEEE PubIfDecisionLSM_MDL_CM_single 0 0 -3.4E+38 3.4E+38 ECU_ADDRESS 0x0040C338 /end MEASUREMENT
/begin MEASUREMENT LSM_LRE_ELEM_0_C2 "" FLOAT32_IEEE PubIfDecisionLSM_MDL_CM_single 0 0 -3.4E+38 3.4E+38 ECU_ADDRESS 0x0040C33C /end MEASUREMENT
/begin MEASUREMENT LSM_LRE_ELEM_0_C3 "" FLOAT32_IEEE PubIfDecisionLSM_MDL_CM_single 0 0 -3.4E+38 3.4E+38 ECU_ADDRESS 0x0040C340 /end MEASUREMENT
/begin MEASUREMENT LSM_LRE_ELEM_0_Range_End "" FLOAT32_IEEE PubIfDecisionLSM_MDL_CM_single 0 0 -3.4E+38 3.4E+38 ECU_ADDRESS 0x0040C344 /end MEASUREMENT
/begin MEASUREMENT LSM_LA_ELEM_0_C0 "" FLOAT32_IEEE PubIfDecisionLSM_MDL_CM_single 0 0 -3.4E+38 3.4E+38 ECU_ADDRESS 0x0040C348 /end MEASUREMENT
/begin MEASUREMENT LSM_LRE_ELEM_0_Range_Start "" FLOAT32_IEEE PubIfDecisionLSM_MDL_CM_single 0 0 -3.4E+38 3.4E+38 ECU_ADDRESS 0x0040C34C /end MEASUREMENT
/begin MEASUREMENT LSM_LRE_ELEM_0_C0 "" FLOAT32_IEEE PubIfDecisionLSM_MDL_CM_single 0 0 -3.4E+38 3.4E+38 ECU_ADDRESS 0x0040C350 /end MEASUREMENT
/begin MEASUREMENT LSM_LRE_ELEM_0_Confidence "" FLOAT32_IEEE PubIfDecisionLSM_MDL_CM_single 0 0 -3.4E+38 3.4E+38 ECU_ADDRESS 0x0040C354 /end MEASUREMENT
/begin MEASUREMENT LSM_LRE_ELEM_1_Confidence "" FLOAT32_IEEE PubIfDecisionLSM_MDL_CM_single 0 0 -3.4E+38 3.4E+38 ECU_ADDRESS 0x0040C358 /end MEASUREMENT
/begin MEASUREMENT LSM_LRE_ELEM_1_C1 "" FLOAT32_IEEE PubIfDecisionLSM_MDL_CM_single 0 0 -3.4E+38 3.4E+38 ECU_ADDRESS 0x0040C35C /end MEASUREMENT
/begin MEASUREMENT LSM_LRE_ELEM_1_C2 "" FLOAT32_IEEE PubIfDecisionLSM_MDL_CM_single 0 0 -3.4E+38 3.4E+38 ECU_ADDRESS 0x0040C360 /end MEASUREMENT
/begin MEASUREMENT LSM_LRE_ELEM_1_C3 "" FLOAT32_IEEE PubIfDecisionLSM_MDL_CM_single 0 0 -3.4E+38 3.4E+38 ECU_ADDRESS 0x0040C364 /end MEASUREMENT
/begin MEASUREMENT LSM_LRE_ELEM_1_Range_End "" FLOAT32_IEEE PubIfDecisionLSM_MDL_CM_single 0 0 -3.4E+38 3.4E+38 ECU_ADDRESS 0x0040C368 /end MEASUREMENT
/begin MEASUREMENT LSM_EN_C0 "" FLOAT32_IEEE PubIfDecisionLSM_MDL_CM_single 0 0 -3.4E+38 3.4E+38 ECU_ADDRESS 0x0040C36C /end MEASUREMENT
/begin MEASUREMENT LSM_EN_C1 "" FLOAT32_IEEE PubIfDecisionLSM_MDL_CM_single 0 0 -3.4E+38 3.4E+38 ECU_ADDRESS 0x0040C370 /end MEASUREMENT
/begin MEASUREMENT LSM_EN_C2 "" FLOAT32_IEEE PubIfDecisionLSM_MDL_CM_single 0 0 -3.4E+38 3.4E+38 ECU_ADDRESS 0x0040C374 /end MEASUREMENT
/begin MEASUREMENT LSM_EN_C3 "" FLOAT32_IEEE PubIfDecisionLSM_MDL_CM_single 0 0 -3.4E+38 3.4E+38 ECU_ADDRESS 0x0040C378 /end MEASUREMENT
/begin MEASUREMENT LSM_EN_Start "" FLOAT32_IEEE PubIfDecisionLSM_MDL_CM_single 0 0 -3.4E+38 3.4E+38 ECU_ADDRESS 0x0040C37C /end MEASUREMENT
/begin MEASUREMENT LSM_EN_Front "" FLOAT32_IEEE PubIfDecisionLSM_MDL_CM_single 0 0 -3.4E+38 3.4E+38 ECU_ADDRESS 0x0040C380 /end MEASUREMENT
/begin MEASUREMENT LSM_Exit_C0 "" FLOAT32_IEEE PubIfDecisionLSM_MDL_CM_single 0 0 -3.4E+38 3.4E+38 ECU_ADDRESS 0x0040C384 /end MEASUREMENT
/begin MEASUREMENT LSM_Exit_C1 "" FLOAT32_IEEE PubIfDecisionLSM_MDL_CM_single 0 0 -3.4E+38 3.4E+38 ECU_ADDRESS 0x0040C388 /end MEASUREMENT
/begin MEASUREMENT LSM_Exit_C2 "" FLOAT32_IEEE PubIfDecisionLSM_MDL_CM_single 0 0 -3.4E+38 3.4E+38 ECU_ADDRESS 0x0040C38C /end MEASUREMENT
/begin MEASUREMENT LSM_Exit_C3 "" FLOAT32_IEEE PubIfDecisionLSM_MDL_CM_single 0 0 -3.4E+38 3.4E+38 ECU_ADDRESS 0x0040C390 /end MEASUREMENT
/begin MEASUREMENT LSM_Exit_Start "" FLOAT32_IEEE PubIfDecisionLSM_MDL_CM_single 0 0 -3.4E+38 3.4E+38 ECU_ADDRESS 0x0040C394 /end MEASUREMENT
/begin MEASUREMENT LSM_Exit_Front "" FLOAT32_IEEE PubIfDecisionLSM_MDL_CM_single 0 0 -3.4E+38 3.4E+38 ECU_ADDRESS 0x0040C398 /end MEASUREMENT
/begin MEASUREMENT LSM_L3_AvaliTime "" FLOAT32_IEEE PubIfDecisionLSM_MDL_CM_single 0 0 -3.4E+38 3.4E+38 ECU_ADDRESS 0x0040C39C /end MEASUREMENT
/begin MEASUREMENT LSM_L2_AvaliTime "" FLOAT32_IEEE PubIfDecisionLSM_MDL_CM_single 0 0 -3.4E+38 3.4E+38 ECU_ADDRESS 0x0040C3A0 /end MEASUREMENT
/begin MEASUREMENT LSM_L1_AvaliDis "" FLOAT32_IEEE PubIfDecisionLSM_MDL_CM_single 0 0 -3.4E+38 3.4E+38 ECU_ADDRESS 0x0040C3A4 /end MEASUREMENT
/begin MEASUREMENT LSM_L2_AvaliDis "" FLOAT32_IEEE PubIfDecisionLSM_MDL_CM_single 0 0 -3.4E+38 3.4E+38 ECU_ADDRESS 0x0040C3A8 /end MEASUREMENT
/begin MEASUREMENT LSM_L1_AvaliTime "" FLOAT32_IEEE PubIfDecisionLSM_MDL_CM_single 0 0 -3.4E+38 3.4E+38 ECU_ADDRESS 0x0040C3AC /end MEASUREMENT
/begin MEASUREMENT LSM_L4_AvaliTime "" FLOAT32_IEEE PubIfDecisionLSM_MDL_CM_single 0 0 -3.4E+38 3.4E+38 ECU_ADDRESS 0x0040C3B0 /end MEASUREMENT
/begin MEASUREMENT LSM_L3_AvaliDis "" FLOAT32_IEEE PubIfDecisionLSM_MDL_CM_single 0 0 -3.4E+38 3.4E+38 ECU_ADDRESS 0x0040C3B4 /end MEASUREMENT
/begin MEASUREMENT LSM_L4_AvaliDis "" FLOAT32_IEEE PubIfDecisionLSM_MDL_CM_single 0 0 -3.4E+38 3.4E+38 ECU_ADDRESS 0x0040C3B8 /end MEASUREMENT
/begin MEASUREMENT LSM_L1_A0 "" FLOAT32_IEEE PubIfDecisionLSM_MDL_CM_single 0 0 -3.4E+38 3.4E+38 ECU_ADDRESS 0x0040C3BC /end MEASUREMENT
/begin MEASUREMENT LSM_L2_A0 "" FLOAT32_IEEE PubIfDecisionLSM_MDL_CM_single 0 0 -3.4E+38 3.4E+38 ECU_ADDRESS 0x0040C3C0 /end MEASUREMENT
/begin MEASUREMENT LSM_L3_A0 "" FLOAT32_IEEE PubIfDecisionLSM_MDL_CM_single 0 0 -3.4E+38 3.4E+38 ECU_ADDRESS 0x0040C3C4 /end MEASUREMENT
/begin MEASUREMENT LSM_L4_A0 "" FLOAT32_IEEE PubIfDecisionLSM_MDL_CM_single 0 0 -3.4E+38 3.4E+38 ECU_ADDRESS 0x0040C3C8 /end MEASUREMENT
/begin MEASUREMENT LSM_CurDis2 "" FLOAT32_IEEE PubIfDecisionLSM_MDL_CM_single 0 0 -3.4E+38 3.4E+38 ECU_ADDRESS 0x0040C3CC /end MEASUREMENT
/begin MEASUREMENT LSM_DeltaDis2 "" FLOAT32_IEEE PubIfDecisionLSM_MDL_CM_single 0 0 -3.4E+38 3.4E+38 ECU_ADDRESS 0x0040C3D0 /end MEASUREMENT
/begin MEASUREMENT LSM_CurDis3 "" FLOAT32_IEEE PubIfDecisionLSM_MDL_CM_single 0 0 -3.4E+38 3.4E+38 ECU_ADDRESS 0x0040C3D4 /end MEASUREMENT
/begin MEASUREMENT LSM_DeltaDis3 "" FLOAT32_IEEE PubIfDecisionLSM_MDL_CM_single 0 0 -3.4E+38 3.4E+38 ECU_ADDRESS 0x0040C3D8 /end MEASUREMENT
/begin MEASUREMENT LSM_RoadWidth1 "" FLOAT32_IEEE PubIfDecisionLSM_MDL_CM_single 0 0 -3.4E+38 3.4E+38 ECU_ADDRESS 0x0040C3DC /end MEASUREMENT
/begin MEASUREMENT LSM_CentLineA3 "" FLOAT32_IEEE PubIfDecisionLSM_MDL_CM_single 0 0 -3.4E+38 3.4E+38 ECU_ADDRESS 0x0040C3E0 /end MEASUREMENT
/begin MEASUREMENT LSM_CentLineA2 "" FLOAT32_IEEE PubIfDecisionLSM_MDL_CM_single 0 0 -3.4E+38 3.4E+38 ECU_ADDRESS 0x0040C3E4 /end MEASUREMENT
/begin MEASUREMENT LSM_CentLineA1 "" FLOAT32_IEEE PubIfDecisionLSM_MDL_CM_single 0 0 -3.4E+38 3.4E+38 ECU_ADDRESS 0x0040C3E8 /end MEASUREMENT
/begin MEASUREMENT LSM_CentLineA0 "" FLOAT32_IEEE PubIfDecisionLSM_MDL_CM_single 0 0 -3.4E+38 3.4E+38 ECU_ADDRESS 0x0040C3EC /end MEASUREMENT
/begin MEASUREMENT LSM_CentLineRange "" FLOAT32_IEEE PubIfDecisionLSM_MDL_CM_single 0 0 -3.4E+38 3.4E+38 ECU_ADDRESS 0x0040C3F0 /end MEASUREMENT
/begin MEASUREMENT LSM_CentQ "" FLOAT32_IEEE PubIfDecisionLSM_MDL_CM_single 0 0 -3.4E+38 3.4E+38 ECU_ADDRESS 0x0040C3F4 /end MEASUREMENT
/begin MEASUREMENT LSM_dDeltaX "" FLOAT32_IEEE PubIfDecisionLSM_MDL_CM_single 0 0 -3.4E+38 3.4E+38 ECU_ADDRESS 0x0040C3F8 /end MEASUREMENT
/begin MEASUREMENT LSM_dDeltaY "" FLOAT32_IEEE PubIfDecisionLSM_MDL_CM_single 0 0 -3.4E+38 3.4E+38 ECU_ADDRESS 0x0040C3FC /end MEASUREMENT
/begin MEASUREMENT LSM_CosOfPsi "" FLOAT32_IEEE PubIfDecisionLSM_MDL_CM_single 0 0 -3.4E+38 3.4E+38 ECU_ADDRESS 0x0040C400 /end MEASUREMENT
/begin MEASUREMENT LSM_SinOfsi "" FLOAT32_IEEE PubIfDecisionLSM_MDL_CM_single 0 0 -3.4E+38 3.4E+38 ECU_ADDRESS 0x0040C404 /end MEASUREMENT
/begin MEASUREMENT LSM_TJA_Line_State1 "" UBYTE PubIfDecisionLSM_MDL_CM_uint8 0 0 0 255 ECU_ADDRESS 0x0040C408 /end MEASUREMENT
/begin MEASUREMENT LSM_HWASts "" UBYTE PubIfDecisionLSM_MDL_CM_uint8 0 0 0 255 ECU_ADDRESS 0x0040C409 /end MEASUREMENT
/begin MEASUREMENT LSM_OTL_Count "" UBYTE PubIfDecisionLSM_MDL_CM_uint8 0 0 0 255 ECU_ADDRESS 0x0040C40A /end MEASUREMENT
/begin MEASUREMENT LSM_RFM_LineCenter_Valid "" UBYTE PubIfDecisionLSM_MDL_CM_uint8 0 0 0 255 ECU_ADDRESS 0x0040C40B /end MEASUREMENT
/begin MEASUREMENT LSM_RFM_LineR1_Valid "" UBYTE PubIfDecisionLSM_MDL_CM_uint8 0 0 0 255 ECU_ADDRESS 0x0040C40C /end MEASUREMENT
/begin MEASUREMENT LSM_RFM_LineL1_Valid "" UBYTE PubIfDecisionLSM_MDL_CM_uint8 0 0 0 255 ECU_ADDRESS 0x0040C40D /end MEASUREMENT
/begin MEASUREMENT LSM_L1_Conf "" UBYTE PubIfDecisionLSM_MDL_CM_uint8 0 0 0 255 ECU_ADDRESS 0x0040C40E /end MEASUREMENT
/begin MEASUREMENT LSM_LRE_ELEM_1_Line_Side "" UBYTE PubIfDecisionLSM_MDL_CM_uint8 0 0 0 255 ECU_ADDRESS 0x0040C40F /end MEASUREMENT
/begin MEASUREMENT LSM_LA_ELEM_0_Availability_State "" UBYTE PubIfDecisionLSM_MDL_CM_uint8 0 0 0 255 ECU_ADDRESS 0x0040C410 /end MEASUREMENT
/begin MEASUREMENT LSM_LA_ELEM_0_Lanemark_Type "" UBYTE PubIfDecisionLSM_MDL_CM_uint8 0 0 0 255 ECU_ADDRESS 0x0040C411 /end MEASUREMENT
/begin MEASUREMENT LSM_LA_ELEM_0_DLM_Type "" UBYTE PubIfDecisionLSM_MDL_CM_uint8 0 0 0 255 ECU_ADDRESS 0x0040C412 /end MEASUREMENT
/begin MEASUREMENT LSM_LA_ELEM_0_Line_Side "" UBYTE PubIfDecisionLSM_MDL_CM_uint8 0 0 0 255 ECU_ADDRESS 0x0040C413 /end MEASUREMENT
/begin MEASUREMENT LSM_L2_Conf "" UBYTE PubIfDecisionLSM_MDL_CM_uint8 0 0 0 255 ECU_ADDRESS 0x0040C414 /end MEASUREMENT
/begin MEASUREMENT LSM_LA_ELEM_1_Availability_State "" UBYTE PubIfDecisionLSM_MDL_CM_uint8 0 0 0 255 ECU_ADDRESS 0x0040C415 /end MEASUREMENT
/begin MEASUREMENT LSM_LA_ELEM_1_Lanemark_Type "" UBYTE PubIfDecisionLSM_MDL_CM_uint8 0 0 0 255 ECU_ADDRESS 0x0040C416 /end MEASUREMENT
/begin MEASUREMENT LSM_LA_ELEM_1_DLM_Type "" UBYTE PubIfDecisionLSM_MDL_CM_uint8 0 0 0 255 ECU_ADDRESS 0x0040C417 /end MEASUREMENT
/begin MEASUREMENT LSM_LA_ELEM_1_Line_Side "" UBYTE PubIfDecisionLSM_MDL_CM_uint8 0 0 0 255 ECU_ADDRESS 0x0040C418 /end MEASUREMENT
/begin MEASUREMENT LSM_LA_ELEM_2_Availability_State "" UBYTE PubIfDecisionLSM_MDL_CM_uint8 0 0 0 255 ECU_ADDRESS 0x0040C419 /end MEASUREMENT
/begin MEASUREMENT LSM_L3_Conf "" UBYTE PubIfDecisionLSM_MDL_CM_uint8 0 0 0 255 ECU_ADDRESS 0x0040C41A /end MEASUREMENT
/begin MEASUREMENT LSM_LA_ELEM_2_Lanemark_Type "" UBYTE PubIfDecisionLSM_MDL_CM_uint8 0 0 0 255 ECU_ADDRESS 0x0040C41B /end MEASUREMENT
/begin MEASUREMENT LSM_LA_ELEM_2_DLM_Type "" UBYTE PubIfDecisionLSM_MDL_CM_uint8 0 0 0 255 ECU_ADDRESS 0x0040C41C /end MEASUREMENT
/begin MEASUREMENT LSM_LA_ELEM_2_Line_Side "" UBYTE PubIfDecisionLSM_MDL_CM_uint8 0 0 0 255 ECU_ADDRESS 0x0040C41D /end MEASUREMENT
/begin MEASUREMENT LSM_LA_ELEM_3_Availability_State "" UBYTE PubIfDecisionLSM_MDL_CM_uint8 0 0 0 255 ECU_ADDRESS 0x0040C41E /end MEASUREMENT
/begin MEASUREMENT LSM_LA_ELEM_3_Lanemark_Type "" UBYTE PubIfDecisionLSM_MDL_CM_uint8 0 0 0 255 ECU_ADDRESS 0x0040C41F /end MEASUREMENT
/begin MEASUREMENT LSM_LA_ELEM_3_DLM_Type "" UBYTE PubIfDecisionLSM_MDL_CM_uint8 0 0 0 255 ECU_ADDRESS 0x0040C420 /end MEASUREMENT
/begin MEASUREMENT LSM_LA_ELEM_3_Line_Side "" UBYTE PubIfDecisionLSM_MDL_CM_uint8 0 0 0 255 ECU_ADDRESS 0x0040C421 /end MEASUREMENT
/begin MEASUREMENT LSM_LH_Count "" UBYTE PubIfDecisionLSM_MDL_CM_uint8 0 0 0 255 ECU_ADDRESS 0x0040C422 /end MEASUREMENT
/begin MEASUREMENT LSM_L4_Conf "" UBYTE PubIfDecisionLSM_MDL_CM_uint8 0 0 0 255 ECU_ADDRESS 0x0040C423 /end MEASUREMENT
/begin MEASUREMENT LSM_LH_ELEM_0_Availability_State "" UBYTE PubIfDecisionLSM_MDL_CM_uint8 0 0 0 255 ECU_ADDRESS 0x0040C424 /end MEASUREMENT
/begin MEASUREMENT LSM_LH_ELEM_0_Lanemark_Type "" UBYTE PubIfDecisionLSM_MDL_CM_uint8 0 0 0 255 ECU_ADDRESS 0x0040C425 /end MEASUREMENT
/begin MEASUREMENT LSM_LH_ELEM_0_DLM_Type "" UBYTE PubIfDecisionLSM_MDL_CM_uint8 0 0 0 255 ECU_ADDRESS 0x0040C426 /end MEASUREMENT
/begin MEASUREMENT LSM_LH_ELEM_0_Line_Side "" UBYTE PubIfDecisionLSM_MDL_CM_uint8 0 0 0 255 ECU_ADDRESS 0x0040C427 /end MEASUREMENT
/begin MEASUREMENT LSM_LH_ELEM_0_Crossing "" UBYTE PubIfDecisionLSM_MDL_CM_uint8 0 0 0 255 ECU_ADDRESS 0x0040C428 /end MEASUREMENT
/begin MEASUREMENT LSM_LH_ELEM_1_Availability_State "" UBYTE PubIfDecisionLSM_MDL_CM_uint8 0 0 0 255 ECU_ADDRESS 0x0040C429 /end MEASUREMENT
/begin MEASUREMENT LSM_LH_ELEM_1_Lanemark_Type "" UBYTE PubIfDecisionLSM_MDL_CM_uint8 0 0 0 255 ECU_ADDRESS 0x0040C42A /end MEASUREMENT
/begin MEASUREMENT LSM_LH_ELEM_1_DLM_Type "" UBYTE PubIfDecisionLSM_MDL_CM_uint8 0 0 0 255 ECU_ADDRESS 0x0040C42B /end MEASUREMENT
/begin MEASUREMENT LSM_LA_Adjacent_Count "" UBYTE PubIfDecisionLSM_MDL_CM_uint8 0 0 0 255 ECU_ADDRESS 0x0040C42C /end MEASUREMENT
/begin MEASUREMENT LSM_LH_ELEM_1_Line_Side "" UBYTE PubIfDecisionLSM_MDL_CM_uint8 0 0 0 255 ECU_ADDRESS 0x0040C42D /end MEASUREMENT
/begin MEASUREMENT LSM_LH_ELEM_1_Crossing "" UBYTE PubIfDecisionLSM_MDL_CM_uint8 0 0 0 255 ECU_ADDRESS 0x0040C42E /end MEASUREMENT
/begin MEASUREMENT LSM_LRE_Count "" UBYTE PubIfDecisionLSM_MDL_CM_uint8 0 0 0 255 ECU_ADDRESS 0x0040C42F /end MEASUREMENT
/begin MEASUREMENT LSM_LRE_ELEM_0_Line_Side "" UBYTE PubIfDecisionLSM_MDL_CM_uint8 0 0 0 255 ECU_ADDRESS 0x0040C430 /end MEASUREMENT
/begin MEASUREMENT LSM_LRE_ELEM_0_Availability_State "" UBYTE PubIfDecisionLSM_MDL_CM_uint8 0 0 0 255 ECU_ADDRESS 0x0040C431 /end MEASUREMENT
/begin MEASUREMENT LSM_LRE_ELEM_1_Availability_State "" UBYTE PubIfDecisionLSM_MDL_CM_uint8 0 0 0 255 ECU_ADDRESS 0x0040C432 /end MEASUREMENT
/begin MEASUREMENT LSM_EN_Valid "" UBYTE PubIfDecisionLSM_MDL_CM_uint8 0 0 0 255 ECU_ADDRESS 0x0040C433 /end MEASUREMENT
/begin MEASUREMENT LSM_Exit_Valid "" UBYTE PubIfDecisionLSM_MDL_CM_uint8 0 0 0 255 ECU_ADDRESS 0x0040C434 /end MEASUREMENT
/begin MEASUREMENT LSM_LeftLineConf "" UBYTE PubIfDecisionLSM_MDL_CM_uint8 0 0 0 255 ECU_ADDRESS 0x0040C435 /end MEASUREMENT
/begin MEASUREMENT LSM_RightLineConf "" UBYTE PubIfDecisionLSM_MDL_CM_uint8 0 0 0 255 ECU_ADDRESS 0x0040C436 /end MEASUREMENT
/begin MEASUREMENT LSM_TJA_Line_State "" UBYTE PubIfDecisionLSM_MDL_CM_uint8 0 0 0 255 ECU_ADDRESS 0x0040C437 /end MEASUREMENT
/begin MEASUREMENT LSM_Wij_State "" UBYTE PubIfDecisionLSM_MDL_CM_uint8 0 0 0 255 ECU_ADDRESS 0x0040C438 /end MEASUREMENT
/begin MEASUREMENT LSM_Line_State "" UBYTE PubIfDecisionLSM_MDL_CM_uint8 0 0 0 255 ECU_ADDRESS 0x0040C439 /end MEASUREMENT
/begin MEASUREMENT LSM_LockCounter "" UBYTE PubIfDecisionLSM_MDL_CM_uint8 0 0 0 255 ECU_ADDRESS 0x0040C43A /end MEASUREMENT
/begin MEASUREMENT LSM_MoveID "" SBYTE PubIfDecisionLSM_MDL_CM_int8 0 0 -128 127 ECU_ADDRESS 0x0040C43B /end MEASUREMENT
/begin MEASUREMENT LSM_LockID "" SBYTE PubIfDecisionLSM_MDL_CM_int8 0 0 -128 127 ECU_ADDRESS 0x0040C43C /end MEASUREMENT
/begin MEASUREMENT LSM_LineValidK1 "" UBYTE PubIfDecisionLSM_MDL_CM_boolean 0 0 0 1 ECU_ADDRESS 0x0040C43D BIT_MASK 0x01 /end MEASUREMENT
/begin MEASUREMENT LSM_LeftMostLane "" UBYTE PubIfDecisionLSM_MDL_CM_boolean 0 0 0 1 ECU_ADDRESS 0x0040C43E BIT_MASK 0x01 /end MEASUREMENT
/begin MEASUREMENT LSM_TJALineValid "" UBYTE PubIfDecisionLSM_MDL_CM_boolean 0 0 0 1 ECU_ADDRESS 0x0040C43F BIT_MASK 0x01 /end MEASUREMENT
/begin MEASUREMENT LSM_HWALineValid "" UBYTE PubIfDecisionLSM_MDL_CM_boolean 0 0 0 1 ECU_ADDRESS 0x0040C440 BIT_MASK 0x01 /end MEASUREMENT
/begin MEASUREMENT LSM_HWARiLineValid "" UBYTE PubIfDecisionLSM_MDL_CM_boolean 0 0 0 1 ECU_ADDRESS 0x0040C441 BIT_MASK 0x01 /end MEASUREMENT
/begin MEASUREMENT LSM_HWALeLineValid "" UBYTE PubIfDecisionLSM_MDL_CM_boolean 0 0 0 1 ECU_ADDRESS 0x0040C442 BIT_MASK 0x01 /end MEASUREMENT
/begin MEASUREMENT LSM_DoubleLineLost_b "" UBYTE PubIfDecisionLSM_MDL_CM_boolean 0 0 0 1 ECU_ADDRESS 0x0040C443 BIT_MASK 0x01 /end MEASUREMENT
/begin MEASUREMENT LSM_ESSLeLineValid "" UBYTE PubIfDecisionLSM_MDL_CM_boolean 0 0 0 1 ECU_ADDRESS 0x0040C444 BIT_MASK 0x01 /end MEASUREMENT
/begin MEASUREMENT LSM_ESSLineValid "" UBYTE PubIfDecisionLSM_MDL_CM_boolean 0 0 0 1 ECU_ADDRESS 0x0040C445 BIT_MASK 0x01 /end MEASUREMENT
/begin MEASUREMENT LSM_ESSRiLineValid "" UBYTE PubIfDecisionLSM_MDL_CM_boolean 0 0 0 1 ECU_ADDRESS 0x0040C446 BIT_MASK 0x01 /end MEASUREMENT
/begin MEASUREMENT LSM_LCKLineValid "" UBYTE PubIfDecisionLSM_MDL_CM_boolean 0 0 0 1 ECU_ADDRESS 0x0040C447 BIT_MASK 0x01 /end MEASUREMENT
/begin MEASUREMENT LSM_MLeLane "" UBYTE PubIfDecisionLSM_MDL_CM_boolean 0 0 0 1 ECU_ADDRESS 0x0040C448 BIT_MASK 0x01 /end MEASUREMENT
/begin MEASUREMENT LSM_LeftLaneChange "" UBYTE PubIfDecisionLSM_MDL_CM_boolean 0 0 0 1 ECU_ADDRESS 0x0040C449 BIT_MASK 0x01 /end MEASUREMENT
/begin MEASUREMENT LSM_RightLaneChange "" UBYTE PubIfDecisionLSM_MDL_CM_boolean 0 0 0 1 ECU_ADDRESS 0x0040C44A BIT_MASK 0x01 /end MEASUREMENT
/begin MEASUREMENT LSM_OTLineValid "" UBYTE PubIfDecisionLSM_MDL_CM_boolean 0 0 0 1 ECU_ADDRESS 0x0040C44B BIT_MASK 0x01 /end MEASUREMENT
/begin MEASUREMENT LSM_SingleLineLost_b "" UBYTE PubIfDecisionLSM_MDL_CM_boolean 0 0 0 1 ECU_ADDRESS 0x0040C44C BIT_MASK 0x01 /end MEASUREMENT
/begin MEASUREMENT LSM_PathLaneAvail "" UBYTE PubIfDecisionLSM_MDL_CM_boolean 0 0 0 1 LAYOUT ROW_DIR MATRIX_DIM 3 1 1 ECU_ADDRESS 0x0040C450 BIT_MASK 0x01 /end MEASUREMENT
/begin MEASUREMENT LSM_LeftOffset_b "" UBYTE PubIfDecisionLSM_MDL_CM_boolean 0 0 0 1 ECU_ADDRESS 0x0040C453 BIT_MASK 0x01 /end MEASUREMENT
/begin MEASUREMENT LSM_RightOffset_b "" UBYTE PubIfDecisionLSM_MDL_CM_boolean 0 0 0 1 ECU_ADDRESS 0x0040C454 BIT_MASK 0x01 /end MEASUREMENT
/begin MEASUREMENT LSM_LeftLineTypeEN "" UBYTE PubIfDecisionLSM_MDL_CM_boolean 0 0 0 1 ECU_ADDRESS 0x0040C455 BIT_MASK 0x01 /end MEASUREMENT
/begin MEASUREMENT LSM_RightLineTypeEN "" UBYTE PubIfDecisionLSM_MDL_CM_boolean 0 0 0 1 ECU_ADDRESS 0x0040C456 BIT_MASK 0x01 /end MEASUREMENT
/begin MEASUREMENT LSM_DOP_EN "" UBYTE PubIfDecisionLSM_MDL_CM_boolean 0 0 0 1 ECU_ADDRESS 0x0040C457 BIT_MASK 0x01 /end MEASUREMENT
/begin MEASUREMENT LSM_DOP_Out "" UBYTE PubIfDecisionLSM_MDL_CM_boolean 0 0 0 1 ECU_ADDRESS 0x0040C458 BIT_MASK 0x01 /end MEASUREMENT
/begin MEASUREMENT LSM_LH1Valid "" UBYTE PubIfDecisionLSM_MDL_CM_boolean 0 0 0 1 ECU_ADDRESS 0x0040C459 BIT_MASK 0x01 /end MEASUREMENT
/begin MEASUREMENT LSM_LH2Valid "" UBYTE PubIfDecisionLSM_MDL_CM_boolean 0 0 0 1 ECU_ADDRESS 0x0040C45A BIT_MASK 0x01 /end MEASUREMENT
/begin MEASUREMENT LSM_CentLineValid "" UBYTE PubIfDecisionLSM_MDL_CM_boolean 0 0 0 1 ECU_ADDRESS 0x0040C45B BIT_MASK 0x01 /end MEASUREMENT
/begin MEASUREMENT LSM_VisLineUpdate "" UBYTE PubIfDecisionLSM_MDL_CM_boolean 0 0 0 1 ECU_ADDRESS 0x0040C45C BIT_MASK 0x01 /end MEASUREMENT
/begin MEASUREMENT LongCtrl_ICEActWheelTrq "" FLOAT64_IEEE PubIfControlLONC_MDL_CM_double 0 0 -1.7E+308 1.7E+308 ECU_ADDRESS 0x00404228 /end MEASUREMENT
/begin MEASUREMENT LongCtrl_VLCState "" FLOAT64_IEEE PubIfControlLONC_MDL_CM_double 0 0 -1.7E+308 1.7E+308 ECU_ADDRESS 0x00404230 /end MEASUREMENT
/begin MEASUREMENT LongCtrl_tECDC "" FLOAT64_IEEE PubIfControlLONC_MDL_CM_double 0 0 -1.7E+308 1.7E+308 ECU_ADDRESS 0x00404238 /end MEASUREMENT
/begin MEASUREMENT LongCtrl_SubModel_VERSION "" ULONG PubIfControlLONC_MDL_CM_uint32 0 0 0 4294967295 ECU_ADDRESS 0x00404240 /end MEASUREMENT
/begin MEASUREMENT LongCtrl_SubModel_Number "" ULONG PubIfControlLONC_MDL_CM_uint32 0 0 0 4294967295 ECU_ADDRESS 0x00404244 /end MEASUREMENT
/begin MEASUREMENT LongCtrl_vxvRefMs "" FLOAT32_IEEE PubIfControlLONC_MDL_CM_single 0 0 -3.4E+38 3.4E+38 ECU_ADDRESS 0x00404248 /end MEASUREMENT
/begin MEASUREMENT LongCtrl_axvRoadSlopeMs2 "" FLOAT32_IEEE PubIfControlLONC_MDL_CM_single 0 0 -3.4E+38 3.4E+38 ECU_ADDRESS 0x0040424C /end MEASUREMENT
/begin MEASUREMENT LongCtrl_accelHoldMin "" FLOAT32_IEEE PubIfControlLONC_MDL_CM_single 0 0 -3.4E+38 3.4E+38 ECU_ADDRESS 0x00404250 /end MEASUREMENT
/begin MEASUREMENT LongCtrl_jerkHold "" FLOAT32_IEEE PubIfControlLONC_MDL_CM_single 0 0 -3.4E+38 3.4E+38 ECU_ADDRESS 0x00404254 /end MEASUREMENT
/begin MEASUREMENT LongCtrl_accelSlidHold "" FLOAT32_IEEE PubIfControlLONC_MDL_CM_single 0 0 -3.4E+38 3.4E+38 ECU_ADDRESS 0x00404258 /end MEASUREMENT
/begin MEASUREMENT LongCtrl_jerkSlidHold "" FLOAT32_IEEE PubIfControlLONC_MDL_CM_single 0 0 -3.4E+38 3.4E+38 ECU_ADDRESS 0x0040425C /end MEASUREMENT
/begin MEASUREMENT LongCtrl_OverrideToDC "" FLOAT32_IEEE PubIfControlLONC_MDL_CM_single 0 0 -3.4E+38 3.4E+38 ECU_ADDRESS 0x00404260 /end MEASUREMENT
/begin MEASUREMENT Longctrl_NetEngTrq "" FLOAT32_IEEE PubIfControlLONC_MDL_CM_single 0 0 -3.4E+38 3.4E+38 ECU_ADDRESS 0x00404264 /end MEASUREMENT
/begin MEASUREMENT Longctrl_NetEngTorqNorm "" FLOAT32_IEEE PubIfControlLONC_MDL_CM_single 0 0 -3.4E+38 3.4E+38 ECU_ADDRESS 0x00404268 /end MEASUREMENT
/begin MEASUREMENT Longctrl_EngSpd "" FLOAT32_IEEE PubIfControlLONC_MDL_CM_single 0 0 -3.4E+38 3.4E+38 ECU_ADDRESS 0x0040426C /end MEASUREMENT
/begin MEASUREMENT LongCtrl_Tr_Ratio "" FLOAT32_IEEE PubIfControlLONC_MDL_CM_single 0 0 -3.4E+38 3.4E+38 ECU_ADDRESS 0x00404270 /end MEASUREMENT
/begin MEASUREMENT LongCtrl_Fz "" FLOAT32_IEEE PubIfControlLONC_MDL_CM_single 0 0 -3.4E+38 3.4E+38 ECU_ADDRESS 0x00404274 /end MEASUREMENT
/begin MEASUREMENT LongCtrl_ICEFzNm "" FLOAT32_IEEE PubIfControlLONC_MDL_CM_single 0 0 -3.4E+38 3.4E+38 ECU_ADDRESS 0x00404278 /end MEASUREMENT
/begin MEASUREMENT Longctrl_VIE_axRefMs2 "" FLOAT32_IEEE PubIfControlLONC_MDL_CM_single 0 0 -3.4E+38 3.4E+38 ECU_ADDRESS 0x0040427C /end MEASUREMENT
/begin MEASUREMENT Longctrl_ACC_axvCvAim "" FLOAT32_IEEE PubIfControlLONC_MDL_CM_single 0 0 -3.4E+38 3.4E+38 ECU_ADDRESS 0x00404280 /end MEASUREMENT
/begin MEASUREMENT Longctrl_ACC_AccelerateJerk "" FLOAT32_IEEE PubIfControlLONC_MDL_CM_single 0 0 -3.4E+38 3.4E+38 ECU_ADDRESS 0x00404284 /end MEASUREMENT
/begin MEASUREMENT Longctrl_ACC_DecelerateJerk "" FLOAT32_IEEE PubIfControlLONC_MDL_CM_single 0 0 -3.4E+38 3.4E+38 ECU_ADDRESS 0x00404288 /end MEASUREMENT
/begin MEASUREMENT LongCtrl_axvDiff "" FLOAT32_IEEE PubIfControlLONC_MDL_CM_single 0 0 -3.4E+38 3.4E+38 ECU_ADDRESS 0x0040428C /end MEASUREMENT
/begin MEASUREMENT LongCtrl_PI_NetEngTorqInc "" FLOAT32_IEEE PubIfControlLONC_MDL_CM_single 0 0 -3.4E+38 3.4E+38 ECU_ADDRESS 0x00404290 /end MEASUREMENT
/begin MEASUREMENT LongCtrl_axvTracActMean "" FLOAT32_IEEE PubIfControlLONC_MDL_CM_single 0 0 -3.4E+38 3.4E+38 ECU_ADDRESS 0x00404294 /end MEASUREMENT
/begin MEASUREMENT LongCtrl_axvModelDiff "" FLOAT32_IEEE PubIfControlLONC_MDL_CM_single 0 0 -3.4E+38 3.4E+38 ECU_ADDRESS 0x00404298 /end MEASUREMENT
/begin MEASUREMENT Longctrl_VIE_AxRefDt "" FLOAT32_IEEE PubIfControlLONC_MDL_CM_single 0 0 -3.4E+38 3.4E+38 ECU_ADDRESS 0x0040429C /end MEASUREMENT
/begin MEASUREMENT LongCtrl_axvModelResidual "" FLOAT32_IEEE PubIfControlLONC_MDL_CM_single 0 0 -3.4E+38 3.4E+38 ECU_ADDRESS 0x004042A0 /end MEASUREMENT
/begin MEASUREMENT LongCtrl_axvClosedLoopControl "" FLOAT32_IEEE PubIfControlLONC_MDL_CM_single 0 0 -3.4E+38 3.4E+38 ECU_ADDRESS 0x004042A4 /end MEASUREMENT
/begin MEASUREMENT LongCtrl_FF_NetEngTorqMax "" FLOAT32_IEEE PubIfControlLONC_MDL_CM_single__ 0 0 -3.4E+38 3.4E+38 ECU_ADDRESS 0x004042A8 /end MEASUREMENT
/begin MEASUREMENT LongCtrl_FF_NetEngTorqInc "" FLOAT32_IEEE PubIfControlLONC_MDL_CM_single 0 0 -3.4E+38 3.4E+38 ECU_ADDRESS 0x004042AC /end MEASUREMENT
/begin MEASUREMENT LongCtrl_UpdateLowerValue "" FLOAT32_IEEE PubIfControlLONC_MDL_CM_single 0 0 -3.4E+38 3.4E+38 ECU_ADDRESS 0x004042B0 /end MEASUREMENT
/begin MEASUREMENT LongCtrl_UpdateUpperValue "" FLOAT32_IEEE PubIfControlLONC_MDL_CM_single 0 0 -3.4E+38 3.4E+38 ECU_ADDRESS 0x004042B4 /end MEASUREMENT
/begin MEASUREMENT LongCtrl_ACC_EngTrqReq "" FLOAT32_IEEE PubIfControlLONC_MDL_CM_single 0 0 -3.4E+38 3.4E+38 ECU_ADDRESS 0x004042B8 /end MEASUREMENT
/begin MEASUREMENT Longctrl_EngTqMinAct "" FLOAT32_IEEE PubIfControlLONC_MDL_CM_single 0 0 -3.4E+38 3.4E+38 ECU_ADDRESS 0x004042BC /end MEASUREMENT
/begin MEASUREMENT Longctrl_ACC_axv_ComfortBandLowerValue "" FLOAT32_IEEE PubIfControlLONC_MDL_CM_single 0 0 -3.4E+38 3.4E+38 ECU_ADDRESS 0x004042C0 /end MEASUREMENT
/begin MEASUREMENT Longctrl_ACC_axv_ComfortBandUpperValue "" FLOAT32_IEEE PubIfControlLONC_MDL_CM_single 0 0 -3.4E+38 3.4E+38 ECU_ADDRESS 0x004042C4 /end MEASUREMENT
/begin MEASUREMENT LongCtrl_PI_NetEngTorq "" FLOAT32_IEEE PubIfControlLONC_MDL_CM_single 0 0 -3.4E+38 3.4E+38 ECU_ADDRESS 0x004042C8 /end MEASUREMENT
/begin MEASUREMENT LongCtrl_FF_NetEngTorq "" FLOAT32_IEEE PubIfControlLONC_MDL_CM_single 0 0 -3.4E+38 3.4E+38 ECU_ADDRESS 0x004042CC /end MEASUREMENT
/begin MEASUREMENT LongCtrl_axvTracMin "" FLOAT32_IEEE PubIfControlLONC_MDL_CM_single 0 0 -3.4E+38 3.4E+38 ECU_ADDRESS 0x004042D0 /end MEASUREMENT
/begin MEASUREMENT LongCtrl_axvModelRef "" FLOAT32_IEEE PubIfControlLONC_MDL_CM_single 0 0 -3.4E+38 3.4E+38 ECU_ADDRESS 0x004042D4 /end MEASUREMENT
/begin MEASUREMENT Longctrl_VIE_alpSideSlipAngle "" FLOAT32_IEEE PubIfControlLONC_MDL_CM_single 0 0 -3.4E+38 3.4E+38 ECU_ADDRESS 0x004042D8 /end MEASUREMENT
/begin MEASUREMENT Longctrl_EngTqMaxActSpd "" FLOAT32_IEEE PubIfControlLONC_MDL_CM_single 0 0 -3.4E+38 3.4E+38 ECU_ADDRESS 0x004042DC /end MEASUREMENT
/begin MEASUREMENT Longctrl_tCycleVLC "" FLOAT32_IEEE PubIfControlLONC_MDL_CM_single 0 0 -3.4E+38 3.4E+38 ECU_ADDRESS 0x004042E0 /end MEASUREMENT
/begin MEASUREMENT LongCtrl_tEC "" FLOAT32_IEEE PubIfControlLONC_MDL_CM_single 0 0 -3.4E+38 3.4E+38 ECU_ADDRESS 0x004042E4 /end MEASUREMENT
/begin MEASUREMENT LongCtrl_ACC_Decel_ReqValue "" FLOAT32_IEEE PubIfControlLONC_MDL_CM_single 0 0 -3.4E+38 3.4E+38 ECU_ADDRESS 0x004042E8 /end MEASUREMENT
/begin MEASUREMENT LongCtrl_Counter "" UBYTE PubIfControlLONC_MDL_CM_uint8 0 0 0 255 ECU_ADDRESS 0x004042EC /end MEASUREMENT
/begin MEASUREMENT Longctrl_ACCSts "" UBYTE PubIfControlLONC_MDL_CM_uint8 0 0 0 255 ECU_ADDRESS 0x004042ED /end MEASUREMENT
/begin MEASUREMENT LongCtrl_RRWheelDriveDirection "" UBYTE PubIfControlLONC_MDL_CM_uint8 0 0 0 255 ECU_ADDRESS 0x004042EE /end MEASUREMENT
/begin MEASUREMENT LongCtrl_RLWheelDriveDirection "" UBYTE PubIfControlLONC_MDL_CM_uint8 0 0 0 255 ECU_ADDRESS 0x004042EF /end MEASUREMENT
/begin MEASUREMENT LongCtrl_FRWheelDriveDirection "" UBYTE PubIfControlLONC_MDL_CM_uint8 0 0 0 255 ECU_ADDRESS 0x004042F0 /end MEASUREMENT
/begin MEASUREMENT LongCtrl_FLWheelDriveDirection "" UBYTE PubIfControlLONC_MDL_CM_uint8 0 0 0 255 ECU_ADDRESS 0x004042F1 /end MEASUREMENT
/begin MEASUREMENT Longctrl_CurrentGear "" UBYTE PubIfControlLONC_MDL_CM_uint8 0 0 0 255 ECU_ADDRESS 0x004042F2 /end MEASUREMENT
/begin MEASUREMENT Longctrl_VehicleStandStill "" UBYTE PubIfControlLONC_MDL_CM_boolean 0 0 0 1 ECU_ADDRESS 0x004042F3 BIT_MASK 0x01 /end MEASUREMENT
/begin MEASUREMENT LongCtrl_Sw2EC "" UBYTE PubIfControlLONC_MDL_CM_boolean 0 0 0 1 ECU_ADDRESS 0x004042F4 BIT_MASK 0x01 /end MEASUREMENT
/begin MEASUREMENT LongCtrl_Sw2DC "" UBYTE PubIfControlLONC_MDL_CM_boolean 0 0 0 1 ECU_ADDRESS 0x004042F5 BIT_MASK 0x01 /end MEASUREMENT
/begin MEASUREMENT LongCtrl_ForwardFlagVxv "" UBYTE PubIfControlLONC_MDL_CM_boolean 0 0 0 1 ECU_ADDRESS 0x004042F6 BIT_MASK 0x01 /end MEASUREMENT
/begin MEASUREMENT LongCtrl_ForwardFlagTrq "" UBYTE PubIfControlLONC_MDL_CM_boolean 0 0 0 1 ECU_ADDRESS 0x004042F7 BIT_MASK 0x01 /end MEASUREMENT
/begin MEASUREMENT LongCtrl_SlideFlag "" UBYTE PubIfControlLONC_MDL_CM_boolean 0 0 0 1 ECU_ADDRESS 0x004042F8 BIT_MASK 0x01 /end MEASUREMENT
/begin MEASUREMENT LongCtrl_VLC_DriveOffConditonFulfilled "" UBYTE PubIfControlLONC_MDL_CM_boolean 0 0 0 1 ECU_ADDRESS 0x004042F9 BIT_MASK 0x01 /end MEASUREMENT
/begin MEASUREMENT Longctrl_ACC_DrvOFF_Req "" UBYTE PubIfControlLONC_MDL_CM_boolean 0 0 0 1 ECU_ADDRESS 0x004042FA BIT_MASK 0x01 /end MEASUREMENT
/begin MEASUREMENT Longctrl_ShiftinProgress "" UBYTE PubIfControlLONC_MDL_CM_boolean 0 0 0 1 ECU_ADDRESS 0x004042FB BIT_MASK 0x01 /end MEASUREMENT
/begin MEASUREMENT Longctrl_NoBrakeForce "" UBYTE PubIfControlLONC_MDL_CM_boolean 0 0 0 1 ECU_ADDRESS 0x004042FC BIT_MASK 0x01 /end MEASUREMENT
/begin MEASUREMENT LongCtrl_UpdateEnable_axvModeldiff "" UBYTE PubIfControlLONC_MDL_CM_boolean 0 0 0 1 ECU_ADDRESS 0x004042FD BIT_MASK 0x01 /end MEASUREMENT
/begin MEASUREMENT Longctrl_ACC_BrakePrefer "" UBYTE PubIfControlLONC_MDL_CM_boolean 0 0 0 1 ECU_ADDRESS 0x004042FE BIT_MASK 0x01 /end MEASUREMENT
/begin MEASUREMENT Longctrl_ACC_DecelToStopReq "" UBYTE PubIfControlLONC_MDL_CM_boolean 0 0 0 1 ECU_ADDRESS 0x004042FF BIT_MASK 0x01 /end MEASUREMENT
/begin MEASUREMENT LongCtrl_Sw2DC6 "" UBYTE PubIfControlLONC_MDL_CM_boolean 0 0 0 1 ECU_ADDRESS 0x00404300 BIT_MASK 0x01 /end MEASUREMENT
/begin MEASUREMENT LongCtrl_Sw2DC1 "" UBYTE PubIfControlLONC_MDL_CM_boolean 0 0 0 1 ECU_ADDRESS 0x00404301 BIT_MASK 0x01 /end MEASUREMENT
/begin MEASUREMENT LongCtrl_Sw2DC3 "" UBYTE PubIfControlLONC_MDL_CM_boolean 0 0 0 1 ECU_ADDRESS 0x00404302 BIT_MASK 0x01 /end MEASUREMENT
/begin MEASUREMENT LongCtrl_Sw2DC5 "" UBYTE PubIfControlLONC_MDL_CM_boolean 0 0 0 1 ECU_ADDRESS 0x00404303 BIT_MASK 0x01 /end MEASUREMENT
/begin MEASUREMENT LongCtrl_Sw2DC7 "" UBYTE PubIfControlLONC_MDL_CM_boolean 0 0 0 1 ECU_ADDRESS 0x00404304 BIT_MASK 0x01 /end MEASUREMENT
/begin MEASUREMENT LongCtrl_Sw2DC2 "" UBYTE PubIfControlLONC_MDL_CM_boolean 0 0 0 1 ECU_ADDRESS 0x00404305 BIT_MASK 0x01 /end MEASUREMENT
/begin MEASUREMENT LongCtrl_Sw2DC4 "" UBYTE PubIfControlLONC_MDL_CM_boolean 0 0 0 1 ECU_ADDRESS 0x00404306 BIT_MASK 0x01 /end MEASUREMENT
/begin MEASUREMENT LongCtrl_Sw2EC1 "" UBYTE PubIfControlLONC_MDL_CM_boolean 0 0 0 1 ECU_ADDRESS 0x00404307 BIT_MASK 0x01 /end MEASUREMENT
/begin MEASUREMENT LongCtrl_Sw2EC3 "" UBYTE PubIfControlLONC_MDL_CM_boolean 0 0 0 1 ECU_ADDRESS 0x00404308 BIT_MASK 0x01 /end MEASUREMENT
/begin MEASUREMENT LongCtrl_Sw2EC2 "" UBYTE PubIfControlLONC_MDL_CM_boolean 0 0 0 1 ECU_ADDRESS 0x00404309 BIT_MASK 0x01 /end MEASUREMENT
/begin MEASUREMENT LongCtrl_Sw2EC5 "" UBYTE PubIfControlLONC_MDL_CM_boolean 0 0 0 1 ECU_ADDRESS 0x0040430A BIT_MASK 0x01 /end MEASUREMENT
/begin MEASUREMENT LongCtrl_Sw2EC4 "" UBYTE PubIfControlLONC_MDL_CM_boolean 0 0 0 1 ECU_ADDRESS 0x0040430B BIT_MASK 0x01 /end MEASUREMENT
/begin MEASUREMENT LongCtrl_ECEnable "" UBYTE PubIfControlLONC_MDL_CM_boolean 0 0 0 1 ECU_ADDRESS 0x0040430C BIT_MASK 0x01 /end MEASUREMENT
/begin MEASUREMENT LongCtrl_DCEnable "" UBYTE PubIfControlLONC_MDL_CM_boolean 0 0 0 1 ECU_ADDRESS 0x0040430D BIT_MASK 0x01 /end MEASUREMENT
/begin MEASUREMENT PLAN_ALC_LcOverTkLe_ALCSwtOn "" UBYTE PubIfDecisionPLAN_MDL_CM_boolean 0 0 0 1 ECU_ADDRESS 0x00404738 BIT_MASK 0x01 /end MEASUREMENT
/begin MEASUREMENT PLAN_ALC_LcOverTkRi_ALCSwtOn "" UBYTE PubIfDecisionPLAN_MDL_CM_boolean 0 0 0 1 ECU_ADDRESS 0x00404739 BIT_MASK 0x01 /end MEASUREMENT
/begin MEASUREMENT VSM_ESS_SubModel_VERSION "" ULONG PubIfStateVSM_MDL_CM_uint32 0 0 0 4294967295 ECU_ADDRESS 0x0040D4A0 /end MEASUREMENT
/begin MEASUREMENT VSM_LCKIE_SubModel_VERSION "" ULONG PubIfStateVSM_MDL_CM_uint32 0 0 0 4294967295 ECU_ADDRESS 0x0040D4A8 /end MEASUREMENT
/begin MEASUREMENT VSM_HOD_DrvTrqFilted "" FLOAT32_IEEE PubIfStateVSM_MDL_CM_single 0 0 -3.4E+38 3.4E+38 ECU_ADDRESS 0x0040D4C0 /end MEASUREMENT
/begin MEASUREMENT VSM_ACC_SpdSetValue "" FLOAT32_IEEE PubIfStateVSM_MDL_CM_single 0 0 -3.4E+38 3.4E+38 ECU_ADDRESS 0x0040D4C4 /end MEASUREMENT
/begin MEASUREMENT VSM_ESS_StateR "" FLOAT32_IEEE PubIfStateVSM_MDL_CM_single 0 0 -3.4E+38 3.4E+38 ECU_ADDRESS 0x0040D4E8 /end MEASUREMENT
/begin MEASUREMENT VSM_ESS_StateL "" FLOAT32_IEEE PubIfStateVSM_MDL_CM_single 0 0 -3.4E+38 3.4E+38 ECU_ADDRESS 0x0040D4EC /end MEASUREMENT
/begin MEASUREMENT VSM_preFLWhelDy "" FLOAT32_IEEE PubIfStateVSM_MDL_CM_single 0 0 -3.4E+38 3.4E+38 ECU_ADDRESS 0x0040D508 /end MEASUREMENT
/begin MEASUREMENT VSM_preFRWhelDy "" FLOAT32_IEEE PubIfStateVSM_MDL_CM_single 0 0 -3.4E+38 3.4E+38 ECU_ADDRESS 0x0040D50C /end MEASUREMENT
/begin MEASUREMENT VSM_FLWhelDy "" FLOAT32_IEEE PubIfStateVSM_MDL_CM_single 0 0 -3.4E+38 3.4E+38 ECU_ADDRESS 0x0040D510 /end MEASUREMENT
/begin MEASUREMENT VSM_FRWhelDy "" FLOAT32_IEEE PubIfStateVSM_MDL_CM_single 0 0 -3.4E+38 3.4E+38 ECU_ADDRESS 0x0040D514 /end MEASUREMENT
/begin MEASUREMENT VSM_ELK_Warning "" FLOAT32_IEEE PubIfStateVSM_MDL_CM_single 0 0 -3.4E+38 3.4E+38 ECU_ADDRESS 0x0040D600 /end MEASUREMENT
/begin MEASUREMENT VSM_ESS_LastPoint "" FLOAT32_IEEE PubIfStateVSM_MDL_CM_single 0 0 -3.4E+38 3.4E+38 ECU_ADDRESS 0x0040D614 /end MEASUREMENT
/begin MEASUREMENT VSM_ACCSts "" SLONG PubIfStateVSM_MDL_CM_ACC_STATE 0 0 0 9 ECU_ADDRESS 0x0040D618 /end MEASUREMENT
/begin MEASUREMENT VSM_ESS_SubModel_Number "" UWORD PubIfStateVSM_MDL_CM_uint16 0 0 0 65535 ECU_ADDRESS 0x0040D61E /end MEASUREMENT
/begin MEASUREMENT VSM_LCKIE_SubModel_Number "" UWORD PubIfStateVSM_MDL_CM_uint16 0 0 0 65535 ECU_ADDRESS 0x0040D620 /end MEASUREMENT
/begin MEASUREMENT VSM_Diagnostic_ACCError "" UBYTE PubIfStateVSM_MDL_CM_uint8 0 0 0 255 ECU_ADDRESS 0x0040D62C /end MEASUREMENT
/begin MEASUREMENT VSM_ACC_SWEngState "" UBYTE PubIfStateVSM_MDL_CM_uint8 0 0 0 255 ECU_ADDRESS 0x0040D62D /end MEASUREMENT
/begin MEASUREMENT VSM_Diagnostic_HWAError "" UBYTE PubIfStateVSM_MDL_CM_uint8 0 0 0 255 ECU_ADDRESS 0x0040D62E /end MEASUREMENT
/begin MEASUREMENT VSM_ESS_VehCnfgESS "" UBYTE PubIfStateVSM_MDL_CM_uint8 0 0 0 255 ECU_ADDRESS 0x0040D62F /end MEASUREMENT
/begin MEASUREMENT VSM_Diagnostic_TJAError "" UBYTE PubIfStateVSM_MDL_CM_uint8 0 0 0 255 ECU_ADDRESS 0x0040D630 /end MEASUREMENT
/begin MEASUREMENT VSM_ELK_VehConfigELK "" UBYTE PubIfStateVSM_MDL_CM_uint8 0 0 0 255 ECU_ADDRESS 0x0040D631 /end MEASUREMENT
/begin MEASUREMENT VSM_TarDangerLevel "" UBYTE PubIfStateVSM_MDL_CM_uint8 0 0 0 255 ECU_ADDRESS 0x0040D633 /end MEASUREMENT
/begin MEASUREMENT VSM_ACC_HazActv "" UBYTE PubIfStateVSM_MDL_CM_uint8 0 0 0 255 ECU_ADDRESS 0x0040D634 /end MEASUREMENT
/begin MEASUREMENT VSM_ACC_ModeDisp "" UBYTE PubIfStateVSM_MDL_CM_uint8 0 0 0 255 ECU_ADDRESS 0x0040D635 /end MEASUREMENT
/begin MEASUREMENT VSM_TJA_ModeDisp "" UBYTE PubIfStateVSM_MDL_CM_uint8 0 0 0 255 ECU_ADDRESS 0x0040D636 /end MEASUREMENT
/begin MEASUREMENT VSM_HWA_LaneChangeReq "" UBYTE PubIfStateVSM_MDL_CM_uint8 0 0 0 255 ECU_ADDRESS 0x0040D63C /end MEASUREMENT
/begin MEASUREMENT VSM_HWA_ModeDisp "" UBYTE PubIfStateVSM_MDL_CM_uint8 0 0 0 255 ECU_ADDRESS 0x0040D63E /end MEASUREMENT
/begin MEASUREMENT VSM_ELKState "" UBYTE PubIfStateVSM_MDL_CM_uint8 0 0 0 255 ECU_ADDRESS 0x0040D63F /end MEASUREMENT
/begin MEASUREMENT VSM_LCKIE_State "" UBYTE PubIfStateVSM_MDL_CM_uint8 0 0 0 255 ECU_ADDRESS 0x0040D642 /end MEASUREMENT
/begin MEASUREMENT VSM_Counter "" UBYTE PubIfStateVSM_MDL_CM_uint8 0 0 0 255 ECU_ADDRESS 0x0040D648 /end MEASUREMENT
/begin MEASUREMENT VSM_TJA_ACC_SelSts "" UBYTE PubIfStateVSM_MDL_CM_uint8 0 0 0 255 ECU_ADDRESS 0x0040D649 /end MEASUREMENT
/begin MEASUREMENT VSM_HandsOffWarningLevel "" UBYTE PubIfStateVSM_MDL_CM_uint8 0 0 0 255 ECU_ADDRESS 0x0040D678 /end MEASUREMENT
/begin MEASUREMENT VSM_ESSState "" UBYTE PubIfStateVSM_MDL_CM_uint8 0 0 0 255 ECU_ADDRESS 0x0040D679 /end MEASUREMENT
/begin MEASUREMENT VSM_ACC_TimeGapSet "" UBYTE PubIfStateVSM_MDL_CM_uint8 0 0 0 255 ECU_ADDRESS 0x0040D67A /end MEASUREMENT
/begin MEASUREMENT VSM_ACC_SWCruise "" UBYTE PubIfStateVSM_MDL_CM_boolean 0 0 0 1 ECU_ADDRESS 0x0040D68F BIT_MASK 0x01 /end MEASUREMENT
/begin MEASUREMENT VSM_User_ACCSet "" UBYTE PubIfStateVSM_MDL_CM_boolean 0 0 0 1 ECU_ADDRESS 0x0040D690 BIT_MASK 0x01 /end MEASUREMENT
/begin MEASUREMENT VSM_ACC_VehCnfgACC "" UBYTE PubIfStateVSM_MDL_CM_boolean 0 0 0 1 ECU_ADDRESS 0x0040D6A0 BIT_MASK 0x01 /end MEASUREMENT
/begin MEASUREMENT VSM_HandsOff "" UBYTE PubIfStateVSM_MDL_CM_boolean 0 0 0 1 ECU_ADDRESS 0x0040D6A5 BIT_MASK 0x01 /end MEASUREMENT
/begin MEASUREMENT VSM_User_TJASet "" UBYTE PubIfStateVSM_MDL_CM_boolean 0 0 0 1 ECU_ADDRESS 0x0040D6A6 BIT_MASK 0x01 /end MEASUREMENT
/begin MEASUREMENT VSM_ESS_PedSwtReq "" UBYTE PubIfStateVSM_MDL_CM_boolean 0 0 0 1 ECU_ADDRESS 0x0040D6A7 BIT_MASK 0x01 /end MEASUREMENT
/begin MEASUREMENT VSM_ESS_VehSwtReq "" UBYTE PubIfStateVSM_MDL_CM_boolean 0 0 0 1 ECU_ADDRESS 0x0040D6A8 BIT_MASK 0x01 /end MEASUREMENT
/begin MEASUREMENT VSM_ESS_Sensor_idle2error "" UBYTE PubIfStateVSM_MDL_CM_boolean 0 0 0 1 ECU_ADDRESS 0x0040D6A9 BIT_MASK 0x01 /end MEASUREMENT
/begin MEASUREMENT VSM_HandsOn "" UBYTE PubIfStateVSM_MDL_CM_boolean 0 0 0 1 ECU_ADDRESS 0x0040D6EC BIT_MASK 0x01 /end MEASUREMENT
/begin MEASUREMENT VSM_ACC_SWSet "" UBYTE PubIfStateVSM_MDL_CM_boolean 0 0 0 1 ECU_ADDRESS 0x0040D701 BIT_MASK 0x01 /end MEASUREMENT
/begin MEASUREMENT VSM_ACC_SWRes "" UBYTE PubIfStateVSM_MDL_CM_boolean 0 0 0 1 ECU_ADDRESS 0x0040D702 BIT_MASK 0x01 /end MEASUREMENT
/begin MEASUREMENT VSM_ACC_VsetBelowMin "" UBYTE PubIfStateVSM_MDL_CM_boolean 0 0 0 1 ECU_ADDRESS 0x0040D703 BIT_MASK 0x01 /end MEASUREMENT
/begin MEASUREMENT VSM_User_ACCRes "" UBYTE PubIfStateVSM_MDL_CM_boolean 0 0 0 1 ECU_ADDRESS 0x0040D7D7 BIT_MASK 0x01 /end MEASUREMENT
/begin MEASUREMENT VSM_HandsOffDetd "" UBYTE PubIfStateVSM_MDL_CM_boolean 0 0 0 1 ECU_ADDRESS 0x0040D7DE BIT_MASK 0x01 /end MEASUREMENT
/begin COMPU_METHOD Noa_Nofusion_CM_double "Q = V" RAT_FUNC "%15.10" "" COEFFS 0 1 0 0 0 1 /end COMPU_METHOD
/begin COMPU_METHOD Noa_Nofusion_CM_single_m "Q = V" RAT_FUNC "%8.6" "m" COEFFS 0 1 0 0 0 1 /end COMPU_METHOD
/begin COMPU_METHOD Noa_Nofusion_CM_single "Q = V" RAT_FUNC "%8.6" "" COEFFS 0 1 0 0 0 1 /end COMPU_METHOD
/begin COMPU_METHOD Noa_Nofusion_CM_uint8 "Q = V" RAT_FUNC "%3.0" "" COEFFS 0 1 0 0 0 1 /end COMPU_METHOD
/begin COMPU_METHOD Noa_Nofusion_CM_ufix16_En7 "Q = V*128.000000" RAT_FUNC "%10.7" "" COEFFS 0 128.000000 0.000000 0 0 1.000000 /end COMPU_METHOD
/begin COMPU_METHOD PubIfChassisHMI_MDL_CM_single "Q = V" RAT_FUNC "%8.6" "" COEFFS 0 1 0 0 0 1 /end COMPU_METHOD
/begin COMPU_METHOD PubIfChassisHMI_MDL_CM_uint8 "Q = V" RAT_FUNC "%3.0" "" COEFFS 0 1 0 0 0 1 /end COMPU_METHOD
/begin COMPU_METHOD PubIfCommonVIE_MDL_CM_single_m_s "Q = V" RAT_FUNC "%8.6" "m/s" COEFFS 0 1 0 0 0 1 /end COMPU_METHOD
/begin COMPU_METHOD PubIfCommonVIE_MDL_CM_single_m "Q = V" RAT_FUNC "%8.6" "m" COEFFS 0 1 0 0 0 1 /end COMPU_METHOD
/begin COMPU_METHOD PubIfCommonVIE_MDL_CM_single "Q = V" RAT_FUNC "%8.6" "" COEFFS 0 1 0 0 0 1 /end COMPU_METHOD
/begin COMPU_METHOD PubIfCommonVIE_MDL_CM_uint32 "Q = V" RAT_FUNC "%10.0" "" COEFFS 0 1 0 0 0 1 /end COMPU_METHOD
/begin COMPU_METHOD PubIfControlLATC_MDL_CM_single "Q = V" RAT_FUNC "%8.6" "" COEFFS 0 1 0 0 0 1 /end COMPU_METHOD
/begin COMPU_METHOD PubIfControlLATC_MDL_CM_uint8 "Q = V" RAT_FUNC "%3.0" "" COEFFS 0 1 0 0 0 1 /end COMPU_METHOD
/begin COMPU_METHOD PubIfControlLATC_MDL_CM_double "Q = V" RAT_FUNC "%15.10" "" COEFFS 0 1 0 0 0 1 /end COMPU_METHOD
/begin COMPU_METHOD PubIfControlLATC_MDL_CM_uint16 "Q = V" RAT_FUNC "%5.0" "" COEFFS 0 1 0 0 0 1 /end COMPU_METHOD
/begin COMPU_METHOD PubIfControlLATC_MDL_CM_boolean "Q = V" RAT_FUNC "%1.0" "" COEFFS 0 1 0 0 0 1 /end COMPU_METHOD
/begin COMPU_METHOD PubIfControlLATC_MDL_CM_uint32 "Q = V" RAT_FUNC "%10.0" "" COEFFS 0 1 0 0 0 1 /end COMPU_METHOD
/begin COMPU_METHOD PubIfDecisionLSM_MDL_CM_single "Q = V" RAT_FUNC "%8.6" "" COEFFS 0 1 0 0 0 1 /end COMPU_METHOD
/begin COMPU_METHOD PubIfDecisionLSM_MDL_CM_double "Q = V" RAT_FUNC "%15.10" "" COEFFS 0 1 0 0 0 1 /end COMPU_METHOD
/begin COMPU_METHOD PubIfDecisionLSM_MDL_CM_uint8 "Q = V" RAT_FUNC "%3.0" "" COEFFS 0 1 0 0 0 1 /end COMPU_METHOD
/begin COMPU_METHOD PubIfDecisionLSM_MDL_CM_uint32 "Q = V" RAT_FUNC "%10.0" "" COEFFS 0 1 0 0 0 1 /end COMPU_METHOD
/begin COMPU_METHOD PubIfDecisionLSM_MDL_CM_int8 "Q = V" RAT_FUNC "%3.0" "" COEFFS 0 1 0 0 0 1 /end COMPU_METHOD
/begin COMPU_METHOD PubIfDecisionLSM_MDL_CM_boolean "Q = V" RAT_FUNC "%1.0" "" COEFFS 0 1 0 0 0 1 /end COMPU_METHOD
/begin COMPU_METHOD PubIfControlLONC_MDL_CM_single "Q = V" RAT_FUNC "%8.6" "" COEFFS 0 1 0 0 0 1 /end COMPU_METHOD
/begin COMPU_METHOD PubIfControlLONC_MDL_CM_single_m_s_2 "Q = V" RAT_FUNC "%8.6" "m/s^2" COEFFS 0 1 0 0 0 1 /end COMPU_METHOD
/begin COMPU_METHOD PubIfControlLONC_MDL_CM_single_m_s_3 "Q = V" RAT_FUNC "%8.6" "m/s^3" COEFFS 0 1 0 0 0 1 /end COMPU_METHOD
/begin COMPU_METHOD PubIfControlLONC_MDL_CM_single_km_h "Q = V" RAT_FUNC "%8.6" "km/h" COEFFS 0 1 0 0 0 1 /end COMPU_METHOD
/begin COMPU_METHOD PubIfControlLONC_MDL_CM_single__ "Q = V" RAT_FUNC "%8.6" "%" COEFFS 0 1 0 0 0 1 /end COMPU_METHOD
/begin COMPU_METHOD PubIfControlLONC_MDL_CM_single_m_s "Q = V" RAT_FUNC "%8.6" "m/s" COEFFS 0 1 0 0 0 1 /end COMPU_METHOD
/begin COMPU_METHOD PubIfControlLONC_MDL_CM_single_m "Q = V" RAT_FUNC "%8.6" "m" COEFFS 0 1 0 0 0 1 /end COMPU_METHOD
/begin COMPU_METHOD PubIfControlLONC_MDL_CM_single_N "Q = V" RAT_FUNC "%8.6" "N" COEFFS 0 1 0 0 0 1 /end COMPU_METHOD
/begin COMPU_METHOD PubIfControlLONC_MDL_CM_single_m_2 "Q = V" RAT_FUNC "%8.6" "m^2" COEFFS 0 1 0 0 0 1 /end COMPU_METHOD
/begin COMPU_METHOD PubIfControlLONC_MDL_CM_boolean "Q = V" RAT_FUNC "%1.0" "" COEFFS 0 1 0 0 0 1 /end COMPU_METHOD
/begin COMPU_METHOD PubIfControlLONC_MDL_CM_double "Q = V" RAT_FUNC "%15.10" "" COEFFS 0 1 0 0 0 1 /end COMPU_METHOD
/begin COMPU_METHOD PubIfControlLONC_MDL_CM_uint32 "Q = V" RAT_FUNC "%10.0" "" COEFFS 0 1 0 0 0 1 /end COMPU_METHOD
/begin COMPU_METHOD PubIfControlLONC_MDL_CM_uint8 "Q = V" RAT_FUNC "%3.0" "" COEFFS 0 1 0 0 0 1 /end COMPU_METHOD
/begin COMPU_METHOD PubIfDecisionPLAN_MDL_CM_single_m "Q = V" RAT_FUNC "%8.6" "m" COEFFS 0 1 0 0 0 1 /end COMPU_METHOD
/begin COMPU_METHOD PubIfDecisionPLAN_MDL_CM_boolean "Q = V" RAT_FUNC "%1.0" "" COEFFS 0 1 0 0 0 1 /end COMPU_METHOD
/begin COMPU_METHOD PubIfStateVSM_MDL_CM_single "Q = V" RAT_FUNC "%8.6" "" COEFFS 0 1 0 0 0 1 /end COMPU_METHOD
/begin COMPU_METHOD PubIfStateVSM_MDL_CM_double "Q = V" RAT_FUNC "%15.10" "" COEFFS 0 1 0 0 0 1 /end COMPU_METHOD
/begin COMPU_METHOD PubIfStateVSM_MDL_CM_single_m "Q = V" RAT_FUNC "%8.6" "m" COEFFS 0 1 0 0 0 1 /end COMPU_METHOD
/begin COMPU_METHOD PubIfStateVSM_MDL_CM_uint16_num "Q = V" RAT_FUNC "%5.0" "num" COEFFS 0 1 0 0 0 1 /end COMPU_METHOD
/begin COMPU_METHOD PubIfStateVSM_MDL_CM_uint16 "Q = V" RAT_FUNC "%5.0" "" COEFFS 0 1 0 0 0 1 /end COMPU_METHOD
/begin COMPU_METHOD PubIfStateVSM_MDL_CM_boolean "Q = V" RAT_FUNC "%1.0" "" COEFFS 0 1 0 0 0 1 /end COMPU_METHOD
/begin COMPU_METHOD PubIfStateVSM_MDL_CM_uint8 "Q = V" RAT_FUNC "%3.0" "" COEFFS 0 1 0 0 0 1 /end COMPU_METHOD
/begin COMPU_METHOD PubIfStateVSM_MDL_CM_uint8_s "Q = V" RAT_FUNC "%3.0" "s" COEFFS 0 1 0 0 0 1 /end COMPU_METHOD
/begin COMPU_METHOD PubIfStateVSM_MDL_CM_uint32 "Q = V" RAT_FUNC "%10.0" "" COEFFS 0 1 0 0 0 1 /end COMPU_METHOD
/begin COMPU_METHOD PubIfStateVSM_MDL_CM_ACC_STATE "Enumerated data type: ACC_STATE" TAB_VERB "%10.6" "" COMPU_TAB_REF VTAB_FOR_PubIfStateVSM_MDL_CM_ACC_STATE /end COMPU_METHOD
/begin COMPU_VTAB VTAB_FOR_PubIfStateVSM_MDL_CM_ACC_STATE "Enumerated data type: ACC_STATE" TAB_VERB 9 0 "ACC_STATE_ACC_Off" 1 "ACC_STATE_ACC_Reject" 2 "ACC_STATE_ACC_Standby" 3 "ACC_STATE_ACC_ActiveControl" 4 "ACC_STATE_ACC_BrakeOnly" 5 "ACC_STATE_ACC_Override" 6 "ACC_STATE_ACC_StandWait" 7 "ACC_STATE_ACC_Failure" 9 "ACC_STATE_ACC_StandActive" /end COMPU_VTAB
/begin GROUP Noa_Nofusion "Noa_Nofusion" /* Root */ ROOT
 /begin SUB_GROUP Root_Chassis1 Root_Common Root_Control1 Root_LPV Root_Subsystem1 Root_Subsystem4 Root_TOS /end SUB_GROUP
/end GROUP
/begin GROUP Root_Chassis1 "Noa_Nofusion/Chassis1" /begin SUB_GROUP S6_HMI /end SUB_GROUP /end GROUP
/begin GROUP Root_Common "Noa_Nofusion/Common" /begin SUB_GROUP PubIfCommonVIE_MDL /end SUB_GROUP /end GROUP
/begin GROUP Root_Control1 "Noa_Nofusion/Control1" /begin SUB_GROUP PubIfControlLATC_MDL PubIfControlLONC_MDL /end SUB_GROUP /begin REF_MEASUREMENT LongCtrl_VlcInternalAcc /end REF_MEASUREMENT /end GROUP
/begin GROUP Root_LPV "Noa_Nofusion/LPV" /begin SUB_GROUP S17_Subsystem5 S17_VSM PubIfDecisionPLAN_MDL /end SUB_GROUP /end GROUP
/begin GROUP Root_Subsystem1 "Noa_Nofusion/Subsystem1" /begin REF_CHARACTERISTIC P_RFM_RoadType P_RFM_mapvalid /end REF_CHARACTERISTIC /end GROUP
/begin GROUP Root_Subsystem4 "Noa_Nofusion/Subsystem4" /begin SUB_GROUP S22_Simulink_Function /end SUB_GROUP
 /begin REF_CHARACTERISTIC P_EQ4_BC0Gain P_Global_EQ2RearAxisX_m P_Global_EQ2RearAxisY_m /end REF_CHARACTERISTIC
 /begin REF_MEASUREMENT RFM_L1_bIsLineExist RFM_L1_dC0V RFM_L1_dC1V RFM_L1_dC3V RFM_L1_dDisFront RFM_L1_dDisStart RFM_L1_eLineType RFM_R1_bIsLineExist RFM_R1_dC0V RFM_R1_dC1V RFM_R1_dC2V RFM_R1_dC3V RFM_R1_dDisFront RFM_R1_dDisStart RFM_R1_eLineType /end REF_MEASUREMENT
/end GROUP
/begin GROUP Root_TOS "Noa_Nofusion/TOS" /begin SUB_GROUP S23_Subsystem2 /end SUB_GROUP /end GROUP
/begin GROUP S6_HMI "Noa_Nofusion/Chassis1/HMI" /begin SUB_GROUP PubIfChassisHMI_MDL /end SUB_GROUP /end GROUP
/begin GROUP S17_Subsystem5 "Noa_Nofusion/LPV/Subsystem5" /begin SUB_GROUP PubIfDecisionLSM_MDL /end SUB_GROUP /begin REF_MEASUREMENT LSM_Line_source /end REF_MEASUREMENT /end GROUP
/begin GROUP S17_VSM "Noa_Nofusion/LPV/VSM" /begin SUB_GROUP PubIfStateVSM_MDL /end SUB_GROUP /end GROUP
/begin GROUP S22_Simulink_Function "Noa_Nofusion/Subsystem4/Simulink Function" /begin REF_CHARACTERISTIC P_Global_EQ2RearAxisX_m P_Global_EQ2RearAxisY_m /end REF_CHARACTERISTIC /end GROUP
/begin GROUP S23_Subsystem2 "Noa_Nofusion/TOS/Subsystem2" /begin SUB_GROUP S170_ACCOSM S170_DOP S170_Subsystem /end SUB_GROUP /end GROUP
/begin GROUP S170_ACCOSM "Noa_Nofusion/TOS/Subsystem2/ACCOSM" /begin SUB_GROUP S172_HWA_Task100ms1 /end SUB_GROUP
 /begin REF_CHARACTERISTIC P_Global_SteeringAngleRatio P_HWA_TOS_P0HeadingAngle P_TOSS_DxOffset /end REF_CHARACTERISTIC
 /begin REF_MEASUREMENT dxP0 /end REF_MEASUREMENT
/end GROUP
/begin GROUP S170_DOP "Noa_Nofusion/TOS/Subsystem2/DOP" /begin SUB_GROUP S174_HWA_Task100ms1 /end SUB_GROUP /begin REF_CHARACTERISTIC P_Global_SteeringAngleRatio /end REF_CHARACTERISTIC /end GROUP
/begin GROUP S170_Subsystem "Noa_Nofusion/TOS/Subsystem2/Subsystem"
 /begin REF_MEASUREMENT EQ4_DX EQ4_Type LCKIE_DX LCKIE_DY LCKIE_ID LCKIE_VX Object_Type /end REF_MEASUREMENT
/end GROUP
/begin GROUP S172_HWA_Task100ms1 "Noa_Nofusion/TOS/Subsystem2/ACCOSM/HWA_Task100ms1" /begin SUB_GROUP S179_VxVy /end SUB_GROUP /begin REF_CHARACTERISTIC P_Global_DxvFrontBumper_m /end REF_CHARACTERISTIC /end GROUP
/begin GROUP S174_HWA_Task100ms1 "Noa_Nofusion/TOS/Subsystem2/DOP/HWA_Task100ms1" /begin SUB_GROUP S220_VxVy /end SUB_GROUP /begin REF_CHARACTERISTIC P_Global_DxvFrontBumper_m /end REF_CHARACTERISTIC /end GROUP
/begin GROUP S179_VxVy "Noa_Nofusion/TOS/Subsystem2/ACCOSM/HWA_Task100ms1/VxVy" /begin REF_CHARACTERISTIC P_Global_EQ2RearAxisX_m /end REF_CHARACTERISTIC /end GROUP
/begin GROUP S220_VxVy "Noa_Nofusion/TOS/Subsystem2/DOP/HWA_Task100ms1/VxVy" /begin REF_CHARACTERISTIC P_Global_EQ2RearAxisX_m /end REF_CHARACTERISTIC /end GROUP
/begin GROUP PubIfChassisHMI_MDL "PubIfChassisHMI_MDL" /begin SUB_GROUP Root_Subsystem /end SUB_GROUP /end GROUP
/begin GROUP Root_Subsystem "PubIfChassisHMI_MDL/Subsystem" /begin SUB_GROUP S1_HMI2_12 /end SUB_GROUP /begin REF_MEASUREMENT HMI_Counter /end REF_MEASUREMENT /end GROUP
/begin GROUP S1_HMI2_12 "PubIfChassisHMI_MDL/Subsystem/HMI2.12" /begin SUB_GROUP S3_HWA__ACC__TJA_Signal1 S3_IFC_Signal1 /end SUB_GROUP /end GROUP
/begin GROUP S3_HWA__ACC__TJA_Signal1 "PubIfChassisHMI_MDL/Subsystem/HMI2.12/HWA//ACC//TJA_Signal1"
 /begin SUB_GROUP S7_Subsystem S7_Subsystem1 S7_Subsystem2 S7_Subsystem3 S7_Subsystem4 S7_Subsystem5 /end SUB_GROUP
/end GROUP
/begin GROUP S3_IFC_Signal1 "PubIfChassisHMI_MDL/Subsystem/HMI2.12/IFC_Signal1" /begin REF_CHARACTERISTIC P_HMI_LDW_LKAWarnTime /end REF_CHARACTERISTIC /end GROUP
/begin GROUP S7_Subsystem "PubIfChassisHMI_MDL/Subsystem/HMI2.12/HWA//ACC//TJA_Signal1/Subsystem" /begin REF_CHARACTERISTIC P_HMI_ObjectTypeFilter /end REF_CHARACTERISTIC /end GROUP
/begin GROUP S7_Subsystem1 "PubIfChassisHMI_MDL/Subsystem/HMI2.12/HWA//ACC//TJA_Signal1/Subsystem1" /begin REF_CHARACTERISTIC P_HMI_ObjectTypeFilter /end REF_CHARACTERISTIC /end GROUP
/begin GROUP S7_Subsystem2 "PubIfChassisHMI_MDL/Subsystem/HMI2.12/HWA//ACC//TJA_Signal1/Subsystem2" /begin REF_CHARACTERISTIC P_HMI_ObjectTypeFilter /end REF_CHARACTERISTIC /end GROUP
/begin GROUP S7_Subsystem3 "PubIfChassisHMI_MDL/Subsystem/HMI2.12/HWA//ACC//TJA_Signal1/Subsystem3" /begin REF_CHARACTERISTIC P_HMI_ObjectTypeFilter /end REF_CHARACTERISTIC /end GROUP
/begin GROUP S7_Subsystem4 "PubIfChassisHMI_MDL/Subsystem/HMI2.12/HWA//ACC//TJA_Signal1/Subsystem4" /begin REF_CHARACTERISTIC P_HMI_ObjectTypeFilter /end REF_CHARACTERISTIC /end GROUP
/begin GROUP S7_Subsystem5 "PubIfChassisHMI_MDL/Subsystem/HMI2.12/HWA//ACC//TJA_Signal1/Subsystem5" /begin REF_CHARACTERISTIC P_HMI_ObjectTypeFilter /end REF_CHARACTERISTIC /end GROUP
/begin GROUP PubIfCommonVIE_MDL "PubIfCommonVIE_MDL" /begin SUB_GROUP Root_Subsystem_Reference /end SUB_GROUP /begin REF_MEASUREMENT VIE_SW_VERSION /end REF_MEASUREMENT /end GROUP
/begin GROUP Root_Subsystem_Reference "PubIfCommonVIE_MDL/Subsystem Reference" /begin SUB_GROUP S1_VIE /end SUB_GROUP /end GROUP
/begin GROUP S1_VIE "PubIfCommonVIE_MDL/Subsystem Reference/VIE" /begin SUB_GROUP S2_VIE /end SUB_GROUP /begin REF_MEASUREMENT VSM_SteerAngOffsetInit /end REF_MEASUREMENT /end GROUP
/begin GROUP S2_VIE "PubIfCommonVIE_MDL/Subsystem Reference/VIE/VIE" /begin SUB_GROUP S3_AxRef S3_VxvRef_Calc /end SUB_GROUP /begin REF_CHARACTERISTIC P_Global_WheelBase_m /end REF_CHARACTERISTIC /end GROUP
/begin GROUP S3_AxRef "PubIfCommonVIE_MDL/Subsystem Reference/VIE/VIE/AxRef" /begin SUB_GROUP S4_axvRoadSlope_calc /end SUB_GROUP /end GROUP
/begin GROUP S3_VxvRef_Calc "PubIfCommonVIE_MDL/Subsystem Reference/VIE/VIE/VxvRef_Calc" /begin SUB_GROUP S8_VxvRef_Calc /end SUB_GROUP
 /begin REF_CHARACTERISTIC P_Global_FrontAxleToCenter_m P_Global_RearAxleToCenter_m P_Global_WheelTrack_m /end REF_CHARACTERISTIC
/end GROUP
/begin GROUP S4_axvRoadSlope_calc "PubIfCommonVIE_MDL/Subsystem Reference/VIE/VIE/AxRef/axvRoadSlope_calc" /begin REF_CHARACTERISTIC P_Global_SideSlipAnglefactor /end REF_CHARACTERISTIC /end GROUP
/begin GROUP S8_VxvRef_Calc "PubIfCommonVIE_MDL/Subsystem Reference/VIE/VIE/VxvRef_Calc/VxvRef_Calc" /begin SUB_GROUP S19_If_Action_Subsystem /end SUB_GROUP
 /begin REF_CHARACTERISTIC P_Global_CharSpd_ms P_Global_SteeringAngleRatio P_Global_WheelBase_m /end REF_CHARACTERISTIC
 /begin REF_MEASUREMENT VSM_SteerAngleOffset_deg /end REF_MEASUREMENT
/end GROUP
/begin GROUP S19_If_Action_Subsystem "PubIfCommonVIE_MDL/Subsystem Reference/VIE/VIE/VxvRef_Calc/VxvRef_Calc/If Action Subsystem" /begin REF_CHARACTERISTIC P_Global_SteeringAngleRatio /end REF_CHARACTERISTIC /end GROUP
/begin GROUP PubIfControlLATC_MDL "PubIfControlLATC_MDL" /begin SUB_GROUP Root_Subsystem_Reference1 /end SUB_GROUP /end GROUP
/begin GROUP Root_Subsystem_Reference1 "PubIfControlLATC_MDL/Subsystem Reference" /begin SUB_GROUP S1_LATC /end SUB_GROUP /end GROUP
/begin GROUP S1_LATC "PubIfControlLATC_MDL/Subsystem Reference/LATC" /begin SUB_GROUP S2_LateralControl /end SUB_GROUP /begin REF_CHARACTERISTIC P_LCS_Trq_Switch /end REF_CHARACTERISTIC
 /begin REF_MEASUREMENT LCS_Counter LCS_SubModel_Number LCS_SubModel_VERSION LCS_Trq_Switch /end REF_MEASUREMENT
/end GROUP
/begin GROUP S2_LateralControl "PubIfControlLATC_MDL/Subsystem Reference/LATC/LateralControl" /begin SUB_GROUP S4_EPSFaultCheck S4_ESS_SteerSpd_Test S4_LCS_Angle /end SUB_GROUP /begin REF_CHARACTERISTIC P_LCS_IN_Offset_Test_SW P_LCS_IN_Offset_Test_Value /end REF_CHARACTERISTIC
 /begin REF_MEASUREMENT LCS_IN_CurrentLaneWidth LCS_IN_EPS_DrvInpTrqVal LCS_IN_EPS_FailSts LCS_IN_EPS_LKAAngDlvdSts LCS_IN_EPS_LKATorqOvrlDlvd LCS_IN_EPS_LKATorqOvrlDlvdVld LCS_IN_EPS_LKATrqOvlDlvdSts LCS_IN_SteerAngOffset_deg LCS_IN_SteerWheelAng LCS_IN_SteerWheelAngleSign LCS_IN_SteerWheelSpd LCS_IN_SteerWheelSpdSign LCS_IN_alpSideSlipAngle LCS_IN_axvRefMs2 LCS_IN_ayvRefMs2 LCS_IN_desLaneA0 LCS_IN_desLaneA1 LCS_IN_desLaneA2 LCS_IN_desLaneA3 LCS_IN_kapTraj LCS_IN_psiDtOpt LCS_IN_vxvRefMs LCS_OUT_AngCmdReqValVld /end REF_MEASUREMENT
/end GROUP
/begin GROUP S4_EPSFaultCheck "PubIfControlLATC_MDL/Subsystem Reference/LATC/LateralControl/EPSFaultCheck" /begin REF_MEASUREMENT LCS_EPSFault /end REF_MEASUREMENT /end GROUP
/begin GROUP S4_ESS_SteerSpd_Test "PubIfControlLATC_MDL/Subsystem Reference/LATC/LateralControl/ESS_SteerSpd_Test" /begin SUB_GROUP S16_LP_filter S16_LP_filter1 S16_NotActiveFlgDelayTime /end SUB_GROUP
 /begin REF_CHARACTERISTIC P_LCS_ESSOverrideTime1 P_LCS_ESSOverrideTime2 P_LCS_ESSOverrideTime3 P_LCS_ESSOverrideValue1 P_LCS_ESSOverrideValue2 P_LCS_ESS_LogicTest_Enable P_LCS_ESS_NotActiveFlgDelayTime P_LCS_ESS_NotActiveFlgDelayTimeSW P_LCS_ESS_SteerAngleErr P_LCS_ESS_SteerAngleFilterTime P_LCS_ESS_TarAngleFilterTime P_LCS_LATC_VehicleSpd_TabX_Kph /end REF_CHARACTERISTIC
 /begin REF_MEASUREMENT LCS_ESS_NotActiveFlg LCS_ESS_NotActiveFlg1 LCS_ESS_NotActiveFlg2 LCS_ESS_NotActiveFlg3 LCS_ESS_NotActiveFlgOriginal LCS_ESS_SteerWheelAngleSpd LCS_ESS_TarAngleSpd /end REF_MEASUREMENT
/end GROUP
/begin GROUP S4_LCS_Angle "PubIfControlLATC_MDL/Subsystem Reference/LATC/LateralControl/LCS_Angle"
 /begin SUB_GROUP S17_Lateral_Control S17_Motion_Planning S17_OverRideDetect S17_SteerAngleCorrect S17_Subsystem S17_Vehicle_Speed /end SUB_GROUP
 /begin REF_MEASUREMENT LCS_IN_TarDangerlLevel LCS_IN_TarDangerlLevel_Delay2Frame LCS_IN_desLaneValid /end REF_MEASUREMENT
/end GROUP
/begin GROUP S16_LP_filter "PubIfControlLATC_MDL/Subsystem Reference/LATC/LateralControl/ESS_SteerSpd_Test/LP filter" /begin REF_MEASUREMENT LCS_ESS_TarAngleSpdFilter /end REF_MEASUREMENT /end GROUP
/begin GROUP S16_LP_filter1 "PubIfControlLATC_MDL/Subsystem Reference/LATC/LateralControl/ESS_SteerSpd_Test/LP filter1" /begin REF_MEASUREMENT LCS_ESS_SteerWheelAngleSpdFilter /end REF_MEASUREMENT /end GROUP
/begin GROUP S16_NotActiveFlgDelayTime "PubIfControlLATC_MDL/Subsystem Reference/LATC/LateralControl/ESS_SteerSpd_Test/NotActiveFlgDelayTime" /begin REF_MEASUREMENT LCS_ESS_NotActiveDelayFlg /end REF_MEASUREMENT /end GROUP
/begin GROUP S17_Lateral_Control "PubIfControlLATC_MDL/Subsystem Reference/LATC/LateralControl/LCS_Angle/Lateral_Control" /begin SUB_GROUP S36_kinematics_MPC /end SUB_GROUP /end GROUP
/begin GROUP S17_Motion_Planning "PubIfControlLATC_MDL/Subsystem Reference/LATC/LateralControl/LCS_Angle/Motion_Planning" /begin SUB_GROUP S37_CartesianTrajectory_MPC /end SUB_GROUP /end GROUP
/begin GROUP S17_OverRideDetect "PubIfControlLATC_MDL/Subsystem Reference/LATC/LateralControl/LCS_Angle/OverRideDetect"
 /begin REF_CHARACTERISTIC P_LCS_DetNoOverRide_DrvTrq_TH P_LCS_DetOverRide_DrvTrq_TH P_LCS_NoOverRideTime_TH_s P_LCS_OverRideDetect_b P_LCS_OverRideTime_TH_s /end REF_CHARACTERISTIC
 /begin REF_MEASUREMENT LCS_OverRideDetect_b /end REF_MEASUREMENT
/end GROUP
/begin GROUP S17_SteerAngleCorrect "PubIfControlLATC_MDL/Subsystem Reference/LATC/LateralControl/LCS_Angle/SteerAngleCorrect"
 /begin REF_MEASUREMENT LCS_CurSteerAngle_deg LCS_IN_CurSteerAngle_deg LCS_IN_SteerAngleSpd_degs /end REF_MEASUREMENT
/end GROUP
/begin GROUP S17_Subsystem "PubIfControlLATC_MDL/Subsystem Reference/LATC/LateralControl/LCS_Angle/Subsystem" /begin REF_MEASUREMENT LCS_EqA0 /end REF_MEASUREMENT /end GROUP
/begin GROUP S17_Vehicle_Speed "PubIfControlLATC_MDL/Subsystem Reference/LATC/LateralControl/LCS_Angle/Vehicle_Speed" /begin REF_MEASUREMENT LCS_IN_Spd_Kph /end REF_MEASUREMENT /end GROUP
/begin GROUP S36_kinematics_MPC "PubIfControlLATC_MDL/Subsystem Reference/LATC/LateralControl/LCS_Angle/Lateral_Control/kinematics_MPC"
 /begin SUB_GROUP S42_Median_Filter S42_SteerAngSlopeCalc S42_Understeer_Offset_Calc /end SUB_GROUP
 /begin REF_CHARACTERISTIC P_Global_SteeringAngleRatio P_LCS_LATC_MPCDeltaT_s P_LCS_LATC_MPCMatrixQ1_st P_LCS_LATC_MPCMatrixQ2_st P_LCS_LATC_MPCMatrixR_st P_LCS_LATC_MPCMaxSterAngleSpd_degs P_LCS_LATC_MPCMaxSterAngle_deg P_LCS_LCC_HeadingErRrateTime_s P_LCS_LCC_HeadingErrTime_s P_LCS_LCC_LaterErrRateTime_s P_LCS_LCC_LaterErrTime_s P_LCS_LCC_RefThetaTime_s P_LCS_LCC_RefcurveTime_s P_LCS_VehicleSpd_TabX_Kph /end REF_CHARACTERISTIC
 /begin REF_MEASUREMENT LCS_LATC_CorrectSteerAngle_deg LCS_LATC_Feedback_deg LCS_LATC_Feedforward_deg LCS_LATC_MPCDeltaT_s LCS_LATC_MatrixResult_deg LCS_LATC_OutTrgSteerAngle LCS_LATC_SteerAngleCmd_deg LCS_LATC_SteerAngleLimit_deg LCS_LATC_TarAngle_deg /end REF_MEASUREMENT
/end GROUP
/begin GROUP S37_CartesianTrajectory_MPC "PubIfControlLATC_MDL/Subsystem Reference/LATC/LateralControl/LCS_Angle/Motion_Planning/CartesianTrajectory_MPC" /begin SUB_GROUP S62_Subsystem /end SUB_GROUP /begin REF_CHARACTERISTIC P_LCS_PLAN_DisFac_Tab_ratio P_LCS_PLAN_MinDis_m /end REF_CHARACTERISTIC
 /begin REF_MEASUREMENT LCS_LATC_PlanAyDt LCS_LATC_PlanLength LCS_LATC_PlanT LCS_PLAN_TrajectoryX LCS_PLAN_Trajectory_NumTraj LCS_PLAN_Trajectory_PlanY /end REF_MEASUREMENT
/end GROUP
/begin GROUP S42_Median_Filter "PubIfControlLATC_MDL/Subsystem Reference/LATC/LateralControl/LCS_Angle/Lateral_Control/kinematics_MPC/Median_Filter" /begin REF_CHARACTERISTIC P_LCS_LATC_TarAngleFliterWindowSize /end REF_CHARACTERISTIC /begin REF_MEASUREMENT LCS_LATC_TarAngleFilter_deg /end REF_MEASUREMENT /end GROUP
/begin GROUP S42_SteerAngSlopeCalc "PubIfControlLATC_MDL/Subsystem Reference/LATC/LateralControl/LCS_Angle/Lateral_Control/kinematics_MPC/SteerAngSlopeCalc" /begin SUB_GROUP S51_Switch_Case_Action_Subsystem /end SUB_GROUP
 /begin REF_CHARACTERISTIC P_LCS_LATC_ELKAngleSlope_ratio P_LCS_LATC_ELKMaxLatAcc_ms2 P_LCS_LATC_ESSAngleSlope_ratio P_LCS_LATC_ESSMaxLatAcc_ms2 P_LCS_LATC_LCAngleSlope_ratio P_LCS_LATC_LCCancleMaxLatAcc_ms2 P_LCS_LATC_LCEcoAngleSlope_ratio P_LCS_LATC_LCEcoMaxLatAcc_ms2 P_LCS_LATC_LCKAngleSlope_ratio P_LCS_LATC_LCKIEAngleSlope_ratio P_LCS_LATC_LCKIEMaxLatAcc_ms2 P_LCS_LATC_LCKMaxLatAcc_ms2 P_LCS_LATC_LCNormalAngleSlope_ratio P_LCS_LATC_LCNormalMaxLatAcc_ms2 P_LCS_LATC_LCSportAngleSlope_ratio P_LCS_LATC_LCSportMaxLatAcc_ms2 P_LCS_LATC_LKAAngleSlope_ratio P_LCS_LATC_LKAMaxLatAcc_ms2 P_LCS_LATC_StateHoldTime_st P_LCS_VehicleSpd_TabX_Kph /end REF_CHARACTERISTIC
 /begin REF_MEASUREMENT LCS_LATC_AngleSlopeFlg_st LCS_LATC_HoldTime_s LCS_LATC_MaxAy_ms2 LCS_LATC_StateActAngleSlope_degs LCS_LATC_StateAngleSlope_degs /end REF_MEASUREMENT
/end GROUP
/begin GROUP S42_Understeer_Offset_Calc "PubIfControlLATC_MDL/Subsystem Reference/LATC/LateralControl/LCS_Angle/Lateral_Control/kinematics_MPC/Understeer&Offset_Calc" /begin SUB_GROUP S53_Enabled_Subsystem /end SUB_GROUP
 /begin REF_CHARACTERISTIC P_Global_CharSpd_ms P_Global_SteeringAngleRatio P_Global_WheelBase_m P_LCS_LATC_CurOffsetA2FliterT_s P_LCS_LATC_CurOffsetVehicleSpdLimitValue_degs /end REF_CHARACTERISTIC
 /begin REF_MEASUREMENT LCS_OffSetUpdate_Flg /end REF_MEASUREMENT
/end GROUP
/begin GROUP S62_Subsystem "PubIfControlLATC_MDL/Subsystem Reference/LATC/LateralControl/LCS_Angle/Motion_Planning/CartesianTrajectory_MPC/Subsystem" /begin SUB_GROUP S64_LP_filter S64_Subsystem /end SUB_GROUP
 /begin REF_CHARACTERISTIC P_LCS_PLAN_A2FliterTime_s P_LCS_PLAN_DesLineA0_TabY_m P_LCS_PLAN_LCKAyDtLimit_Tab_ms3 P_LCS_PLAN_LCPreDisFac_ratio P_LCS_PLAN_PreDisCurve_TabX_m P_LCS_PLAN_PreDis_Tab_m P_LCS_PLAN_StateHoldTime_st P_LCS_PLAN_TarDangerlLevel_Tabx_st P_LCS_PLAN_VehicleSpd_TabY_Kph P_LCS_PlLAN_PreDisFac_Tab_ratio P_LCS_Plan_A2Pretime_s P_LCS_Plan_ELKAyDtLimit_Tab_ms3 P_LCS_Plan_LCAyDtLimit_Tab_ms3 P_LCS_Plan_LCKIEAyDtLimit_Tab_ms3 P_LCS_Plan_LCNomalAyDtLimit_Tab_ms3 P_LCS_Plan_LCSportAyDtLimit_Tab_ms3 P_LCS_Plan_LKAAyDtLimit_Tab_ms3 /end REF_CHARACTERISTIC
 /begin REF_MEASUREMENT LCS_Plan_AyDtlimit LCS_Plan_FinalpreDis /end REF_MEASUREMENT
/end GROUP
/begin GROUP S51_Switch_Case_Action_Subsystem "PubIfControlLATC_MDL/Subsystem Reference/LATC/LateralControl/LCS_Angle/Lateral_Control/kinematics_MPC/SteerAngSlopeCalc/Switch Case Action Subsystem"
 /begin REF_CHARACTERISTIC P_LCS_LATC_StateActivAngleSlopeLimit_ratio P_LCS_LATC_StateActiveFlg_TabX_st P_LCS_LATC_StateActiveHoldTime_TabY_st /end REF_CHARACTERISTIC
/end GROUP
/begin GROUP S53_Enabled_Subsystem "PubIfControlLATC_MDL/Subsystem Reference/LATC/LateralControl/LCS_Angle/Lateral_Control/kinematics_MPC/Understeer&Offset_Calc/Enabled Subsystem"
 /begin REF_CHARACTERISTIC P_Global_SteeringAngleRatio P_LCS_LATC_CurOffsetCurveFliterTime_Tab_s P_LCS_LATC_CurOffsetCurve_TabX_m /end REF_CHARACTERISTIC
 /begin REF_MEASUREMENT LCS_LATC_CurrentSteerAngleOffset_deg /end REF_MEASUREMENT
/end GROUP
/begin GROUP S64_LP_filter "PubIfControlLATC_MDL/Subsystem Reference/LATC/LateralControl/LCS_Angle/Motion_Planning/CartesianTrajectory_MPC/Subsystem/LP filter" /begin REF_MEASUREMENT LCS_PreDisCurve_m /end REF_MEASUREMENT /end GROUP
/begin GROUP S64_Subsystem "PubIfControlLATC_MDL/Subsystem Reference/LATC/LateralControl/LCS_Angle/Motion_Planning/CartesianTrajectory_MPC/Subsystem/Subsystem"
 /begin SUB_GROUP S68_Switch_Case_Action_Subsystem S68_Switch_Case_Action_Subsystem2 S68_Switch_Case_Action_Subsystem5 /end SUB_GROUP
/end GROUP
/begin GROUP S68_Switch_Case_Action_Subsystem "PubIfControlLATC_MDL/Subsystem Reference/LATC/LateralControl/LCS_Angle/Motion_Planning/CartesianTrajectory_MPC/Subsystem/Subsystem/Switch Case Action Subsystem"
 /begin REF_CHARACTERISTIC P_LCS_PLAN_StateActivAngleSlope_Tab_ratio P_LCS_PLAN_StateActiveFlg_TabX_st P_LCS_PLAN_StateActiveHoldTime_TabY_s /end REF_CHARACTERISTIC
/end GROUP
/begin GROUP S68_Switch_Case_Action_Subsystem2 "PubIfControlLATC_MDL/Subsystem Reference/LATC/LateralControl/LCS_Angle/Motion_Planning/CartesianTrajectory_MPC/Subsystem/Subsystem/Switch Case Action Subsystem2"
 /begin REF_CHARACTERISTIC P_LCS_PLAN_StateActiveHoldTime_TabY_s P_LCS_PLAN_StateCompleteAngleSlope_Tab_ratio P_LCS_PLAN_StateCompleteFlg_TabX_st /end REF_CHARACTERISTIC
/end GROUP
/begin GROUP S68_Switch_Case_Action_Subsystem5 "PubIfControlLATC_MDL/Subsystem Reference/LATC/LateralControl/LCS_Angle/Motion_Planning/CartesianTrajectory_MPC/Subsystem/Subsystem/Switch Case Action Subsystem5"
 /begin REF_CHARACTERISTIC P_LCS_PLAN_LCCompletePreDisFac_Tab_ratio P_LCS_PLAN_StateActiveHoldTime_TabY_s P_LCS_PLAN_StateCompleteFlg_TabX_st /end REF_CHARACTERISTIC
/end GROUP
/begin GROUP PubIfDecisionLSM_MDL "PubIfDecisionLSM_MDL" /begin SUB_GROUP Root_Subsystem11 /end SUB_GROUP /end GROUP
/begin GROUP Root_Subsystem11 "PubIfDecisionLSM_MDL/Subsystem1" /begin SUB_GROUP S1_LSM_Signal S1_TargetLineCalc_20ms /end SUB_GROUP
 /begin REF_MEASUREMENT LSM_RFM_LineCenter_C0 LSM_RFM_LineCenter_C1 LSM_RFM_LineCenter_C2 LSM_RFM_LineCenter_C3 LSM_RFM_LineCenter_Front LSM_RFM_LineCenter_Start LSM_RFM_LineCenter_Valid LSM_RFM_LineL1_C0 LSM_RFM_LineL1_C1 LSM_RFM_LineL1_C2 LSM_RFM_LineL1_C3 LSM_RFM_LineL1_Front LSM_RFM_LineL1_Start LSM_RFM_LineL1_Valid LSM_RFM_LineR1_C0 LSM_RFM_LineR1_C1 LSM_RFM_LineR1_C2 LSM_RFM_LineR1_C3 LSM_RFM_LineR1_Front LSM_RFM_LineR1_Start LSM_RFM_LineR1_Valid /end REF_MEASUREMENT
/end GROUP
/begin GROUP S1_LSM_Signal "PubIfDecisionLSM_MDL/Subsystem1/LSM_Signal"
 /begin REF_MEASUREMENT LSM_DoubleLineLost_b LSM_ESSLeLineC0 LSM_ESSLeLineC1 LSM_ESSLeLineC2 LSM_ESSLeLineC3 LSM_ESSLeLineValid LSM_ESSLeRange LSM_ESSLineC0 LSM_ESSLineC1 LSM_ESSLineC2 LSM_ESSLineC3 LSM_ESSLineValid LSM_ESSRange LSM_ESSRiLineC0 LSM_ESSRiLineC1 LSM_ESSRiLineC2 LSM_ESSRiLineC3 LSM_ESSRiLineValid LSM_ESSRiRange LSM_HWALeLineC0 LSM_HWALeLineC1 LSM_HWALeLineC2 LSM_HWALeLineC3 LSM_HWALeLineValid LSM_HWALeRange LSM_HWALineC0 LSM_HWALineC1 LSM_HWALineC2 LSM_HWALineC3 LSM_HWALineValid LSM_HWARange LSM_HWARiLineC0 LSM_HWARiLineC1 LSM_HWARiLineC2 LSM_HWARiLineC3 LSM_HWARiLineValid LSM_HWARiRange LSM_HeadAngDiff LSM_LCKLineC0 LSM_LCKLineC1 LSM_LCKLineC2 LSM_LCKLineC3 LSM_LCKLineValid LSM_LCKRange LSM_LeftLaneChange LSM_MLeLane LSM_OTL_A0 LSM_OTL_A1 LSM_OTL_A2 LSM_OTL_A3 LSM_OTL_Count LSM_OTL_Range LSM_OTLineValid LSM_RightLaneChange LSM_RoadWidth LSM_SingleLineLost_b LSM_TJALineC0 LSM_TJALineC1 LSM_TJALineC2 LSM_TJALineC3 LSM_TJALineValid LSM_TJARange LSM_UpdateCnt LSM_dyDiff /end REF_MEASUREMENT
/end GROUP
/begin GROUP S1_TargetLineCalc_20ms "PubIfDecisionLSM_MDL/Subsystem1/TargetLineCalc_20ms" /begin SUB_GROUP S4_Simulink_Function S4_TargetLineCalc /end SUB_GROUP
 /begin REF_MEASUREMENT LSM_L1_Conf LSM_L1_Range LSM_L2_Conf LSM_L2_Range LSM_L3_Conf LSM_L3_Range LSM_L4_Conf LSM_L4_Range LSM_LA_Adjacent_Count LSM_LA_ELEM_0_Availability_State LSM_LA_ELEM_0_C0 LSM_LA_ELEM_0_C1 LSM_LA_ELEM_0_C2 LSM_LA_ELEM_0_C3 LSM_LA_ELEM_0_Confidence LSM_LA_ELEM_0_DLM_Type LSM_LA_ELEM_0_Lanemark_Type LSM_LA_ELEM_0_Line_Side LSM_LA_ELEM_0_Marker_Width LSM_LA_ELEM_0_Range_End LSM_LA_ELEM_0_Range_Start LSM_LA_ELEM_1_Availability_State LSM_LA_ELEM_1_C0 LSM_LA_ELEM_1_C1 LSM_LA_ELEM_1_C2 LSM_LA_ELEM_1_C3 LSM_LA_ELEM_1_Confidence LSM_LA_ELEM_1_DLM_Type LSM_LA_ELEM_1_Lanemark_Type LSM_LA_ELEM_1_Line_Side LSM_LA_ELEM_1_Marker_Width LSM_LA_ELEM_1_Range_End LSM_LA_ELEM_1_Range_Start LSM_LA_ELEM_2_Availability_State LSM_LA_ELEM_2_C0 LSM_LA_ELEM_2_C1 LSM_LA_ELEM_2_C2 LSM_LA_ELEM_2_C3 LSM_LA_ELEM_2_Confidence LSM_LA_ELEM_2_DLM_Type LSM_LA_ELEM_2_Lanemark_Type LSM_LA_ELEM_2_Line_Side LSM_LA_ELEM_2_Marker_Width LSM_LA_ELEM_2_Range_End LSM_LA_ELEM_2_Range_Start LSM_LA_ELEM_3_Availability_State LSM_LA_ELEM_3_C0 LSM_LA_ELEM_3_C1 LSM_LA_ELEM_3_C2 LSM_LA_ELEM_3_C3 LSM_LA_ELEM_3_Confidence LSM_LA_ELEM_3_DLM_Type LSM_LA_ELEM_3_Lanemark_Type LSM_LA_ELEM_3_Line_Side LSM_LA_ELEM_3_Marker_Width LSM_LA_ELEM_3_Range_End LSM_LA_ELEM_3_Range_Start LSM_LH_Count LSM_LH_ELEM_0_Availability_State LSM_LH_ELEM_0_C0 LSM_LH_ELEM_0_C1 LSM_LH_ELEM_0_C2 LSM_LH_ELEM_0_C3 LSM_LH_ELEM_0_Confidence LSM_LH_ELEM_0_Crossing LSM_LH_ELEM_0_DLM_Type LSM_LH_ELEM_0_Lanemark_Type LSM_LH_ELEM_0_Line_Side LSM_LH_ELEM_0_Marker_Width LSM_LH_ELEM_0_VR_End LSM_LH_ELEM_0_VR_Start LSM_LH_ELEM_1_Availability_State LSM_LH_ELEM_1_C0 LSM_LH_ELEM_1_C1 LSM_LH_ELEM_1_C2 LSM_LH_ELEM_1_C3 LSM_LH_ELEM_1_Confidence LSM_LH_ELEM_1_Crossing LSM_LH_ELEM_1_DLM_Type LSM_LH_ELEM_1_Lanemark_Type LSM_LH_ELEM_1_Line_Side LSM_LH_ELEM_1_Marker_Width LSM_LH_ELEM_1_VR_End LSM_LH_ELEM_1_VR_Start LSM_LRE_Count LSM_LRE_ELEM_0_Availability_State LSM_LRE_ELEM_0_C0 LSM_LRE_ELEM_0_C1 LSM_LRE_ELEM_0_C2 LSM_LRE_ELEM_0_C3 LSM_LRE_ELEM_0_Confidence LSM_LRE_ELEM_0_Line_Side LSM_LRE_ELEM_0_Range_End LSM_LRE_ELEM_0_Range_Start LSM_LRE_ELEM_1_Availability_State LSM_LRE_ELEM_1_C0 LSM_LRE_ELEM_1_C1 LSM_LRE_ELEM_1_C2 LSM_LRE_ELEM_1_C3 LSM_LRE_ELEM_1_Confidence LSM_LRE_ELEM_1_Line_Side LSM_LRE_ELEM_1_Range_End LSM_LRE_ELEM_1_Range_Start LSM_VisLineUpdate /end REF_MEASUREMENT
/end GROUP
/begin GROUP S4_Simulink_Function "PubIfDecisionLSM_MDL/Subsystem1/TargetLineCalc_20ms/Simulink Function" /begin REF_CHARACTERISTIC P_LSM_IFV2CenterAxis P_LSM_IFV2RearAxis /end REF_CHARACTERISTIC /end GROUP
/begin GROUP S4_TargetLineCalc "PubIfDecisionLSM_MDL/Subsystem1/TargetLineCalc_20ms/TargetLineCalc" /begin SUB_GROUP S17_Subsystem2 S17_Subsystem4 S17_Subsystem51 S17_TypeConf /end SUB_GROUP
 /begin REF_CHARACTERISTIC P_LSM_ALC_Enable P_LSM_LineSTD_Limit P_LSM_NOH_Switch P_LSM_Pre_t /end REF_CHARACTERISTIC
 /begin REF_MEASUREMENT LSM_A0K1 LSM_A1K1 LSM_A2K1 LSM_A3K1 LSM_CentLineA0 LSM_CentLineA1 LSM_CentLineA2 LSM_CentLineA3 LSM_CentLineRange LSM_CentLineValid LSM_CentQ LSM_CosOfPsi LSM_EN_C0 LSM_EN_C1 LSM_EN_C2 LSM_EN_C3 LSM_EN_Front LSM_EN_Start LSM_EN_Valid LSM_Exit_C0 LSM_Exit_C1 LSM_Exit_C2 LSM_Exit_C3 LSM_Exit_Front LSM_Exit_Start LSM_Exit_Valid LSM_HWALineC0K1 LSM_HWASts LSM_L1_A0 LSM_L1_AvaliDis LSM_L1_AvaliTime LSM_L2_A0 LSM_L2_AvaliDis LSM_L2_AvaliTime LSM_L3_A0 LSM_L3_AvaliDis LSM_L3_AvaliTime LSM_L4_A0 LSM_L4_AvaliDis LSM_L4_AvaliTime LSM_LH1Valid LSM_LH2Valid LSM_LeftMostLane LSM_LeftOffset_b LSM_LineValidK1 LSM_Line_State LSM_LockCounter LSM_LockID LSM_MoveID LSM_PathLaneAvail LSM_QualityK1 LSM_RangeK1 LSM_RightOffset_b LSM_RoadWidth1 LSM_SinOfsi LSM_TJA_Line_State1 LSM_Wij_State LSM_dDeltaX LSM_dDeltaY LSM_tLostK1 /end REF_MEASUREMENT
/end GROUP
/begin GROUP S17_Subsystem2 "PubIfDecisionLSM_MDL/Subsystem1/TargetLineCalc_20ms/TargetLineCalc/Subsystem2"
 /begin REF_CHARACTERISTIC P_LSM_DOPValid_CheckTime P_LSM_DOP_C0_EN_Limit P_LSM_DOP_C0_out_Limit P_LSM_DOP_C1AndC2_Lim_X P_LSM_DOP_C1_EN_Limit P_LSM_DOP_C1_out_Limit P_LSM_DOP_C2_EN_Limit P_LSM_DOP_C2_out_Limit P_LSM_DOP_In_Pre2Dop_Dis P_LSM_DOP_Out_Pre2Dop_Dis P_LSM_DOP_PreDis_X P_LSM_DOP_PreDis_Y P_LSM_DoubleLine_Curr2Cent_Dislimit P_LSM_DoubleLine_DOPOut_C1 P_LSM_DoubleLine_Dop2Cent_Dislimit P_LSM_DoubleLine_Pre2Cent_Dislimit P_LSM_SingleLine_Cent2Edge_Dislimit P_LSM_SingleLine_Curr2Cent_Dislimit P_LSM_SingleLine_DOPOut_C1 P_LSM_SingleLine_Dop2Cent_Dislimit P_LSM_SingleLine_Pre2Cent_Dislimit /end REF_CHARACTERISTIC
 /begin REF_MEASUREMENT LSM_DOP_EN LSM_DOP_Out LSM_TJA_Line_State /end REF_MEASUREMENT
/end GROUP
/begin GROUP S17_Subsystem4 "PubIfDecisionLSM_MDL/Subsystem1/TargetLineCalc_20ms/TargetLineCalc/Subsystem4" /begin SUB_GROUP S49_If_Action_Subsystem5 /end SUB_GROUP /begin REF_CHARACTERISTIC P_LSM_LineWijCal_C12 P_LSM_LineWijCal_C13 /end REF_CHARACTERISTIC
 /begin REF_MEASUREMENT LSM_CurDis2 LSM_CurDis3 LSM_DeltaDis2 LSM_DeltaDis3 LSM_LH1Wij LSM_LH21 LSM_LH22 LSM_LH23 LSM_LH2Wij LSM_LH31 LSM_LH32 LSM_LH33 LSM_LeftLineConf LSM_RightLineConf /end REF_MEASUREMENT
/end GROUP
/begin GROUP S17_Subsystem51 "PubIfDecisionLSM_MDL/Subsystem1/TargetLineCalc_20ms/TargetLineCalc/Subsystem5" /begin SUB_GROUP S50_If_Action_Subsystem5 /end SUB_GROUP /begin REF_CHARACTERISTIC P_LSM_LineWijCal_C12 P_LSM_LineWijCal_C13 /end REF_CHARACTERISTIC /end GROUP
/begin GROUP S17_TypeConf "PubIfDecisionLSM_MDL/Subsystem1/TargetLineCalc_20ms/TargetLineCalc/TypeConf" /begin REF_MEASUREMENT LSM_LeftLineTypeEN LSM_RightLineTypeEN /end REF_MEASUREMENT /end GROUP
/begin GROUP S49_If_Action_Subsystem5 "PubIfDecisionLSM_MDL/Subsystem1/TargetLineCalc_20ms/TargetLineCalc/Subsystem4/If Action Subsystem5" /begin REF_CHARACTERISTIC P_LSM_PosLineLcFac /end REF_CHARACTERISTIC /end GROUP
/begin GROUP S50_If_Action_Subsystem5 "PubIfDecisionLSM_MDL/Subsystem1/TargetLineCalc_20ms/TargetLineCalc/Subsystem5/If Action Subsystem5" /begin REF_CHARACTERISTIC P_LSM_PosLineLcFac /end REF_CHARACTERISTIC /end GROUP
/begin GROUP PubIfControlLONC_MDL "PubIfControlLONC_MDL" /begin SUB_GROUP Root_Subsystem2 /end SUB_GROUP /end GROUP
/begin GROUP Root_Subsystem2 "PubIfControlLONC_MDL/Subsystem" /begin SUB_GROUP S1_VLC /end SUB_GROUP
 /begin REF_MEASUREMENT LongCtrl_Counter LongCtrl_SubModel_Number LongCtrl_SubModel_VERSION /end REF_MEASUREMENT
/end GROUP
/begin GROUP S1_VLC "PubIfControlLONC_MDL/Subsystem/VLC" /begin SUB_GROUP S3_Vlc /end SUB_GROUP /end GROUP
/begin GROUP S3_Vlc "PubIfControlLONC_MDL/Subsystem/VLC/Vlc"
 /begin SUB_GROUP S6_DC S6_EC S6_FF_Control S6_PI_Control S6_SlidJudge S6_SwitchToBrakeMode S6_SwitchToDriveMode S6_UpdateFlagCalc S6_axvClosedLoopControlCalc S6_axvModelResidualCalc S6_axvTracActMean_calc S6_axvTracMin_calc /end SUB_GROUP
 /begin REF_CHARACTERISTIC P_Global_TireRadius_m P_LongCtrl_VLCMaRatioCharMaYAxis P_LongCtrl_VLCTrRatioCharMaXAxis P_LongCtrl_VLCTrTatioMax P_LongCtrl_VLCTrTatioMin P_LongCtrl_VLCaXCDeadZoneProp_Y P_LongCtrl_VLCaxCtrlDevDeadZoneChar_Y P_LongCtrl_VLCaxCtrlDevEC2DCMax P_LongCtrl_VLCaxCtrlDevFastQuitDCMode P_LongCtrl_VLCaxCtrlDevThresAddEC2DCCharYAxis P_LongCtrl_VLCaxCtrlDevTresAddDC2ECYAxis P_LongCtrl_VLCcoefKiEnlargeADiffYAxis P_LongCtrl_VLCdaxTarEC2DCMax P_LongCtrl_VLCdriveOffAxUpLimXAxix P_LongCtrl_VLCdriveOffAxUpLimYAxix P_LongCtrl_VLCki P_LongCtrl_VLCkp P_LongCtrl_VLCks /end REF_CHARACTERISTIC
 /begin REF_MEASUREMENT LongCtrl_DCEnable LongCtrl_ECEnable LongCtrl_FF_NetEngTorq LongCtrl_FLWheelDriveDirection LongCtrl_FRWheelDriveDirection LongCtrl_OverrideToDC LongCtrl_PI_NetEngTorq LongCtrl_RLWheelDriveDirection LongCtrl_RRWheelDriveDirection LongCtrl_Sw2DC LongCtrl_Sw2EC LongCtrl_Tr_Ratio LongCtrl_VLCState LongCtrl_VLC_DriveOffConditonFulfilled LongCtrl_axvRoadSlopeMs2 LongCtrl_tEC LongCtrl_tECDC LongCtrl_vxvRefMs Longctrl_ACCSts Longctrl_ACC_AccelerateJerk Longctrl_ACC_BrakePrefer Longctrl_ACC_DecelToStopReq Longctrl_ACC_DecelerateJerk Longctrl_ACC_DrvOFF_Req Longctrl_ACC_axvCvAim Longctrl_ACC_axv_ComfortBandLowerValue Longctrl_ACC_axv_ComfortBandUpperValue Longctrl_CurrentGear Longctrl_EngSpd Longctrl_EngTqMaxActSpd Longctrl_EngTqMinAct Longctrl_NetEngTorqNorm Longctrl_NetEngTrq Longctrl_NoBrakeForce Longctrl_ShiftinProgress Longctrl_VIE_AxRefDt Longctrl_VIE_alpSideSlipAngle Longctrl_VIE_axRefMs2 Longctrl_VehicleStandStill Longctrl_tCycleVLC /end REF_MEASUREMENT
/end GROUP
/begin GROUP S6_DC "PubIfControlLONC_MDL/Subsystem/VLC/Vlc/DC"
 /begin REF_CHARACTERISTIC P_LongCtrl_VLCaccelMinHoldXAxis P_LongCtrl_VLCaccelMinHoldYAxis P_LongCtrl_VLCaccelMinSlidHoldXAxis P_LongCtrl_VLCaccelMinSlidHoldYAxis P_LongCtrl_VLCjerkHoldXAxis P_LongCtrl_VLCjerkHoldYAxis P_LongCtrl_VLCjerkSlidHoldXAxis P_LongCtrl_VLCjerkSlidHoldYAxis /end REF_CHARACTERISTIC
 /begin REF_MEASUREMENT LongCtrl_ACC_Decel_ReqValue LongCtrl_accelHoldMin LongCtrl_accelSlidHold LongCtrl_jerkHold LongCtrl_jerkSlidHold /end REF_MEASUREMENT
/end GROUP
/begin GROUP S6_EC "PubIfControlLONC_MDL/Subsystem/VLC/Vlc/EC"
 /begin REF_CHARACTERISTIC P_Global_TireRadius_m P_Global_Weight_N P_LongCtrl_VLCCounterDC2ECTorqDelay P_LongCtrl_VLCCounterDrvOff2EC P_LongCtrl_VLCLowerJerkCounterDrvOff2EC P_LongCtrl_VLCUpperJerkCounterDrvOff2EC P_LongCtrl_VLCcoefPIYAxis P_LongCtrl_VLCvelCharCoefPIXAxis /end REF_CHARACTERISTIC
 /begin REF_MEASUREMENT LongCtrl_ACC_EngTrqReq LongCtrl_UpdateLowerValue LongCtrl_UpdateUpperValue /end REF_MEASUREMENT
/end GROUP
/begin GROUP S6_FF_Control "PubIfControlLONC_MDL/Subsystem/VLC/Vlc/FF_Control"
 /begin REF_CHARACTERISTIC P_Global_TireRadius_m P_Global_Weight_N P_LongCtrl_VLCengInverseEfficientYAxis P_LongCtrl_VLCtorqCharEngInverseEfficientXAxis /end REF_CHARACTERISTIC
 /begin REF_MEASUREMENT LongCtrl_FF_NetEngTorqInc LongCtrl_FF_NetEngTorqMax /end REF_MEASUREMENT
/end GROUP
/begin GROUP S6_PI_Control "PubIfControlLONC_MDL/Subsystem/VLC/Vlc/PI_Control"
 /begin REF_CHARACTERISTIC P_Global_TireRadius_m P_LongCtrl_VLCAxTarDtThreEnableI P_LongCtrl_VLCIACompensionNeg P_LongCtrl_VLCIACompensionPos P_LongCtrl_VLCaDiffCharCoefKiEnableXAxis P_LongCtrl_VLCaDiffCharCoefKiXAxis P_LongCtrl_VLCcoefIFadeOut1Calc P_LongCtrl_VLCcoefIFadeOut1Condition P_LongCtrl_VLCcoefIFadeOut2Calc P_LongCtrl_VLCcoefIFadeOut2Condition P_LongCtrl_VLCcoefIFadeOut3Calc P_LongCtrl_VLCcoefIFadeOut3Condition P_LongCtrl_VLCcoefKiDiffDtEnlargeYAxis P_LongCtrl_VLCcoefKiEnableYAxis P_LongCtrl_VLCdiffDtCharCoefKiEnlargeXAxis P_LongCtrl_VLCvelCharAxCtrlDevDeadZoneXAxis /end REF_CHARACTERISTIC
 /begin REF_MEASUREMENT LongCtrl_PI_NetEngTorqInc /end REF_MEASUREMENT
/end GROUP
/begin GROUP S6_SlidJudge "PubIfControlLONC_MDL/Subsystem/VLC/Vlc/SlidJudge"
 /begin REF_CHARACTERISTIC P_Global_TireRadius_m P_LongCtrl_AxvRoadSlopeThrd P_LongCtrl_SlideFlagEnable P_LongCtrl_TotWheelTrqRatio P_LongCtrl_VxvRefThrd /end REF_CHARACTERISTIC
 /begin REF_MEASUREMENT LongCtrl_ForwardFlagTrq LongCtrl_ForwardFlagVxv LongCtrl_ICEActWheelTrq LongCtrl_ICEFzNm LongCtrl_SlideFlag /end REF_MEASUREMENT
/end GROUP
/begin GROUP S6_SwitchToBrakeMode "PubIfControlLONC_MDL/Subsystem/VLC/Vlc/SwitchToBrakeMode"
 /begin REF_CHARACTERISTIC P_LongCtrl_VLCAxvTracMinDC1FullFillXAxis P_LongCtrl_VLCAxvTracMinDC1FullFillYAxis P_LongCtrl_VLCCounterAxvTracMinTimeout P_LongCtrl_VLCDtAxvRef2UpperBandDC5 P_LongCtrl_VLCTorqDiffThreAxvTracMinTimeout P_LongCtrl_VLCVlcAccThresAxvTracMinTimeout P_LongCtrl_VLCaxDtCharAxCtrlDevTresAddEC2DCXAxis P_LongCtrl_VLCaxvRoadSlopeDC4CharXAxis P_LongCtrl_VLCaxvRoadSlopeDC4CharYAxis /end REF_CHARACTERISTIC
 /begin REF_MEASUREMENT LongCtrl_Sw2DC1 LongCtrl_Sw2DC2 LongCtrl_Sw2DC3 LongCtrl_Sw2DC4 LongCtrl_Sw2DC5 LongCtrl_Sw2DC6 LongCtrl_Sw2DC7 /end REF_MEASUREMENT
/end GROUP
/begin GROUP S6_SwitchToDriveMode "PubIfControlLONC_MDL/Subsystem/VLC/Vlc/SwitchToDriveMode" /begin REF_CHARACTERISTIC P_LongCtrl_VLCaxDtCharAxCtrlDevTresAddDC2ECXAxis /end REF_CHARACTERISTIC
 /begin REF_MEASUREMENT LongCtrl_Sw2EC1 LongCtrl_Sw2EC2 LongCtrl_Sw2EC3 LongCtrl_Sw2EC4 LongCtrl_Sw2EC5 /end REF_MEASUREMENT
/end GROUP
/begin GROUP S6_UpdateFlagCalc "PubIfControlLONC_MDL/Subsystem/VLC/Vlc/UpdateFlagCalc"
 /begin REF_CHARACTERISTIC P_LongCtrl_VLCaDtThresUpdateTorq P_LongCtrl_VLCvelThresUpdateTorq /end REF_CHARACTERISTIC
 /begin REF_MEASUREMENT LongCtrl_UpdateEnable_axvModeldiff /end REF_MEASUREMENT
/end GROUP
/begin GROUP S6_axvClosedLoopControlCalc "PubIfControlLONC_MDL/Subsystem/VLC/Vlc/axvClosedLoopControlCalc" /begin REF_MEASUREMENT LongCtrl_axvClosedLoopControl LongCtrl_axvDiff /end REF_MEASUREMENT /end GROUP
/begin GROUP S6_axvModelResidualCalc "PubIfControlLONC_MDL/Subsystem/VLC/Vlc/axvModelResidualCalc"
 /begin REF_MEASUREMENT LongCtrl_axvModelDiff LongCtrl_axvModelRef LongCtrl_axvModelResidual /end REF_MEASUREMENT
/end GROUP
/begin GROUP S6_axvTracActMean_calc "PubIfControlLONC_MDL/Subsystem/VLC/Vlc/axvTracActMean_calc"
 /begin REF_CHARACTERISTIC P_Global_TireRadius_m P_Global_Weight_N P_LongCtrl_VLC_WindArea P_LongCtrl_VLC_fRollCoef P_LongCtrl_VLCcoefFXAxis P_LongCtrl_VLCcoefFYAxis P_LongCtrl_VLCengEfficientCharYAxis P_LongCtrl_VLCtorqCharEngEfficientXAxis /end REF_CHARACTERISTIC
 /begin REF_MEASUREMENT LongCtrl_Fz LongCtrl_axvTracActMean /end REF_MEASUREMENT
/end GROUP
/begin GROUP S6_axvTracMin_calc "PubIfControlLONC_MDL/Subsystem/VLC/Vlc/axvTracMin_calc"
 /begin REF_CHARACTERISTIC P_Global_TireRadius_m P_Global_Weight_N P_LongCtrl_VLC_WindArea P_LongCtrl_VLC_fRollCoef P_LongCtrl_VLCcoefFXAxis P_LongCtrl_VLCcoefFYAxis P_LongCtrl_VLCengEfficientCharYAxis P_LongCtrl_VLCtorqCharEngEfficientXAxis /end REF_CHARACTERISTIC
 /begin REF_MEASUREMENT LongCtrl_axvTracMin /end REF_MEASUREMENT
/end GROUP
/begin GROUP PubIfDecisionPLAN_MDL "PubIfDecisionPLAN_MDL" /begin SUB_GROUP Root_Subsystem_Reference2 /end SUB_GROUP /end GROUP
/begin GROUP Root_Subsystem_Reference2 "PubIfDecisionPLAN_MDL/Subsystem Reference" /begin SUB_GROUP S1_Subsystem_Reference1 S1_Subsystem_Reference2 /end SUB_GROUP /end GROUP
/begin GROUP S1_Subsystem_Reference1 "PubIfDecisionPLAN_MDL/Subsystem Reference/Subsystem Reference1" /begin SUB_GROUP S4_LcCancelFinishCalc1 S4_LcOverTk /end SUB_GROUP /end GROUP
/begin GROUP S1_Subsystem_Reference2 "PubIfDecisionPLAN_MDL/Subsystem Reference/Subsystem Reference2" /begin SUB_GROUP S5_DPCLock S5_DangerPlausCalc /end SUB_GROUP /end GROUP
/begin GROUP S4_LcCancelFinishCalc1 "PubIfDecisionPLAN_MDL/Subsystem Reference/Subsystem Reference1/LcCancelFinishCalc1" /begin SUB_GROUP S184_Subsystem3 /end SUB_GROUP /end GROUP
/begin GROUP S4_LcOverTk "PubIfDecisionPLAN_MDL/Subsystem Reference/Subsystem Reference1/LcOverTk" /begin REF_MEASUREMENT PLAN_ALC_LcOverTkLe_ALCSwtOn PLAN_ALC_LcOverTkRi_ALCSwtOn /end REF_MEASUREMENT /end GROUP
/begin GROUP S5_DPCLock "PubIfDecisionPLAN_MDL/Subsystem Reference/Subsystem Reference2/DPCLock" /begin REF_CHARACTERISTIC P_Global_DxvFrontBumper_m P_Global_DxvRearBumper_m /end REF_CHARACTERISTIC /end GROUP
/begin GROUP S5_DangerPlausCalc "PubIfDecisionPLAN_MDL/Subsystem Reference/Subsystem Reference2/DangerPlausCalc" /begin REF_CHARACTERISTIC P_Global_DxvFrontBumper_m P_Global_DxvRearBumper_m /end REF_CHARACTERISTIC /end GROUP
/begin GROUP S184_Subsystem3 "PubIfDecisionPLAN_MDL/Subsystem Reference/Subsystem Reference1/LcCancelFinishCalc1/Subsystem3" /begin REF_CHARACTERISTIC P_Global_WheelBase_m P_Global_WheelTrack_m /end REF_CHARACTERISTIC /end GROUP
/begin GROUP PubIfStateVSM_MDL "PubIfStateVSM_MDL" /begin SUB_GROUP Root_Subsystem_Reference3 /end SUB_GROUP /end GROUP
/begin GROUP Root_Subsystem_Reference3 "PubIfStateVSM_MDL/Subsystem Reference" /begin SUB_GROUP S1_Subsystem /end SUB_GROUP /end GROUP
/begin GROUP S1_Subsystem "PubIfStateVSM_MDL/Subsystem Reference/Subsystem" /begin SUB_GROUP S2_StateManage /end SUB_GROUP /begin REF_MEASUREMENT VSM_Counter /end REF_MEASUREMENT /end GROUP
/begin GROUP S2_StateManage "PubIfStateVSM_MDL/Subsystem Reference/Subsystem/StateManage" /begin SUB_GROUP S6_Cruise S6_ESS S6_Enlong2s1 S6_HOD S6_LSS S6_UOM /end SUB_GROUP
 /begin REF_CHARACTERISTIC P_VSM_ACCSOS_SW P_VSM_AESSwtReq P_VSM_ELKSwtReq P_VSM_ESS_VehSwtReq P_VSM_ICA_HandsOffSwtReq P_VSM_ISLSwtReq P_VSM_IntelligentEvaSwtReq P_VSM_LCKSwtReq P_VSM_LDWSwtReq P_VSM_LKASwtReq P_VSM_LSSSwtReq P_VSM_NOH_Act_Req P_VSM_NOH_Swt_Req P_VSM_TSRSwtReq P_VSM_TSRWarnSwtReq /end REF_CHARACTERISTIC
/end GROUP
/begin GROUP S6_Cruise "PubIfStateVSM_MDL/Subsystem Reference/Subsystem/StateManage/Cruise" /begin SUB_GROUP S19_Cruise /end SUB_GROUP /end GROUP
/begin GROUP S6_ESS "PubIfStateVSM_MDL/Subsystem Reference/Subsystem/StateManage/ESS" /begin SUB_GROUP S21_ESS /end SUB_GROUP /end GROUP
/begin GROUP S6_Enlong2s1 "PubIfStateVSM_MDL/Subsystem Reference/Subsystem/StateManage/Enlong2s1" /begin REF_CHARACTERISTIC P_VSM_SOSContinueTime P_VSM_SOSSpdLimit /end REF_CHARACTERISTIC /end GROUP
/begin GROUP S6_HOD "PubIfStateVSM_MDL/Subsystem Reference/Subsystem/StateManage/HOD" /begin SUB_GROUP S23_HOD /end SUB_GROUP /end GROUP
/begin GROUP S6_LSS "PubIfStateVSM_MDL/Subsystem Reference/Subsystem/StateManage/LSS" /begin SUB_GROUP S24_LCK_LKA_LDW_ELKStateMachine3 S24_TLS /end SUB_GROUP /end GROUP
/begin GROUP S6_UOM "PubIfStateVSM_MDL/Subsystem Reference/Subsystem/StateManage/UOM" /begin SUB_GROUP S28_GW_V71 /end SUB_GROUP /begin REF_CHARACTERISTIC P_VSM_CruiseFunUserInputMappingWays /end REF_CHARACTERISTIC /end GROUP
/begin GROUP S19_Cruise "PubIfStateVSM_MDL/Subsystem Reference/Subsystem/StateManage/Cruise/Cruise" /begin SUB_GROUP S29_ACC S29_HWA S29_ISL S29_LngHMI S29_SetSpd /end SUB_GROUP
 /begin REF_MEASUREMENT VSM_ACC_VehCnfgACC VSM_Diagnostic_ACCError VSM_Diagnostic_HWAError VSM_Diagnostic_TJAError VSM_HandsOn /end REF_MEASUREMENT
/end GROUP
/begin GROUP S21_ESS "PubIfStateVSM_MDL/Subsystem Reference/Subsystem/StateManage/ESS/ESS" /begin SUB_GROUP S490_Subsystem1 /end SUB_GROUP /end GROUP
/begin GROUP S23_HOD "PubIfStateVSM_MDL/Subsystem Reference/Subsystem/StateManage/HOD/HOD" /begin SUB_GROUP S620_LP_filter /end SUB_GROUP
 /begin REF_CHARACTERISTIC P_VSM_HOD_HWA_HandsOffLev1TimeCnt P_VSM_HOD_HWA_HandsOffLev2TimeCnt P_VSM_HOD_HWA_HandsOffLev3TimeCnt P_VSM_HOD_HWA_HandsOffLev4TimeCnt P_VSM_HOD_HandsOff_Tr P_VSM_HOD_HandsOn_Tr P_VSM_HOD_Handson_TimeInsertPoint P_VSM_HOD_Handson_TrqInsertPoint P_VSM_HOD_LCKTJA_HandsOffLev1TimeCnt P_VSM_HOD_LCKTJA_HandsOffLev2TimeCnt P_VSM_HOD_LCKTJA_HandsOffLev3TimeCnt P_VSM_HOD_LCKTJA_HandsOffLev4TimeCnt /end REF_CHARACTERISTIC
 /begin REF_MEASUREMENT VSM_HandsOff VSM_HandsOffDetd VSM_HandsOffWarningLevel /end REF_MEASUREMENT
/end GROUP
/begin GROUP S24_LCK_LKA_LDW_ELKStateMachine3 "PubIfStateVSM_MDL/Subsystem Reference/Subsystem/StateManage/LSS/LCK_LKA_LDW_ELKStateMachine3"
 /begin SUB_GROUP S641_ELKState_Machine S641_LCK S641_LCKIE S641_LDW S641_LKA S641_Signal_calculate /end SUB_GROUP
/end GROUP
/begin GROUP S24_TLS "PubIfStateVSM_MDL/Subsystem Reference/Subsystem/StateManage/LSS/TLS" /begin SUB_GROUP S642_TargetLineSelect /end SUB_GROUP /end GROUP
/begin GROUP S28_GW_V71 "PubIfStateVSM_MDL/Subsystem Reference/Subsystem/StateManage/UOM/GW_V71" /begin SUB_GROUP S1686_UOM /end SUB_GROUP /end GROUP
/begin GROUP S29_ACC "PubIfStateVSM_MDL/Subsystem Reference/Subsystem/StateManage/Cruise/Cruise/ACC" /begin SUB_GROUP S30_Subsystem /end SUB_GROUP /end GROUP
/begin GROUP S29_HWA "PubIfStateVSM_MDL/Subsystem Reference/Subsystem/StateManage/Cruise/Cruise/HWA" /begin SUB_GROUP S31_Subsystem /end SUB_GROUP /end GROUP
/begin GROUP S29_ISL "PubIfStateVSM_MDL/Subsystem Reference/Subsystem/StateManage/Cruise/Cruise/ISL" /begin SUB_GROUP S32_SM_Conds /end SUB_GROUP /end GROUP
/begin GROUP S29_LngHMI "PubIfStateVSM_MDL/Subsystem Reference/Subsystem/StateManage/Cruise/Cruise/LngHMI" /begin SUB_GROUP S33_Subsystem3 /end SUB_GROUP /end GROUP
/begin GROUP S29_SetSpd "PubIfStateVSM_MDL/Subsystem Reference/Subsystem/StateManage/Cruise/Cruise/SetSpd" /begin SUB_GROUP S34_Subsystem /end SUB_GROUP /end GROUP
/begin GROUP S490_Subsystem1 "PubIfStateVSM_MDL/Subsystem Reference/Subsystem/StateManage/ESS/ESS/Subsystem1" /begin SUB_GROUP S491_ESS_StateMachine /end SUB_GROUP /begin REF_MEASUREMENT VSM_ESS_SubModel_Number VSM_ESS_SubModel_VERSION /end REF_MEASUREMENT /end GROUP
/begin GROUP S620_LP_filter "PubIfStateVSM_MDL/Subsystem Reference/Subsystem/StateManage/HOD/HOD/LP filter" /begin REF_CHARACTERISTIC P_VSM_HOD_DrvTrqFlterTIme /end REF_CHARACTERISTIC /begin REF_MEASUREMENT VSM_HOD_DrvTrqFilted /end REF_MEASUREMENT /end GROUP
/begin GROUP S641_ELKState_Machine "PubIfStateVSM_MDL/Subsystem Reference/Subsystem/StateManage/LSS/LCK_LKA_LDW_ELKStateMachine3/ELKState_Machine" /begin SUB_GROUP S643_ELK /end SUB_GROUP /end GROUP
/begin GROUP S641_LCK "PubIfStateVSM_MDL/Subsystem Reference/Subsystem/StateManage/LSS/LCK_LKA_LDW_ELKStateMachine3/LCK" /begin SUB_GROUP S645_LCK /end SUB_GROUP /end GROUP
/begin GROUP S641_LCKIE "PubIfStateVSM_MDL/Subsystem Reference/Subsystem/StateManage/LSS/LCK_LKA_LDW_ELKStateMachine3/LCKIE" /begin SUB_GROUP S646_LCKIE /end SUB_GROUP /end GROUP
/begin GROUP S641_LDW "PubIfStateVSM_MDL/Subsystem Reference/Subsystem/StateManage/LSS/LCK_LKA_LDW_ELKStateMachine3/LDW" /begin SUB_GROUP S647_LDW /end SUB_GROUP /end GROUP
/begin GROUP S641_LKA "PubIfStateVSM_MDL/Subsystem Reference/Subsystem/StateManage/LSS/LCK_LKA_LDW_ELKStateMachine3/LKA" /begin SUB_GROUP S648_LKA /end SUB_GROUP /end GROUP
/begin GROUP S641_Signal_calculate "PubIfStateVSM_MDL/Subsystem Reference/Subsystem/StateManage/LSS/LCK_LKA_LDW_ELKStateMachine3/Signal_calculate" /begin SUB_GROUP S650_LKA_LDW_SignalProcess S650_LaneAndRe_SignalProcess /end SUB_GROUP /end GROUP
/begin GROUP S642_TargetLineSelect "PubIfStateVSM_MDL/Subsystem Reference/Subsystem/StateManage/LSS/TLS/TargetLineSelect" /begin SUB_GROUP S1615_Enlong3s1 S1615_Enlong3s3 /end SUB_GROUP /begin REF_MEASUREMENT VSM_TarDangerLevel /end REF_MEASUREMENT /end GROUP
/begin GROUP S1686_UOM "PubIfStateVSM_MDL/Subsystem Reference/Subsystem/StateManage/UOM/GW_V71/UOM" /begin SUB_GROUP S1687_Subsystem /end SUB_GROUP /begin REF_CHARACTERISTIC P_VSM_ALCSwtReq /end REF_CHARACTERISTIC /end GROUP
/begin GROUP S30_Subsystem "PubIfStateVSM_MDL/Subsystem Reference/Subsystem/StateManage/Cruise/Cruise/ACC/Subsystem" /begin SUB_GROUP S36_ACCTJA_SM S36_ACC_Condotion S36_Subsystem /end SUB_GROUP /end GROUP
/begin GROUP S31_Subsystem "PubIfStateVSM_MDL/Subsystem Reference/Subsystem/StateManage/Cruise/Cruise/HWA/Subsystem" /begin SUB_GROUP S226_HWA_Condotion S226_HWA_SM /end SUB_GROUP /begin REF_CHARACTERISTIC P_VSM_HWA_ALCStsSW /end REF_CHARACTERISTIC /begin REF_MEASUREMENT VSM_HWA_LaneChangeReq /end REF_MEASUREMENT /end GROUP
/begin GROUP S32_SM_Conds "PubIfStateVSM_MDL/Subsystem Reference/Subsystem/StateManage/Cruise/Cruise/ISL/SM_Conds" /begin REF_CHARACTERISTIC P_VSM_ISL_TimeInformDis P_VSM_ISL_TimeTakeOver /end REF_CHARACTERISTIC /end GROUP
/begin GROUP S33_Subsystem3 "PubIfStateVSM_MDL/Subsystem Reference/Subsystem/StateManage/Cruise/Cruise/LngHMI/Subsystem3" /begin SUB_GROUP S365_Enlong3s S365_Enlong3s1 S365_Enlong3s2 /end SUB_GROUP
 /begin REF_MEASUREMENT VSM_ACC_HazActv VSM_ACC_ModeDisp VSM_HWA_ModeDisp VSM_TJA_ModeDisp /end REF_MEASUREMENT
/end GROUP
/begin GROUP S34_Subsystem "PubIfStateVSM_MDL/Subsystem Reference/Subsystem/StateManage/Cruise/Cruise/SetSpd/Subsystem" /begin REF_CHARACTERISTIC P_VSM_TimeGapHMI_SW /end REF_CHARACTERISTIC
 /begin REF_MEASUREMENT VSM_ACC_SpdSetValue VSM_ACC_TimeGapSet VSM_ACC_VsetBelowMin /end REF_MEASUREMENT
/end GROUP
/begin GROUP S491_ESS_StateMachine "PubIfStateVSM_MDL/Subsystem Reference/Subsystem/StateManage/ESS/ESS/Subsystem1/ESS_StateMachine" /begin SUB_GROUP S492_ESS_Condition S492_Subsystem /end SUB_GROUP
 /begin REF_CHARACTERISTIC P_Global_WheelBase_m P_VSM_ESS_ACtiveTime P_VSM_ESS_AngleSpdTable_deg P_VSM_ESS_SafeDistance_m P_VSM_ESS_SpdPoint_kmh P_VSM_ESS_SpdTime_s /end REF_CHARACTERISTIC
 /begin REF_MEASUREMENT VSM_ESSState VSM_ESS_LastPoint VSM_ESS_PedSwtReq VSM_ESS_Sensor_idle2error VSM_ESS_StateL VSM_ESS_StateR VSM_ESS_VehCnfgESS VSM_ESS_VehSwtReq /end REF_MEASUREMENT
/end GROUP
/begin GROUP S643_ELK "PubIfStateVSM_MDL/Subsystem Reference/Subsystem/StateManage/LSS/LCK_LKA_LDW_ELKStateMachine3/ELKState_Machine/ELK" /begin SUB_GROUP S651_ELK_Condition S651_ELK_OnComing_OverTaking /end SUB_GROUP /begin REF_MEASUREMENT VSM_ELKState VSM_ELK_VehConfigELK VSM_ELK_Warning /end REF_MEASUREMENT /end GROUP
/begin GROUP S645_LCK "PubIfStateVSM_MDL/Subsystem Reference/Subsystem/StateManage/LSS/LCK_LKA_LDW_ELKStateMachine3/LCK/LCK" /begin SUB_GROUP S844_LCK2 /end SUB_GROUP /end GROUP
/begin GROUP S646_LCKIE "PubIfStateVSM_MDL/Subsystem Reference/Subsystem/StateManage/LSS/LCK_LKA_LDW_ELKStateMachine3/LCKIE/LCKIE" /begin SUB_GROUP S1133_LCKIE_StateMachine S1133_Subsystem1 /end SUB_GROUP
 /begin REF_MEASUREMENT VSM_LCKIE_State VSM_LCKIE_SubModel_Number VSM_LCKIE_SubModel_VERSION /end REF_MEASUREMENT
/end GROUP
/begin GROUP S647_LDW "PubIfStateVSM_MDL/Subsystem Reference/Subsystem/StateManage/LSS/LCK_LKA_LDW_ELKStateMachine3/LDW/LDW" /begin SUB_GROUP S1225_LDW2 /end SUB_GROUP /end GROUP
/begin GROUP S648_LKA "PubIfStateVSM_MDL/Subsystem Reference/Subsystem/StateManage/LSS/LCK_LKA_LDW_ELKStateMachine3/LKA/LKA" /begin SUB_GROUP S1354_LKA2 /end SUB_GROUP /end GROUP
/begin GROUP S650_LKA_LDW_SignalProcess "PubIfStateVSM_MDL/Subsystem Reference/Subsystem/StateManage/LSS/LCK_LKA_LDW_ELKStateMachine3/Signal_calculate/LKA_LDW_SignalProcess"
 /begin REF_CHARACTERISTIC P_Global_VehicleWidthMin_m P_VSM_LDW_State_Param_LaneTime P_VSM_LDW_State_Param_Speed /end REF_CHARACTERISTIC
 /begin REF_MEASUREMENT VSM_FLWhelDy VSM_FRWhelDy VSM_preFLWhelDy VSM_preFRWhelDy /end REF_MEASUREMENT
/end GROUP
/begin GROUP S650_LaneAndRe_SignalProcess "PubIfStateVSM_MDL/Subsystem Reference/Subsystem/StateManage/LSS/LCK_LKA_LDW_ELKStateMachine3/Signal_calculate/LaneAndRe_SignalProcess" /begin SUB_GROUP S1544_InCondition1 S1544_LaneRage_Handle /end SUB_GROUP /end GROUP
/begin GROUP S1615_Enlong3s1 "PubIfStateVSM_MDL/Subsystem Reference/Subsystem/StateManage/LSS/TLS/TargetLineSelect/Enlong3s1" /begin REF_CHARACTERISTIC P_VSM_TLS_LCCancelTime /end REF_CHARACTERISTIC /end GROUP
/begin GROUP S1615_Enlong3s3 "PubIfStateVSM_MDL/Subsystem Reference/Subsystem/StateManage/LSS/TLS/TargetLineSelect/Enlong3s3" /begin REF_CHARACTERISTIC P_VSM_TLS_LCCancelTime /end REF_CHARACTERISTIC /end GROUP
/begin GROUP S1687_Subsystem "PubIfStateVSM_MDL/Subsystem Reference/Subsystem/StateManage/UOM/GW_V71/UOM/Subsystem"
 /begin REF_MEASUREMENT VSM_ACC_SWCruise VSM_ACC_SWEngState VSM_ACC_SWRes VSM_ACC_SWSet VSM_TJA_ACC_SelSts VSM_User_ACCRes VSM_User_ACCSet VSM_User_TJASet /end REF_MEASUREMENT
/end GROUP
/begin GROUP S36_ACCTJA_SM "PubIfStateVSM_MDL/Subsystem Reference/Subsystem/StateManage/Cruise/Cruise/ACC/Subsystem/ACCTJA_SM" /begin SUB_GROUP S37_Subsystem /end SUB_GROUP /begin REF_CHARACTERISTIC P_VSM_ACC_BrakeOnlyNum /end REF_CHARACTERISTIC /begin REF_MEASUREMENT VSM_ACCSts /end REF_MEASUREMENT /end GROUP
/begin GROUP S654_OnComing "PubIfStateVSM_MDL/Subsystem Reference/Subsystem/StateManage/LSS/LCK_LKA_LDW_ELKStateMachine3/ELKState_Machine/ELK/ELK_OnComing_OverTaking/OnComing" /begin REF_CHARACTERISTIC P_Global_VehicleWidthMin_m /end REF_CHARACTERISTIC /end GROUP
/begin GROUP S654_OverTaking "PubIfStateVSM_MDL/Subsystem Reference/Subsystem/StateManage/LSS/LCK_LKA_LDW_ELKStateMachine3/ELKState_Machine/ELK/ELK_OnComing_OverTaking/OverTaking" /begin REF_CHARACTERISTIC P_Global_DxvRearBumper_m P_Global_VehicleWidthMin_m /end REF_CHARACTERISTIC /end GROUP
/begin GROUP S654_Subsystem "PubIfStateVSM_MDL/Subsystem Reference/Subsystem/StateManage/LSS/LCK_LKA_LDW_ELKStateMachine3/ELKState_Machine/ELK/ELK_OnComing_OverTaking/Subsystem" /begin REF_CHARACTERISTIC P_Global_VehicleWidthMin_m /end REF_CHARACTERISTIC /end GROUP
/begin GROUP S1135_LCKIE_SignalProcess1 "PubIfStateVSM_MDL/Subsystem Reference/Subsystem/StateManage/LSS/LCK_LKA_LDW_ELKStateMachine3/LCKIE/LCKIE/Subsystem1/LCKIE_SignalProcess1" /begin REF_CHARACTERISTIC P_Global_VehicleWidthMin_m /end REF_CHARACTERISTIC /end GROUP
/* ******** Computation Methods *********************************************** */ /* ******** Computation Tab Refs ********************************************** */ /* ******** Record Layouts **************************************************** */
/end MODULE
/end PROJECT
/* ******** [EOF] ************************************************************* */
