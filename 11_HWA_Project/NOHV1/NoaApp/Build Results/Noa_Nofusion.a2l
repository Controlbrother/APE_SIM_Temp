ASAP2_VERSION 1 61
/begin PROJECT Noa_Nofusion ""
/begin MODULE Noa_Nofusion ""
/begin MOD_COMMON /* Comment */ "" DEPOSIT ABSOLUTE BYTE_ORDER MSB_LAST ALIGNMENT_BYTE 0x01 ALIGNMENT_WORD 0x02 ALIGNMENT_LONG 0x04 ALIGNMENT_FLOAT32_IEEE 0x04 ALIGNMENT_FLOAT64_IEEE 0x08 /end MOD_COMMON
/begin RECORD_LAYOUT Scalar_BOOLEAN FNC_VALUES 1 UBYTE ROW_DIR DIRECT /end RECORD_LAYOUT
/begin RECORD_LAYOUT Scalar_UBYTE FNC_VALUES 1 UBYTE ROW_DIR DIRECT /end RECORD_LAYOUT
/begin RECORD_LAYOUT Scalar_UWORD FNC_VALUES 1 UWORD ROW_DIR DIRECT /end RECORD_LAYOUT
/begin RECORD_LAYOUT Scalar_FLOAT32_IEEE FNC_VALUES 1 FLOAT32_IEEE ROW_DIR DIRECT /end RECORD_LAYOUT
/begin RECORD_LAYOUT Scalar_FLOAT64_IEEE FNC_VALUES 1 FLOAT64_IEEE ROW_DIR DIRECT /end RECORD_LAYOUT
/begin RECORD_LAYOUT Lookup1D_FLOAT32_IEEE FNC_VALUES 1 FLOAT32_IEEE ROW_DIR DIRECT /end RECORD_LAYOUT
/begin RECORD_LAYOUT Lookup1D_X_FLOAT32_IEEE AXIS_PTS_X 1 FLOAT32_IEEE INDEX_INCR DIRECT /end RECORD_LAYOUT
/begin RECORD_LAYOUT Lookup2D_FLOAT64_IEEE FNC_VALUES 1 FLOAT64_IEEE ROW_DIR DIRECT /end RECORD_LAYOUT
/begin RECORD_LAYOUT Lookup2D_X_BOOLEAN AXIS_PTS_X 1 UBYTE INDEX_INCR DIRECT /end RECORD_LAYOUT
/begin RECORD_LAYOUT Lookup2D_X_BYTE AXIS_PTS_X 1 SBYTE INDEX_INCR DIRECT /end RECORD_LAYOUT
/begin RECORD_LAYOUT Lookup2D_X_UWORD AXIS_PTS_X 1 UWORD INDEX_INCR DIRECT /end RECORD_LAYOUT
/begin RECORD_LAYOUT Lookup2D_X_WORD AXIS_PTS_X 1 SWORD INDEX_INCR DIRECT /end RECORD_LAYOUT
/begin RECORD_LAYOUT Lookup2D_X_ULONG AXIS_PTS_X 1 ULONG INDEX_INCR DIRECT /end RECORD_LAYOUT
/begin RECORD_LAYOUT Lookup2D_X_LONG AXIS_PTS_X 1 SLONG INDEX_INCR DIRECT /end RECORD_LAYOUT
/begin CHARACTERISTIC P_VSM_ESS_MaxLateral_mss "" CURVE 0x003C5648 Lookup1D_FLOAT32_IEEE 0 PubIfStateVSM_MDL_CM_single -3.4E+38 3.4E+38
 /begin AXIS_DESCR COM_AXIS NO_INPUT_QUANTITY PubIfStateVSM_MDL_CM_single 6 -3.4E+38 3.4E+38 AXIS_PTS_REF P_VSM_ESS_IPSpeed_kmh /end AXIS_DESCR
/end CHARACTERISTIC
/begin CHARACTERISTIC P_VSM_ESS_SteerWheelSpd_Param "" CURVE 0x003C56AC Lookup1D_FLOAT32_IEEE 0 PubIfStateVSM_MDL_CM_single -3.4E+38 3.4E+38
 /begin AXIS_DESCR COM_AXIS NO_INPUT_QUANTITY PubIfStateVSM_MDL_CM_single 6 -3.4E+38 3.4E+38 AXIS_PTS_REF P_VSM_ESS_SteerWheelSpd_BP /end AXIS_DESCR
/end CHARACTERISTIC
/begin CHARACTERISTIC P_VSM_ESS_DriveIn "" CURVE 0x003C55D8 Lookup1D_FLOAT32_IEEE 0 PubIfStateVSM_MDL_CM_single -3.4E+38 3.4E+38
 /begin AXIS_DESCR COM_AXIS NO_INPUT_QUANTITY PubIfStateVSM_MDL_CM_single 6 -3.4E+38 3.4E+38 AXIS_PTS_REF P_VSM_ESS_DriveIn_BP /end AXIS_DESCR
/end CHARACTERISTIC
/begin CHARACTERISTIC P_VSM_ESS_DriverInputTrq_Param "" CURVE 0x003C5608 Lookup1D_FLOAT32_IEEE 0 PubIfStateVSM_MDL_CM_single -3.4E+38 3.4E+38
 /begin AXIS_DESCR COM_AXIS NO_INPUT_QUANTITY PubIfStateVSM_MDL_CM_single 6 -3.4E+38 3.4E+38 AXIS_PTS_REF P_VSM_ESS_DriveIn_BP /end AXIS_DESCR
/end CHARACTERISTIC
/begin CHARACTERISTIC P_VSM_LCKIE_Laneoffset "" CURVE 0x003C5758 Lookup1D_FLOAT32_IEEE 0 PubIfStateVSM_MDL_CM_single -3.4E+38 3.4E+38
 /begin AXIS_DESCR COM_AXIS NO_INPUT_QUANTITY PubIfStateVSM_MDL_CM_single 5 -3.4E+38 3.4E+38 AXIS_PTS_REF P_VSM_LCKIE_Laneoffset_BP /end AXIS_DESCR
/end CHARACTERISTIC
/begin CHARACTERISTIC P_VSM_LCKIE_LATC_LimitDis "" CURVE 0x003C5730 Lookup1D_FLOAT32_IEEE 0 PubIfStateVSM_MDL_CM_single -3.4E+38 3.4E+38
 /begin AXIS_DESCR COM_AXIS VSM_LCKIE_LatC_DetaDis PubIfStateVSM_MDL_CM_single 5 -3.4E+38 3.4E+38 AXIS_PTS_REF P_VSM_LCKIE_LATC_LimitDis_BP /end AXIS_DESCR
/end CHARACTERISTIC
/begin CHARACTERISTIC P_VSM_LCKIE_LatC_DisOffofLanWidth "" CURVE 0x003C5780 Lookup1D_FLOAT32_IEEE 0 PubIfStateVSM_MDL_CM_single -3.4E+38 3.4E+38
 /begin AXIS_DESCR COM_AXIS VSM_LCKIE_OS_RoadWidth PubIfStateVSM_MDL_CM_single 4 -3.4E+38 3.4E+38 AXIS_PTS_REF P_VSM_LCKIE_LatC_LanWidth /end AXIS_DESCR
/end CHARACTERISTIC
/begin CHARACTERISTIC P_VSM_LCKIE_LatC_DisOffofSpd "" CURVE 0x003C5790 Lookup1D_FLOAT32_IEEE 0 PubIfStateVSM_MDL_CM_single -3.4E+38 3.4E+38
 /begin AXIS_DESCR COM_AXIS NO_INPUT_QUANTITY PubIfStateVSM_MDL_CM_single 6 -3.4E+38 3.4E+38 AXIS_PTS_REF P_VSM_LCKIE_LatC_Spd /end AXIS_DESCR
/end CHARACTERISTIC
/begin CHARACTERISTIC P_VSM_LCKIE_LatC_SafeDisofLanWidth "" CURVE 0x003C57C4 Lookup1D_FLOAT32_IEEE 0 PubIfStateVSM_MDL_CM_single -3.4E+38 3.4E+38
 /begin AXIS_DESCR COM_AXIS VSM_LCKIE_OS_RoadWidth PubIfStateVSM_MDL_CM_single 4 -3.4E+38 3.4E+38 AXIS_PTS_REF P_VSM_LCKIE_LatC_LanWidth /end AXIS_DESCR
/end CHARACTERISTIC
/begin CHARACTERISTIC P_VSM_LCKIE_LongC_d1 "" CURVE 0x003C5828 Lookup1D_FLOAT32_IEEE 0 PubIfStateVSM_MDL_CM_single -3.4E+38 3.4E+38
 /begin AXIS_DESCR COM_AXIS NO_INPUT_QUANTITY PubIfStateVSM_MDL_CM_single 6 -3.4E+38 3.4E+38 AXIS_PTS_REF P_VSM_LCKIE_LongC_Spd /end AXIS_DESCR
/end CHARACTERISTIC
/begin CHARACTERISTIC P_VSM_LCKIE_LongC_d2 "" CURVE 0x003C5840 Lookup1D_FLOAT32_IEEE 0 PubIfStateVSM_MDL_CM_single -3.4E+38 3.4E+38
 /begin AXIS_DESCR COM_AXIS VSM_LCKIE_OS_DetaSpdSelect PubIfStateVSM_MDL_CM_single 3 -3.4E+38 3.4E+38 AXIS_PTS_REF P_VSM_LCKIE_LongC_DetaSpd /end AXIS_DESCR
/end CHARACTERISTIC
/begin CHARACTERISTIC P_VSM_LCK_AbsEspInTime "" VALUE 0x003C2860 Scalar_FLOAT64_IEEE 0 PubIfStateVSM_MDL_CM_double -1.7E+308 1.7E+308 /end CHARACTERISTIC
/begin CHARACTERISTIC P_VSM_LCK_AccRateInTime "" VALUE 0x003C2868 Scalar_FLOAT64_IEEE 0 PubIfStateVSM_MDL_CM_double -1.7E+308 1.7E+308 /end CHARACTERISTIC
/begin CHARACTERISTIC P_VSM_LCK_AccrPelRateOut "" VALUE 0x003D6DC0 Scalar_FLOAT64_IEEE 0 PubIfStateVSM_MDL_CM_double -1.7E+308 1.7E+308 /end CHARACTERISTIC
/begin CHARACTERISTIC P_VSM_LCK_BrakePressInTime "" VALUE 0x003C2870 Scalar_FLOAT64_IEEE 0 PubIfStateVSM_MDL_CM_double -1.7E+308 1.7E+308 /end CHARACTERISTIC
/begin CHARACTERISTIC P_VSM_LCK_C0 "" VALUE 0x003C2878 Scalar_FLOAT64_IEEE 0 PubIfStateVSM_MDL_CM_double -1.7E+308 1.7E+308 /end CHARACTERISTIC
/begin CHARACTERISTIC P_VSM_LCK_DrvInputTrqValueInTime "" VALUE 0x003C2880 Scalar_FLOAT64_IEEE 0 PubIfStateVSM_MDL_CM_double -1.7E+308 1.7E+308 /end CHARACTERISTIC
/begin CHARACTERISTIC P_VSM_LCK_LCOverrideTime "" VALUE 0x003C2888 Scalar_FLOAT64_IEEE 0 PubIfStateVSM_MDL_CM_double -1.7E+308 1.7E+308 /end CHARACTERISTIC
/begin CHARACTERISTIC P_VSM_LCK_LanechangeSwitch "" VALUE 0x003D6DC8 Scalar_FLOAT64_IEEE 0 PubIfStateVSM_MDL_CM_double -1.7E+308 1.7E+308 /end CHARACTERISTIC
/begin CHARACTERISTIC P_VSM_LCK_Lanewidthswitch "" VALUE 0x003D6DD0 Scalar_FLOAT64_IEEE 0 PubIfStateVSM_MDL_CM_double -1.7E+308 1.7E+308 /end CHARACTERISTIC
/begin CHARACTERISTIC P_VSM_LCK_LateralAcceInTime "" VALUE 0x003C2890 Scalar_FLOAT64_IEEE 0 PubIfStateVSM_MDL_CM_double -1.7E+308 1.7E+308 /end CHARACTERISTIC
/begin CHARACTERISTIC P_VSM_LCK_LongitudeAccInTime "" VALUE 0x003C2898 Scalar_FLOAT64_IEEE 0 PubIfStateVSM_MDL_CM_double -1.7E+308 1.7E+308 /end CHARACTERISTIC
/begin CHARACTERISTIC P_VSM_LCK_OverrideInTime "" VALUE 0x003C28A0 Scalar_FLOAT64_IEEE 0 PubIfStateVSM_MDL_CM_double -1.7E+308 1.7E+308 /end CHARACTERISTIC
/begin CHARACTERISTIC P_VSM_LCK_OverrideTime "" VALUE 0x003C28A8 Scalar_FLOAT64_IEEE 0 PubIfStateVSM_MDL_CM_double -1.7E+308 1.7E+308 /end CHARACTERISTIC
/begin CHARACTERISTIC P_VSM_LCK_ParamA1 "" VAL_BLK 0x003D6DD8 Scalar_FLOAT64_IEEE 0 PubIfStateVSM_MDL_CM_double -1.7E+308 1.7E+308 MATRIX_DIM 1 4 1 /end CHARACTERISTIC
/begin CHARACTERISTIC P_VSM_LCK_State_ESSSts_enable "" VALUE 0x003C28B0 Scalar_FLOAT64_IEEE 0 PubIfStateVSM_MDL_CM_double -1.7E+308 1.7E+308 /end CHARACTERISTIC
/begin CHARACTERISTIC P_VSM_LCK_State_LaneChange_enable "" VALUE 0x003C28B8 Scalar_FLOAT64_IEEE 0 PubIfStateVSM_MDL_CM_double -1.7E+308 1.7E+308 /end CHARACTERISTIC
/begin CHARACTERISTIC P_VSM_LCK_State_Param_LaneCurve "" VAL_BLK 0x003C28C0 Scalar_FLOAT64_IEEE 0 PubIfStateVSM_MDL_CM_double -1.7E+308 1.7E+308 MATRIX_DIM 1 4 1 /end CHARACTERISTIC
/begin CHARACTERISTIC P_VSM_LCK_State_Param_LaneCurve_Offset "" VAL_BLK 0x003C28E0 Scalar_FLOAT64_IEEE 0 PubIfStateVSM_MDL_CM_double -1.7E+308 1.7E+308 MATRIX_DIM 1 4 1 /end CHARACTERISTIC
/begin CHARACTERISTIC P_VSM_LCK_State_Param_LaneWidth "" VAL_BLK 0x003C2900 Scalar_FLOAT64_IEEE 0 PubIfStateVSM_MDL_CM_double -1.7E+308 1.7E+308 MATRIX_DIM 1 7 1 /end CHARACTERISTIC
/begin CHARACTERISTIC P_VSM_LCK_State_Param_LaneWidth_Offset "" VAL_BLK 0x003C2938 Scalar_FLOAT64_IEEE 0 PubIfStateVSM_MDL_CM_double -1.7E+308 1.7E+308 MATRIX_DIM 1 7 1 /end CHARACTERISTIC
/begin CHARACTERISTIC P_VSM_LCK_SteerAngleSpdInTime "" VALUE 0x003C2970 Scalar_FLOAT64_IEEE 0 PubIfStateVSM_MDL_CM_double -1.7E+308 1.7E+308 /end CHARACTERISTIC
/begin CHARACTERISTIC P_VSM_LCK_SteerWheelAngleInTime "" VALUE 0x003C2978 Scalar_FLOAT64_IEEE 0 PubIfStateVSM_MDL_CM_double -1.7E+308 1.7E+308 /end CHARACTERISTIC
/begin CHARACTERISTIC P_VSM_LCK_T0 "" VALUE 0x003C2980 Scalar_FLOAT64_IEEE 0 PubIfStateVSM_MDL_CM_double -1.7E+308 1.7E+308 /end CHARACTERISTIC
/begin CHARACTERISTIC P_VSM_LCK_TargetInSwitch "" VALUE 0x003D6DF8 Scalar_FLOAT64_IEEE 0 PubIfStateVSM_MDL_CM_double -1.7E+308 1.7E+308 /end CHARACTERISTIC
/begin CHARACTERISTIC P_VSM_LCK_YawRateInTime "" VALUE 0x003C2988 Scalar_FLOAT64_IEEE 0 PubIfStateVSM_MDL_CM_double -1.7E+308 1.7E+308 /end CHARACTERISTIC
/begin CHARACTERISTIC P_VSM_LCK_dypreFactor "" VALUE 0x003C2990 Scalar_FLOAT64_IEEE 0 PubIfStateVSM_MDL_CM_double -1.7E+308 1.7E+308 /end CHARACTERISTIC
/begin CHARACTERISTIC P_VSM_LDW_AbsEspInTime "" VALUE 0x003C2998 Scalar_FLOAT64_IEEE 0 PubIfStateVSM_MDL_CM_double -1.7E+308 1.7E+308 /end CHARACTERISTIC
/begin CHARACTERISTIC P_VSM_LDW_AccRateInTime "" VALUE 0x003C29A0 Scalar_FLOAT64_IEEE 0 PubIfStateVSM_MDL_CM_double -1.7E+308 1.7E+308 /end CHARACTERISTIC
/begin CHARACTERISTIC P_VSM_LDW_BrakePressInTime "" VALUE 0x003C29A8 Scalar_FLOAT64_IEEE 0 PubIfStateVSM_MDL_CM_double -1.7E+308 1.7E+308 /end CHARACTERISTIC
/begin CHARACTERISTIC P_VSM_LDW_LaneChangeOffset "" VALUE 0x003C29B0 Scalar_FLOAT64_IEEE 0 PubIfStateVSM_MDL_CM_double -1.7E+308 1.7E+308 /end CHARACTERISTIC
/begin CHARACTERISTIC P_VSM_LDW_LateralAcceInTime "" VALUE 0x003C29B8 Scalar_FLOAT64_IEEE 0 PubIfStateVSM_MDL_CM_double -1.7E+308 1.7E+308 /end CHARACTERISTIC
/begin CHARACTERISTIC P_VSM_LDW_LongitudeAccInTime "" VALUE 0x003C29C0 Scalar_FLOAT64_IEEE 0 PubIfStateVSM_MDL_CM_double -1.7E+308 1.7E+308 /end CHARACTERISTIC
/begin CHARACTERISTIC P_VSM_LDW_State_ESSSts_enable "" VALUE 0x003C29C8 Scalar_FLOAT64_IEEE 0 PubIfStateVSM_MDL_CM_double -1.7E+308 1.7E+308 /end CHARACTERISTIC
/begin CHARACTERISTIC P_VSM_LDW_SteerWheelAngleInTime "" VALUE 0x003C29D0 Scalar_FLOAT64_IEEE 0 PubIfStateVSM_MDL_CM_double -1.7E+308 1.7E+308 /end CHARACTERISTIC
/begin CHARACTERISTIC P_VSM_LDW_SteerWheelSpdInTime "" VALUE 0x003C29D8 Scalar_FLOAT64_IEEE 0 PubIfStateVSM_MDL_CM_double -1.7E+308 1.7E+308 /end CHARACTERISTIC
/begin CHARACTERISTIC P_VSM_LDW_TurnLightInTime "" VALUE 0x003C29E0 Scalar_FLOAT64_IEEE 0 PubIfStateVSM_MDL_CM_double -1.7E+308 1.7E+308 /end CHARACTERISTIC
/begin CHARACTERISTIC P_VSM_LDW_YawRateInTime "" VALUE 0x003C29E8 Scalar_FLOAT64_IEEE 0 PubIfStateVSM_MDL_CM_double -1.7E+308 1.7E+308 /end CHARACTERISTIC
/begin CHARACTERISTIC P_VSM_LKA_AbsEspInTime "" VALUE 0x003C29F0 Scalar_FLOAT64_IEEE 0 PubIfStateVSM_MDL_CM_double -1.7E+308 1.7E+308 /end CHARACTERISTIC
/begin CHARACTERISTIC P_VSM_LKA_AccPedalRateOutTime "" VALUE 0x003D6E00 Scalar_FLOAT64_IEEE 0 PubIfStateVSM_MDL_CM_double -1.7E+308 1.7E+308 /end CHARACTERISTIC
/begin CHARACTERISTIC P_VSM_LKA_AccRateInTime "" VALUE 0x003C29F8 Scalar_FLOAT64_IEEE 0 PubIfStateVSM_MDL_CM_double -1.7E+308 1.7E+308 /end CHARACTERISTIC
/begin CHARACTERISTIC P_VSM_LKA_BrakePressInTime "" VALUE 0x003C2A00 Scalar_FLOAT64_IEEE 0 PubIfStateVSM_MDL_CM_double -1.7E+308 1.7E+308 /end CHARACTERISTIC
/begin CHARACTERISTIC P_VSM_LKA_CurveFactor "" VALUE 0x003C2A08 Scalar_FLOAT64_IEEE 0 PubIfStateVSM_MDL_CM_double -1.7E+308 1.7E+308 /end CHARACTERISTIC
/begin CHARACTERISTIC P_VSM_LKA_DriverInputTrqValueInTime "" VALUE 0x003C2A10 Scalar_FLOAT64_IEEE 0 PubIfStateVSM_MDL_CM_double -1.7E+308 1.7E+308 /end CHARACTERISTIC
/begin CHARACTERISTIC P_VSM_LKA_EndSwitch "" VALUE 0x003C2A18 Scalar_FLOAT64_IEEE 0 PubIfStateVSM_MDL_CM_double -1.7E+308 1.7E+308 /end CHARACTERISTIC
/begin CHARACTERISTIC P_VSM_LKA_LaneChangeOffset "" VALUE 0x003C2A20 Scalar_FLOAT64_IEEE 0 PubIfStateVSM_MDL_CM_double -1.7E+308 1.7E+308 /end CHARACTERISTIC
/begin CHARACTERISTIC P_VSM_LKA_LateralAcceInTime "" VALUE 0x003C2A28 Scalar_FLOAT64_IEEE 0 PubIfStateVSM_MDL_CM_double -1.7E+308 1.7E+308 /end CHARACTERISTIC
/begin CHARACTERISTIC P_VSM_LKA_OverrideInTime "" VALUE 0x003C2A30 Scalar_FLOAT64_IEEE 0 PubIfStateVSM_MDL_CM_double -1.7E+308 1.7E+308 /end CHARACTERISTIC
/begin CHARACTERISTIC P_VSM_LKA_OverrideTime "" VALUE 0x003C2A38 Scalar_FLOAT64_IEEE 0 PubIfStateVSM_MDL_CM_double -1.7E+308 1.7E+308 /end CHARACTERISTIC
/begin CHARACTERISTIC P_VSM_LKA_State_ESSSts_enable "" VALUE 0x003C2A40 Scalar_FLOAT64_IEEE 0 PubIfStateVSM_MDL_CM_double -1.7E+308 1.7E+308 /end CHARACTERISTIC
/begin CHARACTERISTIC P_VSM_LKA_State_Param_LaneCurve "" VAL_BLK 0x003C2A48 Scalar_FLOAT64_IEEE 0 PubIfStateVSM_MDL_CM_double -1.7E+308 1.7E+308 MATRIX_DIM 1 4 1 /end CHARACTERISTIC
/begin CHARACTERISTIC P_VSM_LKA_State_Param_LaneCurve_Offset "" VAL_BLK 0x003C2A68 Scalar_FLOAT64_IEEE 0 PubIfStateVSM_MDL_CM_double -1.7E+308 1.7E+308 MATRIX_DIM 1 4 1 /end CHARACTERISTIC
/begin CHARACTERISTIC P_VSM_LKA_SteerWheelAngleInTime "" VALUE 0x003C2A88 Scalar_FLOAT64_IEEE 0 PubIfStateVSM_MDL_CM_double -1.7E+308 1.7E+308 /end CHARACTERISTIC
/begin CHARACTERISTIC P_VSM_LKA_SteerWheelSpdInTime "" VALUE 0x003C2A90 Scalar_FLOAT64_IEEE 0 PubIfStateVSM_MDL_CM_double -1.7E+308 1.7E+308 /end CHARACTERISTIC
/begin CHARACTERISTIC P_VSM_LKA_TurnLightInTime "" VALUE 0x003C2A98 Scalar_FLOAT64_IEEE 0 PubIfStateVSM_MDL_CM_double -1.7E+308 1.7E+308 /end CHARACTERISTIC
/begin CHARACTERISTIC P_VSM_LKA_WarnInTime "" VALUE 0x003C2AA0 Scalar_FLOAT64_IEEE 0 PubIfStateVSM_MDL_CM_double -1.7E+308 1.7E+308 /end CHARACTERISTIC
/begin CHARACTERISTIC P_VSM_LKA_YawRateInTime "" VALUE 0x003C2AA8 Scalar_FLOAT64_IEEE 0 PubIfStateVSM_MDL_CM_double -1.7E+308 1.7E+308 /end CHARACTERISTIC
/begin CHARACTERISTIC P_VSM_LKA_absLongitudeAcceInTime "" VALUE 0x003C2AB0 Scalar_FLOAT64_IEEE 0 PubIfStateVSM_MDL_CM_double -1.7E+308 1.7E+308 /end CHARACTERISTIC
/begin CHARACTERISTIC P_VSM_NOH_Swt_Req_SW "" VALUE 0x003D6E08 Scalar_FLOAT64_IEEE 0 PubIfStateVSM_MDL_CM_double -1.7E+308 1.7E+308 /end CHARACTERISTIC
/begin CHARACTERISTIC P_Global_IEnvironment_RefPX_Front_Bumper "摄像头到前保险杠的X向距离偏移量" VALUE 0x003C2AD0 Scalar_FLOAT32_IEEE 0 PubIfStateVSM_MDL_CM_single_m -3.4E+38 3.4E+38 /end CHARACTERISTIC
/begin CHARACTERISTIC P_Global_Vehicle_Length_m "车长" VALUE 0x003C2AE8 Scalar_FLOAT32_IEEE 0 PubIfStateVSM_MDL_CM_single_m -3.4E+38 3.4E+38 /end CHARACTERISTIC
/begin CHARACTERISTIC P_VSM_ACC_BOMEntry_ACCDecReqValue "" VALUE 0x003C543C Scalar_FLOAT32_IEEE 0 PubIfStateVSM_MDL_CM_single -2.0 0.0 /end CHARACTERISTIC
/begin CHARACTERISTIC P_VSM_ACC_BOMEntry_AxvRefMs2 "" VALUE 0x003C5440 Scalar_FLOAT32_IEEE 0 PubIfStateVSM_MDL_CM_single -2.0 0.0 /end CHARACTERISTIC
/begin CHARACTERISTIC P_VSM_ACC_BOMExit_ACCDecReqValue "" VALUE 0x003C5444 Scalar_FLOAT32_IEEE 0 PubIfStateVSM_MDL_CM_single -2.0 0.0 /end CHARACTERISTIC
/begin CHARACTERISTIC P_VSM_ACC_RadarOffset "" VALUE 0x003C5448 Scalar_FLOAT32_IEEE 0 PubIfStateVSM_MDL_CM_single -3.4E+38 3.4E+38 /end CHARACTERISTIC
/begin CHARACTERISTIC P_VSM_ELK_Lane_Width_Table "" VAL_BLK 0x003C544C Scalar_FLOAT32_IEEE 0 PubIfStateVSM_MDL_CM_single -3.4E+38 3.4E+38 MATRIX_DIM 1 7 1 /end CHARACTERISTIC
/begin CHARACTERISTIC P_VSM_ELK_Lane_Width_Table_Calibration "" VAL_BLK 0x003D6E4C Scalar_FLOAT32_IEEE 0 PubIfStateVSM_MDL_CM_single -3.4E+38 3.4E+38 MATRIX_DIM 1 7 1 /end CHARACTERISTIC
/begin CHARACTERISTIC P_VSM_ELK_OnComing_Lateral "" VALUE 0x003C5468 Scalar_FLOAT32_IEEE 0 PubIfStateVSM_MDL_CM_single -3.4E+38 3.4E+38 /end CHARACTERISTIC
/begin CHARACTERISTIC P_VSM_ELK_OnComing_TTC "" VALUE 0x003C546C Scalar_FLOAT32_IEEE 0 PubIfStateVSM_MDL_CM_single -3.4E+38 3.4E+38 /end CHARACTERISTIC
/begin CHARACTERISTIC P_VSM_ELK_OverTaking_Lateral "" VALUE 0x003C5470 Scalar_FLOAT32_IEEE 0 PubIfStateVSM_MDL_CM_single -3.4E+38 3.4E+38 /end CHARACTERISTIC
/begin CHARACTERISTIC P_VSM_ELK_OverTaking_TTC "" VALUE 0x003C5474 Scalar_FLOAT32_IEEE 0 PubIfStateVSM_MDL_CM_single -3.4E+38 3.4E+38 /end CHARACTERISTIC
/begin CHARACTERISTIC P_VSM_ELK_Sensitive_Table "" VAL_BLK 0x003C5478 Scalar_FLOAT32_IEEE 0 PubIfStateVSM_MDL_CM_single -3.4E+38 3.4E+38 MATRIX_DIM 1 3 1 /end CHARACTERISTIC
/begin CHARACTERISTIC P_VSM_ELK_Sensitive_Table_Calibration "" VAL_BLK 0x003C5484 Scalar_FLOAT32_IEEE 0 PubIfStateVSM_MDL_CM_single -3.4E+38 3.4E+38 MATRIX_DIM 1 3 1 /end CHARACTERISTIC
/begin CHARACTERISTIC P_VSM_ELK_State_Absesp_enable "" VALUE 0x003C5490 Scalar_FLOAT32_IEEE 0 PubIfStateVSM_MDL_CM_single -3.4E+38 3.4E+38 /end CHARACTERISTIC
/begin CHARACTERISTIC P_VSM_ELK_State_Accpedalrate_enable "" VALUE 0x003C5494 Scalar_FLOAT32_IEEE 0 PubIfStateVSM_MDL_CM_single -3.4E+38 3.4E+38 /end CHARACTERISTIC
/begin CHARACTERISTIC P_VSM_ELK_State_Breakpressure_enable "" VALUE 0x003C5498 Scalar_FLOAT32_IEEE 0 PubIfStateVSM_MDL_CM_single -3.4E+38 3.4E+38 /end CHARACTERISTIC
/begin CHARACTERISTIC P_VSM_ELK_State_DriverInputTrqValue_enable "" VALUE 0x003C549C Scalar_FLOAT32_IEEE 0 PubIfStateVSM_MDL_CM_single -3.4E+38 3.4E+38 /end CHARACTERISTIC
/begin CHARACTERISTIC P_VSM_ELK_State_ESSSts_enable "" VALUE 0x003C54A0 Scalar_FLOAT32_IEEE 0 PubIfStateVSM_MDL_CM_single -3.4E+38 3.4E+38 /end CHARACTERISTIC
/begin CHARACTERISTIC P_VSM_ELK_State_Eps_enable "" VALUE 0x003C54A4 Scalar_FLOAT32_IEEE 0 PubIfStateVSM_MDL_CM_single -3.4E+38 3.4E+38 /end CHARACTERISTIC
/begin CHARACTERISTIC P_VSM_ELK_State_Failsafe_enable "" VALUE 0x003C54A8 Scalar_FLOAT32_IEEE 0 PubIfStateVSM_MDL_CM_single -3.4E+38 3.4E+38 /end CHARACTERISTIC
/begin CHARACTERISTIC P_VSM_ELK_State_GEAR_enable "" VALUE 0x003C54AC Scalar_FLOAT32_IEEE 0 PubIfStateVSM_MDL_CM_single -3.4E+38 3.4E+38 /end CHARACTERISTIC
/begin CHARACTERISTIC P_VSM_ELK_State_Headingangle_enable "" VALUE 0x003C54B0 Scalar_FLOAT32_IEEE 0 PubIfStateVSM_MDL_CM_single -3.4E+38 3.4E+38 /end CHARACTERISTIC
/begin CHARACTERISTIC P_VSM_ELK_State_LaneChange_enable "" VALUE 0x003C54B4 Scalar_FLOAT32_IEEE 0 PubIfStateVSM_MDL_CM_single -3.4E+38 3.4E+38 /end CHARACTERISTIC
/begin CHARACTERISTIC P_VSM_ELK_State_Lane_enable "" VALUE 0x003C54B8 Scalar_FLOAT32_IEEE 0 PubIfStateVSM_MDL_CM_single -3.4E+38 3.4E+38 /end CHARACTERISTIC
/begin CHARACTERISTIC P_VSM_ELK_State_Lanecurve_enable "" VALUE 0x003C54BC Scalar_FLOAT32_IEEE 0 PubIfStateVSM_MDL_CM_single -3.4E+38 3.4E+38 /end CHARACTERISTIC
/begin CHARACTERISTIC P_VSM_ELK_State_LateralAcce_enable "" VALUE 0x003C54C0 Scalar_FLOAT32_IEEE 0 PubIfStateVSM_MDL_CM_single -3.4E+38 3.4E+38 /end CHARACTERISTIC
/begin CHARACTERISTIC P_VSM_ELK_State_LongitudeAcc_enable "" VALUE 0x003C54C4 Scalar_FLOAT32_IEEE 0 PubIfStateVSM_MDL_CM_single -3.4E+38 3.4E+38 /end CHARACTERISTIC
/begin CHARACTERISTIC P_VSM_ELK_State_Overide_enable "" VALUE 0x003C54C8 Scalar_FLOAT32_IEEE 0 PubIfStateVSM_MDL_CM_single -3.4E+38 3.4E+38 /end CHARACTERISTIC
/begin CHARACTERISTIC P_VSM_ELK_State_Param_AngleOffset "" VALUE 0x003C54CC Scalar_FLOAT32_IEEE 0 PubIfStateVSM_MDL_CM_single -3.4E+38 3.4E+38 /end CHARACTERISTIC
/begin CHARACTERISTIC P_VSM_ELK_State_Param_OnTime "" VAL_BLK 0x003C54D0 Scalar_FLOAT32_IEEE 0 PubIfStateVSM_MDL_CM_single -3.4E+38 3.4E+38 MATRIX_DIM 1 16 1 /end CHARACTERISTIC
/begin CHARACTERISTIC P_VSM_ELK_State_Param_Oncoming "" VALUE 0x003C5510 Scalar_FLOAT32_IEEE 0 PubIfStateVSM_MDL_CM_single -3.4E+38 3.4E+38 /end CHARACTERISTIC
/begin CHARACTERISTIC P_VSM_ELK_State_Param_OutOffset "" VALUE 0x003C5514 Scalar_FLOAT32_IEEE 0 PubIfStateVSM_MDL_CM_single -3.4E+38 3.4E+38 /end CHARACTERISTIC
/begin CHARACTERISTIC P_VSM_ELK_State_Param_OvTime "" VAL_BLK 0x003C5518 Scalar_FLOAT32_IEEE 0 PubIfStateVSM_MDL_CM_single -3.4E+38 3.4E+38 MATRIX_DIM 1 16 1 /end CHARACTERISTIC
/begin CHARACTERISTIC P_VSM_ELK_State_Param_Over "" VALUE 0x003C5558 Scalar_FLOAT32_IEEE 0 PubIfStateVSM_MDL_CM_single -3.4E+38 3.4E+38 /end CHARACTERISTIC
/begin CHARACTERISTIC P_VSM_ELK_State_Param_Speed "" VAL_BLK 0x003C555C Scalar_FLOAT32_IEEE 0 PubIfStateVSM_MDL_CM_single -3.4E+38 3.4E+38 MATRIX_DIM 1 16 1 /end CHARACTERISTIC
/begin CHARACTERISTIC P_VSM_ELK_State_SteerWheelAngle_enable "" VALUE 0x003C559C Scalar_FLOAT32_IEEE 0 PubIfStateVSM_MDL_CM_single -3.4E+38 3.4E+38 /end CHARACTERISTIC
/begin CHARACTERISTIC P_VSM_ELK_State_SteerWheelSpd_enable "" VALUE 0x003C55A0 Scalar_FLOAT32_IEEE 0 PubIfStateVSM_MDL_CM_single -3.4E+38 3.4E+38 /end CHARACTERISTIC
/begin CHARACTERISTIC P_VSM_ELK_State_Vehspeed_enable "" VALUE 0x003C55A4 Scalar_FLOAT32_IEEE 0 PubIfStateVSM_MDL_CM_single -3.4E+38 3.4E+38 /end CHARACTERISTIC
/begin CHARACTERISTIC P_VSM_ELK_State_Yawsup_enable "" VALUE 0x003C55A8 Scalar_FLOAT32_IEEE 0 PubIfStateVSM_MDL_CM_single -3.4E+38 3.4E+38 /end CHARACTERISTIC
/begin CHARACTERISTIC P_VSM_ESS_AccPedlPosn_Param "" VALUE 0x003C55B0 Scalar_FLOAT32_IEEE 0 PubIfStateVSM_MDL_CM_single -3.4E+38 3.4E+38 /end CHARACTERISTIC
/begin CHARACTERISTIC P_VSM_ESS_DangerPlausLeft "" VALUE 0x003C55CC Scalar_FLOAT32_IEEE 0 PubIfStateVSM_MDL_CM_single -3.4E+38 3.4E+38 /end CHARACTERISTIC
/begin CHARACTERISTIC P_VSM_ESS_DangerPlausRight "" VALUE 0x003C55D0 Scalar_FLOAT32_IEEE 0 PubIfStateVSM_MDL_CM_single -3.4E+38 3.4E+38 /end CHARACTERISTIC
/begin CHARACTERISTIC P_VSM_ESS_DelayTime "" VALUE 0x003C55D4 Scalar_FLOAT32_IEEE 0 PubIfStateVSM_MDL_CM_single -3.4E+38 3.4E+38 /end CHARACTERISTIC
/begin CHARACTERISTIC P_VSM_ESS_DrvOverTime_Param "" VALUE 0x003C5620 Scalar_FLOAT32_IEEE 0 PubIfStateVSM_MDL_CM_single -3.4E+38 3.4E+38 /end CHARACTERISTIC
/begin CHARACTERISTIC P_VSM_ESS_LgtAccelLower_Param "" VALUE 0x003C563C Scalar_FLOAT32_IEEE 0 PubIfStateVSM_MDL_CM_single -3.4E+38 3.4E+38 /end CHARACTERISTIC
/begin CHARACTERISTIC P_VSM_ESS_LgtAccelUpper_Param "" VALUE 0x003C5640 Scalar_FLOAT32_IEEE 0 PubIfStateVSM_MDL_CM_single -3.4E+38 3.4E+38 /end CHARACTERISTIC
/begin CHARACTERISTIC P_VSM_ESS_MasterCylindBrake "" VALUE 0x003C5644 Scalar_FLOAT32_IEEE 0 PubIfStateVSM_MDL_CM_single -3.4E+38 3.4E+38 /end CHARACTERISTIC
/begin CHARACTERISTIC P_VSM_ESS_StopA0_Param "" VALUE 0x003C56C4 Scalar_FLOAT32_IEEE 0 PubIfStateVSM_MDL_CM_single -3.4E+38 3.4E+38 /end CHARACTERISTIC
/begin CHARACTERISTIC P_VSM_ESS_StopA1Time_Param "" VALUE 0x003C56C8 Scalar_FLOAT32_IEEE 0 PubIfStateVSM_MDL_CM_single -3.4E+38 3.4E+38 /end CHARACTERISTIC
/begin CHARACTERISTIC P_VSM_ESS_StopA1_Param "" VALUE 0x003C56CC Scalar_FLOAT32_IEEE 0 PubIfStateVSM_MDL_CM_single -3.4E+38 3.4E+38 /end CHARACTERISTIC
/begin CHARACTERISTIC P_VSM_HWAActivation_NOAMOd_Spd "" VALUE 0x003C5724 Scalar_FLOAT32_IEEE 0 PubIfStateVSM_MDL_CM_single -3.4E+38 3.4E+38 /end CHARACTERISTIC
/begin CHARACTERISTIC P_VSM_HWAActivation_Spd_Low "" VALUE 0x003C5728 Scalar_FLOAT32_IEEE 0 PubIfStateVSM_MDL_CM_single -3.4E+38 3.4E+38 /end CHARACTERISTIC
/begin CHARACTERISTIC P_VSM_HWAActivation_Spd_Up "" VALUE 0x003C572C Scalar_FLOAT32_IEEE 0 PubIfStateVSM_MDL_CM_single -3.4E+38 3.4E+38 /end CHARACTERISTIC
/begin CHARACTERISTIC P_VSM_LCKIE_ClassInput "" VALUE 0x003D6E68 Scalar_FLOAT32_IEEE 0 PubIfStateVSM_MDL_CM_single -3.4E+38 3.4E+38 /end CHARACTERISTIC
/begin CHARACTERISTIC P_VSM_LCKIE_LatC_DisSW "" VALUE 0x003D6E6C Scalar_FLOAT32_IEEE 0 PubIfStateVSM_MDL_CM_single -3.4E+38 3.4E+38 /end CHARACTERISTIC
/begin CHARACTERISTIC P_VSM_LCKIE_LatC_LimitDisEgoToObjSelt "" VALUE 0x003C57B8 Scalar_FLOAT32_IEEE 0 PubIfStateVSM_MDL_CM_single -3.4E+38 3.4E+38 /end CHARACTERISTIC
/begin CHARACTERISTIC P_VSM_LCKIE_LatC_LimitEgoToOppLane "" VALUE 0x003C57BC Scalar_FLOAT32_IEEE 0 PubIfStateVSM_MDL_CM_single -3.4E+38 3.4E+38 /end CHARACTERISTIC
/begin CHARACTERISTIC P_VSM_LCKIE_LatC_MoveEnableDis "" VALUE 0x003D6E70 Scalar_FLOAT32_IEEE 0 PubIfStateVSM_MDL_CM_single -3.4E+38 3.4E+38 /end CHARACTERISTIC
/begin CHARACTERISTIC P_VSM_LCKIE_LatC_RESafDis "" VALUE 0x003C57C0 Scalar_FLOAT32_IEEE 0 PubIfStateVSM_MDL_CM_single -3.4E+38 3.4E+38 /end CHARACTERISTIC
/begin CHARACTERISTIC P_VSM_LCKIE_LatC_maxLimitDisREToLane "" VALUE 0x003C57EC Scalar_FLOAT32_IEEE 0 PubIfStateVSM_MDL_CM_single -3.4E+38 3.4E+38 /end CHARACTERISTIC
/begin CHARACTERISTIC P_VSM_LCKIE_LatC_minLimitDisREToLane "" VALUE 0x003C57F0 Scalar_FLOAT32_IEEE 0 PubIfStateVSM_MDL_CM_single -3.4E+38 3.4E+38 /end CHARACTERISTIC
/begin CHARACTERISTIC P_VSM_LCKIE_LongC_DirecChangeDis "" VALUE 0x003C5800 Scalar_FLOAT32_IEEE 0 PubIfStateVSM_MDL_CM_single -3.4E+38 3.4E+38 /end CHARACTERISTIC
/begin CHARACTERISTIC P_VSM_LCKIE_LongC_FleetOff "" VALUE 0x003C5804 Scalar_FLOAT32_IEEE 0 PubIfStateVSM_MDL_CM_single -3.4E+38 3.4E+38 /end CHARACTERISTIC
/begin CHARACTERISTIC P_VSM_LCKIE_LongC_ShutDownLongDis "" VALUE 0x003C5808 Scalar_FLOAT32_IEEE 0 PubIfStateVSM_MDL_CM_single -3.4E+38 3.4E+38 /end CHARACTERISTIC
/begin CHARACTERISTIC P_VSM_LCKIE_LongC_ShutDownTTC "" VALUE 0x003C580C Scalar_FLOAT32_IEEE 0 PubIfStateVSM_MDL_CM_single -3.4E+38 3.4E+38 /end CHARACTERISTIC
/begin CHARACTERISTIC P_VSM_LCKIE_LongC_maxDis "" VALUE 0x003C584C Scalar_FLOAT32_IEEE 0 PubIfStateVSM_MDL_CM_single -3.4E+38 3.4E+38 /end CHARACTERISTIC
/begin CHARACTERISTIC P_VSM_LCKIE_LongC_minDis "" VALUE 0x003C5850 Scalar_FLOAT32_IEEE 0 PubIfStateVSM_MDL_CM_single -3.4E+38 3.4E+38 /end CHARACTERISTIC
/begin CHARACTERISTIC P_VSM_LCKIE_LongC_toff "" VALUE 0x003C5854 Scalar_FLOAT32_IEEE 0 PubIfStateVSM_MDL_CM_single -3.4E+38 3.4E+38 /end CHARACTERISTIC
/begin CHARACTERISTIC P_VSM_LCKIE_OFC_ActDis "" VALUE 0x003C5858 Scalar_FLOAT32_IEEE 0 PubIfStateVSM_MDL_CM_single -3.4E+38 3.4E+38 /end CHARACTERISTIC
/begin CHARACTERISTIC P_VSM_LCKIE_OFC_DownDis "" VALUE 0x003C585C Scalar_FLOAT32_IEEE 0 PubIfStateVSM_MDL_CM_single -3.4E+38 3.4E+38 /end CHARACTERISTIC
/begin CHARACTERISTIC P_VSM_LCKIE_OFC_DownTTC "" VALUE 0x003C5860 Scalar_FLOAT32_IEEE 0 PubIfStateVSM_MDL_CM_single -3.4E+38 3.4E+38 /end CHARACTERISTIC
/begin CHARACTERISTIC P_VSM_LCKIE_OFC_SafDis "" VALUE 0x003C5864 Scalar_FLOAT32_IEEE 0 PubIfStateVSM_MDL_CM_single -3.4E+38 3.4E+38 /end CHARACTERISTIC
/begin CHARACTERISTIC P_VSM_LCKIE_OFC_Toff "" VALUE 0x003C5868 Scalar_FLOAT32_IEEE 0 PubIfStateVSM_MDL_CM_single -3.4E+38 3.4E+38 /end CHARACTERISTIC
/begin CHARACTERISTIC P_VSM_LCKIE_ORC_LatDis "" VALUE 0x003C586C Scalar_FLOAT32_IEEE 0 PubIfStateVSM_MDL_CM_single -3.4E+38 3.4E+38 /end CHARACTERISTIC
/begin CHARACTERISTIC P_VSM_LCKIE_ORC_LimitDis1 "" VALUE 0x003C5870 Scalar_FLOAT32_IEEE 0 PubIfStateVSM_MDL_CM_single -3.4E+38 3.4E+38 /end CHARACTERISTIC
/begin CHARACTERISTIC P_VSM_LCKIE_ORC_LimitDis2 "" VALUE 0x003C5874 Scalar_FLOAT32_IEEE 0 PubIfStateVSM_MDL_CM_single -3.4E+38 3.4E+38 /end CHARACTERISTIC
/begin CHARACTERISTIC P_VSM_LCKIE_ORC_LimitTTC "" VALUE 0x003C5878 Scalar_FLOAT32_IEEE 0 PubIfStateVSM_MDL_CM_single -3.4E+38 3.4E+38 /end CHARACTERISTIC
/begin CHARACTERISTIC P_VSM_LCKIE_ORC_LowSpd "" VALUE 0x003C587C Scalar_FLOAT32_IEEE 0 PubIfStateVSM_MDL_CM_single -3.4E+38 3.4E+38 /end CHARACTERISTIC
/begin CHARACTERISTIC P_VSM_LCKIE_POC_Delaytime "" VAL_BLK 0x003C5880 Scalar_FLOAT32_IEEE 0 PubIfStateVSM_MDL_CM_single -3.4E+38 3.4E+38 MATRIX_DIM 1 6 1 /end CHARACTERISTIC
/begin CHARACTERISTIC P_VSM_LCKIE_POC_LimitDis "" VALUE 0x003C5898 Scalar_FLOAT32_IEEE 0 PubIfStateVSM_MDL_CM_single -3.4E+38 3.4E+38 /end CHARACTERISTIC
/begin CHARACTERISTIC P_VSM_LCKIE_POC_LimitTTC "" VALUE 0x003C589C Scalar_FLOAT32_IEEE 0 PubIfStateVSM_MDL_CM_single -3.4E+38 3.4E+38 /end CHARACTERISTIC
/begin CHARACTERISTIC P_VSM_LCKIE_POC_detaSpd "" VAL_BLK 0x003C58A0 Scalar_FLOAT32_IEEE 0 PubIfStateVSM_MDL_CM_single -3.4E+38 3.4E+38 MATRIX_DIM 1 6 1 /end CHARACTERISTIC
/begin CHARACTERISTIC P_VSM_LCKIE_STATE_ORCObjenable "" VALUE 0x003D6E74 Scalar_FLOAT32_IEEE 0 PubIfStateVSM_MDL_CM_single -3.4E+38 3.4E+38 /end CHARACTERISTIC
/begin CHARACTERISTIC P_VSM_LCKIE_State_CurveMax "" VALUE 0x003C58B8 Scalar_FLOAT32_IEEE 0 PubIfStateVSM_MDL_CM_single -3.4E+38 3.4E+38 /end CHARACTERISTIC
/begin CHARACTERISTIC P_VSM_LCKIE_State_CurveMin "" VALUE 0x003C58BC Scalar_FLOAT32_IEEE 0 PubIfStateVSM_MDL_CM_single -3.4E+38 3.4E+38 /end CHARACTERISTIC
/begin CHARACTERISTIC P_VSM_LCKIE_State_DriverInputTrqValue_enable "" VALUE 0x003C58C0 Scalar_FLOAT32_IEEE 0 PubIfStateVSM_MDL_CM_single -3.4E+38 3.4E+38 /end CHARACTERISTIC
/begin CHARACTERISTIC P_VSM_LCKIE_State_ELKObjClc "" VALUE 0x003C58C4 Scalar_FLOAT32_IEEE 0 PubIfStateVSM_MDL_CM_single -3.4E+38 3.4E+38 /end CHARACTERISTIC
/begin CHARACTERISTIC P_VSM_LCKIE_State_HWASts_disable "" VALUE 0x003C58C8 Scalar_FLOAT32_IEEE 0 PubIfStateVSM_MDL_CM_single -3.4E+38 3.4E+38 /end CHARACTERISTIC
/begin CHARACTERISTIC P_VSM_LCKIE_State_IEObjClc "" VALUE 0x003C58CC Scalar_FLOAT32_IEEE 0 PubIfStateVSM_MDL_CM_single -3.4E+38 3.4E+38 /end CHARACTERISTIC
/begin CHARACTERISTIC P_VSM_LCKIE_State_IFVReady "" VALUE 0x003C58D0 Scalar_FLOAT32_IEEE 0 PubIfStateVSM_MDL_CM_single -3.4E+38 3.4E+38 /end CHARACTERISTIC
/begin CHARACTERISTIC P_VSM_LCKIE_State_LaneWidth_enable "" VALUE 0x003C58D4 Scalar_FLOAT32_IEEE 0 PubIfStateVSM_MDL_CM_single -3.4E+38 3.4E+38 /end CHARACTERISTIC
/begin CHARACTERISTIC P_VSM_LCKIE_State_Lanecurve_enable "" VALUE 0x003C58D8 Scalar_FLOAT32_IEEE 0 PubIfStateVSM_MDL_CM_single -3.4E+38 3.4E+38 /end CHARACTERISTIC
/begin CHARACTERISTIC P_VSM_LCKIE_State_Off2on "" VALUE 0x003C58DC Scalar_FLOAT32_IEEE 0 PubIfStateVSM_MDL_CM_single -3.4E+38 3.4E+38 /end CHARACTERISTIC
/begin CHARACTERISTIC P_VSM_LCKIE_State_OppObjClc "" VALUE 0x003C58E0 Scalar_FLOAT32_IEEE 0 PubIfStateVSM_MDL_CM_single -3.4E+38 3.4E+38 /end CHARACTERISTIC
/begin CHARACTERISTIC P_VSM_LCKIE_State_Vehspeed_enable "" VALUE 0x003C58E4 Scalar_FLOAT32_IEEE 0 PubIfStateVSM_MDL_CM_single -3.4E+38 3.4E+38 /end CHARACTERISTIC
/begin CHARACTERISTIC P_VSM_LCKIE_State_detaspd "" VALUE 0x003C58E8 Scalar_FLOAT32_IEEE 0 PubIfStateVSM_MDL_CM_single -3.4E+38 3.4E+38 /end CHARACTERISTIC
/begin CHARACTERISTIC P_VSM_LCKIE_State_detaspd_enable "" VALUE 0x003C58EC Scalar_FLOAT32_IEEE 0 PubIfStateVSM_MDL_CM_single -3.4E+38 3.4E+38 /end CHARACTERISTIC
/begin CHARACTERISTIC P_VSM_LCKIE_State_lamb_enable "" VALUE 0x003C58F0 Scalar_FLOAT32_IEEE 0 PubIfStateVSM_MDL_CM_single -3.4E+38 3.4E+38 /end CHARACTERISTIC
/begin CHARACTERISTIC P_VSM_LCKIE_State_wiper_enable "" VALUE 0x003C58F4 Scalar_FLOAT32_IEEE 0 PubIfStateVSM_MDL_CM_single -3.4E+38 3.4E+38 /end CHARACTERISTIC
/begin CHARACTERISTIC P_VSM_LCKIE_tcycle "" VALUE 0x003C58F8 Scalar_FLOAT32_IEEE 0 PubIfStateVSM_MDL_CM_single -3.4E+38 3.4E+38 /end CHARACTERISTIC
/begin CHARACTERISTIC P_VSM_LCK_AccRateIn "" VALUE 0x003C58FC Scalar_FLOAT32_IEEE 0 PubIfStateVSM_MDL_CM_single -3.4E+38 3.4E+38 /end CHARACTERISTIC
/begin CHARACTERISTIC P_VSM_LCK_AccRateOut "" VALUE 0x003C5900 Scalar_FLOAT32_IEEE 0 PubIfStateVSM_MDL_CM_single -3.4E+38 3.4E+38 /end CHARACTERISTIC
/begin CHARACTERISTIC P_VSM_LCK_AccrPelOut "" VALUE 0x003C5904 Scalar_FLOAT32_IEEE 0 PubIfStateVSM_MDL_CM_single -3.4E+38 3.4E+38 /end CHARACTERISTIC
/begin CHARACTERISTIC P_VSM_LCK_BrakePressIn "" VALUE 0x003C5908 Scalar_FLOAT32_IEEE 0 PubIfStateVSM_MDL_CM_single -3.4E+38 3.4E+38 /end CHARACTERISTIC
/begin CHARACTERISTIC P_VSM_LCK_BrakePressOut "" VALUE 0x003C590C Scalar_FLOAT32_IEEE 0 PubIfStateVSM_MDL_CM_single -3.4E+38 3.4E+38 /end CHARACTERISTIC
/begin CHARACTERISTIC P_VSM_LCK_DrvInputTrqValueIn "" VALUE 0x003C5910 Scalar_FLOAT32_IEEE 0 PubIfStateVSM_MDL_CM_single -3.4E+38 3.4E+38 /end CHARACTERISTIC
/begin CHARACTERISTIC P_VSM_LCK_DrvInputTrqValueOut "" VALUE 0x003C5914 Scalar_FLOAT32_IEEE 0 PubIfStateVSM_MDL_CM_single -3.4E+38 3.4E+38 /end CHARACTERISTIC
/begin CHARACTERISTIC P_VSM_LCK_IdleInTime "" VALUE 0x003C5918 Scalar_FLOAT32_IEEE 0 PubIfStateVSM_MDL_CM_single -3.4E+38 3.4E+38 /end CHARACTERISTIC
/begin CHARACTERISTIC P_VSM_LCK_LCDrvInputTrqValueOut "" VALUE 0x003C591C Scalar_FLOAT32_IEEE 0 PubIfStateVSM_MDL_CM_single -3.4E+38 3.4E+38 /end CHARACTERISTIC
/begin CHARACTERISTIC P_VSM_LCK_LCOverrideValue "" VALUE 0x003C5920 Scalar_FLOAT32_IEEE 0 PubIfStateVSM_MDL_CM_single -3.4E+38 3.4E+38 /end CHARACTERISTIC
/begin CHARACTERISTIC P_VSM_LCK_LateralAcceIn "" VALUE 0x003C5924 Scalar_FLOAT32_IEEE 0 PubIfStateVSM_MDL_CM_single -3.4E+38 3.4E+38 /end CHARACTERISTIC
/begin CHARACTERISTIC P_VSM_LCK_LateralAcceOut "" VALUE 0x003C5928 Scalar_FLOAT32_IEEE 0 PubIfStateVSM_MDL_CM_single -3.4E+38 3.4E+38 /end CHARACTERISTIC
/begin CHARACTERISTIC P_VSM_LCK_LongitudeAccIn "" VALUE 0x003C592C Scalar_FLOAT32_IEEE 0 PubIfStateVSM_MDL_CM_single -3.4E+38 3.4E+38 /end CHARACTERISTIC
/begin CHARACTERISTIC P_VSM_LCK_LongitudeAccOut "" VALUE 0x003C5930 Scalar_FLOAT32_IEEE 0 PubIfStateVSM_MDL_CM_single -3.4E+38 3.4E+38 /end CHARACTERISTIC
/begin CHARACTERISTIC P_VSM_LCK_OverrideValue "" VALUE 0x003C5934 Scalar_FLOAT32_IEEE 0 PubIfStateVSM_MDL_CM_single -3.4E+38 3.4E+38 /end CHARACTERISTIC
/begin CHARACTERISTIC P_VSM_LCK_State_Absesp_enable "" VALUE 0x003C5938 Scalar_FLOAT32_IEEE 0 PubIfStateVSM_MDL_CM_single -3.4E+38 3.4E+38 /end CHARACTERISTIC
/begin CHARACTERISTIC P_VSM_LCK_State_Accpedalrate_enable "" VALUE 0x003D6E78 Scalar_FLOAT32_IEEE 0 PubIfStateVSM_MDL_CM_single -3.4E+38 3.4E+38 /end CHARACTERISTIC
/begin CHARACTERISTIC P_VSM_LCK_State_Breakpressure_enable "" VALUE 0x003C593C Scalar_FLOAT32_IEEE 0 PubIfStateVSM_MDL_CM_single -3.4E+38 3.4E+38 /end CHARACTERISTIC
/begin CHARACTERISTIC P_VSM_LCK_State_DriverInputTrqValue_enable "" VALUE 0x003C5940 Scalar_FLOAT32_IEEE 0 PubIfStateVSM_MDL_CM_single -3.4E+38 3.4E+38 /end CHARACTERISTIC
/begin CHARACTERISTIC P_VSM_LCK_State_Eps_enable "" VALUE 0x003C5944 Scalar_FLOAT32_IEEE 0 PubIfStateVSM_MDL_CM_single -3.4E+38 3.4E+38 /end CHARACTERISTIC
/begin CHARACTERISTIC P_VSM_LCK_State_GEAR_enable "" VALUE 0x003C5948 Scalar_FLOAT32_IEEE 0 PubIfStateVSM_MDL_CM_single -3.4E+38 3.4E+38 /end CHARACTERISTIC
/begin CHARACTERISTIC P_VSM_LCK_State_Handson_enable "" VALUE 0x003C594C Scalar_FLOAT32_IEEE 0 PubIfStateVSM_MDL_CM_single -3.4E+38 3.4E+38 /end CHARACTERISTIC
/begin CHARACTERISTIC P_VSM_LCK_State_IdleInTime_enable "" VALUE 0x003D6E7C Scalar_FLOAT32_IEEE 0 PubIfStateVSM_MDL_CM_single -3.4E+38 3.4E+38 /end CHARACTERISTIC
/begin CHARACTERISTIC P_VSM_LCK_State_LSMLine_enable "" VALUE 0x003C5950 Scalar_FLOAT32_IEEE 0 PubIfStateVSM_MDL_CM_single -3.4E+38 3.4E+38 /end CHARACTERISTIC
/begin CHARACTERISTIC P_VSM_LCK_State_LaneCurve_enable "" VALUE 0x003D6E80 Scalar_FLOAT32_IEEE 0 PubIfStateVSM_MDL_CM_single -3.4E+38 3.4E+38 /end CHARACTERISTIC
/begin CHARACTERISTIC P_VSM_LCK_State_Lane_enable "" VALUE 0x003C5954 Scalar_FLOAT32_IEEE 0 PubIfStateVSM_MDL_CM_single -3.4E+38 3.4E+38 /end CHARACTERISTIC
/begin CHARACTERISTIC P_VSM_LCK_State_LateralAcce_enable "" VALUE 0x003C5958 Scalar_FLOAT32_IEEE 0 PubIfStateVSM_MDL_CM_single -3.4E+38 3.4E+38 /end CHARACTERISTIC
/begin CHARACTERISTIC P_VSM_LCK_State_LongitudeAcc_enable "" VALUE 0x003C595C Scalar_FLOAT32_IEEE 0 PubIfStateVSM_MDL_CM_single -3.4E+38 3.4E+38 /end CHARACTERISTIC
/begin CHARACTERISTIC P_VSM_LCK_State_Overide_enable "" VALUE 0x003C5960 Scalar_FLOAT32_IEEE 0 PubIfStateVSM_MDL_CM_single -3.4E+38 3.4E+38 /end CHARACTERISTIC
/begin CHARACTERISTIC P_VSM_LCK_State_SteerWheelAngle_enable "" VALUE 0x003C5964 Scalar_FLOAT32_IEEE 0 PubIfStateVSM_MDL_CM_single -3.4E+38 3.4E+38 /end CHARACTERISTIC
/begin CHARACTERISTIC P_VSM_LCK_State_SteerWheelSpd_enable "" VALUE 0x003C5968 Scalar_FLOAT32_IEEE 0 PubIfStateVSM_MDL_CM_single -3.4E+38 3.4E+38 /end CHARACTERISTIC
/begin CHARACTERISTIC P_VSM_LCK_State_TargetLaneIn_enable "" VALUE 0x003C596C Scalar_FLOAT32_IEEE 0 PubIfStateVSM_MDL_CM_single -3.4E+38 3.4E+38 /end CHARACTERISTIC
/begin CHARACTERISTIC P_VSM_LCK_State_TurnLight_enable "" VALUE 0x003C5970 Scalar_FLOAT32_IEEE 0 PubIfStateVSM_MDL_CM_single -3.4E+38 3.4E+38 /end CHARACTERISTIC
/begin CHARACTERISTIC P_VSM_LCK_State_Vehspeed_enable "" VALUE 0x003C5974 Scalar_FLOAT32_IEEE 0 PubIfStateVSM_MDL_CM_single -3.4E+38 3.4E+38 /end CHARACTERISTIC
/begin CHARACTERISTIC P_VSM_LCK_State_Yawsup_enable "" VALUE 0x003C5978 Scalar_FLOAT32_IEEE 0 PubIfStateVSM_MDL_CM_single -3.4E+38 3.4E+38 /end CHARACTERISTIC
/begin CHARACTERISTIC P_VSM_LCK_SteerAngleSpdIn "" VALUE 0x003C597C Scalar_FLOAT32_IEEE 0 PubIfStateVSM_MDL_CM_single -3.4E+38 3.4E+38 /end CHARACTERISTIC
/begin CHARACTERISTIC P_VSM_LCK_SteerAngleSpdOut "" VALUE 0x003C5980 Scalar_FLOAT32_IEEE 0 PubIfStateVSM_MDL_CM_single -3.4E+38 3.4E+38 /end CHARACTERISTIC
/begin CHARACTERISTIC P_VSM_LCK_SteerWheelAngleIn "" VALUE 0x003C5984 Scalar_FLOAT32_IEEE 0 PubIfStateVSM_MDL_CM_single -3.4E+38 3.4E+38 /end CHARACTERISTIC
/begin CHARACTERISTIC P_VSM_LCK_SteerWheelAngleOut "" VALUE 0x003C5988 Scalar_FLOAT32_IEEE 0 PubIfStateVSM_MDL_CM_single -3.4E+38 3.4E+38 /end CHARACTERISTIC
/begin CHARACTERISTIC P_VSM_LCK_Warnarea1 "" VALUE 0x003C598C Scalar_FLOAT32_IEEE 0 PubIfStateVSM_MDL_CM_single -3.4E+38 3.4E+38 /end CHARACTERISTIC
/begin CHARACTERISTIC P_VSM_LCK_Warnarea2 "" VALUE 0x003C5990 Scalar_FLOAT32_IEEE 0 PubIfStateVSM_MDL_CM_single -3.4E+38 3.4E+38 /end CHARACTERISTIC
/begin CHARACTERISTIC P_VSM_LCK_YawRateIn "" VALUE 0x003C5994 Scalar_FLOAT32_IEEE 0 PubIfStateVSM_MDL_CM_single -3.4E+38 3.4E+38 /end CHARACTERISTIC
/begin CHARACTERISTIC P_VSM_LCK_YawRateOut "" VALUE 0x003C5998 Scalar_FLOAT32_IEEE 0 PubIfStateVSM_MDL_CM_single -3.4E+38 3.4E+38 /end CHARACTERISTIC
/begin CHARACTERISTIC P_VSM_LCK_absLongitudeAccIn "" VALUE 0x003C599C Scalar_FLOAT32_IEEE 0 PubIfStateVSM_MDL_CM_single -3.4E+38 3.4E+38 /end CHARACTERISTIC
/begin CHARACTERISTIC P_VSM_LCK_absLongitudeAccOut "" VALUE 0x003C59A0 Scalar_FLOAT32_IEEE 0 PubIfStateVSM_MDL_CM_single -3.4E+38 3.4E+38 /end CHARACTERISTIC
/begin CHARACTERISTIC P_VSM_LDW_AccPedalOut "" VALUE 0x003C59A4 Scalar_FLOAT32_IEEE 0 PubIfStateVSM_MDL_CM_single -3.4E+38 3.4E+38 /end CHARACTERISTIC
/begin CHARACTERISTIC P_VSM_LDW_AccRateIn "" VALUE 0x003C59A8 Scalar_FLOAT32_IEEE 0 PubIfStateVSM_MDL_CM_single -3.4E+38 3.4E+38 /end CHARACTERISTIC
/begin CHARACTERISTIC P_VSM_LDW_AccRateOut "" VALUE 0x003C59AC Scalar_FLOAT32_IEEE 0 PubIfStateVSM_MDL_CM_single -3.4E+38 3.4E+38 /end CHARACTERISTIC
/begin CHARACTERISTIC P_VSM_LDW_BrakePressIn "" VALUE 0x003C59B0 Scalar_FLOAT32_IEEE 0 PubIfStateVSM_MDL_CM_single -3.4E+38 3.4E+38 /end CHARACTERISTIC
/begin CHARACTERISTIC P_VSM_LDW_BrakePressOut "" VALUE 0x003C59B4 Scalar_FLOAT32_IEEE 0 PubIfStateVSM_MDL_CM_single -3.4E+38 3.4E+38 /end CHARACTERISTIC
/begin CHARACTERISTIC P_VSM_LDW_LaneCurveIn "" VALUE 0x003C59B8 Scalar_FLOAT32_IEEE 0 PubIfStateVSM_MDL_CM_single -3.4E+38 3.4E+38 /end CHARACTERISTIC
/begin CHARACTERISTIC P_VSM_LDW_LaneCurveOut "" VALUE 0x003C59BC Scalar_FLOAT32_IEEE 0 PubIfStateVSM_MDL_CM_single -3.4E+38 3.4E+38 /end CHARACTERISTIC
/begin CHARACTERISTIC P_VSM_LDW_LateralAcceIn "" VALUE 0x003C59C0 Scalar_FLOAT32_IEEE 0 PubIfStateVSM_MDL_CM_single -3.4E+38 3.4E+38 /end CHARACTERISTIC
/begin CHARACTERISTIC P_VSM_LDW_LateralAcceOut "" VALUE 0x003C59C4 Scalar_FLOAT32_IEEE 0 PubIfStateVSM_MDL_CM_single -3.4E+38 3.4E+38 /end CHARACTERISTIC
/begin CHARACTERISTIC P_VSM_LDW_LongitudeAccIn "" VALUE 0x003C59C8 Scalar_FLOAT32_IEEE 0 PubIfStateVSM_MDL_CM_single -3.4E+38 3.4E+38 /end CHARACTERISTIC
/begin CHARACTERISTIC P_VSM_LDW_LongitudeAccOut "" VALUE 0x003C59CC Scalar_FLOAT32_IEEE 0 PubIfStateVSM_MDL_CM_single -3.4E+38 3.4E+38 /end CHARACTERISTIC
/begin CHARACTERISTIC P_VSM_LDW_State_Absesp_enable "" VALUE 0x003C59D0 Scalar_FLOAT32_IEEE 0 PubIfStateVSM_MDL_CM_single -3.4E+38 3.4E+38 /end CHARACTERISTIC
/begin CHARACTERISTIC P_VSM_LDW_State_Accpedalrate_enable "" VALUE 0x003C59D4 Scalar_FLOAT32_IEEE 0 PubIfStateVSM_MDL_CM_single -3.4E+38 3.4E+38 /end CHARACTERISTIC
/begin CHARACTERISTIC P_VSM_LDW_State_Breakpressure_enable "" VALUE 0x003C59D8 Scalar_FLOAT32_IEEE 0 PubIfStateVSM_MDL_CM_single -3.4E+38 3.4E+38 /end CHARACTERISTIC
/begin CHARACTERISTIC P_VSM_LDW_State_Failsafe_enable "" VALUE 0x003C59DC Scalar_FLOAT32_IEEE 0 PubIfStateVSM_MDL_CM_single -3.4E+38 3.4E+38 /end CHARACTERISTIC
/begin CHARACTERISTIC P_VSM_LDW_State_GEAR_enable "" VALUE 0x003C59E0 Scalar_FLOAT32_IEEE 0 PubIfStateVSM_MDL_CM_single -3.4E+38 3.4E+38 /end CHARACTERISTIC
/begin CHARACTERISTIC P_VSM_LDW_State_Headingangle_enable "" VALUE 0x003C59E4 Scalar_FLOAT32_IEEE 0 PubIfStateVSM_MDL_CM_single -3.4E+38 3.4E+38 /end CHARACTERISTIC
/begin CHARACTERISTIC P_VSM_LDW_State_LaneChange_enable "" VALUE 0x003C59E8 Scalar_FLOAT32_IEEE 0 PubIfStateVSM_MDL_CM_single -3.4E+38 3.4E+38 /end CHARACTERISTIC
/begin CHARACTERISTIC P_VSM_LDW_State_Lane_enable "" VALUE 0x003C59EC Scalar_FLOAT32_IEEE 0 PubIfStateVSM_MDL_CM_single -3.4E+38 3.4E+38 /end CHARACTERISTIC
/begin CHARACTERISTIC P_VSM_LDW_State_Lanecurve_enable "" VALUE 0x003C59F0 Scalar_FLOAT32_IEEE 0 PubIfStateVSM_MDL_CM_single -3.4E+38 3.4E+38 /end CHARACTERISTIC
/begin CHARACTERISTIC P_VSM_LDW_State_LateralAcce_enable "" VALUE 0x003C59F4 Scalar_FLOAT32_IEEE 0 PubIfStateVSM_MDL_CM_single -3.4E+38 3.4E+38 /end CHARACTERISTIC
/begin CHARACTERISTIC P_VSM_LDW_State_LongitudeAcc_enable "" VALUE 0x003C59F8 Scalar_FLOAT32_IEEE 0 PubIfStateVSM_MDL_CM_single -3.4E+38 3.4E+38 /end CHARACTERISTIC
/begin CHARACTERISTIC P_VSM_LDW_State_Param_LaneWidth_Offset "" VAL_BLK 0x003C5A3C Scalar_FLOAT32_IEEE 0 PubIfStateVSM_MDL_CM_single -3.4E+38 3.4E+38 MATRIX_DIM 1 7 1 /end CHARACTERISTIC
/begin CHARACTERISTIC P_VSM_LDW_State_Param_REWarningZoneIn "" VALUE 0x003C5A58 Scalar_FLOAT32_IEEE 0 PubIfStateVSM_MDL_CM_single -3.4E+38 3.4E+38 /end CHARACTERISTIC
/begin CHARACTERISTIC P_VSM_LDW_State_Param_Sensitive_Offset "" VAL_BLK 0x003C5A5C Scalar_FLOAT32_IEEE 0 PubIfStateVSM_MDL_CM_single -3.4E+38 3.4E+38 MATRIX_DIM 1 3 1 /end CHARACTERISTIC
/begin CHARACTERISTIC P_VSM_LDW_State_Param_WarningZoneIn "" VALUE 0x003C5AA8 Scalar_FLOAT32_IEEE 0 PubIfStateVSM_MDL_CM_single -3.4E+38 3.4E+38 /end CHARACTERISTIC
/begin CHARACTERISTIC P_VSM_LDW_State_Param_WarningZoneOut "" VALUE 0x003C5AAC Scalar_FLOAT32_IEEE 0 PubIfStateVSM_MDL_CM_single -3.4E+38 3.4E+38 /end CHARACTERISTIC
/begin CHARACTERISTIC P_VSM_LDW_State_SteerWheelAngle_enable "" VALUE 0x003C5AB0 Scalar_FLOAT32_IEEE 0 PubIfStateVSM_MDL_CM_single -3.4E+38 3.4E+38 /end CHARACTERISTIC
/begin CHARACTERISTIC P_VSM_LDW_State_SteerWheelSpd_enable "" VALUE 0x003C5AB4 Scalar_FLOAT32_IEEE 0 PubIfStateVSM_MDL_CM_single -3.4E+38 3.4E+38 /end CHARACTERISTIC
/begin CHARACTERISTIC P_VSM_LDW_State_TurnLight_enable "" VALUE 0x003C5AB8 Scalar_FLOAT32_IEEE 0 PubIfStateVSM_MDL_CM_single -3.4E+38 3.4E+38 /end CHARACTERISTIC
/begin CHARACTERISTIC P_VSM_LDW_State_Vehspeed_enable "" VALUE 0x003C5ABC Scalar_FLOAT32_IEEE 0 PubIfStateVSM_MDL_CM_single -3.4E+38 3.4E+38 /end CHARACTERISTIC
/begin CHARACTERISTIC P_VSM_LDW_State_Yawsup_enable "" VALUE 0x003C5AC0 Scalar_FLOAT32_IEEE 0 PubIfStateVSM_MDL_CM_single -3.4E+38 3.4E+38 /end CHARACTERISTIC
/begin CHARACTERISTIC P_VSM_LDW_SteerWheelAngleIn "" VALUE 0x003C5AC4 Scalar_FLOAT32_IEEE 0 PubIfStateVSM_MDL_CM_single -3.4E+38 3.4E+38 /end CHARACTERISTIC
/begin CHARACTERISTIC P_VSM_LDW_SteerWheelAngleOut "" VALUE 0x003C5AC8 Scalar_FLOAT32_IEEE 0 PubIfStateVSM_MDL_CM_single -3.4E+38 3.4E+38 /end CHARACTERISTIC
/begin CHARACTERISTIC P_VSM_LDW_SteerWheelSpdIn "" VALUE 0x003C5ACC Scalar_FLOAT32_IEEE 0 PubIfStateVSM_MDL_CM_single -3.4E+38 3.4E+38 /end CHARACTERISTIC
/begin CHARACTERISTIC P_VSM_LDW_SteerWheelSpdOut "" VALUE 0x003C5AD0 Scalar_FLOAT32_IEEE 0 PubIfStateVSM_MDL_CM_single -3.4E+38 3.4E+38 /end CHARACTERISTIC
/begin CHARACTERISTIC P_VSM_LDW_WhelDy "" VALUE 0x003C5AD4 Scalar_FLOAT32_IEEE 0 PubIfStateVSM_MDL_CM_single -3.4E+38 3.4E+38 /end CHARACTERISTIC
/begin CHARACTERISTIC P_VSM_LDW_YawRateIn "" VALUE 0x003C5AD8 Scalar_FLOAT32_IEEE 0 PubIfStateVSM_MDL_CM_single -3.4E+38 3.4E+38 /end CHARACTERISTIC
/begin CHARACTERISTIC P_VSM_LDW_YawRateOut "" VALUE 0x003C5ADC Scalar_FLOAT32_IEEE 0 PubIfStateVSM_MDL_CM_single -3.4E+38 3.4E+38 /end CHARACTERISTIC
/begin CHARACTERISTIC P_VSM_LDW_absLongitudeAccIn "" VALUE 0x003C5AE0 Scalar_FLOAT32_IEEE 0 PubIfStateVSM_MDL_CM_single -3.4E+38 3.4E+38 /end CHARACTERISTIC
/begin CHARACTERISTIC P_VSM_LDW_absLongitudeAccOut "" VALUE 0x003C5AE4 Scalar_FLOAT32_IEEE 0 PubIfStateVSM_MDL_CM_single -3.4E+38 3.4E+38 /end CHARACTERISTIC
/begin CHARACTERISTIC P_VSM_LKA_AccPedalPosnOut "" VALUE 0x003C5AE8 Scalar_FLOAT32_IEEE 0 PubIfStateVSM_MDL_CM_single -3.4E+38 3.4E+38 /end CHARACTERISTIC
/begin CHARACTERISTIC P_VSM_LKA_AccRateIn "" VALUE 0x003C5AEC Scalar_FLOAT32_IEEE 0 PubIfStateVSM_MDL_CM_single -3.4E+38 3.4E+38 /end CHARACTERISTIC
/begin CHARACTERISTIC P_VSM_LKA_AccRateOut "" VALUE 0x003C5AF0 Scalar_FLOAT32_IEEE 0 PubIfStateVSM_MDL_CM_single -3.4E+38 3.4E+38 /end CHARACTERISTIC
/begin CHARACTERISTIC P_VSM_LKA_BrakePressIn "" VALUE 0x003C5AF4 Scalar_FLOAT32_IEEE 0 PubIfStateVSM_MDL_CM_single -3.4E+38 3.4E+38 /end CHARACTERISTIC
/begin CHARACTERISTIC P_VSM_LKA_BrakePressOut "" VALUE 0x003C5AF8 Scalar_FLOAT32_IEEE 0 PubIfStateVSM_MDL_CM_single -3.4E+38 3.4E+38 /end CHARACTERISTIC
/begin CHARACTERISTIC P_VSM_LKA_DriverInputTrqValueIn "" VALUE 0x003C5AFC Scalar_FLOAT32_IEEE 0 PubIfStateVSM_MDL_CM_single -3.4E+38 3.4E+38 /end CHARACTERISTIC
/begin CHARACTERISTIC P_VSM_LKA_DriverInputTrqValueOut "" VALUE 0x003C5B00 Scalar_FLOAT32_IEEE 0 PubIfStateVSM_MDL_CM_single -3.4E+38 3.4E+38 /end CHARACTERISTIC
/begin CHARACTERISTIC P_VSM_LKA_LaneCurveIn "" VALUE 0x003C5B04 Scalar_FLOAT32_IEEE 0 PubIfStateVSM_MDL_CM_single -3.4E+38 3.4E+38 /end CHARACTERISTIC
/begin CHARACTERISTIC P_VSM_LKA_LaneCurveOut "" VALUE 0x003C5B08 Scalar_FLOAT32_IEEE 0 PubIfStateVSM_MDL_CM_single -3.4E+38 3.4E+38 /end CHARACTERISTIC
/begin CHARACTERISTIC P_VSM_LKA_LateralAcceIn "" VALUE 0x003C5B0C Scalar_FLOAT32_IEEE 0 PubIfStateVSM_MDL_CM_single -3.4E+38 3.4E+38 /end CHARACTERISTIC
/begin CHARACTERISTIC P_VSM_LKA_LateralAcceOut "" VALUE 0x003C5B10 Scalar_FLOAT32_IEEE 0 PubIfStateVSM_MDL_CM_single -3.4E+38 3.4E+38 /end CHARACTERISTIC
/begin CHARACTERISTIC P_VSM_LKA_LongitudeAcceIn "" VALUE 0x003C5B14 Scalar_FLOAT32_IEEE 0 PubIfStateVSM_MDL_CM_single -3.4E+38 3.4E+38 /end CHARACTERISTIC
/begin CHARACTERISTIC P_VSM_LKA_LongitudeAcceOut "" VALUE 0x003C5B18 Scalar_FLOAT32_IEEE 0 PubIfStateVSM_MDL_CM_single -3.4E+38 3.4E+38 /end CHARACTERISTIC
/begin CHARACTERISTIC P_VSM_LKA_OverrideValue "" VALUE 0x003C5B1C Scalar_FLOAT32_IEEE 0 PubIfStateVSM_MDL_CM_single -3.4E+38 3.4E+38 /end CHARACTERISTIC
/begin CHARACTERISTIC P_VSM_LKA_State_Absesp_enable "" VALUE 0x003C5B20 Scalar_FLOAT32_IEEE 0 PubIfStateVSM_MDL_CM_single -3.4E+38 3.4E+38 /end CHARACTERISTIC
/begin CHARACTERISTIC P_VSM_LKA_State_Accpedalrate_enable "" VALUE 0x003C5B24 Scalar_FLOAT32_IEEE 0 PubIfStateVSM_MDL_CM_single -3.4E+38 3.4E+38 /end CHARACTERISTIC
/begin CHARACTERISTIC P_VSM_LKA_State_Breakpressure_enable "" VALUE 0x003C5B28 Scalar_FLOAT32_IEEE 0 PubIfStateVSM_MDL_CM_single -3.4E+38 3.4E+38 /end CHARACTERISTIC
/begin CHARACTERISTIC P_VSM_LKA_State_DriverInputTrqValue_enable "" VALUE 0x003C5B2C Scalar_FLOAT32_IEEE 0 PubIfStateVSM_MDL_CM_single -3.4E+38 3.4E+38 /end CHARACTERISTIC
/begin CHARACTERISTIC P_VSM_LKA_State_Eps_enable "" VALUE 0x003C5B30 Scalar_FLOAT32_IEEE 0 PubIfStateVSM_MDL_CM_single -3.4E+38 3.4E+38 /end CHARACTERISTIC
/begin CHARACTERISTIC P_VSM_LKA_State_Failsafe_enable "" VALUE 0x003C5B34 Scalar_FLOAT32_IEEE 0 PubIfStateVSM_MDL_CM_single -3.4E+38 3.4E+38 /end CHARACTERISTIC
/begin CHARACTERISTIC P_VSM_LKA_State_GEAR_enable "" VALUE 0x003C5B38 Scalar_FLOAT32_IEEE 0 PubIfStateVSM_MDL_CM_single -3.4E+38 3.4E+38 /end CHARACTERISTIC
/begin CHARACTERISTIC P_VSM_LKA_State_Headingangle_enable "" VALUE 0x003C5B3C Scalar_FLOAT32_IEEE 0 PubIfStateVSM_MDL_CM_single -3.4E+38 3.4E+38 /end CHARACTERISTIC
/begin CHARACTERISTIC P_VSM_LKA_State_LaneChange_enable "" VALUE 0x003C5B40 Scalar_FLOAT32_IEEE 0 PubIfStateVSM_MDL_CM_single -3.4E+38 3.4E+38 /end CHARACTERISTIC
/begin CHARACTERISTIC P_VSM_LKA_State_Lane_enable "" VALUE 0x003C5B44 Scalar_FLOAT32_IEEE 0 PubIfStateVSM_MDL_CM_single -3.4E+38 3.4E+38 /end CHARACTERISTIC
/begin CHARACTERISTIC P_VSM_LKA_State_Lanecurve_enable "" VALUE 0x003C5B48 Scalar_FLOAT32_IEEE 0 PubIfStateVSM_MDL_CM_single -3.4E+38 3.4E+38 /end CHARACTERISTIC
/begin CHARACTERISTIC P_VSM_LKA_State_LateralAcce_enable "" VALUE 0x003C5B4C Scalar_FLOAT32_IEEE 0 PubIfStateVSM_MDL_CM_single -3.4E+38 3.4E+38 /end CHARACTERISTIC
/begin CHARACTERISTIC P_VSM_LKA_State_LongitudeAcc_enable "" VALUE 0x003C5B50 Scalar_FLOAT32_IEEE 0 PubIfStateVSM_MDL_CM_single -3.4E+38 3.4E+38 /end CHARACTERISTIC
/begin CHARACTERISTIC P_VSM_LKA_State_Overide_enable "" VALUE 0x003C5B54 Scalar_FLOAT32_IEEE 0 PubIfStateVSM_MDL_CM_single -3.4E+38 3.4E+38 /end CHARACTERISTIC
/begin CHARACTERISTIC P_VSM_LKA_State_Param_AngleOffset "" VALUE 0x003C5B58 Scalar_FLOAT32_IEEE 0 PubIfStateVSM_MDL_CM_single -3.4E+38 3.4E+38 /end CHARACTERISTIC
/begin CHARACTERISTIC P_VSM_LKA_State_Param_InterventionZoneIn "" VALUE 0x003C5B5C Scalar_FLOAT32_IEEE 0 PubIfStateVSM_MDL_CM_single -3.4E+38 3.4E+38 /end CHARACTERISTIC
/begin CHARACTERISTIC P_VSM_LKA_State_Param_InterventionZoneOut "" VALUE 0x003C5B60 Scalar_FLOAT32_IEEE 0 PubIfStateVSM_MDL_CM_single -3.4E+38 3.4E+38 /end CHARACTERISTIC
/begin CHARACTERISTIC P_VSM_LKA_State_Param_LaneWidth_Offset "" VAL_BLK 0x003C5B64 Scalar_FLOAT32_IEEE 0 PubIfStateVSM_MDL_CM_single -3.4E+38 3.4E+38 MATRIX_DIM 1 7 1 /end CHARACTERISTIC
/begin CHARACTERISTIC P_VSM_LKA_State_Param_Offset "" VALUE 0x003C5B80 Scalar_FLOAT32_IEEE 0 PubIfStateVSM_MDL_CM_single -3.4E+38 3.4E+38 /end CHARACTERISTIC
/begin CHARACTERISTIC P_VSM_LKA_State_Param_OutOffset "" VALUE 0x003C5B84 Scalar_FLOAT32_IEEE 0 PubIfStateVSM_MDL_CM_single -3.4E+38 3.4E+38 /end CHARACTERISTIC
/begin CHARACTERISTIC P_VSM_LKA_State_Param_REInterventionZoneIn "" VALUE 0x003C5B88 Scalar_FLOAT32_IEEE 0 PubIfStateVSM_MDL_CM_single -3.4E+38 3.4E+38 /end CHARACTERISTIC
/begin CHARACTERISTIC P_VSM_LKA_State_Param_Sensitive_Offset "" VAL_BLK 0x003C5B8C Scalar_FLOAT32_IEEE 0 PubIfStateVSM_MDL_CM_single -3.4E+38 3.4E+38 MATRIX_DIM 1 3 1 /end CHARACTERISTIC
/begin CHARACTERISTIC P_VSM_LKA_State_SteerWheelAngle_enable "" VALUE 0x003C5B98 Scalar_FLOAT32_IEEE 0 PubIfStateVSM_MDL_CM_single -3.4E+38 3.4E+38 /end CHARACTERISTIC
/begin CHARACTERISTIC P_VSM_LKA_State_SteerWheelSpd_enable "" VALUE 0x003C5B9C Scalar_FLOAT32_IEEE 0 PubIfStateVSM_MDL_CM_single -3.4E+38 3.4E+38 /end CHARACTERISTIC
/begin CHARACTERISTIC P_VSM_LKA_State_TJASts_enable "" VALUE 0x003C5BA0 Scalar_FLOAT32_IEEE 0 PubIfStateVSM_MDL_CM_single -3.4E+38 3.4E+38 /end CHARACTERISTIC
/begin CHARACTERISTIC P_VSM_LKA_State_TurnLight_enable "" VALUE 0x003C5BA4 Scalar_FLOAT32_IEEE 0 PubIfStateVSM_MDL_CM_single -3.4E+38 3.4E+38 /end CHARACTERISTIC
/begin CHARACTERISTIC P_VSM_LKA_State_Vehspeed_enable "" VALUE 0x003C5BA8 Scalar_FLOAT32_IEEE 0 PubIfStateVSM_MDL_CM_single -3.4E+38 3.4E+38 /end CHARACTERISTIC
/begin CHARACTERISTIC P_VSM_LKA_State_Yawsup_enable "" VALUE 0x003C5BAC Scalar_FLOAT32_IEEE 0 PubIfStateVSM_MDL_CM_single -3.4E+38 3.4E+38 /end CHARACTERISTIC
/begin CHARACTERISTIC P_VSM_LKA_SteerWheelAngleIn "" VALUE 0x003C5BB0 Scalar_FLOAT32_IEEE 0 PubIfStateVSM_MDL_CM_single -3.4E+38 3.4E+38 /end CHARACTERISTIC
/begin CHARACTERISTIC P_VSM_LKA_SteerWheelAngleOut "" VALUE 0x003C5BB4 Scalar_FLOAT32_IEEE 0 PubIfStateVSM_MDL_CM_single -3.4E+38 3.4E+38 /end CHARACTERISTIC
/begin CHARACTERISTIC P_VSM_LKA_SteerWheelSpdIn "" VALUE 0x003C5BB8 Scalar_FLOAT32_IEEE 0 PubIfStateVSM_MDL_CM_single -3.4E+38 3.4E+38 /end CHARACTERISTIC
/begin CHARACTERISTIC P_VSM_LKA_SteerWheelSpdOut "" VALUE 0x003C5BBC Scalar_FLOAT32_IEEE 0 PubIfStateVSM_MDL_CM_single -3.4E+38 3.4E+38 /end CHARACTERISTIC
/begin CHARACTERISTIC P_VSM_LKA_Warnarea1 "" VALUE 0x003C5BC0 Scalar_FLOAT32_IEEE 0 PubIfStateVSM_MDL_CM_single -3.4E+38 3.4E+38 /end CHARACTERISTIC
/begin CHARACTERISTIC P_VSM_LKA_Warnarea2 "" VALUE 0x003C5BC4 Scalar_FLOAT32_IEEE 0 PubIfStateVSM_MDL_CM_single -3.4E+38 3.4E+38 /end CHARACTERISTIC
/begin CHARACTERISTIC P_VSM_LKA_WhelDy "" VALUE 0x003C5BC8 Scalar_FLOAT32_IEEE 0 PubIfStateVSM_MDL_CM_single -3.4E+38 3.4E+38 /end CHARACTERISTIC
/begin CHARACTERISTIC P_VSM_LKA_YawRateIn "" VALUE 0x003C5BCC Scalar_FLOAT32_IEEE 0 PubIfStateVSM_MDL_CM_single -3.4E+38 3.4E+38 /end CHARACTERISTIC
/begin CHARACTERISTIC P_VSM_LKA_YawRateOut "" VALUE 0x003C5BD0 Scalar_FLOAT32_IEEE 0 PubIfStateVSM_MDL_CM_single -3.4E+38 3.4E+38 /end CHARACTERISTIC
/begin CHARACTERISTIC P_VSM_LKA_absLongitudeAcceIn "" VALUE 0x003C5BD4 Scalar_FLOAT32_IEEE 0 PubIfStateVSM_MDL_CM_single -3.4E+38 3.4E+38 /end CHARACTERISTIC
/begin CHARACTERISTIC P_VSM_LKA_absLongitudeAcceOut "" VALUE 0x003C5BD8 Scalar_FLOAT32_IEEE 0 PubIfStateVSM_MDL_CM_single -3.4E+38 3.4E+38 /end CHARACTERISTIC
/begin CHARACTERISTIC P_VSM_LSMC_SampleTime "" VALUE 0x003C5BDC Scalar_FLOAT32_IEEE 0 PubIfStateVSM_MDL_CM_single -3.4E+38 3.4E+38 /end CHARACTERISTIC
/begin CHARACTERISTIC P_VSM_ACCExit_AccOverride "" VALUE 0x003C5BE4 Scalar_UWORD 0 PubIfStateVSM_MDL_CM_uint16_s 0.0 1000.0 /end CHARACTERISTIC
/begin CHARACTERISTIC P_VSM_ACCExit_StandWaitTime "" VALUE 0x003C5BE6 Scalar_UWORD 0 PubIfStateVSM_MDL_CM_uint16__S_ 0.0 1000.0 /end CHARACTERISTIC
/begin CHARACTERISTIC P_VSM_ACC_StandActiveNumACCMode "" VALUE 0x003C5BEA Scalar_UWORD 0 PubIfStateVSM_MDL_CM_uint16_num 0.0 9000.0 /end CHARACTERISTIC
/begin CHARACTERISTIC P_VSM_ACC_StandActiveNumHWAMode "" VALUE 0x003C5BEC Scalar_UWORD 0 PubIfStateVSM_MDL_CM_uint16_num 0.0 9000.0 /end CHARACTERISTIC
/begin CHARACTERISTIC P_VSM_TJA_ActiveWaitNum "" VALUE 0x003C5BF0 Scalar_UWORD 0 PubIfStateVSM_MDL_CM_uint16_num 0.0 3000.0 /end CHARACTERISTIC
/begin CHARACTERISTIC P_VSM_ACC_AutoGoSW "" VALUE 0x003C5BF6 Scalar_BOOLEAN 0 PubIfStateVSM_MDL_CM_boolean 0 1 BIT_MASK 0x01 /end CHARACTERISTIC
/begin CHARACTERISTIC P_VSM_ESS_AEBFlag_enable "" VALUE 0x003C5BF7 Scalar_BOOLEAN 0 PubIfStateVSM_MDL_CM_boolean 0 1 BIT_MASK 0x01 /end CHARACTERISTIC
/begin CHARACTERISTIC P_VSM_ESS_AccelPed_enable "" VALUE 0x003C5BF8 Scalar_BOOLEAN 0 PubIfStateVSM_MDL_CM_boolean 0 1 BIT_MASK 0x01 /end CHARACTERISTIC
/begin CHARACTERISTIC P_VSM_ESS_DoorSts_enable "" VALUE 0x003C5BF9 Scalar_BOOLEAN 0 PubIfStateVSM_MDL_CM_boolean 0 1 BIT_MASK 0x01 /end CHARACTERISTIC
/begin CHARACTERISTIC P_VSM_ESS_DrvSBR_enable "" VALUE 0x003C5BFA Scalar_BOOLEAN 0 PubIfStateVSM_MDL_CM_boolean 0 1 BIT_MASK 0x01 /end CHARACTERISTIC
/begin CHARACTERISTIC P_VSM_ESS_ESPActive_enable "" VALUE 0x003C5BFB Scalar_BOOLEAN 0 PubIfStateVSM_MDL_CM_boolean 0 1 BIT_MASK 0x01 /end CHARACTERISTIC
/begin CHARACTERISTIC P_VSM_ESS_ESPFuncOffSts_enable "" VALUE 0x003C5BFC Scalar_BOOLEAN 0 PubIfStateVSM_MDL_CM_boolean 0 1 BIT_MASK 0x01 /end CHARACTERISTIC
/begin CHARACTERISTIC P_VSM_ESS_FcwDisFlag_enable "" VALUE 0x003C5BFD Scalar_BOOLEAN 0 PubIfStateVSM_MDL_CM_boolean 0 1 BIT_MASK 0x01 /end CHARACTERISTIC
/begin CHARACTERISTIC P_VSM_ESS_FcwSw_enable "" VALUE 0x003C5BFE Scalar_BOOLEAN 0 PubIfStateVSM_MDL_CM_boolean 0 1 BIT_MASK 0x01 /end CHARACTERISTIC
/begin CHARACTERISTIC P_VSM_ESS_HiLoBeam_enable "" VALUE 0x003C5BFF Scalar_BOOLEAN 0 PubIfStateVSM_MDL_CM_boolean 0 1 BIT_MASK 0x01 /end CHARACTERISTIC
/begin CHARACTERISTIC P_VSM_ESS_LateralAccel_enable "" VALUE 0x003C5C00 Scalar_BOOLEAN 0 PubIfStateVSM_MDL_CM_boolean 0 1 BIT_MASK 0x01 /end CHARACTERISTIC
/begin CHARACTERISTIC P_VSM_ESS_OVERRIDE_SW "" VALUE 0x003D6E88 Scalar_BOOLEAN 0 PubIfStateVSM_MDL_CM_boolean 0 1 BIT_MASK 0x01 /end CHARACTERISTIC
/begin CHARACTERISTIC P_VSM_ESS_SteerWheelSpd_enable "" VALUE 0x003C5C01 Scalar_BOOLEAN 0 PubIfStateVSM_MDL_CM_boolean 0 1 BIT_MASK 0x01 /end CHARACTERISTIC
/begin CHARACTERISTIC P_VSM_ESS_TrailerSts_enable "" VALUE 0x003C5C02 Scalar_BOOLEAN 0 PubIfStateVSM_MDL_CM_boolean 0 1 BIT_MASK 0x01 /end CHARACTERISTIC
/begin CHARACTERISTIC P_VSM_ESS_VehLgtAccel_enable "" VALUE 0x003C5C03 Scalar_BOOLEAN 0 PubIfStateVSM_MDL_CM_boolean 0 1 BIT_MASK 0x01 /end CHARACTERISTIC
/begin CHARACTERISTIC P_VSM_ESS_Vehspeed_enable "" VALUE 0x003C5C04 Scalar_BOOLEAN 0 PubIfStateVSM_MDL_CM_boolean 0 1 BIT_MASK 0x01 /end CHARACTERISTIC
/begin CHARACTERISTIC P_VSM_ESS_WiprReq_enable "" VALUE 0x003C5C05 Scalar_BOOLEAN 0 PubIfStateVSM_MDL_CM_boolean 0 1 BIT_MASK 0x01 /end CHARACTERISTIC
/begin CHARACTERISTIC P_VSM_HWA_EHR_Enable "EHR使能开关" VALUE 0x003D6E8A Scalar_BOOLEAN 0 PubIfStateVSM_MDL_CM_boolean 0 1 BIT_MASK 0x01 /end CHARACTERISTIC
/begin CHARACTERISTIC P_Global_VehiclePowerType "动力形式，0-V71混动；1-V61混动；" VALUE 0x003D6E97 Scalar_UBYTE 0 PubIfStateVSM_MDL_CM_uint8 0 255 /end CHARACTERISTIC
/begin CHARACTERISTIC P_VSM_LCK_A1 "" VALUE 0x003D6E9C Scalar_UBYTE 0 PubIfStateVSM_MDL_CM_uint8 0 255 /end CHARACTERISTIC
/begin CHARACTERISTIC P_VSM_NOH_PilotSelc_SW "" VALUE 0x003D6E9D Scalar_UBYTE 0 PubIfStateVSM_MDL_CM_uint8 0 255 /end CHARACTERISTIC
/begin AXIS_PTS P_VSM_ESS_IPSpeed_kmh "" 0x003C5624 NO_INPUT_QUANTITY Lookup1D_X_FLOAT32_IEEE 0 PubIfStateVSM_MDL_CM_single 6 -3.4E+38 3.4E+38 /end AXIS_PTS
/begin AXIS_PTS P_VSM_ESS_SteerWheelSpd_BP "" 0x003C5694 NO_INPUT_QUANTITY Lookup1D_X_FLOAT32_IEEE 0 PubIfStateVSM_MDL_CM_single 6 -3.4E+38 3.4E+38 /end AXIS_PTS
/begin AXIS_PTS P_VSM_ESS_DriveIn_BP "" 0x003C55F0 NO_INPUT_QUANTITY Lookup1D_X_FLOAT32_IEEE 0 PubIfStateVSM_MDL_CM_single 6 -3.4E+38 3.4E+38 /end AXIS_PTS
/begin AXIS_PTS P_VSM_LCKIE_Laneoffset_BP "" 0x003C576C NO_INPUT_QUANTITY Lookup1D_X_FLOAT32_IEEE 0 PubIfStateVSM_MDL_CM_single 5 -3.4E+38 3.4E+38 /end AXIS_PTS
/begin AXIS_PTS P_VSM_LCKIE_LATC_LimitDis_BP "" 0x003C5744 VSM_LCKIE_LatC_DetaDis Lookup1D_X_FLOAT32_IEEE 0 PubIfStateVSM_MDL_CM_single 5 -3.4E+38 3.4E+38 /end AXIS_PTS
/begin AXIS_PTS P_VSM_LCKIE_LatC_LanWidth "" 0x003C57A8 VSM_LCKIE_OS_RoadWidth Lookup1D_X_FLOAT32_IEEE 0 PubIfStateVSM_MDL_CM_single 4 -3.4E+38 3.4E+38 /end AXIS_PTS
/begin AXIS_PTS P_VSM_LCKIE_LatC_Spd "" 0x003C57D4 NO_INPUT_QUANTITY Lookup1D_X_FLOAT32_IEEE 0 PubIfStateVSM_MDL_CM_single 6 -3.4E+38 3.4E+38 /end AXIS_PTS
/begin AXIS_PTS P_VSM_LCKIE_LongC_Spd "" 0x003C5810 NO_INPUT_QUANTITY Lookup1D_X_FLOAT32_IEEE 0 PubIfStateVSM_MDL_CM_single 6 -3.4E+38 3.4E+38 /end AXIS_PTS
/begin AXIS_PTS P_VSM_LCKIE_LongC_DetaSpd "" 0x003C57F4 VSM_LCKIE_OS_DetaSpdSelect Lookup1D_X_FLOAT32_IEEE 0 PubIfStateVSM_MDL_CM_single 3 -3.4E+38 3.4E+38 /end AXIS_PTS
/begin MEASUREMENT VSM_LCK_Warning "" FLOAT64_IEEE PubIfStateVSM_MDL_CM_double 0 0 -1.7E+308 1.7E+308 ECU_ADDRESS 0x0040D478 /end MEASUREMENT
/begin MEASUREMENT VSM_LCK_d0 "" FLOAT64_IEEE PubIfStateVSM_MDL_CM_double 0 0 -1.7E+308 1.7E+308 ECU_ADDRESS 0x0040D480 /end MEASUREMENT
/begin MEASUREMENT VSM_LCK_LaneWidth_offset "" FLOAT64_IEEE PubIfStateVSM_MDL_CM_double 0 0 -1.7E+308 1.7E+308 ECU_ADDRESS 0x0040D488 /end MEASUREMENT
/begin MEASUREMENT VSM_LCK_LaneCure_Offset "" FLOAT64_IEEE PubIfStateVSM_MDL_CM_double 0 0 -1.7E+308 1.7E+308 ECU_ADDRESS 0x0040D490 /end MEASUREMENT
/begin MEASUREMENT VSM_ACCActCondF "" FLOAT64_IEEE PubIfStateVSM_MDL_CM_double 0 0 -1.7E+308 1.7E+308 ECU_ADDRESS 0x0040D498 /end MEASUREMENT
/begin MEASUREMENT VSM_LCK_VERSION "" ULONG PubIfStateVSM_MDL_CM_uint32 0 0 0 4294967295 ECU_ADDRESS 0x0040D4A4 /end MEASUREMENT
/begin MEASUREMENT VSM_LDW_VERSION "" ULONG PubIfStateVSM_MDL_CM_uint32 0 0 0 4294967295 ECU_ADDRESS 0x0040D4AC /end MEASUREMENT
/begin MEASUREMENT VSM_LKA_VERSION "" ULONG PubIfStateVSM_MDL_CM_uint32 0 0 0 4294967295 ECU_ADDRESS 0x0040D4B0 /end MEASUREMENT
/begin MEASUREMENT VSM_ACC_USSObjDxMin "" FLOAT32_IEEE PubIfStateVSM_MDL_CM_single 0 0 -3.4E+38 3.4E+38 ECU_ADDRESS 0x0040D4B4 /end MEASUREMENT
/begin MEASUREMENT VSM_ACC_P0DxThrehod "" FLOAT32_IEEE PubIfStateVSM_MDL_CM_single 0 0 -3.4E+38 3.4E+38 ECU_ADDRESS 0x0040D4B8 /end MEASUREMENT
/begin MEASUREMENT VSM_ACC_DecReqValue "" FLOAT32_IEEE PubIfStateVSM_MDL_CM_single 0 0 -3.4E+38 3.4E+38 ECU_ADDRESS 0x0040D4BC /end MEASUREMENT
/begin MEASUREMENT VSM_LCK_LaneCure "" FLOAT32_IEEE PubIfStateVSM_MDL_CM_single 0 0 -3.4E+38 3.4E+38 ECU_ADDRESS 0x0040D4C8 /end MEASUREMENT
/begin MEASUREMENT VSM_LCKIE_LatC_SafeDisToLaneEdge "" FLOAT32_IEEE PubIfStateVSM_MDL_CM_single 0 0 -3.4E+38 3.4E+38 ECU_ADDRESS 0x0040D4CC /end MEASUREMENT
/begin MEASUREMENT VSM_LCKIE_LatC_DisEgo2ObjOff "" FLOAT32_IEEE PubIfStateVSM_MDL_CM_single 0 0 -3.4E+38 3.4E+38 ECU_ADDRESS 0x0040D4D0 /end MEASUREMENT
/begin MEASUREMENT VSM_LCKIE_POC_delay_time "" FLOAT32_IEEE PubIfStateVSM_MDL_CM_single 0 0 -3.4E+38 3.4E+38 ECU_ADDRESS 0x0040D4D4 /end MEASUREMENT
/begin MEASUREMENT VSM_LCKIE_LongC_d2 "" FLOAT32_IEEE PubIfStateVSM_MDL_CM_single 0 0 -3.4E+38 3.4E+38 ECU_ADDRESS 0x0040D4D8 /end MEASUREMENT
/begin MEASUREMENT VSM_LCKIE_LongC_d1 "" FLOAT32_IEEE PubIfStateVSM_MDL_CM_single 0 0 -3.4E+38 3.4E+38 ECU_ADDRESS 0x0040D4DC /end MEASUREMENT
/begin MEASUREMENT VSM_LCKIE_LongC_LongDis "" FLOAT32_IEEE PubIfStateVSM_MDL_CM_single 0 0 -3.4E+38 3.4E+38 ECU_ADDRESS 0x0040D4E0 /end MEASUREMENT
/begin MEASUREMENT VSM_LCKIE_LatC_DetaDis "" FLOAT32_IEEE PubIfStateVSM_MDL_CM_single 0 0 -3.4E+38 3.4E+38 ECU_ADDRESS 0x0040D4E4 /end MEASUREMENT
/begin MEASUREMENT VSM_LCK_preDis "" FLOAT32_IEEE PubIfStateVSM_MDL_CM_single 0 0 -3.4E+38 3.4E+38 ECU_ADDRESS 0x0040D4F0 /end MEASUREMENT
/begin MEASUREMENT VSM_LCK_Lanewidth "" FLOAT32_IEEE PubIfStateVSM_MDL_CM_single 0 0 -3.4E+38 3.4E+38 ECU_ADDRESS 0x0040D4F4 /end MEASUREMENT
/begin MEASUREMENT VSM_LDW_Count "" FLOAT32_IEEE PubIfStateVSM_MDL_CM_single 0 0 -3.4E+38 3.4E+38 ECU_ADDRESS 0x0040D4F8 /end MEASUREMENT
/begin MEASUREMENT VSM_LDW_wCount "" FLOAT32_IEEE PubIfStateVSM_MDL_CM_single 0 0 -3.4E+38 3.4E+38 ECU_ADDRESS 0x0040D4FC /end MEASUREMENT
/begin MEASUREMENT VSM_ERROR_RIGHT "" FLOAT32_IEEE PubIfStateVSM_MDL_CM_single 0 0 -3.4E+38 3.4E+38 ECU_ADDRESS 0x0040D500 /end MEASUREMENT
/begin MEASUREMENT VSM_ERROR_LEFT "" FLOAT32_IEEE PubIfStateVSM_MDL_CM_single 0 0 -3.4E+38 3.4E+38 ECU_ADDRESS 0x0040D504 /end MEASUREMENT
/begin MEASUREMENT VSM_LKA_LKAactive "" FLOAT32_IEEE PubIfStateVSM_MDL_CM_single 0 0 -3.4E+38 3.4E+38 ECU_ADDRESS 0x0040D518 /end MEASUREMENT
/begin MEASUREMENT VSM_LKA_LKAout "" FLOAT32_IEEE PubIfStateVSM_MDL_CM_single 0 0 -3.4E+38 3.4E+38 ECU_ADDRESS 0x0040D51C /end MEASUREMENT
/begin MEASUREMENT VSM_LDW_Leftwarnflag "" FLOAT32_IEEE PubIfStateVSM_MDL_CM_single 0 0 -3.4E+38 3.4E+38 ECU_ADDRESS 0x0040D520 /end MEASUREMENT
/begin MEASUREMENT VSM_LDW_Rightwarnflag "" FLOAT32_IEEE PubIfStateVSM_MDL_CM_single 0 0 -3.4E+38 3.4E+38 ECU_ADDRESS 0x0040D524 /end MEASUREMENT
/begin MEASUREMENT VSM_LCKIE_POC_OvertakeSpd "" FLOAT32_IEEE PubIfStateVSM_MDL_CM_single 0 0 -3.4E+38 3.4E+38 ECU_ADDRESS 0x0040D528 /end MEASUREMENT
/begin MEASUREMENT VSM_LCKIE_POC_POCObjLong "" FLOAT32_IEEE PubIfStateVSM_MDL_CM_single 0 0 -3.4E+38 3.4E+38 ECU_ADDRESS 0x0040D52C /end MEASUREMENT
/begin MEASUREMENT VSM_LCKIE_POC_POCObjTTC "" FLOAT32_IEEE PubIfStateVSM_MDL_CM_single 0 0 -3.4E+38 3.4E+38 ECU_ADDRESS 0x0040D530 /end MEASUREMENT
/begin MEASUREMENT VSM_LCKIE_OS_RoadWidth "" FLOAT32_IEEE PubIfStateVSM_MDL_CM_single 0 0 -3.4E+38 3.4E+38 ECU_ADDRESS 0x0040D534 /end MEASUREMENT
/begin MEASUREMENT VSM_LCKIE_OS_DisEgo2ObjSelect "" FLOAT32_IEEE PubIfStateVSM_MDL_CM_single 0 0 -3.4E+38 3.4E+38 ECU_ADDRESS 0x0040D538 /end MEASUREMENT
/begin MEASUREMENT VSM_LCKIE_OS_DisEgo2Obj "" FLOAT32_IEEE PubIfStateVSM_MDL_CM_single 0 0 -3.4E+38 3.4E+38 LAYOUT ROW_DIR MATRIX_DIM 9 1 1 ECU_ADDRESS 0x0040D53C /end MEASUREMENT
/begin MEASUREMENT VSM_LCKIE_OS_DetaSpdSelect "" FLOAT32_IEEE PubIfStateVSM_MDL_CM_single 0 0 -3.4E+38 3.4E+38 ECU_ADDRESS 0x0040D560 /end MEASUREMENT
/begin MEASUREMENT VSM_LCKIE_OS_DisEgo2OppLane "" FLOAT32_IEEE PubIfStateVSM_MDL_CM_single 0 0 -3.4E+38 3.4E+38 ECU_ADDRESS 0x0040D564 /end MEASUREMENT
/begin MEASUREMENT VSM_LCKIE_OS_DetaSpd "" FLOAT32_IEEE PubIfStateVSM_MDL_CM_single 0 0 -3.4E+38 3.4E+38 LAYOUT ROW_DIR MATRIX_DIM 9 1 1 ECU_ADDRESS 0x0040D568 /end MEASUREMENT
/begin MEASUREMENT VSM_LCKIE_OS_TTC "" FLOAT32_IEEE PubIfStateVSM_MDL_CM_single 0 0 -3.4E+38 3.4E+38 LAYOUT ROW_DIR MATRIX_DIM 9 1 1 ECU_ADDRESS 0x0040D58C /end MEASUREMENT
/begin MEASUREMENT VSM_LCKIE_ORC_ObjTTC "" FLOAT32_IEEE PubIfStateVSM_MDL_CM_single 0 0 -3.4E+38 3.4E+38 ECU_ADDRESS 0x0040D5B0 /end MEASUREMENT
/begin MEASUREMENT VSM_LCKIE_ORC_ObjLong "" FLOAT32_IEEE PubIfStateVSM_MDL_CM_single 0 0 -3.4E+38 3.4E+38 ECU_ADDRESS 0x0040D5B4 /end MEASUREMENT
/begin MEASUREMENT VSM_LCKIE_ORC_ObjLatPos "" FLOAT32_IEEE PubIfStateVSM_MDL_CM_single 0 0 -3.4E+38 3.4E+38 ECU_ADDRESS 0x0040D5B8 /end MEASUREMENT
/begin MEASUREMENT VSM_LCKIE_ORC_ObjDetaSpd "" FLOAT32_IEEE PubIfStateVSM_MDL_CM_single 0 0 -3.4E+38 3.4E+38 ECU_ADDRESS 0x0040D5BC /end MEASUREMENT
/begin MEASUREMENT VSM_LCKIE_OFC_Long "" FLOAT32_IEEE PubIfStateVSM_MDL_CM_single 0 0 -3.4E+38 3.4E+38 ECU_ADDRESS 0x0040D5C0 /end MEASUREMENT
/begin MEASUREMENT VSM_LCKIE_OFC_OppObjDetaSpd "" FLOAT32_IEEE PubIfStateVSM_MDL_CM_single 0 0 -3.4E+38 3.4E+38 ECU_ADDRESS 0x0040D5C4 /end MEASUREMENT
/begin MEASUREMENT VSM_LCKIE_OFC_ObjTTC "" FLOAT32_IEEE PubIfStateVSM_MDL_CM_single 0 0 -3.4E+38 3.4E+38 ECU_ADDRESS 0x0040D5C8 /end MEASUREMENT
/begin MEASUREMENT VSM_LCKIE_OFC_Tset "" FLOAT32_IEEE PubIfStateVSM_MDL_CM_single 0 0 -3.4E+38 3.4E+38 ECU_ADDRESS 0x0040D5CC /end MEASUREMENT
/begin MEASUREMENT VSM_LCKIE_LongC_LongDisfinal "" FLOAT32_IEEE PubIfStateVSM_MDL_CM_single 0 0 -3.4E+38 3.4E+38 ECU_ADDRESS 0x0040D5D0 /end MEASUREMENT
/begin MEASUREMENT VSM_LCKIE_LongC_ObjLong "" FLOAT32_IEEE PubIfStateVSM_MDL_CM_single 0 0 -3.4E+38 3.4E+38 ECU_ADDRESS 0x0040D5D4 /end MEASUREMENT
/begin MEASUREMENT VSM_LCKIE_LatC_LatMovDis "" FLOAT32_IEEE PubIfStateVSM_MDL_CM_single 0 0 -3.4E+38 3.4E+38 ECU_ADDRESS 0x0040D5D8 /end MEASUREMENT
/begin MEASUREMENT VSM_LCKIE_LatC_ts "" FLOAT32_IEEE PubIfStateVSM_MDL_CM_single 0 0 -3.4E+38 3.4E+38 ECU_ADDRESS 0x0040D5DC /end MEASUREMENT
/begin MEASUREMENT VSM_LCKIE_LatC_MoveDis "" FLOAT32_IEEE PubIfStateVSM_MDL_CM_single 0 0 -3.4E+38 3.4E+38 ECU_ADDRESS 0x0040D5E0 /end MEASUREMENT
/begin MEASUREMENT VSM_LCKIE_LatC_DisREToLane "" FLOAT32_IEEE PubIfStateVSM_MDL_CM_single 0 0 -3.4E+38 3.4E+38 ECU_ADDRESS 0x0040D5E4 /end MEASUREMENT
/begin MEASUREMENT VSM_LCKIE_LatC_SafDis "" FLOAT32_IEEE PubIfStateVSM_MDL_CM_single 0 0 -3.4E+38 3.4E+38 ECU_ADDRESS 0x0040D5E8 /end MEASUREMENT
/begin MEASUREMENT VSM_LCKIE_LatC_latmovori "" FLOAT32_IEEE PubIfStateVSM_MDL_CM_single 0 0 -3.4E+38 3.4E+38 ECU_ADDRESS 0x0040D5EC /end MEASUREMENT
/begin MEASUREMENT VSM_LCKIE_Laneoffset "" FLOAT32_IEEE PubIfStateVSM_MDL_CM_single 0 0 -3.4E+38 3.4E+38 ECU_ADDRESS 0x0040D5F0 /end MEASUREMENT
/begin MEASUREMENT VSM_LCK_dy0 "" FLOAT32_IEEE PubIfStateVSM_MDL_CM_single 0 0 -3.4E+38 3.4E+38 ECU_ADDRESS 0x0040D5F4 /end MEASUREMENT
/begin MEASUREMENT VSM_LCK_dypreoffset "" FLOAT32_IEEE PubIfStateVSM_MDL_CM_single 0 0 -3.4E+38 3.4E+38 ECU_ADDRESS 0x0040D5F8 /end MEASUREMENT
/begin MEASUREMENT VSM_LCK_dypre "" FLOAT32_IEEE PubIfStateVSM_MDL_CM_single 0 0 -3.4E+38 3.4E+38 ECU_ADDRESS 0x0040D5FC /end MEASUREMENT
/begin MEASUREMENT VSM_ELK_OnComing_Rv_re "" FLOAT32_IEEE PubIfStateVSM_MDL_CM_single 0 0 -3.4E+38 3.4E+38 ECU_ADDRESS 0x0040D604 /end MEASUREMENT
/begin MEASUREMENT VSM_ELK_OnComing_Rlateral "" FLOAT32_IEEE PubIfStateVSM_MDL_CM_single 0 0 -3.4E+38 3.4E+38 ECU_ADDRESS 0x0040D608 /end MEASUREMENT
/begin MEASUREMENT VSM_ELK_OnComing_Lv_re "" FLOAT32_IEEE PubIfStateVSM_MDL_CM_single 0 0 -3.4E+38 3.4E+38 ECU_ADDRESS 0x0040D60C /end MEASUREMENT
/begin MEASUREMENT VSM_ELK_OnComing_Llateral "" FLOAT32_IEEE PubIfStateVSM_MDL_CM_single 0 0 -3.4E+38 3.4E+38 ECU_ADDRESS 0x0040D610 /end MEASUREMENT
/begin MEASUREMENT VSM_ACCStandActiveTime "" UWORD PubIfStateVSM_MDL_CM_uint16 0 0 0 65535 ECU_ADDRESS 0x0040D61C /end MEASUREMENT
/begin MEASUREMENT VSM_LCKIE_POC_Couter1 "" UWORD PubIfStateVSM_MDL_CM_uint16 0 0 0 65535 ECU_ADDRESS 0x0040D622 /end MEASUREMENT
/begin MEASUREMENT VSM_LCKIE_LongC_CouterOff "" UWORD PubIfStateVSM_MDL_CM_uint16 0 0 0 65535 ECU_ADDRESS 0x0040D624 /end MEASUREMENT
/begin MEASUREMENT VSM_LCKIE_LongC_Couter1 "" UWORD PubIfStateVSM_MDL_CM_uint16 0 0 0 65535 ECU_ADDRESS 0x0040D626 /end MEASUREMENT
/begin MEASUREMENT VSM_LCKIE_LongC_Couter2 "" UWORD PubIfStateVSM_MDL_CM_uint16 0 0 0 65535 ECU_ADDRESS 0x0040D628 /end MEASUREMENT
/begin MEASUREMENT VSM_LCKIE_LongC_Couter3 "" UWORD PubIfStateVSM_MDL_CM_uint16 0 0 0 65535 ECU_ADDRESS 0x0040D62A /end MEASUREMENT
/begin MEASUREMENT VSM_LKAState "" UBYTE PubIfStateVSM_MDL_CM_uint8 0 0 0 255 ECU_ADDRESS 0x0040D632 /end MEASUREMENT
/begin MEASUREMENT VSM_HWANOA_Mode "" UBYTE PubIfStateVSM_MDL_CM_uint8 0 0 0 255 ECU_ADDRESS 0x0040D637 /end MEASUREMENT
/begin MEASUREMENT VSM_TJATextDisp "" UBYTE PubIfStateVSM_MDL_CM_uint8 0 0 0 255 ECU_ADDRESS 0x0040D638 /end MEASUREMENT
/begin MEASUREMENT VSM_HWATextDisp "" UBYTE PubIfStateVSM_MDL_CM_uint8 0 0 0 255 ECU_ADDRESS 0x0040D639 /end MEASUREMENT
/begin MEASUREMENT VSM_ACCTextDisp "" UBYTE PubIfStateVSM_MDL_CM_uint8 0 0 0 255 ECU_ADDRESS 0x0040D63A /end MEASUREMENT
/begin MEASUREMENT VSM_LKA_Warning "" UBYTE PubIfStateVSM_MDL_CM_uint8 0 0 0 255 ECU_ADDRESS 0x0040D63B /end MEASUREMENT
/begin MEASUREMENT VSM_ACC_DrvrOff_Disp "" UBYTE PubIfStateVSM_MDL_CM_uint8 0 0 0 255 ECU_ADDRESS 0x0040D63D /end MEASUREMENT
/begin MEASUREMENT VSM_LCKState "" UBYTE PubIfStateVSM_MDL_CM_uint8 0 0 0 255 ECU_ADDRESS 0x0040D640 /end MEASUREMENT
/begin MEASUREMENT VSM_LCK_Counter "" UBYTE PubIfStateVSM_MDL_CM_uint8 0 0 0 255 ECU_ADDRESS 0x0040D641 /end MEASUREMENT
/begin MEASUREMENT VSM_LDWSts "" UBYTE PubIfStateVSM_MDL_CM_uint8 0 0 0 255 ECU_ADDRESS 0x0040D643 /end MEASUREMENT
/begin MEASUREMENT VSM_LDW_Error "" UBYTE PubIfStateVSM_MDL_CM_uint8 0 0 0 255 ECU_ADDRESS 0x0040D644 /end MEASUREMENT
/begin MEASUREMENT VSM_LDW_Counter "" UBYTE PubIfStateVSM_MDL_CM_uint8 0 0 0 255 ECU_ADDRESS 0x0040D645 /end MEASUREMENT
/begin MEASUREMENT VSM_LKA_Error "" UBYTE PubIfStateVSM_MDL_CM_uint8 0 0 0 255 ECU_ADDRESS 0x0040D646 /end MEASUREMENT
/begin MEASUREMENT VSM_LKA_Counter "" UBYTE PubIfStateVSM_MDL_CM_uint8 0 0 0 255 ECU_ADDRESS 0x0040D647 /end MEASUREMENT
/begin MEASUREMENT VSM_LCKIE_POC_OvertakeFlg "" UBYTE PubIfStateVSM_MDL_CM_uint8 0 0 0 255 ECU_ADDRESS 0x0040D64A /end MEASUREMENT
/begin MEASUREMENT VSM_LCKIE_POC_LongDown "" UBYTE PubIfStateVSM_MDL_CM_uint8 0 0 0 255 ECU_ADDRESS 0x0040D64B /end MEASUREMENT
/begin MEASUREMENT VSM_LCKIE_POC_POSID "" UBYTE PubIfStateVSM_MDL_CM_uint8 0 0 0 255 ECU_ADDRESS 0x0040D64C /end MEASUREMENT
/begin MEASUREMENT VSM_LCKIE_POC_POSObjID "" UBYTE PubIfStateVSM_MDL_CM_uint8 0 0 0 255 ECU_ADDRESS 0x0040D64D /end MEASUREMENT
/begin MEASUREMENT VSM_LCKIE_POC_Counter "" UBYTE PubIfStateVSM_MDL_CM_uint8 0 0 0 255 ECU_ADDRESS 0x0040D64E /end MEASUREMENT
/begin MEASUREMENT VSM_LCKIE_POC_Couter2 "" UBYTE PubIfStateVSM_MDL_CM_uint8 0 0 0 255 ECU_ADDRESS 0x0040D64F /end MEASUREMENT
/begin MEASUREMENT VSM_LCKIE_OS_OppFObjID "" UBYTE PubIfStateVSM_MDL_CM_uint8 0 0 0 255 ECU_ADDRESS 0x0040D650 /end MEASUREMENT
/begin MEASUREMENT VSM_LCKIE_OS_OppRObjID "" UBYTE PubIfStateVSM_MDL_CM_uint8 0 0 0 255 ECU_ADDRESS 0x0040D651 /end MEASUREMENT
/begin MEASUREMENT VSM_LCKIE_OS_POSRObjID "" UBYTE PubIfStateVSM_MDL_CM_uint8 0 0 0 255 ECU_ADDRESS 0x0040D652 /end MEASUREMENT
/begin MEASUREMENT VSM_LCKIE_OS_ObjLane "" UBYTE PubIfStateVSM_MDL_CM_uint8 0 0 0 255 LAYOUT ROW_DIR MATRIX_DIM 9 1 1 ECU_ADDRESS 0x0040D654 /end MEASUREMENT
/begin MEASUREMENT VSM_LCKIE_OS_ObjSelectID "" UBYTE PubIfStateVSM_MDL_CM_uint8 0 0 0 255 ECU_ADDRESS 0x0040D65D /end MEASUREMENT
/begin MEASUREMENT VSM_LCKIE_OS_ObjIDSelect "" UBYTE PubIfStateVSM_MDL_CM_uint8 0 0 0 255 ECU_ADDRESS 0x0040D65E /end MEASUREMENT
/begin MEASUREMENT VSM_LCKIE_OS_Couter "" UBYTE PubIfStateVSM_MDL_CM_uint8 0 0 0 255 ECU_ADDRESS 0x0040D65F /end MEASUREMENT
/begin MEASUREMENT VSM_LCKIE_OS_Couter1 "" UBYTE PubIfStateVSM_MDL_CM_uint8 0 0 0 255 ECU_ADDRESS 0x0040D660 /end MEASUREMENT
/begin MEASUREMENT VSM_LCKIE_ORC_OppREARObjReady "" UBYTE PubIfStateVSM_MDL_CM_uint8 0 0 0 255 ECU_ADDRESS 0x0040D661 /end MEASUREMENT
/begin MEASUREMENT VSM_LCKIE_ORC_Counter "" UBYTE PubIfStateVSM_MDL_CM_uint8 0 0 0 255 ECU_ADDRESS 0x0040D662 /end MEASUREMENT
/begin MEASUREMENT VSM_LCKIE_OFC_OppObjReady "" UBYTE PubIfStateVSM_MDL_CM_uint8 0 0 0 255 ECU_ADDRESS 0x0040D663 /end MEASUREMENT
/begin MEASUREMENT VSM_LCKIE_OFC_OppObjFail "" UBYTE PubIfStateVSM_MDL_CM_uint8 0 0 0 255 ECU_ADDRESS 0x0040D664 /end MEASUREMENT
/begin MEASUREMENT VSM_LCKIE_OFC_Counter "" UBYTE PubIfStateVSM_MDL_CM_uint8 0 0 0 255 ECU_ADDRESS 0x0040D665 /end MEASUREMENT
/begin MEASUREMENT VSM_LCKIE_OFC_Counter1 "" UBYTE PubIfStateVSM_MDL_CM_uint8 0 0 0 255 ECU_ADDRESS 0x0040D666 /end MEASUREMENT
/begin MEASUREMENT VSM_LCKIE_LongC_PocFlg "" UBYTE PubIfStateVSM_MDL_CM_uint8 0 0 0 255 ECU_ADDRESS 0x0040D667 /end MEASUREMENT
/begin MEASUREMENT VSM_LCKIE_LongC_IEReady "" UBYTE PubIfStateVSM_MDL_CM_uint8 0 0 0 255 ECU_ADDRESS 0x0040D668 /end MEASUREMENT
/begin MEASUREMENT VSM_LCKIE_LongC_LongFlg "" UBYTE PubIfStateVSM_MDL_CM_uint8 0 0 0 255 ECU_ADDRESS 0x0040D669 /end MEASUREMENT
/begin MEASUREMENT VSM_LCKIE_LatC_Flg "" UBYTE PubIfStateVSM_MDL_CM_uint8 0 0 0 255 ECU_ADDRESS 0x0040D66A /end MEASUREMENT
/begin MEASUREMENT VSM_LCKIE_LatC_MovDirct1 "" UBYTE PubIfStateVSM_MDL_CM_uint8 0 0 0 255 ECU_ADDRESS 0x0040D66B /end MEASUREMENT
/begin MEASUREMENT VSM_LCKIE_LatC_LatWarning "" UBYTE PubIfStateVSM_MDL_CM_uint8 0 0 0 255 ECU_ADDRESS 0x0040D66C /end MEASUREMENT
/begin MEASUREMENT VSM_LCKIE_LatC_DirectChange "" UBYTE PubIfStateVSM_MDL_CM_uint8 0 0 0 255 ECU_ADDRESS 0x0040D66D /end MEASUREMENT
/begin MEASUREMENT VSM_LCKIE_LatC_ObjLatFailFlg "" UBYTE PubIfStateVSM_MDL_CM_uint8 0 0 0 255 ECU_ADDRESS 0x0040D66E /end MEASUREMENT
/begin MEASUREMENT VSM_LCKIE_LatC_MovDirct "" UBYTE PubIfStateVSM_MDL_CM_uint8 0 0 0 255 ECU_ADDRESS 0x0040D66F /end MEASUREMENT
/begin MEASUREMENT VSM_LCKIE_LatC_LatFLg "" UBYTE PubIfStateVSM_MDL_CM_uint8 0 0 0 255 ECU_ADDRESS 0x0040D670 /end MEASUREMENT
/begin MEASUREMENT VSM_LCKIE_LatC_Counter "" UBYTE PubIfStateVSM_MDL_CM_uint8 0 0 0 255 ECU_ADDRESS 0x0040D671 /end MEASUREMENT
/begin MEASUREMENT VSM_LCKIE_LatC_Counter1 "" UBYTE PubIfStateVSM_MDL_CM_uint8 0 0 0 255 ECU_ADDRESS 0x0040D672 /end MEASUREMENT
/begin MEASUREMENT VSM_LCKIE_LatC_Counter2 "" UBYTE PubIfStateVSM_MDL_CM_uint8 0 0 0 255 ECU_ADDRESS 0x0040D673 /end MEASUREMENT
/begin MEASUREMENT VSM_LCKIE_LatC_Counter3 "" UBYTE PubIfStateVSM_MDL_CM_uint8 0 0 0 255 ECU_ADDRESS 0x0040D674 /end MEASUREMENT
/begin MEASUREMENT VSM_LCKIE_LatC_Counter4 "" UBYTE PubIfStateVSM_MDL_CM_uint8 0 0 0 255 ECU_ADDRESS 0x0040D675 /end MEASUREMENT
/begin MEASUREMENT VSM_LCKIE_LatC_Counter5 "" UBYTE PubIfStateVSM_MDL_CM_uint8 0 0 0 255 ECU_ADDRESS 0x0040D676 /end MEASUREMENT
/begin MEASUREMENT VSM_LCKIE_DelayReady "" UBYTE PubIfStateVSM_MDL_CM_uint8 0 0 0 255 ECU_ADDRESS 0x0040D677 /end MEASUREMENT
/begin MEASUREMENT VSM_HWAWarningLevel "" UBYTE PubIfStateVSM_MDL_CM_uint8 0 0 0 255 ECU_ADDRESS 0x0040D67B /end MEASUREMENT
/begin MEASUREMENT VSM_ACCFastExitCons_Standstill3min "" UBYTE PubIfStateVSM_MDL_CM_boolean 0 0 0 1 ECU_ADDRESS 0x0040D67C BIT_MASK 0x01 /end MEASUREMENT
/begin MEASUREMENT VSM_VehicleStandStill "" UBYTE PubIfStateVSM_MDL_CM_boolean 0 0 0 1 ECU_ADDRESS 0x0040D67D BIT_MASK 0x01 /end MEASUREMENT
/begin MEASUREMENT VSM_ACCFastExitCons_StandstillNoBrakeForce "" UBYTE PubIfStateVSM_MDL_CM_boolean 0 0 0 1 ECU_ADDRESS 0x0040D67E BIT_MASK 0x01 /end MEASUREMENT
/begin MEASUREMENT VSM_ACCFastExitCons_RollingBack "" UBYTE PubIfStateVSM_MDL_CM_boolean 0 0 0 1 ECU_ADDRESS 0x0040D67F BIT_MASK 0x01 /end MEASUREMENT
/begin MEASUREMENT VSM_ACCFastExitCons_EngineOff "" UBYTE PubIfStateVSM_MDL_CM_boolean 0 0 0 1 ECU_ADDRESS 0x0040D680 BIT_MASK 0x01 /end MEASUREMENT
/begin MEASUREMENT VSM_ACCFastExitCons_BrakeDiskOverHeat "" UBYTE PubIfStateVSM_MDL_CM_boolean 0 0 0 1 ECU_ADDRESS 0x0040D681 BIT_MASK 0x01 /end MEASUREMENT
/begin MEASUREMENT VSM_ACCFastExitCons_Cancel "" UBYTE PubIfStateVSM_MDL_CM_boolean 0 0 0 1 ECU_ADDRESS 0x0040D682 BIT_MASK 0x01 /end MEASUREMENT
/begin MEASUREMENT VSM_ACCFastExitCons_EspOff "" UBYTE PubIfStateVSM_MDL_CM_boolean 0 0 0 1 ECU_ADDRESS 0x0040D683 BIT_MASK 0x01 /end MEASUREMENT
/begin MEASUREMENT VSM_ACCFastExitCons_NoForwardGear "" UBYTE PubIfStateVSM_MDL_CM_boolean 0 0 0 1 ECU_ADDRESS 0x0040D684 BIT_MASK 0x01 /end MEASUREMENT
/begin MEASUREMENT VSM_ACC_DriverBrake "" UBYTE PubIfStateVSM_MDL_CM_boolean 0 0 0 1 ECU_ADDRESS 0x0040D685 BIT_MASK 0x01 /end MEASUREMENT
/begin MEASUREMENT VSM_ACCFastExitCons_DriveBrakeExit "" UBYTE PubIfStateVSM_MDL_CM_boolean 0 0 0 1 ECU_ADDRESS 0x0040D686 BIT_MASK 0x01 /end MEASUREMENT
/begin MEASUREMENT VSM_ACCFastExitCons_EPBClosed "" UBYTE PubIfStateVSM_MDL_CM_boolean 0 0 0 1 ECU_ADDRESS 0x0040D687 BIT_MASK 0x01 /end MEASUREMENT
/begin MEASUREMENT VSM_ACCFastExitCons_DriverDoorOpen "" UBYTE PubIfStateVSM_MDL_CM_boolean 0 0 0 1 ECU_ADDRESS 0x0040D688 BIT_MASK 0x01 /end MEASUREMENT
/begin MEASUREMENT VSM_ACCFastExitCons_AEBTrigger "" UBYTE PubIfStateVSM_MDL_CM_boolean 0 0 0 1 ECU_ADDRESS 0x0040D689 BIT_MASK 0x01 /end MEASUREMENT
/begin MEASUREMENT VSM_ACCFastExitCons_VehSpdExit "" UBYTE PubIfStateVSM_MDL_CM_boolean 0 0 0 1 ECU_ADDRESS 0x0040D68A BIT_MASK 0x01 /end MEASUREMENT
/begin MEASUREMENT VSM_ACCFastExitCons_DrivingModExit "" UBYTE PubIfStateVSM_MDL_CM_boolean 0 0 0 1 ECU_ADDRESS 0x0040D68B BIT_MASK 0x01 /end MEASUREMENT
/begin MEASUREMENT VSM_ACCFastExitCons_APSGuidance "" UBYTE PubIfStateVSM_MDL_CM_boolean 0 0 0 1 ECU_ADDRESS 0x0040D68C BIT_MASK 0x01 /end MEASUREMENT
/begin MEASUREMENT VSM_ACCFastExitCons_ACCError_Inhibit "" UBYTE PubIfStateVSM_MDL_CM_boolean 0 0 0 1 ECU_ADDRESS 0x0040D68D BIT_MASK 0x01 /end MEASUREMENT
/begin MEASUREMENT VSM_ACCFastExitCons_ACCOverride "" UBYTE PubIfStateVSM_MDL_CM_boolean 0 0 0 1 ECU_ADDRESS 0x0040D68E BIT_MASK 0x01 /end MEASUREMENT
/begin MEASUREMENT VSM_DriveBrake "" UBYTE PubIfStateVSM_MDL_CM_boolean 0 0 0 1 ECU_ADDRESS 0x0040D691 BIT_MASK 0x01 /end MEASUREMENT
/begin MEASUREMENT VSM_ACCSlowExitCons_EspActive400ms "" UBYTE PubIfStateVSM_MDL_CM_boolean 0 0 0 1 ECU_ADDRESS 0x0040D692 BIT_MASK 0x01 /end MEASUREMENT
/begin MEASUREMENT VSM_ACCSlowExitCons_MSRactive800ms "" UBYTE PubIfStateVSM_MDL_CM_boolean 0 0 0 1 ECU_ADDRESS 0x0040D693 BIT_MASK 0x01 /end MEASUREMENT
/begin MEASUREMENT VSM_ACCSlowExitCons_HDCactive40ms "" UBYTE PubIfStateVSM_MDL_CM_boolean 0 0 0 1 ECU_ADDRESS 0x0040D694 BIT_MASK 0x01 /end MEASUREMENT
/begin MEASUREMENT VSM_ACCSlowExitCons_ABSactive400ms "" UBYTE PubIfStateVSM_MDL_CM_boolean 0 0 0 1 ECU_ADDRESS 0x0040D695 BIT_MASK 0x01 /end MEASUREMENT
/begin MEASUREMENT VSM_ACCSlowExitCons_TCS1active3000ms "" UBYTE PubIfStateVSM_MDL_CM_boolean 0 0 0 1 ECU_ADDRESS 0x0040D696 BIT_MASK 0x01 /end MEASUREMENT
/begin MEASUREMENT VSM_ACCSlowExitCons_TCS2active3000ms "" UBYTE PubIfStateVSM_MDL_CM_boolean 0 0 0 1 ECU_ADDRESS 0x0040D697 BIT_MASK 0x01 /end MEASUREMENT
/begin MEASUREMENT VSM_ACCFastExitCons_DriverSBR "" UBYTE PubIfStateVSM_MDL_CM_boolean 0 0 0 1 ECU_ADDRESS 0x0040D698 BIT_MASK 0x01 /end MEASUREMENT
/begin MEASUREMENT VSM_ActiveEnable "" UBYTE PubIfStateVSM_MDL_CM_boolean 0 0 0 1 ECU_ADDRESS 0x0040D699 BIT_MASK 0x01 /end MEASUREMENT
/begin MEASUREMENT VSM_ACC_USSObjExist "" UBYTE PubIfStateVSM_MDL_CM_boolean 0 0 0 1 ECU_ADDRESS 0x0040D69A BIT_MASK 0x01 /end MEASUREMENT
/begin MEASUREMENT VSM_ACC_DrvOfftoSM "" UBYTE PubIfStateVSM_MDL_CM_boolean 0 0 0 1 ECU_ADDRESS 0x0040D69B BIT_MASK 0x01 /end MEASUREMENT
/begin MEASUREMENT VSM_AccOverride "" UBYTE PubIfStateVSM_MDL_CM_boolean 0 0 0 1 ECU_ADDRESS 0x0040D69C BIT_MASK 0x01 /end MEASUREMENT
/begin MEASUREMENT VSM_ACCFastExit "" UBYTE PubIfStateVSM_MDL_CM_boolean 0 0 0 1 ECU_ADDRESS 0x0040D69D BIT_MASK 0x01 /end MEASUREMENT
/begin MEASUREMENT VSM_ACCSlowExit "" UBYTE PubIfStateVSM_MDL_CM_boolean 0 0 0 1 ECU_ADDRESS 0x0040D69E BIT_MASK 0x01 /end MEASUREMENT
/begin MEASUREMENT VSM_ACC_AccPedalTouch "" UBYTE PubIfStateVSM_MDL_CM_boolean 0 0 0 1 ECU_ADDRESS 0x0040D69F BIT_MASK 0x01 /end MEASUREMENT
/begin MEASUREMENT VSM_ACC_BOMExit "" UBYTE PubIfStateVSM_MDL_CM_boolean 0 0 0 1 ECU_ADDRESS 0x0040D6A1 BIT_MASK 0x01 /end MEASUREMENT
/begin MEASUREMENT VSM_ACCStandActive2Wait_DrvrSts "" UBYTE PubIfStateVSM_MDL_CM_boolean 0 0 0 1 ECU_ADDRESS 0x0040D6A2 BIT_MASK 0x01 /end MEASUREMENT
/begin MEASUREMENT VSM_ACCStandActive2Wait_USS "" UBYTE PubIfStateVSM_MDL_CM_boolean 0 0 0 1 ECU_ADDRESS 0x0040D6A3 BIT_MASK 0x01 /end MEASUREMENT
/begin MEASUREMENT VSM_ACCStandActive2Active_DrvrSts "" UBYTE PubIfStateVSM_MDL_CM_boolean 0 0 0 1 ECU_ADDRESS 0x0040D6A4 BIT_MASK 0x01 /end MEASUREMENT
/begin MEASUREMENT VSM_ESS_VehicleSpd_IDLE2READY "" UBYTE PubIfStateVSM_MDL_CM_boolean 0 0 0 1 ECU_ADDRESS 0x0040D6AA BIT_MASK 0x01 /end MEASUREMENT
/begin MEASUREMENT VSM_ESS_ESPFuncOffSts_IDLE2READY "" UBYTE PubIfStateVSM_MDL_CM_boolean 0 0 0 1 ECU_ADDRESS 0x0040D6AB BIT_MASK 0x01 /end MEASUREMENT
/begin MEASUREMENT VSM_ESS_DoorSts_IDLE2READY "" UBYTE PubIfStateVSM_MDL_CM_boolean 0 0 0 1 ECU_ADDRESS 0x0040D6AC BIT_MASK 0x01 /end MEASUREMENT
/begin MEASUREMENT VSM_ESS_DrvSBR_IDLE2READY "" UBYTE PubIfStateVSM_MDL_CM_boolean 0 0 0 1 ECU_ADDRESS 0x0040D6AD BIT_MASK 0x01 /end MEASUREMENT
/begin MEASUREMENT VSM_ESS_TrailerSts_IDLE2READY "" UBYTE PubIfStateVSM_MDL_CM_boolean 0 0 0 1 ECU_ADDRESS 0x0040D6AE BIT_MASK 0x01 /end MEASUREMENT
/begin MEASUREMENT VSM_ESS_WiprReq_IDLE2READY "" UBYTE PubIfStateVSM_MDL_CM_boolean 0 0 0 1 ECU_ADDRESS 0x0040D6AF BIT_MASK 0x01 /end MEASUREMENT
/begin MEASUREMENT VSM_ESS_HiLoBeam_IDLE2READY "" UBYTE PubIfStateVSM_MDL_CM_boolean 0 0 0 1 ECU_ADDRESS 0x0040D6B0 BIT_MASK 0x01 /end MEASUREMENT
/begin MEASUREMENT VSM_ESS_ESPActive_IDLE2READY "" UBYTE PubIfStateVSM_MDL_CM_boolean 0 0 0 1 ECU_ADDRESS 0x0040D6B1 BIT_MASK 0x01 /end MEASUREMENT
/begin MEASUREMENT VSM_ESS_LateralAccel_IDLE2READY "" UBYTE PubIfStateVSM_MDL_CM_boolean 0 0 0 1 ECU_ADDRESS 0x0040D6B2 BIT_MASK 0x01 /end MEASUREMENT
/begin MEASUREMENT VSM_ESS_IDLE2READY "" UBYTE PubIfStateVSM_MDL_CM_boolean 0 0 0 1 ECU_ADDRESS 0x0040D6B3 BIT_MASK 0x01 /end MEASUREMENT
/begin MEASUREMENT VSM_ESS_VehicleSpd_READY2IDLE "" UBYTE PubIfStateVSM_MDL_CM_boolean 0 0 0 1 ECU_ADDRESS 0x0040D6B4 BIT_MASK 0x01 /end MEASUREMENT
/begin MEASUREMENT VSM_ESS_ESPFuncOffSts_READY2IDLE "" UBYTE PubIfStateVSM_MDL_CM_boolean 0 0 0 1 ECU_ADDRESS 0x0040D6B5 BIT_MASK 0x01 /end MEASUREMENT
/begin MEASUREMENT VSM_ESS_DoorSts_READY2IDLE "" UBYTE PubIfStateVSM_MDL_CM_boolean 0 0 0 1 ECU_ADDRESS 0x0040D6B6 BIT_MASK 0x01 /end MEASUREMENT
/begin MEASUREMENT VSM_ESS_DrvSBR_READY2IDLE "" UBYTE PubIfStateVSM_MDL_CM_boolean 0 0 0 1 ECU_ADDRESS 0x0040D6B7 BIT_MASK 0x01 /end MEASUREMENT
/begin MEASUREMENT VSM_ESS_TrailerSts_READY2IDLE "" UBYTE PubIfStateVSM_MDL_CM_boolean 0 0 0 1 ECU_ADDRESS 0x0040D6B8 BIT_MASK 0x01 /end MEASUREMENT
/begin MEASUREMENT VSM_ESS_WiprReq_READY2IDLE "" UBYTE PubIfStateVSM_MDL_CM_boolean 0 0 0 1 ECU_ADDRESS 0x0040D6B9 BIT_MASK 0x01 /end MEASUREMENT
/begin MEASUREMENT VSM_ESS_HiLoBeam_READY2IDLE "" UBYTE PubIfStateVSM_MDL_CM_boolean 0 0 0 1 ECU_ADDRESS 0x0040D6BA BIT_MASK 0x01 /end MEASUREMENT
/begin MEASUREMENT VSM_ESS_ESPActive_READY2IDLE "" UBYTE PubIfStateVSM_MDL_CM_boolean 0 0 0 1 ECU_ADDRESS 0x0040D6BB BIT_MASK 0x01 /end MEASUREMENT
/begin MEASUREMENT VSM_ESS_LateralAccel_READY2IDLE "" UBYTE PubIfStateVSM_MDL_CM_boolean 0 0 0 1 ECU_ADDRESS 0x0040D6BC BIT_MASK 0x01 /end MEASUREMENT
/begin MEASUREMENT VSM_ESS_READY2IDLE "" UBYTE PubIfStateVSM_MDL_CM_boolean 0 0 0 1 ECU_ADDRESS 0x0040D6BD BIT_MASK 0x01 /end MEASUREMENT
/begin MEASUREMENT VSM_ESS_FcwWarn_Ready2Active "" UBYTE PubIfStateVSM_MDL_CM_boolean 0 0 0 1 ECU_ADDRESS 0x0040D6BE BIT_MASK 0x01 /end MEASUREMENT
/begin MEASUREMENT VSM_ESS_FcwDisFlag_Ready2Active "" UBYTE PubIfStateVSM_MDL_CM_boolean 0 0 0 1 ECU_ADDRESS 0x0040D6BF BIT_MASK 0x01 /end MEASUREMENT
/begin MEASUREMENT VSM_ESS_FcwFlag_READY2ACTIVE "" UBYTE PubIfStateVSM_MDL_CM_boolean 0 0 0 1 ECU_ADDRESS 0x0040D6C0 BIT_MASK 0x01 /end MEASUREMENT
/begin MEASUREMENT VSM_ESS_AEBVehFlag_Ready2Active "" UBYTE PubIfStateVSM_MDL_CM_boolean 0 0 0 1 ECU_ADDRESS 0x0040D6C1 BIT_MASK 0x01 /end MEASUREMENT
/begin MEASUREMENT VSM_ESS_AEBVruFlag_Ready2Active "" UBYTE PubIfStateVSM_MDL_CM_boolean 0 0 0 1 ECU_ADDRESS 0x0040D6C2 BIT_MASK 0x01 /end MEASUREMENT
/begin MEASUREMENT VSM_ESS_AEBFlag_READY2ACTIVE "" UBYTE PubIfStateVSM_MDL_CM_boolean 0 0 0 1 ECU_ADDRESS 0x0040D6C3 BIT_MASK 0x01 /end MEASUREMENT
/begin MEASUREMENT VSM_ESS_AccelPed_READY2ACTIVE "" UBYTE PubIfStateVSM_MDL_CM_boolean 0 0 0 1 ECU_ADDRESS 0x0040D6C4 BIT_MASK 0x01 /end MEASUREMENT
/begin MEASUREMENT VSM_ESS_VehLgtAccel_READY2ACTIVE "" UBYTE PubIfStateVSM_MDL_CM_boolean 0 0 0 1 ECU_ADDRESS 0x0040D6C5 BIT_MASK 0x01 /end MEASUREMENT
/begin MEASUREMENT VSM_ESS_READY2ACTIVE "" UBYTE PubIfStateVSM_MDL_CM_boolean 0 0 0 1 ECU_ADDRESS 0x0040D6C6 BIT_MASK 0x01 /end MEASUREMENT
/begin MEASUREMENT VSM_ESS_ESPActive_ACTIVE2IDLE "" UBYTE PubIfStateVSM_MDL_CM_boolean 0 0 0 1 ECU_ADDRESS 0x0040D6C7 BIT_MASK 0x01 /end MEASUREMENT
/begin MEASUREMENT VSM_ESS_LateralAccel_ACTIVE2IDLE "" UBYTE PubIfStateVSM_MDL_CM_boolean 0 0 0 1 ECU_ADDRESS 0x0040D6C8 BIT_MASK 0x01 /end MEASUREMENT
/begin MEASUREMENT VSM_ESS_ESPFuncOffSts_ACTIVE2IDLE "" UBYTE PubIfStateVSM_MDL_CM_boolean 0 0 0 1 ECU_ADDRESS 0x0040D6C9 BIT_MASK 0x01 /end MEASUREMENT
/begin MEASUREMENT VSM_ESS_DoorSts_ACTIVE2IDLE "" UBYTE PubIfStateVSM_MDL_CM_boolean 0 0 0 1 ECU_ADDRESS 0x0040D6CA BIT_MASK 0x01 /end MEASUREMENT
/begin MEASUREMENT VSM_ESS_DrvSBR_ACTIVE2IDLE "" UBYTE PubIfStateVSM_MDL_CM_boolean 0 0 0 1 ECU_ADDRESS 0x0040D6CB BIT_MASK 0x01 /end MEASUREMENT
/begin MEASUREMENT VSM_ESS_AEBTrigFlag_ACTIVE2IDLE "" UBYTE PubIfStateVSM_MDL_CM_boolean 0 0 0 1 ECU_ADDRESS 0x0040D6CC BIT_MASK 0x01 /end MEASUREMENT
/begin MEASUREMENT VSM_ESS_VehicleSpd_ACTIVE2IDLE "" UBYTE PubIfStateVSM_MDL_CM_boolean 0 0 0 1 ECU_ADDRESS 0x0040D6CD BIT_MASK 0x01 /end MEASUREMENT
/begin MEASUREMENT VSM_ESS_MasterCylindBrakePress_ACTIVE2IDLE "" UBYTE PubIfStateVSM_MDL_CM_boolean 0 0 0 1 ECU_ADDRESS 0x0040D6CE BIT_MASK 0x01 /end MEASUREMENT
/begin MEASUREMENT VSM_ESS_ACTIVE2IDLE "" UBYTE PubIfStateVSM_MDL_CM_boolean 0 0 0 1 ECU_ADDRESS 0x0040D6CF BIT_MASK 0x01 /end MEASUREMENT
/begin MEASUREMENT VSM_ESS_DPC_L_Active2Ready "" UBYTE PubIfStateVSM_MDL_CM_boolean 0 0 0 1 ECU_ADDRESS 0x0040D6D0 BIT_MASK 0x01 /end MEASUREMENT
/begin MEASUREMENT VSM_ESS_LineA1_Active2Ready "" UBYTE PubIfStateVSM_MDL_CM_boolean 0 0 0 1 ECU_ADDRESS 0x0040D6D1 BIT_MASK 0x01 /end MEASUREMENT
/begin MEASUREMENT VSM_ESS_LineA0_Active2Ready "" UBYTE PubIfStateVSM_MDL_CM_boolean 0 0 0 1 ECU_ADDRESS 0x0040D6D2 BIT_MASK 0x01 /end MEASUREMENT
/begin MEASUREMENT VSM_ESS_DrvOver_Active2Ready_DiffDirc "" UBYTE PubIfStateVSM_MDL_CM_boolean 0 0 0 1 ECU_ADDRESS 0x0040D6D3 BIT_MASK 0x01 /end MEASUREMENT
/begin MEASUREMENT VSM_ESS_DrvOver_Active2Ready_SamDirc "" UBYTE PubIfStateVSM_MDL_CM_boolean 0 0 0 1 ECU_ADDRESS 0x0040D6D4 BIT_MASK 0x01 /end MEASUREMENT
/begin MEASUREMENT VSM_ESS_DrvOver_Active2Ready "" UBYTE PubIfStateVSM_MDL_CM_boolean 0 0 0 1 ECU_ADDRESS 0x0040D6D5 BIT_MASK 0x01 /end MEASUREMENT
/begin MEASUREMENT VSM_ESS_L_Oncoming_Active2Ready "" UBYTE PubIfStateVSM_MDL_CM_boolean 0 0 0 1 ECU_ADDRESS 0x0040D6D6 BIT_MASK 0x01 /end MEASUREMENT
/begin MEASUREMENT VSM_ESS_LValid_Active2Ready "" UBYTE PubIfStateVSM_MDL_CM_boolean 0 0 0 1 ECU_ADDRESS 0x0040D6D7 BIT_MASK 0x01 /end MEASUREMENT
/begin MEASUREMENT VSM_ESS_L_ACTIVE2READY "" UBYTE PubIfStateVSM_MDL_CM_boolean 0 0 0 1 ECU_ADDRESS 0x0040D6D8 BIT_MASK 0x01 /end MEASUREMENT
/begin MEASUREMENT VSM_ESS_DPC_R_Active2Ready "" UBYTE PubIfStateVSM_MDL_CM_boolean 0 0 0 1 ECU_ADDRESS 0x0040D6D9 BIT_MASK 0x01 /end MEASUREMENT
/begin MEASUREMENT VSM_ESS_R_Oncoming_Active2Ready "" UBYTE PubIfStateVSM_MDL_CM_boolean 0 0 0 1 ECU_ADDRESS 0x0040D6DA BIT_MASK 0x01 /end MEASUREMENT
/begin MEASUREMENT VSM_ESS_RValid_Active2Ready "" UBYTE PubIfStateVSM_MDL_CM_boolean 0 0 0 1 ECU_ADDRESS 0x0040D6DB BIT_MASK 0x01 /end MEASUREMENT
/begin MEASUREMENT VSM_ESS_R_ACTIVE2READY "" UBYTE PubIfStateVSM_MDL_CM_boolean 0 0 0 1 ECU_ADDRESS 0x0040D6DC BIT_MASK 0x01 /end MEASUREMENT
/begin MEASUREMENT VSM_ESS_L_SteerWheelSpdSign_Ready2Active "" UBYTE PubIfStateVSM_MDL_CM_boolean 0 0 0 1 ECU_ADDRESS 0x0040D6DD BIT_MASK 0x01 /end MEASUREMENT
/begin MEASUREMENT VSM_ESS_LineLValid_Ready2Active "" UBYTE PubIfStateVSM_MDL_CM_boolean 0 0 0 1 ECU_ADDRESS 0x0040D6DE BIT_MASK 0x01 /end MEASUREMENT
/begin MEASUREMENT VSM_ESS_LeftOncoming_Ready2Active "" UBYTE PubIfStateVSM_MDL_CM_boolean 0 0 0 1 ECU_ADDRESS 0x0040D6DF BIT_MASK 0x01 /end MEASUREMENT
/begin MEASUREMENT VSM_ESS_DangerPlausLeft_Ready2Active "" UBYTE PubIfStateVSM_MDL_CM_boolean 0 0 0 1 ECU_ADDRESS 0x0040D6E0 BIT_MASK 0x01 /end MEASUREMENT
/begin MEASUREMENT VSM_ESS_SteerWheelSpd_READY2ACTIVE "" UBYTE PubIfStateVSM_MDL_CM_boolean 0 0 0 1 ECU_ADDRESS 0x0040D6E1 BIT_MASK 0x01 /end MEASUREMENT
/begin MEASUREMENT VSM_ESS_Left_READY2ACTIVE "" UBYTE PubIfStateVSM_MDL_CM_boolean 0 0 0 1 ECU_ADDRESS 0x0040D6E2 BIT_MASK 0x01 /end MEASUREMENT
/begin MEASUREMENT VSM_ESS_R_SteerWheelSpdSign_Ready2Active "" UBYTE PubIfStateVSM_MDL_CM_boolean 0 0 0 1 ECU_ADDRESS 0x0040D6E3 BIT_MASK 0x01 /end MEASUREMENT
/begin MEASUREMENT VSM_ESS_LineRValid_Ready2Active "" UBYTE PubIfStateVSM_MDL_CM_boolean 0 0 0 1 ECU_ADDRESS 0x0040D6E4 BIT_MASK 0x01 /end MEASUREMENT
/begin MEASUREMENT VSM_ESS_RightOncoming_Ready2Active "" UBYTE PubIfStateVSM_MDL_CM_boolean 0 0 0 1 ECU_ADDRESS 0x0040D6E5 BIT_MASK 0x01 /end MEASUREMENT
/begin MEASUREMENT VSM_ESS_DangerPlausRight_Ready2Active "" UBYTE PubIfStateVSM_MDL_CM_boolean 0 0 0 1 ECU_ADDRESS 0x0040D6E6 BIT_MASK 0x01 /end MEASUREMENT
/begin MEASUREMENT VSM_ESS_Right_READY2ACTIVE "" UBYTE PubIfStateVSM_MDL_CM_boolean 0 0 0 1 ECU_ADDRESS 0x0040D6E7 BIT_MASK 0x01 /end MEASUREMENT
/begin MEASUREMENT VSM_SomeHWASafeStop2ExitConditions_b "" UBYTE PubIfStateVSM_MDL_CM_boolean 0 0 0 1 ECU_ADDRESS 0x0040D6E8 BIT_MASK 0x01 /end MEASUREMENT
/begin MEASUREMENT VSM_HWASlowExitCons_NotHighWayArterialRoad5s "" UBYTE PubIfStateVSM_MDL_CM_boolean 0 0 0 1 ECU_ADDRESS 0x0040D6E9 BIT_MASK 0x01 /end MEASUREMENT
/begin MEASUREMENT VSM_HWASlowExitCons_ACCError "" UBYTE PubIfStateVSM_MDL_CM_boolean 0 0 0 1 ECU_ADDRESS 0x0040D6EA BIT_MASK 0x01 /end MEASUREMENT
/begin MEASUREMENT VSM_HWASlowExitConditions_b "" UBYTE PubIfStateVSM_MDL_CM_boolean 0 0 0 1 ECU_ADDRESS 0x0040D6EB BIT_MASK 0x01 /end MEASUREMENT
/begin MEASUREMENT VSM_LCK_Con_SteerAngleSpd_Active2Ready "" UBYTE PubIfStateVSM_MDL_CM_boolean 0 0 0 1 ECU_ADDRESS 0x0040D6ED BIT_MASK 0x01 /end MEASUREMENT
/begin MEASUREMENT VSM_LCK_Con_OverRide_Active2Ready "" UBYTE PubIfStateVSM_MDL_CM_boolean 0 0 0 1 ECU_ADDRESS 0x0040D6EE BIT_MASK 0x01 /end MEASUREMENT
/begin MEASUREMENT VSM_LCK_Con_SteerWheelAngle_Active2Ready "" UBYTE PubIfStateVSM_MDL_CM_boolean 0 0 0 1 ECU_ADDRESS 0x0040D6EF BIT_MASK 0x01 /end MEASUREMENT
/begin MEASUREMENT VSM_LCK_Con_DriverInput_Active2Ready "" UBYTE PubIfStateVSM_MDL_CM_boolean 0 0 0 1 ECU_ADDRESS 0x0040D6F0 BIT_MASK 0x01 /end MEASUREMENT
/begin MEASUREMENT VSM_LDW_Con_AccPedalRate_Active2Ready "" UBYTE PubIfStateVSM_MDL_CM_boolean 0 0 0 1 ECU_ADDRESS 0x0040D6F1 BIT_MASK 0x01 /end MEASUREMENT
/begin MEASUREMENT VSM_LDW_Con_BrakePressure_Active2Ready "" UBYTE PubIfStateVSM_MDL_CM_boolean 0 0 0 1 ECU_ADDRESS 0x0040D6F2 BIT_MASK 0x01 /end MEASUREMENT
/begin MEASUREMENT VSM_LDW_Con_SteerWheelAngle_Active2Ready "" UBYTE PubIfStateVSM_MDL_CM_boolean 0 0 0 1 ECU_ADDRESS 0x0040D6F3 BIT_MASK 0x01 /end MEASUREMENT
/begin MEASUREMENT VSM_LDW_Con_SteerWheelSpd_Active2Ready "" UBYTE PubIfStateVSM_MDL_CM_boolean 0 0 0 1 ECU_ADDRESS 0x0040D6F4 BIT_MASK 0x01 /end MEASUREMENT
/begin MEASUREMENT VSM_LKA_Con_AccPedalRate_Active2Ready "" UBYTE PubIfStateVSM_MDL_CM_boolean 0 0 0 1 ECU_ADDRESS 0x0040D6F5 BIT_MASK 0x01 /end MEASUREMENT
/begin MEASUREMENT VSM_LKA_Con_BrakePressure_Active2Ready "" UBYTE PubIfStateVSM_MDL_CM_boolean 0 0 0 1 ECU_ADDRESS 0x0040D6F6 BIT_MASK 0x01 /end MEASUREMENT
/begin MEASUREMENT VSM_LKA_Con_SteerWheelAngle_Active2Ready "" UBYTE PubIfStateVSM_MDL_CM_boolean 0 0 0 1 ECU_ADDRESS 0x0040D6F7 BIT_MASK 0x01 /end MEASUREMENT
/begin MEASUREMENT VSM_LKA_Con_DriverInput_Active2Ready "" UBYTE PubIfStateVSM_MDL_CM_boolean 0 0 0 1 ECU_ADDRESS 0x0040D6F8 BIT_MASK 0x01 /end MEASUREMENT
/begin MEASUREMENT VSM_LKA_Con_SteerWheelSpd_Active2Ready "" UBYTE PubIfStateVSM_MDL_CM_boolean 0 0 0 1 ECU_ADDRESS 0x0040D6F9 BIT_MASK 0x01 /end MEASUREMENT
/begin MEASUREMENT VSM_LKA_Con_OverRide_Active2Ready "" UBYTE PubIfStateVSM_MDL_CM_boolean 0 0 0 1 ECU_ADDRESS 0x0040D6FA BIT_MASK 0x01 /end MEASUREMENT
/begin MEASUREMENT VSM_ELK_Con_AccPedalRate_Active2Ready "" UBYTE PubIfStateVSM_MDL_CM_boolean 0 0 0 1 ECU_ADDRESS 0x0040D6FB BIT_MASK 0x01 /end MEASUREMENT
/begin MEASUREMENT VSM_ELK_Con_BrakePressure_Active2Ready "" UBYTE PubIfStateVSM_MDL_CM_boolean 0 0 0 1 ECU_ADDRESS 0x0040D6FC BIT_MASK 0x01 /end MEASUREMENT
/begin MEASUREMENT VSM_ELK_Con_SteerWheelAngle_Active2Ready "" UBYTE PubIfStateVSM_MDL_CM_boolean 0 0 0 1 ECU_ADDRESS 0x0040D6FD BIT_MASK 0x01 /end MEASUREMENT
/begin MEASUREMENT VSM_ELK_Con_SteerWheelSpd_Active2Ready "" UBYTE PubIfStateVSM_MDL_CM_boolean 0 0 0 1 ECU_ADDRESS 0x0040D6FE BIT_MASK 0x01 /end MEASUREMENT
/begin MEASUREMENT VSM_LCK_Con_AccPedalRate_Active2Ready "" UBYTE PubIfStateVSM_MDL_CM_boolean 0 0 0 1 ECU_ADDRESS 0x0040D6FF BIT_MASK 0x01 /end MEASUREMENT
/begin MEASUREMENT VSM_LCK_Con_BrakePress_Active2Ready "" UBYTE PubIfStateVSM_MDL_CM_boolean 0 0 0 1 ECU_ADDRESS 0x0040D700 BIT_MASK 0x01 /end MEASUREMENT
/begin MEASUREMENT VSM_ACC_DrvOffReq "" UBYTE PubIfStateVSM_MDL_CM_boolean 0 0 0 1 ECU_ADDRESS 0x0040D704 BIT_MASK 0x01 /end MEASUREMENT
/begin MEASUREMENT VSM_ELK_Con_YawRate_Idle2Ready "" UBYTE PubIfStateVSM_MDL_CM_boolean 0 0 0 1 ECU_ADDRESS 0x0040D705 BIT_MASK 0x01 /end MEASUREMENT
/begin MEASUREMENT VSM_ELK_Con_AbsEsp_Idle2Ready "" UBYTE PubIfStateVSM_MDL_CM_boolean 0 0 0 1 ECU_ADDRESS 0x0040D706 BIT_MASK 0x01 /end MEASUREMENT
/begin MEASUREMENT VSM_ELK_Con_Headingangel_Idle2Ready "" UBYTE PubIfStateVSM_MDL_CM_boolean 0 0 0 1 ECU_ADDRESS 0x0040D707 BIT_MASK 0x01 /end MEASUREMENT
/begin MEASUREMENT VSM_ELK_Con_Failsafe_Idle2Ready "" UBYTE PubIfStateVSM_MDL_CM_boolean 0 0 0 1 ECU_ADDRESS 0x0040D708 BIT_MASK 0x01 /end MEASUREMENT
/begin MEASUREMENT VSM_ELK_Con_LaneCurve_Idle2Ready "" UBYTE PubIfStateVSM_MDL_CM_boolean 0 0 0 1 ECU_ADDRESS 0x0040D709 BIT_MASK 0x01 /end MEASUREMENT
/begin MEASUREMENT VSM_ELK_Con_VehicleSpeed_Idle2ReadyELK "" UBYTE PubIfStateVSM_MDL_CM_boolean 0 0 0 1 ECU_ADDRESS 0x0040D70A BIT_MASK 0x01 /end MEASUREMENT
/begin MEASUREMENT VSM_ELK_Lane_valid "" UBYTE PubIfStateVSM_MDL_CM_boolean 0 0 0 1 ECU_ADDRESS 0x0040D70B BIT_MASK 0x01 /end MEASUREMENT
/begin MEASUREMENT VSM_ELK_Lwidth_Valid "" UBYTE PubIfStateVSM_MDL_CM_boolean 0 0 0 1 ECU_ADDRESS 0x0040D70C BIT_MASK 0x01 /end MEASUREMENT
/begin MEASUREMENT VSM_ELK_Con_Lane_Idle2Ready "" UBYTE PubIfStateVSM_MDL_CM_boolean 0 0 0 1 ECU_ADDRESS 0x0040D70D BIT_MASK 0x01 /end MEASUREMENT
/begin MEASUREMENT VSM_ELK_Con_ESSSts_Idle2Ready "" UBYTE PubIfStateVSM_MDL_CM_boolean 0 0 0 1 ECU_ADDRESS 0x0040D70E BIT_MASK 0x01 /end MEASUREMENT
/begin MEASUREMENT VSM_ELK_Idle2Ready "" UBYTE PubIfStateVSM_MDL_CM_boolean 0 0 0 1 ECU_ADDRESS 0x0040D70F BIT_MASK 0x01 /end MEASUREMENT
/begin MEASUREMENT VSM_ELK_Con_YawRate_Ready2Idle "" UBYTE PubIfStateVSM_MDL_CM_boolean 0 0 0 1 ECU_ADDRESS 0x0040D710 BIT_MASK 0x01 /end MEASUREMENT
/begin MEASUREMENT VSM_ELK_Con_AbsEsp_Ready2Idle "" UBYTE PubIfStateVSM_MDL_CM_boolean 0 0 0 1 ECU_ADDRESS 0x0040D711 BIT_MASK 0x01 /end MEASUREMENT
/begin MEASUREMENT VSM_ELK_Con_Failsafe_Ready2Idle "" UBYTE PubIfStateVSM_MDL_CM_boolean 0 0 0 1 ECU_ADDRESS 0x0040D712 BIT_MASK 0x01 /end MEASUREMENT
/begin MEASUREMENT VSM_ELK_Con_LaneCurve_Ready2Idle "" UBYTE PubIfStateVSM_MDL_CM_boolean 0 0 0 1 ECU_ADDRESS 0x0040D713 BIT_MASK 0x01 /end MEASUREMENT
/begin MEASUREMENT VSM_ELK_Con_Headingangle_Ready2Idle "" UBYTE PubIfStateVSM_MDL_CM_boolean 0 0 0 1 ECU_ADDRESS 0x0040D714 BIT_MASK 0x01 /end MEASUREMENT
/begin MEASUREMENT VSM_ELK_Con_VehicleSpeed_Ready2Idle "" UBYTE PubIfStateVSM_MDL_CM_boolean 0 0 0 1 ECU_ADDRESS 0x0040D715 BIT_MASK 0x01 /end MEASUREMENT
/begin MEASUREMENT VSM_ELK_Con_Lane_Ready2Idle "" UBYTE PubIfStateVSM_MDL_CM_boolean 0 0 0 1 ECU_ADDRESS 0x0040D716 BIT_MASK 0x01 /end MEASUREMENT
/begin MEASUREMENT VSM_ELK_Con_ESSSts_Ready2Idle "" UBYTE PubIfStateVSM_MDL_CM_boolean 0 0 0 1 ECU_ADDRESS 0x0040D717 BIT_MASK 0x01 /end MEASUREMENT
/begin MEASUREMENT VSM_ELK_Other2Idle "" UBYTE PubIfStateVSM_MDL_CM_boolean 0 0 0 1 ECU_ADDRESS 0x0040D718 BIT_MASK 0x01 /end MEASUREMENT
/begin MEASUREMENT VSM_ELK_Con_SteerWheelAngle_Ready2Active "" UBYTE PubIfStateVSM_MDL_CM_boolean 0 0 0 1 ECU_ADDRESS 0x0040D719 BIT_MASK 0x01 /end MEASUREMENT
/begin MEASUREMENT VSM_ELK_Con_DriverInput_Ready2Active "" UBYTE PubIfStateVSM_MDL_CM_boolean 0 0 0 1 ECU_ADDRESS 0x0040D71A BIT_MASK 0x01 /end MEASUREMENT
/begin MEASUREMENT VSM_ELK_Con_SteerWheelSpd_Ready2Active "" UBYTE PubIfStateVSM_MDL_CM_boolean 0 0 0 1 ECU_ADDRESS 0x0040D71B BIT_MASK 0x01 /end MEASUREMENT
/begin MEASUREMENT VSM_ELK_Con_LateralAcc_Ready2Active "" UBYTE PubIfStateVSM_MDL_CM_boolean 0 0 0 1 ECU_ADDRESS 0x0040D71C BIT_MASK 0x01 /end MEASUREMENT
/begin MEASUREMENT VSM_ELK_Con_LongitudeAcc_Ready2Active "" UBYTE PubIfStateVSM_MDL_CM_boolean 0 0 0 1 ECU_ADDRESS 0x0040D71D BIT_MASK 0x01 /end MEASUREMENT
/begin MEASUREMENT VSM_ELK_Con_BrakePressure_Ready2Active "" UBYTE PubIfStateVSM_MDL_CM_boolean 0 0 0 1 ECU_ADDRESS 0x0040D71E BIT_MASK 0x01 /end MEASUREMENT
/begin MEASUREMENT VSM_ELK_Con_AccPedalRate_Ready2Active "" UBYTE PubIfStateVSM_MDL_CM_boolean 0 0 0 1 ECU_ADDRESS 0x0040D71F BIT_MASK 0x01 /end MEASUREMENT
/begin MEASUREMENT VSM_ELK_Con_EpsSta_Ready2Active "" UBYTE PubIfStateVSM_MDL_CM_boolean 0 0 0 1 ECU_ADDRESS 0x0040D720 BIT_MASK 0x01 /end MEASUREMENT
/begin MEASUREMENT VSM_ELK_Con_CURRENT_GEAR_Ready2Active "" UBYTE PubIfStateVSM_MDL_CM_boolean 0 0 0 1 ECU_ADDRESS 0x0040D721 BIT_MASK 0x01 /end MEASUREMENT
/begin MEASUREMENT VSM_ELK_Con_Override_Ready2Active "" UBYTE PubIfStateVSM_MDL_CM_boolean 0 0 0 1 ECU_ADDRESS 0x0040D722 BIT_MASK 0x01 /end MEASUREMENT
/begin MEASUREMENT VSM_LeftChange_old "" UBYTE PubIfStateVSM_MDL_CM_boolean 0 0 0 1 ECU_ADDRESS 0x0040D723 BIT_MASK 0x01 /end MEASUREMENT
/begin MEASUREMENT VSM_LeftChange_new "" UBYTE PubIfStateVSM_MDL_CM_boolean 0 0 0 1 ECU_ADDRESS 0x0040D724 BIT_MASK 0x01 /end MEASUREMENT
/begin MEASUREMENT VSM_RightChange_old "" UBYTE PubIfStateVSM_MDL_CM_boolean 0 0 0 1 ECU_ADDRESS 0x0040D725 BIT_MASK 0x01 /end MEASUREMENT
/begin MEASUREMENT VSM_RightChange_new "" UBYTE PubIfStateVSM_MDL_CM_boolean 0 0 0 1 ECU_ADDRESS 0x0040D726 BIT_MASK 0x01 /end MEASUREMENT
/begin MEASUREMENT VSM_ELK_Con_LaneChange_Ready2Active "" UBYTE PubIfStateVSM_MDL_CM_boolean 0 0 0 1 ECU_ADDRESS 0x0040D727 BIT_MASK 0x01 /end MEASUREMENT
/begin MEASUREMENT VSM_ELK_Ready2Active "" UBYTE PubIfStateVSM_MDL_CM_boolean 0 0 0 1 ECU_ADDRESS 0x0040D728 BIT_MASK 0x01 /end MEASUREMENT
/begin MEASUREMENT VSM_ELK_Con_DriverInput_Active2Ready "" UBYTE PubIfStateVSM_MDL_CM_boolean 0 0 0 1 ECU_ADDRESS 0x0040D729 BIT_MASK 0x01 /end MEASUREMENT
/begin MEASUREMENT VSM_ELK_Con_LateralAcc_Active2Ready "" UBYTE PubIfStateVSM_MDL_CM_boolean 0 0 0 1 ECU_ADDRESS 0x0040D72A BIT_MASK 0x01 /end MEASUREMENT
/begin MEASUREMENT VSM_ELK_Con_LongitudeAcc_Active2Ready "" UBYTE PubIfStateVSM_MDL_CM_boolean 0 0 0 1 ECU_ADDRESS 0x0040D72B BIT_MASK 0x01 /end MEASUREMENT
/begin MEASUREMENT VSM_ELK_Con_EpsSta_Active2Ready "" UBYTE PubIfStateVSM_MDL_CM_boolean 0 0 0 1 ECU_ADDRESS 0x0040D72C BIT_MASK 0x01 /end MEASUREMENT
/begin MEASUREMENT VSM_ELK_Con_OverRide_Active2Ready "" UBYTE PubIfStateVSM_MDL_CM_boolean 0 0 0 1 ECU_ADDRESS 0x0040D72D BIT_MASK 0x01 /end MEASUREMENT
/begin MEASUREMENT VSM_ELK_Con_CURRENT_GEAR_Active2Ready "" UBYTE PubIfStateVSM_MDL_CM_boolean 0 0 0 1 ECU_ADDRESS 0x0040D72E BIT_MASK 0x01 /end MEASUREMENT
/begin MEASUREMENT VSM_ELK_Con_LaneChange_Active2Ready "" UBYTE PubIfStateVSM_MDL_CM_boolean 0 0 0 1 ECU_ADDRESS 0x0040D72F BIT_MASK 0x01 /end MEASUREMENT
/begin MEASUREMENT VSM_ELK_Active2Ready "" UBYTE PubIfStateVSM_MDL_CM_boolean 0 0 0 1 ECU_ADDRESS 0x0040D730 BIT_MASK 0x01 /end MEASUREMENT
/begin MEASUREMENT VSM_LKA_Con_YawRate_Idle2Ready "" UBYTE PubIfStateVSM_MDL_CM_boolean 0 0 0 1 ECU_ADDRESS 0x0040D731 BIT_MASK 0x01 /end MEASUREMENT
/begin MEASUREMENT VSM_LKA_Con_AbsEsp_Idle2Ready "" UBYTE PubIfStateVSM_MDL_CM_boolean 0 0 0 1 ECU_ADDRESS 0x0040D732 BIT_MASK 0x01 /end MEASUREMENT
/begin MEASUREMENT VSM_LKA_Con_Headingangle_Idle2Ready "" UBYTE PubIfStateVSM_MDL_CM_boolean 0 0 0 1 ECU_ADDRESS 0x0040D733 BIT_MASK 0x01 /end MEASUREMENT
/begin MEASUREMENT VSM_LKA_Con_Failsafe_Idle2Ready "" UBYTE PubIfStateVSM_MDL_CM_boolean 0 0 0 1 ECU_ADDRESS 0x0040D734 BIT_MASK 0x01 /end MEASUREMENT
/begin MEASUREMENT VSM_LKA_Con_ESSSts_Idle2Ready "" UBYTE PubIfStateVSM_MDL_CM_boolean 0 0 0 1 ECU_ADDRESS 0x0040D735 BIT_MASK 0x01 /end MEASUREMENT
/begin MEASUREMENT VSM_LKA_Con_LaneCurve_Idle2Ready "" UBYTE PubIfStateVSM_MDL_CM_boolean 0 0 0 1 ECU_ADDRESS 0x0040D736 BIT_MASK 0x01 /end MEASUREMENT
/begin MEASUREMENT VSM_LKA_Con_Lane_Idle2Ready "" UBYTE PubIfStateVSM_MDL_CM_boolean 0 0 0 1 ECU_ADDRESS 0x0040D737 BIT_MASK 0x01 /end MEASUREMENT
/begin MEASUREMENT VSM_LKA_Con_VehicleSpeed_Idle2Ready "" UBYTE PubIfStateVSM_MDL_CM_boolean 0 0 0 1 ECU_ADDRESS 0x0040D738 BIT_MASK 0x01 /end MEASUREMENT
/begin MEASUREMENT VSM_LKA_Idle2Ready "" UBYTE PubIfStateVSM_MDL_CM_boolean 0 0 0 1 ECU_ADDRESS 0x0040D739 BIT_MASK 0x01 /end MEASUREMENT
/begin MEASUREMENT VSM_LKA_Con_YawRate_Ready2Idle "" UBYTE PubIfStateVSM_MDL_CM_boolean 0 0 0 1 ECU_ADDRESS 0x0040D73A BIT_MASK 0x01 /end MEASUREMENT
/begin MEASUREMENT VSM_LKA_Con_AbsEsp_Ready2Idle "" UBYTE PubIfStateVSM_MDL_CM_boolean 0 0 0 1 ECU_ADDRESS 0x0040D73B BIT_MASK 0x01 /end MEASUREMENT
/begin MEASUREMENT VSM_LKA_Con_Failsafe_Ready2Idle "" UBYTE PubIfStateVSM_MDL_CM_boolean 0 0 0 1 ECU_ADDRESS 0x0040D73C BIT_MASK 0x01 /end MEASUREMENT
/begin MEASUREMENT VSM_LKA_Con_LaneCurve_Ready2Idle "" UBYTE PubIfStateVSM_MDL_CM_boolean 0 0 0 1 ECU_ADDRESS 0x0040D73D BIT_MASK 0x01 /end MEASUREMENT
/begin MEASUREMENT VSM_LKA_Con_Headingangle_Ready2Idle "" UBYTE PubIfStateVSM_MDL_CM_boolean 0 0 0 1 ECU_ADDRESS 0x0040D73E BIT_MASK 0x01 /end MEASUREMENT
/begin MEASUREMENT VSM_LKA_Con_ESSSts_Ready2Idle "" UBYTE PubIfStateVSM_MDL_CM_boolean 0 0 0 1 ECU_ADDRESS 0x0040D73F BIT_MASK 0x01 /end MEASUREMENT
/begin MEASUREMENT VSM_LKA_Con_Lane_Ready2Idle "" UBYTE PubIfStateVSM_MDL_CM_boolean 0 0 0 1 ECU_ADDRESS 0x0040D740 BIT_MASK 0x01 /end MEASUREMENT
/begin MEASUREMENT VSM_LKA_Con_VehicleSpeed_Ready2Idle "" UBYTE PubIfStateVSM_MDL_CM_boolean 0 0 0 1 ECU_ADDRESS 0x0040D741 BIT_MASK 0x01 /end MEASUREMENT
/begin MEASUREMENT VSM_LKA_Other2Idle "" UBYTE PubIfStateVSM_MDL_CM_boolean 0 0 0 1 ECU_ADDRESS 0x0040D742 BIT_MASK 0x01 /end MEASUREMENT
/begin MEASUREMENT VSM_LKA_Con_SteerWheelAngle_Ready2Active "" UBYTE PubIfStateVSM_MDL_CM_boolean 0 0 0 1 ECU_ADDRESS 0x0040D743 BIT_MASK 0x01 /end MEASUREMENT
/begin MEASUREMENT VSM_LKA_Con_DriverInput_Ready2Active "" UBYTE PubIfStateVSM_MDL_CM_boolean 0 0 0 1 ECU_ADDRESS 0x0040D744 BIT_MASK 0x01 /end MEASUREMENT
/begin MEASUREMENT VSM_LKA_Con_SteerWheelSpd_Ready2Active "" UBYTE PubIfStateVSM_MDL_CM_boolean 0 0 0 1 ECU_ADDRESS 0x0040D745 BIT_MASK 0x01 /end MEASUREMENT
/begin MEASUREMENT VSM_LKA_Con_LateralAcc_Ready2Active "" UBYTE PubIfStateVSM_MDL_CM_boolean 0 0 0 1 ECU_ADDRESS 0x0040D746 BIT_MASK 0x01 /end MEASUREMENT
/begin MEASUREMENT VSM_LKA_Con_LongitudeAcc_Ready2Active "" UBYTE PubIfStateVSM_MDL_CM_boolean 0 0 0 1 ECU_ADDRESS 0x0040D747 BIT_MASK 0x01 /end MEASUREMENT
/begin MEASUREMENT VSM_LKA_Con_BrakePressure_Ready2Active "" UBYTE PubIfStateVSM_MDL_CM_boolean 0 0 0 1 ECU_ADDRESS 0x0040D748 BIT_MASK 0x01 /end MEASUREMENT
/begin MEASUREMENT VSM_LKA_Con_AccPedalRate_Ready2Active "" UBYTE PubIfStateVSM_MDL_CM_boolean 0 0 0 1 ECU_ADDRESS 0x0040D749 BIT_MASK 0x01 /end MEASUREMENT
/begin MEASUREMENT VSM_LKA_Con_EpsSta_Ready2Active "" UBYTE PubIfStateVSM_MDL_CM_boolean 0 0 0 1 ECU_ADDRESS 0x0040D74A BIT_MASK 0x01 /end MEASUREMENT
/begin MEASUREMENT VSM_LKA_Con_CURRENT_GEAR_Ready2Active "" UBYTE PubIfStateVSM_MDL_CM_boolean 0 0 0 1 ECU_ADDRESS 0x0040D74B BIT_MASK 0x01 /end MEASUREMENT
/begin MEASUREMENT VSM_LKA_Con_TurnLight_Ready2Active "" UBYTE PubIfStateVSM_MDL_CM_boolean 0 0 0 1 ECU_ADDRESS 0x0040D74C BIT_MASK 0x01 /end MEASUREMENT
/begin MEASUREMENT VSM_LKA_Con_Override_Ready2Active "" UBYTE PubIfStateVSM_MDL_CM_boolean 0 0 0 1 ECU_ADDRESS 0x0040D74D BIT_MASK 0x01 /end MEASUREMENT
/begin MEASUREMENT VSM_LKA_Con_LaneChange_Ready2Active "" UBYTE PubIfStateVSM_MDL_CM_boolean 0 0 0 1 ECU_ADDRESS 0x0040D74E BIT_MASK 0x01 /end MEASUREMENT
/begin MEASUREMENT VSM_LKA_Con_TJASts_Ready2Active "" UBYTE PubIfStateVSM_MDL_CM_boolean 0 0 0 1 ECU_ADDRESS 0x0040D74F BIT_MASK 0x01 /end MEASUREMENT
/begin MEASUREMENT VSM_LKA_Ready2Active "" UBYTE PubIfStateVSM_MDL_CM_boolean 0 0 0 1 ECU_ADDRESS 0x0040D750 BIT_MASK 0x01 /end MEASUREMENT
/begin MEASUREMENT VSM_LKAWarnflag "" UBYTE PubIfStateVSM_MDL_CM_boolean 0 0 0 1 ECU_ADDRESS 0x0040D751 BIT_MASK 0x01 /end MEASUREMENT
/begin MEASUREMENT VSM_LKA_Con_LateralAcc_Active2Ready "" UBYTE PubIfStateVSM_MDL_CM_boolean 0 0 0 1 ECU_ADDRESS 0x0040D752 BIT_MASK 0x01 /end MEASUREMENT
/begin MEASUREMENT VSM_LKA_Con_LongitudeAcc_Active2Ready "" UBYTE PubIfStateVSM_MDL_CM_boolean 0 0 0 1 ECU_ADDRESS 0x0040D753 BIT_MASK 0x01 /end MEASUREMENT
/begin MEASUREMENT VSM_LKA_Con_EpsSta_Active2Ready "" UBYTE PubIfStateVSM_MDL_CM_boolean 0 0 0 1 ECU_ADDRESS 0x0040D754 BIT_MASK 0x01 /end MEASUREMENT
/begin MEASUREMENT VSM_LKA_Con_CURRENT_GEAR_Active2Ready "" UBYTE PubIfStateVSM_MDL_CM_boolean 0 0 0 1 ECU_ADDRESS 0x0040D755 BIT_MASK 0x01 /end MEASUREMENT
/begin MEASUREMENT VSM_LKA_Con_TurnLight_Active2Ready "" UBYTE PubIfStateVSM_MDL_CM_boolean 0 0 0 1 ECU_ADDRESS 0x0040D756 BIT_MASK 0x01 /end MEASUREMENT
/begin MEASUREMENT VSM_LKA_Con_LaneChange_Active2Ready "" UBYTE PubIfStateVSM_MDL_CM_boolean 0 0 0 1 ECU_ADDRESS 0x0040D757 BIT_MASK 0x01 /end MEASUREMENT
/begin MEASUREMENT VSM_LKA_Con_ESSSts_Active2Ready "" UBYTE PubIfStateVSM_MDL_CM_boolean 0 0 0 1 ECU_ADDRESS 0x0040D758 BIT_MASK 0x01 /end MEASUREMENT
/begin MEASUREMENT VSM_LKA_Con_TJASts_Active2Ready "" UBYTE PubIfStateVSM_MDL_CM_boolean 0 0 0 1 ECU_ADDRESS 0x0040D759 BIT_MASK 0x01 /end MEASUREMENT
/begin MEASUREMENT VSM_LKA_Active2Ready "" UBYTE PubIfStateVSM_MDL_CM_boolean 0 0 0 1 ECU_ADDRESS 0x0040D75A BIT_MASK 0x01 /end MEASUREMENT
/begin MEASUREMENT VSM_LKA_End "" UBYTE PubIfStateVSM_MDL_CM_boolean 0 0 0 1 ECU_ADDRESS 0x0040D75B BIT_MASK 0x01 /end MEASUREMENT
/begin MEASUREMENT VSM_LKA_LeftWarning "" UBYTE PubIfStateVSM_MDL_CM_boolean 0 0 0 1 ECU_ADDRESS 0x0040D75C BIT_MASK 0x01 /end MEASUREMENT
/begin MEASUREMENT VSM_LKA_RightWarning "" UBYTE PubIfStateVSM_MDL_CM_boolean 0 0 0 1 ECU_ADDRESS 0x0040D75D BIT_MASK 0x01 /end MEASUREMENT
/begin MEASUREMENT VSM_ELK_OnComing_LOnComing "" UBYTE PubIfStateVSM_MDL_CM_boolean 0 0 0 1 ECU_ADDRESS 0x0040D75E BIT_MASK 0x01 /end MEASUREMENT
/begin MEASUREMENT VSM_ELK_OnComing_Lttc "" UBYTE PubIfStateVSM_MDL_CM_boolean 0 0 0 1 ECU_ADDRESS 0x0040D75F BIT_MASK 0x01 /end MEASUREMENT
/begin MEASUREMENT VSM_ELK_OnComing_ROnComing "" UBYTE PubIfStateVSM_MDL_CM_boolean 0 0 0 1 ECU_ADDRESS 0x0040D760 BIT_MASK 0x01 /end MEASUREMENT
/begin MEASUREMENT VSM_ELK_OnComing_Rttc "" UBYTE PubIfStateVSM_MDL_CM_boolean 0 0 0 1 ECU_ADDRESS 0x0040D761 BIT_MASK 0x01 /end MEASUREMENT
/begin MEASUREMENT VSM_ELK_OnComing_LetfCondition "" UBYTE PubIfStateVSM_MDL_CM_boolean 0 0 0 1 ECU_ADDRESS 0x0040D762 BIT_MASK 0x01 /end MEASUREMENT
/begin MEASUREMENT VSM_ELK_OnComing_RightCondition "" UBYTE PubIfStateVSM_MDL_CM_boolean 0 0 0 1 ECU_ADDRESS 0x0040D763 BIT_MASK 0x01 /end MEASUREMENT
/begin MEASUREMENT VSM_ELK_OverTaking_LLateral "" UBYTE PubIfStateVSM_MDL_CM_boolean 0 0 0 1 ECU_ADDRESS 0x0040D764 BIT_MASK 0x01 /end MEASUREMENT
/begin MEASUREMENT VSM_ELK_OverTaking_RLateral "" UBYTE PubIfStateVSM_MDL_CM_boolean 0 0 0 1 ECU_ADDRESS 0x0040D765 BIT_MASK 0x01 /end MEASUREMENT
/begin MEASUREMENT VSM_ELK_OverTaking_LeftCondition "" UBYTE PubIfStateVSM_MDL_CM_boolean 0 0 0 1 ECU_ADDRESS 0x0040D766 BIT_MASK 0x01 /end MEASUREMENT
/begin MEASUREMENT VSM_ELK_OverTaking_RightCondition "" UBYTE PubIfStateVSM_MDL_CM_boolean 0 0 0 1 ECU_ADDRESS 0x0040D767 BIT_MASK 0x01 /end MEASUREMENT
/begin MEASUREMENT VSM_LCK_Con_ESSSts_Idle2Ready "" UBYTE PubIfStateVSM_MDL_CM_boolean 0 0 0 1 ECU_ADDRESS 0x0040D768 BIT_MASK 0x01 /end MEASUREMENT
/begin MEASUREMENT VSM_LCK_Con_YawRate_Idle2Ready "" UBYTE PubIfStateVSM_MDL_CM_boolean 0 0 0 1 ECU_ADDRESS 0x0040D769 BIT_MASK 0x01 /end MEASUREMENT
/begin MEASUREMENT VSM_LCK_Con_VehicleSpd_Idle2Ready "" UBYTE PubIfStateVSM_MDL_CM_boolean 0 0 0 1 ECU_ADDRESS 0x0040D76A BIT_MASK 0x01 /end MEASUREMENT
/begin MEASUREMENT VSM_LCK_Con_HandsOff_Ready2Idle "" UBYTE PubIfStateVSM_MDL_CM_boolean 0 0 0 1 ECU_ADDRESS 0x0040D76B BIT_MASK 0x01 /end MEASUREMENT
/begin MEASUREMENT VSM_LCK_Con_Handson_Idle2Ready "" UBYTE PubIfStateVSM_MDL_CM_boolean 0 0 0 1 ECU_ADDRESS 0x0040D76C BIT_MASK 0x01 /end MEASUREMENT
/begin MEASUREMENT VSM_LCK_Con_AbsEsp_Idle2Ready "" UBYTE PubIfStateVSM_MDL_CM_boolean 0 0 0 1 ECU_ADDRESS 0x0040D76D BIT_MASK 0x01 /end MEASUREMENT
/begin MEASUREMENT VSM_LCK_Con_ESSSts_Ready2Idle "" UBYTE PubIfStateVSM_MDL_CM_boolean 0 0 0 1 ECU_ADDRESS 0x0040D76E BIT_MASK 0x01 /end MEASUREMENT
/begin MEASUREMENT VSM_LCK_Con_YawRate_Ready2Idle "" UBYTE PubIfStateVSM_MDL_CM_boolean 0 0 0 1 ECU_ADDRESS 0x0040D76F BIT_MASK 0x01 /end MEASUREMENT
/begin MEASUREMENT VSM_LCK_Con_VehicleSpd_Ready2Idle "" UBYTE PubIfStateVSM_MDL_CM_boolean 0 0 0 1 ECU_ADDRESS 0x0040D770 BIT_MASK 0x01 /end MEASUREMENT
/begin MEASUREMENT VSM_LCK_Con_LSMLine_Ready2Idle "" UBYTE PubIfStateVSM_MDL_CM_boolean 0 0 0 1 ECU_ADDRESS 0x0040D771 BIT_MASK 0x01 /end MEASUREMENT
/begin MEASUREMENT VSM_LCK_Con_AbsEsp_Ready2Idle "" UBYTE PubIfStateVSM_MDL_CM_boolean 0 0 0 1 ECU_ADDRESS 0x0040D772 BIT_MASK 0x01 /end MEASUREMENT
/begin MEASUREMENT VSM_LCK_Con_LaneCurve_Ready2Idle "" UBYTE PubIfStateVSM_MDL_CM_boolean 0 0 0 1 ECU_ADDRESS 0x0040D773 BIT_MASK 0x01 /end MEASUREMENT
/begin MEASUREMENT VSM_LCK_Ready2Idle "" UBYTE PubIfStateVSM_MDL_CM_boolean 0 0 0 1 ECU_ADDRESS 0x0040D774 BIT_MASK 0x01 /end MEASUREMENT
/begin MEASUREMENT VSM_LCK_Con_InTime_Idle2Ready "" UBYTE PubIfStateVSM_MDL_CM_boolean 0 0 0 1 ECU_ADDRESS 0x0040D775 BIT_MASK 0x01 /end MEASUREMENT
/begin MEASUREMENT VSM_LCK_Con_LaneCurve_Idle2Ready "" UBYTE PubIfStateVSM_MDL_CM_boolean 0 0 0 1 ECU_ADDRESS 0x0040D776 BIT_MASK 0x01 /end MEASUREMENT
/begin MEASUREMENT VSM_LCK_Con_LSMLine_Idle2Ready "" UBYTE PubIfStateVSM_MDL_CM_boolean 0 0 0 1 ECU_ADDRESS 0x0040D777 BIT_MASK 0x01 /end MEASUREMENT
/begin MEASUREMENT VSM_LCK_Idle2Ready "" UBYTE PubIfStateVSM_MDL_CM_boolean 0 0 0 1 ECU_ADDRESS 0x0040D778 BIT_MASK 0x01 /end MEASUREMENT
/begin MEASUREMENT VSM_LCK_Con_TurnLight_Ready2Active "" UBYTE PubIfStateVSM_MDL_CM_boolean 0 0 0 1 ECU_ADDRESS 0x0040D779 BIT_MASK 0x01 /end MEASUREMENT
/begin MEASUREMENT VSM_LCK_Con_SteerAngleSpd_Ready2Active "" UBYTE PubIfStateVSM_MDL_CM_boolean 0 0 0 1 ECU_ADDRESS 0x0040D77A BIT_MASK 0x01 /end MEASUREMENT
/begin MEASUREMENT VSM_LCK_Con_BrakePress_Ready2Active "" UBYTE PubIfStateVSM_MDL_CM_boolean 0 0 0 1 ECU_ADDRESS 0x0040D77B BIT_MASK 0x01 /end MEASUREMENT
/begin MEASUREMENT VSM_LCK_Con_AccPedalRate_Ready2Active "" UBYTE PubIfStateVSM_MDL_CM_boolean 0 0 0 1 ECU_ADDRESS 0x0040D77C BIT_MASK 0x01 /end MEASUREMENT
/begin MEASUREMENT VSM_LCK_Con_SteerWheelAngle_Ready2Active "" UBYTE PubIfStateVSM_MDL_CM_boolean 0 0 0 1 ECU_ADDRESS 0x0040D77D BIT_MASK 0x01 /end MEASUREMENT
/begin MEASUREMENT VSM_LCK_Con_DrvInputTrqValue_Ready2Active "" UBYTE PubIfStateVSM_MDL_CM_boolean 0 0 0 1 ECU_ADDRESS 0x0040D77E BIT_MASK 0x01 /end MEASUREMENT
/begin MEASUREMENT VSM_LCK_Con_LateralAcc_Ready2Active "" UBYTE PubIfStateVSM_MDL_CM_boolean 0 0 0 1 ECU_ADDRESS 0x0040D77F BIT_MASK 0x01 /end MEASUREMENT
/begin MEASUREMENT VSM_LCK_Con_LongitudeAcc_Ready2Active "" UBYTE PubIfStateVSM_MDL_CM_boolean 0 0 0 1 ECU_ADDRESS 0x0040D780 BIT_MASK 0x01 /end MEASUREMENT
/begin MEASUREMENT VSM_LCK_Con_CURRENT_GEAR_Ready2Active "" UBYTE PubIfStateVSM_MDL_CM_boolean 0 0 0 1 ECU_ADDRESS 0x0040D781 BIT_MASK 0x01 /end MEASUREMENT
/begin MEASUREMENT VSM_LCK_Con_OverRide_Ready2Active "" UBYTE PubIfStateVSM_MDL_CM_boolean 0 0 0 1 ECU_ADDRESS 0x0040D782 BIT_MASK 0x01 /end MEASUREMENT
/begin MEASUREMENT VSM_LCK_Con_EpsSts_Ready2Active "" UBYTE PubIfStateVSM_MDL_CM_boolean 0 0 0 1 ECU_ADDRESS 0x0040D783 BIT_MASK 0x01 /end MEASUREMENT
/begin MEASUREMENT VSM_LCK_Con_LaneChange_Ready2Active "" UBYTE PubIfStateVSM_MDL_CM_boolean 0 0 0 1 ECU_ADDRESS 0x0040D784 BIT_MASK 0x01 /end MEASUREMENT
/begin MEASUREMENT VSM_LCK_Ready2Active "" UBYTE PubIfStateVSM_MDL_CM_boolean 0 0 0 1 ECU_ADDRESS 0x0040D785 BIT_MASK 0x01 /end MEASUREMENT
/begin MEASUREMENT VSM_LCK_Con_TurnLight_Active2Ready "" UBYTE PubIfStateVSM_MDL_CM_boolean 0 0 0 1 ECU_ADDRESS 0x0040D786 BIT_MASK 0x01 /end MEASUREMENT
/begin MEASUREMENT VSM_LCK_Con_EpsSta_Active2Ready "" UBYTE PubIfStateVSM_MDL_CM_boolean 0 0 0 1 ECU_ADDRESS 0x0040D787 BIT_MASK 0x01 /end MEASUREMENT
/begin MEASUREMENT VSM_LCK_Con_LateralAcc_Active2Ready "" UBYTE PubIfStateVSM_MDL_CM_boolean 0 0 0 1 ECU_ADDRESS 0x0040D788 BIT_MASK 0x01 /end MEASUREMENT
/begin MEASUREMENT VSM_LCK_Con_LongitudeAcc_Active2Ready "" UBYTE PubIfStateVSM_MDL_CM_boolean 0 0 0 1 ECU_ADDRESS 0x0040D789 BIT_MASK 0x01 /end MEASUREMENT
/begin MEASUREMENT VSM_LCK_Con_CURRENT_GEAR_Active2Ready "" UBYTE PubIfStateVSM_MDL_CM_boolean 0 0 0 1 ECU_ADDRESS 0x0040D78A BIT_MASK 0x01 /end MEASUREMENT
/begin MEASUREMENT VSM_LCK_Con_LaneChange_Active2Ready "" UBYTE PubIfStateVSM_MDL_CM_boolean 0 0 0 1 ECU_ADDRESS 0x0040D78B BIT_MASK 0x01 /end MEASUREMENT
/begin MEASUREMENT VSM_LCK_Active2Ready "" UBYTE PubIfStateVSM_MDL_CM_boolean 0 0 0 1 ECU_ADDRESS 0x0040D78C BIT_MASK 0x01 /end MEASUREMENT
/begin MEASUREMENT VSM_LCKIE_State_Vehspeed_Idel2Ready "" UBYTE PubIfStateVSM_MDL_CM_boolean 0 0 0 1 ECU_ADDRESS 0x0040D78D BIT_MASK 0x01 /end MEASUREMENT
/begin MEASUREMENT VSM_LCKIE_State_Lanecurve_Idel2Ready "" UBYTE PubIfStateVSM_MDL_CM_boolean 0 0 0 1 ECU_ADDRESS 0x0040D78E BIT_MASK 0x01 /end MEASUREMENT
/begin MEASUREMENT VSM_LCKIE_State_LaneWidth_Idel2Ready "" UBYTE PubIfStateVSM_MDL_CM_boolean 0 0 0 1 ECU_ADDRESS 0x0040D78F BIT_MASK 0x01 /end MEASUREMENT
/begin MEASUREMENT VSM_LCKIE_State_wiper_Idel2Ready "" UBYTE PubIfStateVSM_MDL_CM_boolean 0 0 0 1 ECU_ADDRESS 0x0040D790 BIT_MASK 0x01 /end MEASUREMENT
/begin MEASUREMENT VSM_LCKIE_State_lamb_Idel2Ready "" UBYTE PubIfStateVSM_MDL_CM_boolean 0 0 0 1 ECU_ADDRESS 0x0040D791 BIT_MASK 0x01 /end MEASUREMENT
/begin MEASUREMENT VSM_LCKIE_State_detaspd_Idel2Ready "" UBYTE PubIfStateVSM_MDL_CM_boolean 0 0 0 1 ECU_ADDRESS 0x0040D792 BIT_MASK 0x01 /end MEASUREMENT
/begin MEASUREMENT VSM_LCKIE_State_Idel2Ready "" UBYTE PubIfStateVSM_MDL_CM_boolean 0 0 0 1 ECU_ADDRESS 0x0040D793 BIT_MASK 0x01 /end MEASUREMENT
/begin MEASUREMENT VSM_LCKIE_State_DrvInputTrqValue_Ready2Active "" UBYTE PubIfStateVSM_MDL_CM_boolean 0 0 0 1 ECU_ADDRESS 0x0040D794 BIT_MASK 0x01 /end MEASUREMENT
/begin MEASUREMENT VSM_LCKIE_State_ELKObj_Ready2Active "" UBYTE PubIfStateVSM_MDL_CM_boolean 0 0 0 1 ECU_ADDRESS 0x0040D795 BIT_MASK 0x01 /end MEASUREMENT
/begin MEASUREMENT VSM_LCKIE_State_OppFrontObj_Ready2Active "" UBYTE PubIfStateVSM_MDL_CM_boolean 0 0 0 1 ECU_ADDRESS 0x0040D796 BIT_MASK 0x01 /end MEASUREMENT
/begin MEASUREMENT VSM_LCKIE_State_IEObj_Ready2Active "" UBYTE PubIfStateVSM_MDL_CM_boolean 0 0 0 1 ECU_ADDRESS 0x0040D797 BIT_MASK 0x01 /end MEASUREMENT
/begin MEASUREMENT VSM_LCKIE_State_Ready2Active "" UBYTE PubIfStateVSM_MDL_CM_boolean 0 0 0 1 ECU_ADDRESS 0x0040D798 BIT_MASK 0x01 /end MEASUREMENT
/begin MEASUREMENT VSM_LCKIE_State_Vehspeed_Ready2Idel "" UBYTE PubIfStateVSM_MDL_CM_boolean 0 0 0 1 ECU_ADDRESS 0x0040D799 BIT_MASK 0x01 /end MEASUREMENT
/begin MEASUREMENT VSM_LCKIE_State_Lanecurve_Ready2Idel "" UBYTE PubIfStateVSM_MDL_CM_boolean 0 0 0 1 ECU_ADDRESS 0x0040D79A BIT_MASK 0x01 /end MEASUREMENT
/begin MEASUREMENT VSM_LCKIE_State_LaneWidth_Ready2Idel "" UBYTE PubIfStateVSM_MDL_CM_boolean 0 0 0 1 ECU_ADDRESS 0x0040D79B BIT_MASK 0x01 /end MEASUREMENT
/begin MEASUREMENT VSM_LCKIE_State_wiper_Ready2Idel "" UBYTE PubIfStateVSM_MDL_CM_boolean 0 0 0 1 ECU_ADDRESS 0x0040D79C BIT_MASK 0x01 /end MEASUREMENT
/begin MEASUREMENT VSM_LCKIE_State_lamb_Ready2Idel "" UBYTE PubIfStateVSM_MDL_CM_boolean 0 0 0 1 ECU_ADDRESS 0x0040D79D BIT_MASK 0x01 /end MEASUREMENT
/begin MEASUREMENT VSM_LCKIE_State_detaspd_Ready2Idel "" UBYTE PubIfStateVSM_MDL_CM_boolean 0 0 0 1 ECU_ADDRESS 0x0040D79E BIT_MASK 0x01 /end MEASUREMENT
/begin MEASUREMENT VSM_LCKIE_State_Ready2Idel "" UBYTE PubIfStateVSM_MDL_CM_boolean 0 0 0 1 ECU_ADDRESS 0x0040D79F BIT_MASK 0x01 /end MEASUREMENT
/begin MEASUREMENT VSM_LCKIE_State_DrvInputTrqValue_Active2Ready "" UBYTE PubIfStateVSM_MDL_CM_boolean 0 0 0 1 ECU_ADDRESS 0x0040D7A0 BIT_MASK 0x01 /end MEASUREMENT
/begin MEASUREMENT VSM_LCKIE_State_ELKObj_Active2Ready "" UBYTE PubIfStateVSM_MDL_CM_boolean 0 0 0 1 ECU_ADDRESS 0x0040D7A1 BIT_MASK 0x01 /end MEASUREMENT
/begin MEASUREMENT VSM_LCKIE_State_OppFrontObj_Active2Ready "" UBYTE PubIfStateVSM_MDL_CM_boolean 0 0 0 1 ECU_ADDRESS 0x0040D7A2 BIT_MASK 0x01 /end MEASUREMENT
/begin MEASUREMENT VSM_LCKIE_State_IEObj_Active2Ready "" UBYTE PubIfStateVSM_MDL_CM_boolean 0 0 0 1 ECU_ADDRESS 0x0040D7A3 BIT_MASK 0x01 /end MEASUREMENT
/begin MEASUREMENT VSM_LCKIE_State_Active2Ready "" UBYTE PubIfStateVSM_MDL_CM_boolean 0 0 0 1 ECU_ADDRESS 0x0040D7A4 BIT_MASK 0x01 /end MEASUREMENT
/begin MEASUREMENT VSM_LCKIE_State_HWASts_Ready2Active "" UBYTE PubIfStateVSM_MDL_CM_boolean 0 0 0 1 ECU_ADDRESS 0x0040D7A5 BIT_MASK 0x01 /end MEASUREMENT
/begin MEASUREMENT VSM_LCKIE_State_IFVReady "" UBYTE PubIfStateVSM_MDL_CM_boolean 0 0 0 1 ECU_ADDRESS 0x0040D7A6 BIT_MASK 0x01 /end MEASUREMENT
/begin MEASUREMENT VSM_LCKIE_State_IFVFail "" UBYTE PubIfStateVSM_MDL_CM_boolean 0 0 0 1 ECU_ADDRESS 0x0040D7A7 BIT_MASK 0x01 /end MEASUREMENT
/begin MEASUREMENT VSM_LDW_Con_YawRate_Idle2Ready "" UBYTE PubIfStateVSM_MDL_CM_boolean 0 0 0 1 ECU_ADDRESS 0x0040D7A8 BIT_MASK 0x01 /end MEASUREMENT
/begin MEASUREMENT VSM_LDW_Con_AbsEsp_Idle2Ready "" UBYTE PubIfStateVSM_MDL_CM_boolean 0 0 0 1 ECU_ADDRESS 0x0040D7A9 BIT_MASK 0x01 /end MEASUREMENT
/begin MEASUREMENT VSM_LDW_Con_Headingangle_Idle2Ready "" UBYTE PubIfStateVSM_MDL_CM_boolean 0 0 0 1 ECU_ADDRESS 0x0040D7AA BIT_MASK 0x01 /end MEASUREMENT
/begin MEASUREMENT VSM_LDW_Con_Failsafe_Idle2Ready "" UBYTE PubIfStateVSM_MDL_CM_boolean 0 0 0 1 ECU_ADDRESS 0x0040D7AB BIT_MASK 0x01 /end MEASUREMENT
/begin MEASUREMENT VSM_LDW_Con_LaneCurve_Idle2Ready "" UBYTE PubIfStateVSM_MDL_CM_boolean 0 0 0 1 ECU_ADDRESS 0x0040D7AC BIT_MASK 0x01 /end MEASUREMENT
/begin MEASUREMENT VSM_LDW_Con_Lane_Idle2Ready "" UBYTE PubIfStateVSM_MDL_CM_boolean 0 0 0 1 ECU_ADDRESS 0x0040D7AD BIT_MASK 0x01 /end MEASUREMENT
/begin MEASUREMENT VSM_LDW_Con_VehicleSpeed_Idle2Ready "" UBYTE PubIfStateVSM_MDL_CM_boolean 0 0 0 1 ECU_ADDRESS 0x0040D7AE BIT_MASK 0x01 /end MEASUREMENT
/begin MEASUREMENT VSM_LDW_Con_ESSSts_Idle2Ready "" UBYTE PubIfStateVSM_MDL_CM_boolean 0 0 0 1 ECU_ADDRESS 0x0040D7AF BIT_MASK 0x01 /end MEASUREMENT
/begin MEASUREMENT VSM_LDW_Idle2Ready "" UBYTE PubIfStateVSM_MDL_CM_boolean 0 0 0 1 ECU_ADDRESS 0x0040D7B0 BIT_MASK 0x01 /end MEASUREMENT
/begin MEASUREMENT VSM_LDW_Con_YawRate_Ready2Idle "" UBYTE PubIfStateVSM_MDL_CM_boolean 0 0 0 1 ECU_ADDRESS 0x0040D7B1 BIT_MASK 0x01 /end MEASUREMENT
/begin MEASUREMENT VSM_LDW_Con_AbsEsp_Ready2Idle "" UBYTE PubIfStateVSM_MDL_CM_boolean 0 0 0 1 ECU_ADDRESS 0x0040D7B2 BIT_MASK 0x01 /end MEASUREMENT
/begin MEASUREMENT VSM_LDW_Con_Failsafe_Ready2Idle "" UBYTE PubIfStateVSM_MDL_CM_boolean 0 0 0 1 ECU_ADDRESS 0x0040D7B3 BIT_MASK 0x01 /end MEASUREMENT
/begin MEASUREMENT VSM_LDW_Con_LaneCurve_Ready2Idle "" UBYTE PubIfStateVSM_MDL_CM_boolean 0 0 0 1 ECU_ADDRESS 0x0040D7B4 BIT_MASK 0x01 /end MEASUREMENT
/begin MEASUREMENT VSM_LDW_Con_Headingangle_Ready2Idle "" UBYTE PubIfStateVSM_MDL_CM_boolean 0 0 0 1 ECU_ADDRESS 0x0040D7B5 BIT_MASK 0x01 /end MEASUREMENT
/begin MEASUREMENT VSM_LDW_Con_VehicleSpeed_Ready2Idle "" UBYTE PubIfStateVSM_MDL_CM_boolean 0 0 0 1 ECU_ADDRESS 0x0040D7B6 BIT_MASK 0x01 /end MEASUREMENT
/begin MEASUREMENT VSM_LDW_Con_Lane_Ready2Idle "" UBYTE PubIfStateVSM_MDL_CM_boolean 0 0 0 1 ECU_ADDRESS 0x0040D7B7 BIT_MASK 0x01 /end MEASUREMENT
/begin MEASUREMENT VSM_LDW_Con_ESSSts_Ready2Idle "" UBYTE PubIfStateVSM_MDL_CM_boolean 0 0 0 1 ECU_ADDRESS 0x0040D7B8 BIT_MASK 0x01 /end MEASUREMENT
/begin MEASUREMENT VSM_LDW_Other2Idle "" UBYTE PubIfStateVSM_MDL_CM_boolean 0 0 0 1 ECU_ADDRESS 0x0040D7B9 BIT_MASK 0x01 /end MEASUREMENT
/begin MEASUREMENT VSM_LDW_Con_SteerWheelAngle_Ready2Active "" UBYTE PubIfStateVSM_MDL_CM_boolean 0 0 0 1 ECU_ADDRESS 0x0040D7BA BIT_MASK 0x01 /end MEASUREMENT
/begin MEASUREMENT VSM_LDW_Con_SteerWheelSpd_Ready2Active "" UBYTE PubIfStateVSM_MDL_CM_boolean 0 0 0 1 ECU_ADDRESS 0x0040D7BB BIT_MASK 0x01 /end MEASUREMENT
/begin MEASUREMENT VSM_LDW_Con_LateralAcc_Ready2Active "" UBYTE PubIfStateVSM_MDL_CM_boolean 0 0 0 1 ECU_ADDRESS 0x0040D7BC BIT_MASK 0x01 /end MEASUREMENT
/begin MEASUREMENT VSM_LDW_Con_LongitudeAcc_Ready2Active "" UBYTE PubIfStateVSM_MDL_CM_boolean 0 0 0 1 ECU_ADDRESS 0x0040D7BD BIT_MASK 0x01 /end MEASUREMENT
/begin MEASUREMENT VSM_LDW_Con_BrakePressure_Ready2Active "" UBYTE PubIfStateVSM_MDL_CM_boolean 0 0 0 1 ECU_ADDRESS 0x0040D7BE BIT_MASK 0x01 /end MEASUREMENT
/begin MEASUREMENT VSM_LDW_Con_AccPedalRate_Ready2Active "" UBYTE PubIfStateVSM_MDL_CM_boolean 0 0 0 1 ECU_ADDRESS 0x0040D7BF BIT_MASK 0x01 /end MEASUREMENT
/begin MEASUREMENT VSM_LDW_Con_CURRENT_GEAR_Ready2Active "" UBYTE PubIfStateVSM_MDL_CM_boolean 0 0 0 1 ECU_ADDRESS 0x0040D7C0 BIT_MASK 0x01 /end MEASUREMENT
/begin MEASUREMENT VSM_LDW_Con_TurnLight_Ready2Active "" UBYTE PubIfStateVSM_MDL_CM_boolean 0 0 0 1 ECU_ADDRESS 0x0040D7C1 BIT_MASK 0x01 /end MEASUREMENT
/begin MEASUREMENT VSM_LDW_Con_LaneChange_Ready2Active "" UBYTE PubIfStateVSM_MDL_CM_boolean 0 0 0 1 ECU_ADDRESS 0x0040D7C2 BIT_MASK 0x01 /end MEASUREMENT
/begin MEASUREMENT VSM_LDW_Ready2Active "" UBYTE PubIfStateVSM_MDL_CM_boolean 0 0 0 1 ECU_ADDRESS 0x0040D7C3 BIT_MASK 0x01 /end MEASUREMENT
/begin MEASUREMENT VSM_LDW_Con_CURRENT_GEAR_Active2Ready "" UBYTE PubIfStateVSM_MDL_CM_boolean 0 0 0 1 ECU_ADDRESS 0x0040D7C4 BIT_MASK 0x01 /end MEASUREMENT
/begin MEASUREMENT VSM_LDW_Con_LateralAcc_Active2Ready "" UBYTE PubIfStateVSM_MDL_CM_boolean 0 0 0 1 ECU_ADDRESS 0x0040D7C5 BIT_MASK 0x01 /end MEASUREMENT
/begin MEASUREMENT VSM_LDW_Con_LongitudeAcc_Active2Ready "" UBYTE PubIfStateVSM_MDL_CM_boolean 0 0 0 1 ECU_ADDRESS 0x0040D7C6 BIT_MASK 0x01 /end MEASUREMENT
/begin MEASUREMENT VSM_LDW_Con_LaneChange_Active2Ready "" UBYTE PubIfStateVSM_MDL_CM_boolean 0 0 0 1 ECU_ADDRESS 0x0040D7C7 BIT_MASK 0x01 /end MEASUREMENT
/begin MEASUREMENT VSM_LDW_Con_TurnLight_Active2Ready "" UBYTE PubIfStateVSM_MDL_CM_boolean 0 0 0 1 ECU_ADDRESS 0x0040D7C8 BIT_MASK 0x01 /end MEASUREMENT
/begin MEASUREMENT VSM_LDW_Active2Ready "" UBYTE PubIfStateVSM_MDL_CM_boolean 0 0 0 1 ECU_ADDRESS 0x0040D7C9 BIT_MASK 0x01 /end MEASUREMENT
/begin MEASUREMENT VSM_LCK_TargetLaneIn2 "" UBYTE PubIfStateVSM_MDL_CM_boolean 0 0 0 1 ECU_ADDRESS 0x0040D7CA BIT_MASK 0x01 /end MEASUREMENT
/begin MEASUREMENT VSM_LCK_TargetLaneIn "" UBYTE PubIfStateVSM_MDL_CM_boolean 0 0 0 1 ECU_ADDRESS 0x0040D7CB BIT_MASK 0x01 /end MEASUREMENT
/begin MEASUREMENT VSM_LCK_Con_TJAVehicleSpd_Idle2Ready "" UBYTE PubIfStateVSM_MDL_CM_boolean 0 0 0 1 ECU_ADDRESS 0x0040D7CC BIT_MASK 0x01 /end MEASUREMENT
/begin MEASUREMENT VSM_LCK_Con_TJAVehicleSpd_Ready2Idle "" UBYTE PubIfStateVSM_MDL_CM_boolean 0 0 0 1 ECU_ADDRESS 0x0040D7CD BIT_MASK 0x01 /end MEASUREMENT
/begin MEASUREMENT VSM_LCK_Con_Lane_Idle2Ready "" UBYTE PubIfStateVSM_MDL_CM_boolean 0 0 0 1 ECU_ADDRESS 0x0040D7CE BIT_MASK 0x01 /end MEASUREMENT
/begin MEASUREMENT VSM_LCK_Con_TargetLaneIn_Idle2Ready "" UBYTE PubIfStateVSM_MDL_CM_boolean 0 0 0 1 ECU_ADDRESS 0x0040D7CF BIT_MASK 0x01 /end MEASUREMENT
/begin MEASUREMENT VSM_LCK_TJAReady2Active "" UBYTE PubIfStateVSM_MDL_CM_boolean 0 0 0 1 ECU_ADDRESS 0x0040D7D0 BIT_MASK 0x01 /end MEASUREMENT
/begin MEASUREMENT VSM_LCK_Con_TJALane_Ready2Idle "" UBYTE PubIfStateVSM_MDL_CM_boolean 0 0 0 1 ECU_ADDRESS 0x0040D7D1 BIT_MASK 0x01 /end MEASUREMENT
/begin MEASUREMENT VSM_LCK_Con_Lane_Ready2Idle "" UBYTE PubIfStateVSM_MDL_CM_boolean 0 0 0 1 ECU_ADDRESS 0x0040D7D2 BIT_MASK 0x01 /end MEASUREMENT
/begin MEASUREMENT VSM_LCK_Con_TJALane_Idle2Ready "" UBYTE PubIfStateVSM_MDL_CM_boolean 0 0 0 1 ECU_ADDRESS 0x0040D7D3 BIT_MASK 0x01 /end MEASUREMENT
/begin MEASUREMENT VSM_LCK_TJAIdle2Ready "" UBYTE PubIfStateVSM_MDL_CM_boolean 0 0 0 1 ECU_ADDRESS 0x0040D7D4 BIT_MASK 0x01 /end MEASUREMENT
/begin MEASUREMENT VSM_LCK_TJAReady2Idle "" UBYTE PubIfStateVSM_MDL_CM_boolean 0 0 0 1 ECU_ADDRESS 0x0040D7D5 BIT_MASK 0x01 /end MEASUREMENT
/begin MEASUREMENT VSM_ACCFastExitCons_EngLimpHome "" UBYTE PubIfStateVSM_MDL_CM_boolean 0 0 0 1 ECU_ADDRESS 0x0040D7D6 BIT_MASK 0x01 /end MEASUREMENT
/begin MEASUREMENT VSM_ELK_OverTaking_LOut "" UBYTE PubIfStateVSM_MDL_CM_boolean 0 0 0 1 ECU_ADDRESS 0x0040D7D8 BIT_MASK 0x01 /end MEASUREMENT
/begin MEASUREMENT VSM_ELK_OverTaking_ROut "" UBYTE PubIfStateVSM_MDL_CM_boolean 0 0 0 1 ECU_ADDRESS 0x0040D7D9 BIT_MASK 0x01 /end MEASUREMENT
/begin MEASUREMENT VSM_ELK_OverTaking_rightcar "" UBYTE PubIfStateVSM_MDL_CM_boolean 0 0 0 1 ECU_ADDRESS 0x0040D7DA BIT_MASK 0x01 /end MEASUREMENT
/begin MEASUREMENT VSM_ELK_OverTaking_leftcar "" UBYTE PubIfStateVSM_MDL_CM_boolean 0 0 0 1 ECU_ADDRESS 0x0040D7DB BIT_MASK 0x01 /end MEASUREMENT
/begin MEASUREMENT VSM_ELK_OnComing_LOut "" UBYTE PubIfStateVSM_MDL_CM_boolean 0 0 0 1 ECU_ADDRESS 0x0040D7DC BIT_MASK 0x01 /end MEASUREMENT
/begin MEASUREMENT VSM_ELK_OnComing_ROut "" UBYTE PubIfStateVSM_MDL_CM_boolean 0 0 0 1 ECU_ADDRESS 0x0040D7DD BIT_MASK 0x01 /end MEASUREMENT
/begin MEASUREMENT VSM_ESS_DelayReady "" UBYTE PubIfStateVSM_MDL_CM_boolean 0 0 0 1 ECU_ADDRESS 0x0040D7DF BIT_MASK 0x01 /end MEASUREMENT
/begin MEASUREMENT VSM_HWA_ParkShiftReq "" UBYTE PubIfStateVSM_MDL_CM_boolean 0 0 0 1 ECU_ADDRESS 0x0040D7E0 BIT_MASK 0x01 /end MEASUREMENT
/begin MEASUREMENT VSM_HWAActive "" UBYTE PubIfStateVSM_MDL_CM_boolean 0 0 0 1 ECU_ADDRESS 0x0040D7E1 BIT_MASK 0x01 /end MEASUREMENT
/begin MEASUREMENT VSM_HWASafeStopEn "" UBYTE PubIfStateVSM_MDL_CM_boolean 0 0 0 1 ECU_ADDRESS 0x0040D7E2 BIT_MASK 0x01 /end MEASUREMENT
/begin MEASUREMENT VSM_HWAFastExit_b "" UBYTE PubIfStateVSM_MDL_CM_boolean 0 0 0 1 ECU_ADDRESS 0x0040D7E3 BIT_MASK 0x01 /end MEASUREMENT
/begin MEASUREMENT VSM_HWASlowExit_b "" UBYTE PubIfStateVSM_MDL_CM_boolean 0 0 0 1 ECU_ADDRESS 0x0040D7E4 BIT_MASK 0x01 /end MEASUREMENT
/begin MEASUREMENT VSM_TJASts "" UBYTE PubIfStateVSM_MDL_CM_TJA_STATE 0 0 0 10 ECU_ADDRESS 0x0040D7E5 /end MEASUREMENT
/begin MEASUREMENT VSM_TJALCKState "" UBYTE PubIfStateVSM_MDL_CM_LCK_STATE 0 0 0 7 ECU_ADDRESS 0x0040D7E6 /end MEASUREMENT
/begin MEASUREMENT VSM_HWASts "" UBYTE PubIfStateVSM_MDL_CM_HWA_STATE 0 0 0 12 ECU_ADDRESS 0x0040D7E7 /end MEASUREMENT
/begin COMPU_METHOD PubIfControlLATC_MDL_CM_single_m_s "Q = V" RAT_FUNC "%8.6" "m/s" COEFFS 0 1 0 0 0 1 /end COMPU_METHOD
/begin COMPU_METHOD PubIfControlLATC_MDL_CM_single_m "Q = V" RAT_FUNC "%8.6" "m" COEFFS 0 1 0 0 0 1 /end COMPU_METHOD
/begin COMPU_METHOD PubIfStateVSM_MDL_CM_single "Q = V" RAT_FUNC "%8.6" "" COEFFS 0 1 0 0 0 1 /end COMPU_METHOD
/begin COMPU_METHOD PubIfStateVSM_MDL_CM_double "Q = V" RAT_FUNC "%15.10" "" COEFFS 0 1 0 0 0 1 /end COMPU_METHOD
/begin COMPU_METHOD PubIfStateVSM_MDL_CM_single_m "Q = V" RAT_FUNC "%8.6" "m" COEFFS 0 1 0 0 0 1 /end COMPU_METHOD
/begin COMPU_METHOD PubIfStateVSM_MDL_CM_uint16_s "Q = V" RAT_FUNC "%5.0" "s" COEFFS 0 1 0 0 0 1 /end COMPU_METHOD
/begin COMPU_METHOD PubIfStateVSM_MDL_CM_uint16__S_ "Q = V" RAT_FUNC "%5.0" "<S>" COEFFS 0 1 0 0 0 1 /end COMPU_METHOD
/begin COMPU_METHOD PubIfStateVSM_MDL_CM_uint16_num "Q = V" RAT_FUNC "%5.0" "num" COEFFS 0 1 0 0 0 1 /end COMPU_METHOD
/begin COMPU_METHOD PubIfStateVSM_MDL_CM_uint16 "Q = V" RAT_FUNC "%5.0" "" COEFFS 0 1 0 0 0 1 /end COMPU_METHOD
/begin COMPU_METHOD PubIfStateVSM_MDL_CM_boolean "Q = V" RAT_FUNC "%1.0" "" COEFFS 0 1 0 0 0 1 /end COMPU_METHOD
/begin COMPU_METHOD PubIfStateVSM_MDL_CM_uint8 "Q = V" RAT_FUNC "%3.0" "" COEFFS 0 1 0 0 0 1 /end COMPU_METHOD
/begin COMPU_METHOD PubIfStateVSM_MDL_CM_uint32 "Q = V" RAT_FUNC "%10.0" "" COEFFS 0 1 0 0 0 1 /end COMPU_METHOD
/begin COMPU_METHOD PubIfStateVSM_MDL_CM_TJA_STATE "Enumerated data type: TJA_STATE" TAB_VERB "%10.6" "" COMPU_TAB_REF VTAB_FOR_PubIfStateVSM_MDL_CM_TJA_STATE /end COMPU_METHOD
/begin COMPU_METHOD PubIfStateVSM_MDL_CM_LCK_STATE "Enumerated data type: LCK_STATE" TAB_VERB "%10.6" "" COMPU_TAB_REF VTAB_FOR_PubIfStateVSM_MDL_CM_LCK_STATE /end COMPU_METHOD
/begin COMPU_METHOD PubIfStateVSM_MDL_CM_HWA_STATE "Enumerated data type: HWA_STATE" TAB_VERB "%10.6" "" COMPU_TAB_REF VTAB_FOR_PubIfStateVSM_MDL_CM_HWA_STATE /end COMPU_METHOD
/begin COMPU_VTAB VTAB_FOR_PubIfStateVSM_MDL_CM_TJA_STATE "Enumerated data type: TJA_STATE" TAB_VERB 8 0 "TJA_STATE_TJA_Off" 1 "TJA_STATE_TJA_Idle" 2 "TJA_STATE_TJA_Ready" 3 "TJA_STATE_TJA_Active" 7 "TJA_STATE_TJA_Error" 9 "TJA_STATE_TJA_SafeStop" 6 "TJA_STATE_TJA_Wait" 10 "TJA_STATE_TJA_SlowRetreat" /end COMPU_VTAB
/begin COMPU_VTAB VTAB_FOR_PubIfStateVSM_MDL_CM_LCK_STATE "Enumerated data type: LCK_STATE" TAB_VERB 5 0 "LCK_STATE_LCK_Off" 1 "LCK_STATE_LCK_Idle" 2 "LCK_STATE_LCK_Ready" 3 "LCK_STATE_LCK_Active" 7 "LCK_STATE_LCK_Error" /end COMPU_VTAB
/begin COMPU_VTAB VTAB_FOR_PubIfStateVSM_MDL_CM_HWA_STATE "Enumerated data type: HWA_STATE" TAB_VERB 12 0 "HWA_STATE_HWA_Off" 1 "HWA_STATE_HWA_Idle" 2 "HWA_STATE_HWA_Ready" 3 "HWA_STATE_HWA_CCAct" 4 "HWA_STATE_HWA_Pause" 5 "HWA_STATE_HWA_LeftTurn" 6 "HWA_STATE_HWA_RightTurn" 7 "HWA_STATE_HWA_Error" 9 "HWA_STATE_HWA_SafeStop" 10 "HWA_STATE_HWA_SlowRetreat" 11 "HWA_STATE_HWA_LeftTurnPrepare" 12 "HWA_STATE_HWA_RightTurnPrepare" /end COMPU_VTAB
/begin GROUP S36_ACC_Condotion "PubIfStateVSM_MDL/Subsystem Reference/Subsystem/StateManage/Cruise/Cruise/ACC/Subsystem/ACC_Condotion" /begin SUB_GROUP S38_StandstillNoBrakeForce /end SUB_GROUP
 /begin REF_CHARACTERISTIC P_Global_VehiclePowerType P_VSM_ACCExit_AccOverride P_VSM_ACCExit_StandWaitTime P_VSM_ACC_BOMEntry_ACCDecReqValue P_VSM_ACC_BOMEntry_AxvRefMs2 P_VSM_ACC_BOMExit_ACCDecReqValue /end REF_CHARACTERISTIC
 /begin REF_MEASUREMENT VSM_ACCActCondF VSM_ACCFastExit VSM_ACCFastExitCons_ACCError_Inhibit VSM_ACCFastExitCons_ACCOverride VSM_ACCFastExitCons_AEBTrigger VSM_ACCFastExitCons_APSGuidance VSM_ACCFastExitCons_BrakeDiskOverHeat VSM_ACCFastExitCons_Cancel VSM_ACCFastExitCons_DriveBrakeExit VSM_ACCFastExitCons_DriverDoorOpen VSM_ACCFastExitCons_DriverSBR VSM_ACCFastExitCons_DrivingModExit VSM_ACCFastExitCons_EPBClosed VSM_ACCFastExitCons_EngLimpHome VSM_ACCFastExitCons_EngineOff VSM_ACCFastExitCons_EspOff VSM_ACCFastExitCons_NoForwardGear VSM_ACCFastExitCons_RollingBack VSM_ACCFastExitCons_Standstill3min VSM_ACCFastExitCons_VehSpdExit VSM_ACCSlowExit VSM_ACCSlowExitCons_ABSactive400ms VSM_ACCSlowExitCons_EspActive400ms VSM_ACCSlowExitCons_HDCactive40ms VSM_ACCSlowExitCons_MSRactive800ms VSM_ACCSlowExitCons_TCS1active3000ms VSM_ACCSlowExitCons_TCS2active3000ms VSM_ACC_AccPedalTouch VSM_ACC_BOMExit VSM_ACC_DecReqValue VSM_ACC_DriverBrake VSM_AccOverride VSM_ActiveEnable VSM_DriveBrake VSM_VehicleStandStill /end REF_MEASUREMENT
/end GROUP
/begin GROUP S36_Subsystem "PubIfStateVSM_MDL/Subsystem Reference/Subsystem/StateManage/Cruise/Cruise/ACC/Subsystem/Subsystem"
 /begin REF_CHARACTERISTIC P_VSM_ACC_AutoGoSW P_VSM_ACC_RadarOffset P_VSM_ACC_StandActiveNumACCMode P_VSM_ACC_StandActiveNumHWAMode /end REF_CHARACTERISTIC
 /begin REF_MEASUREMENT VSM_ACCStandActive2Active_DrvrSts VSM_ACCStandActive2Wait_DrvrSts VSM_ACCStandActive2Wait_USS VSM_ACCStandActiveTime VSM_ACC_DrvOfftoSM VSM_ACC_DrvrOff_Disp VSM_ACC_P0DxThrehod VSM_ACC_USSObjDxMin VSM_ACC_USSObjExist /end REF_MEASUREMENT
/end GROUP
/begin GROUP S226_HWA_Condotion "PubIfStateVSM_MDL/Subsystem Reference/Subsystem/StateManage/Cruise/Cruise/HWA/Subsystem/HWA_Condotion"
 /begin REF_CHARACTERISTIC P_VSM_HWAActivation_NOAMOd_Spd P_VSM_HWAActivation_Spd_Low P_VSM_HWAActivation_Spd_Up P_VSM_HWA_EHR_Enable /end REF_CHARACTERISTIC
 /begin REF_MEASUREMENT VSM_HWAFastExit_b VSM_HWANOA_Mode VSM_HWASafeStopEn VSM_HWASlowExitConditions_b VSM_HWASlowExitCons_ACCError VSM_HWASlowExitCons_NotHighWayArterialRoad5s VSM_HWASlowExit_b VSM_HWAWarningLevel VSM_SomeHWASafeStop2ExitConditions_b /end REF_MEASUREMENT
/end GROUP
/begin GROUP S226_HWA_SM "PubIfStateVSM_MDL/Subsystem Reference/Subsystem/StateManage/Cruise/Cruise/HWA/Subsystem/HWA_SM"
 /begin REF_CHARACTERISTIC P_VSM_NOH_PilotSelc_SW P_VSM_NOH_Swt_Req_SW P_VSM_TJA_ActiveWaitNum /end REF_CHARACTERISTIC
 /begin REF_MEASUREMENT VSM_HWAActive VSM_HWASts VSM_HWA_ParkShiftReq VSM_TJASts /end REF_MEASUREMENT
/end GROUP
/begin GROUP S365_Enlong3s "PubIfStateVSM_MDL/Subsystem Reference/Subsystem/StateManage/Cruise/Cruise/LngHMI/Subsystem3/Enlong3s" /begin REF_MEASUREMENT VSM_TJATextDisp /end REF_MEASUREMENT /end GROUP
/begin GROUP S365_Enlong3s1 "PubIfStateVSM_MDL/Subsystem Reference/Subsystem/StateManage/Cruise/Cruise/LngHMI/Subsystem3/Enlong3s1" /begin REF_MEASUREMENT VSM_ACCTextDisp /end REF_MEASUREMENT /end GROUP
/begin GROUP S365_Enlong3s2 "PubIfStateVSM_MDL/Subsystem Reference/Subsystem/StateManage/Cruise/Cruise/LngHMI/Subsystem3/Enlong3s2" /begin REF_MEASUREMENT VSM_HWATextDisp /end REF_MEASUREMENT /end GROUP
/begin GROUP S492_ESS_Condition "PubIfStateVSM_MDL/Subsystem Reference/Subsystem/StateManage/ESS/ESS/Subsystem1/ESS_StateMachine/ESS_Condition"
 /begin REF_CHARACTERISTIC P_VSM_ESS_AEBFlag_enable P_VSM_ESS_AccPedlPosn_Param P_VSM_ESS_AccelPed_enable P_VSM_ESS_DangerPlausLeft P_VSM_ESS_DangerPlausRight P_VSM_ESS_DoorSts_enable P_VSM_ESS_DriveIn P_VSM_ESS_DriveIn_BP P_VSM_ESS_DriverInputTrq_Param P_VSM_ESS_DrvOverTime_Param P_VSM_ESS_DrvSBR_enable P_VSM_ESS_ESPActive_enable P_VSM_ESS_ESPFuncOffSts_enable P_VSM_ESS_FcwDisFlag_enable P_VSM_ESS_FcwSw_enable P_VSM_ESS_HiLoBeam_enable P_VSM_ESS_IPSpeed_kmh P_VSM_ESS_LateralAccel_enable P_VSM_ESS_LgtAccelLower_Param P_VSM_ESS_LgtAccelUpper_Param P_VSM_ESS_MasterCylindBrake P_VSM_ESS_MaxLateral_mss P_VSM_ESS_OVERRIDE_SW P_VSM_ESS_SteerWheelSpd_BP P_VSM_ESS_SteerWheelSpd_Param P_VSM_ESS_SteerWheelSpd_enable P_VSM_ESS_StopA0_Param P_VSM_ESS_StopA1Time_Param P_VSM_ESS_StopA1_Param P_VSM_ESS_TrailerSts_enable P_VSM_ESS_VehLgtAccel_enable P_VSM_ESS_Vehspeed_enable P_VSM_ESS_WiprReq_enable /end REF_CHARACTERISTIC
 /begin REF_MEASUREMENT VSM_ESS_ACTIVE2IDLE VSM_ESS_AEBFlag_READY2ACTIVE VSM_ESS_AEBTrigFlag_ACTIVE2IDLE VSM_ESS_AEBVehFlag_Ready2Active VSM_ESS_AEBVruFlag_Ready2Active VSM_ESS_AccelPed_READY2ACTIVE VSM_ESS_DPC_L_Active2Ready VSM_ESS_DPC_R_Active2Ready VSM_ESS_DangerPlausLeft_Ready2Active VSM_ESS_DangerPlausRight_Ready2Active VSM_ESS_DoorSts_ACTIVE2IDLE VSM_ESS_DoorSts_IDLE2READY VSM_ESS_DoorSts_READY2IDLE VSM_ESS_DrvOver_Active2Ready VSM_ESS_DrvOver_Active2Ready_DiffDirc VSM_ESS_DrvOver_Active2Ready_SamDirc VSM_ESS_DrvSBR_ACTIVE2IDLE VSM_ESS_DrvSBR_IDLE2READY VSM_ESS_DrvSBR_READY2IDLE VSM_ESS_ESPActive_ACTIVE2IDLE VSM_ESS_ESPActive_IDLE2READY VSM_ESS_ESPActive_READY2IDLE VSM_ESS_ESPFuncOffSts_ACTIVE2IDLE VSM_ESS_ESPFuncOffSts_IDLE2READY VSM_ESS_ESPFuncOffSts_READY2IDLE VSM_ESS_FcwDisFlag_Ready2Active VSM_ESS_FcwFlag_READY2ACTIVE VSM_ESS_FcwWarn_Ready2Active VSM_ESS_HiLoBeam_IDLE2READY VSM_ESS_HiLoBeam_READY2IDLE VSM_ESS_IDLE2READY VSM_ESS_LValid_Active2Ready VSM_ESS_L_ACTIVE2READY VSM_ESS_L_Oncoming_Active2Ready VSM_ESS_L_SteerWheelSpdSign_Ready2Active VSM_ESS_LateralAccel_ACTIVE2IDLE VSM_ESS_LateralAccel_IDLE2READY VSM_ESS_LateralAccel_READY2IDLE VSM_ESS_LeftOncoming_Ready2Active VSM_ESS_Left_READY2ACTIVE VSM_ESS_LineA0_Active2Ready VSM_ESS_LineA1_Active2Ready VSM_ESS_LineLValid_Ready2Active VSM_ESS_LineRValid_Ready2Active VSM_ESS_MasterCylindBrakePress_ACTIVE2IDLE VSM_ESS_READY2ACTIVE VSM_ESS_READY2IDLE VSM_ESS_RValid_Active2Ready VSM_ESS_R_ACTIVE2READY VSM_ESS_R_Oncoming_Active2Ready VSM_ESS_R_SteerWheelSpdSign_Ready2Active VSM_ESS_RightOncoming_Ready2Active VSM_ESS_Right_READY2ACTIVE VSM_ESS_SteerWheelSpd_READY2ACTIVE VSM_ESS_TrailerSts_IDLE2READY VSM_ESS_TrailerSts_READY2IDLE VSM_ESS_VehLgtAccel_READY2ACTIVE VSM_ESS_VehicleSpd_ACTIVE2IDLE VSM_ESS_VehicleSpd_IDLE2READY VSM_ESS_VehicleSpd_READY2IDLE VSM_ESS_WiprReq_IDLE2READY VSM_ESS_WiprReq_READY2IDLE /end REF_MEASUREMENT
/end GROUP
/begin GROUP S492_Subsystem "PubIfStateVSM_MDL/Subsystem Reference/Subsystem/StateManage/ESS/ESS/Subsystem1/ESS_StateMachine/Subsystem" /begin REF_CHARACTERISTIC P_VSM_ESS_DelayTime /end REF_CHARACTERISTIC /begin REF_MEASUREMENT VSM_ESS_DelayReady /end REF_MEASUREMENT /end GROUP
/begin GROUP S651_ELK_Condition "PubIfStateVSM_MDL/Subsystem Reference/Subsystem/StateManage/LSS/LCK_LKA_LDW_ELKStateMachine3/ELKState_Machine/ELK/ELK_Condition"
 /begin SUB_GROUP S653_Subsystem S653_Subsystem1 S653_Subsystem10 S653_Subsystem11 S653_Subsystem12 S653_Subsystem15 S653_Subsystem17 S653_Subsystem4 S653_Subsystem5 S653_Subsystem6 S653_Subsystem7 S653_Subsystem8 S653_Subsystem9 /end SUB_GROUP
 /begin REF_CHARACTERISTIC P_VSM_ELK_State_Absesp_enable P_VSM_ELK_State_Accpedalrate_enable P_VSM_ELK_State_Breakpressure_enable P_VSM_ELK_State_DriverInputTrqValue_enable P_VSM_ELK_State_ESSSts_enable P_VSM_ELK_State_Eps_enable P_VSM_ELK_State_Failsafe_enable P_VSM_ELK_State_GEAR_enable P_VSM_ELK_State_Headingangle_enable P_VSM_ELK_State_LaneChange_enable P_VSM_ELK_State_Lane_enable P_VSM_ELK_State_Lanecurve_enable P_VSM_ELK_State_LateralAcce_enable P_VSM_ELK_State_LongitudeAcc_enable P_VSM_ELK_State_Overide_enable P_VSM_ELK_State_SteerWheelAngle_enable P_VSM_ELK_State_SteerWheelSpd_enable P_VSM_ELK_State_Vehspeed_enable P_VSM_ELK_State_Yawsup_enable /end REF_CHARACTERISTIC
 /begin REF_MEASUREMENT VSM_ELK_Active2Ready VSM_ELK_Con_AbsEsp_Idle2Ready VSM_ELK_Con_AbsEsp_Ready2Idle VSM_ELK_Con_AccPedalRate_Active2Ready VSM_ELK_Con_AccPedalRate_Ready2Active VSM_ELK_Con_BrakePressure_Active2Ready VSM_ELK_Con_BrakePressure_Ready2Active VSM_ELK_Con_CURRENT_GEAR_Active2Ready VSM_ELK_Con_CURRENT_GEAR_Ready2Active VSM_ELK_Con_DriverInput_Active2Ready VSM_ELK_Con_DriverInput_Ready2Active VSM_ELK_Con_ESSSts_Idle2Ready VSM_ELK_Con_ESSSts_Ready2Idle VSM_ELK_Con_EpsSta_Active2Ready VSM_ELK_Con_EpsSta_Ready2Active VSM_ELK_Con_Failsafe_Idle2Ready VSM_ELK_Con_Failsafe_Ready2Idle VSM_ELK_Con_Headingangel_Idle2Ready VSM_ELK_Con_Headingangle_Ready2Idle VSM_ELK_Con_LaneChange_Active2Ready VSM_ELK_Con_LaneChange_Ready2Active VSM_ELK_Con_LaneCurve_Idle2Ready VSM_ELK_Con_LaneCurve_Ready2Idle VSM_ELK_Con_Lane_Idle2Ready VSM_ELK_Con_Lane_Ready2Idle VSM_ELK_Con_LateralAcc_Active2Ready VSM_ELK_Con_LateralAcc_Ready2Active VSM_ELK_Con_LongitudeAcc_Active2Ready VSM_ELK_Con_LongitudeAcc_Ready2Active VSM_ELK_Con_OverRide_Active2Ready VSM_ELK_Con_Override_Ready2Active VSM_ELK_Con_SteerWheelAngle_Active2Ready VSM_ELK_Con_SteerWheelAngle_Ready2Active VSM_ELK_Con_SteerWheelSpd_Active2Ready VSM_ELK_Con_SteerWheelSpd_Ready2Active VSM_ELK_Con_VehicleSpeed_Idle2ReadyELK VSM_ELK_Con_VehicleSpeed_Ready2Idle VSM_ELK_Con_YawRate_Idle2Ready VSM_ELK_Con_YawRate_Ready2Idle VSM_ELK_Idle2Ready VSM_ELK_Other2Idle VSM_ELK_Ready2Active /end REF_MEASUREMENT
/end GROUP
/begin GROUP S651_ELK_OnComing_OverTaking "PubIfStateVSM_MDL/Subsystem Reference/Subsystem/StateManage/LSS/LCK_LKA_LDW_ELKStateMachine3/ELKState_Machine/ELK/ELK_OnComing_OverTaking"
 /begin SUB_GROUP S654_OnComing S654_OverTaking S654_Subsystem S654_Subsystem2 S654_Subsystem3 /end SUB_GROUP
 /begin REF_CHARACTERISTIC P_VSM_ELK_Lane_Width_Table P_VSM_ELK_Lane_Width_Table_Calibration P_VSM_ELK_Sensitive_Table P_VSM_ELK_Sensitive_Table_Calibration P_VSM_ELK_State_Param_AngleOffset P_VSM_ELK_State_Param_OnTime P_VSM_ELK_State_Param_Oncoming P_VSM_ELK_State_Param_OutOffset P_VSM_ELK_State_Param_OvTime P_VSM_ELK_State_Param_Over P_VSM_ELK_State_Param_Speed /end REF_CHARACTERISTIC
/end GROUP
/begin GROUP S844_LCK2 "PubIfStateVSM_MDL/Subsystem Reference/Subsystem/StateManage/LSS/LCK_LKA_LDW_ELKStateMachine3/LCK/LCK/LCK2" /begin SUB_GROUP S845_LCK S845_LCK_Condition1 /end SUB_GROUP
 /begin REF_MEASUREMENT VSM_LCKState VSM_LCK_Counter VSM_LCK_VERSION VSM_TJALCKState /end REF_MEASUREMENT
/end GROUP
/begin GROUP S1133_LCKIE_StateMachine "PubIfStateVSM_MDL/Subsystem Reference/Subsystem/StateManage/LSS/LCK_LKA_LDW_ELKStateMachine3/LCKIE/LCKIE/LCKIE_StateMachine" /begin SUB_GROUP S1134_Subsystem S1134_Subsystem1 /end SUB_GROUP /begin REF_CHARACTERISTIC P_VSM_LCKIE_Laneoffset P_VSM_LCKIE_Laneoffset_BP /end REF_CHARACTERISTIC /end GROUP
/begin GROUP S1133_Subsystem1 "PubIfStateVSM_MDL/Subsystem Reference/Subsystem/StateManage/LSS/LCK_LKA_LDW_ELKStateMachine3/LCKIE/LCKIE/Subsystem1" /begin SUB_GROUP S1135_IEStateClc S1135_LCKIE_SignalProcess1 /end SUB_GROUP /end GROUP
/begin GROUP S1225_LDW2 "PubIfStateVSM_MDL/Subsystem Reference/Subsystem/StateManage/LSS/LCK_LKA_LDW_ELKStateMachine3/LDW/LDW/LDW2"
 /begin SUB_GROUP S1226_LDWSignal_calculate S1226_LDW_Condition S1226_LDW_StateMachine /end SUB_GROUP
 /begin REF_CHARACTERISTIC P_VSM_LDW_State_Param_LaneWidth_Offset P_VSM_LDW_State_Param_Sensitive_Offset /end REF_CHARACTERISTIC
 /begin REF_MEASUREMENT VSM_LDWSts VSM_LDW_Counter VSM_LDW_Error VSM_LDW_VERSION /end REF_MEASUREMENT
/end GROUP
/begin GROUP S1354_LKA2 "PubIfStateVSM_MDL/Subsystem Reference/Subsystem/StateManage/LSS/LCK_LKA_LDW_ELKStateMachine3/LKA/LKA/LKA2" /begin SUB_GROUP S1355_LKA S1355_LKA_Condition S1355_LKA_StateMachine /end SUB_GROUP
 /begin REF_CHARACTERISTIC P_VSM_LKA_State_Param_LaneCurve P_VSM_LKA_State_Param_LaneCurve_Offset P_VSM_LKA_State_Param_LaneWidth_Offset P_VSM_LKA_State_Param_Sensitive_Offset /end REF_CHARACTERISTIC
 /begin REF_MEASUREMENT VSM_LKAState VSM_LKA_Counter VSM_LKA_VERSION /end REF_MEASUREMENT
/end GROUP
/begin GROUP S1544_InCondition1 "PubIfStateVSM_MDL/Subsystem Reference/Subsystem/StateManage/LSS/LCK_LKA_LDW_ELKStateMachine3/Signal_calculate/LaneAndRe_SignalProcess/InCondition1" /begin REF_CHARACTERISTIC P_VSM_LSMC_SampleTime /end REF_CHARACTERISTIC /end GROUP
/begin GROUP S1544_LaneRage_Handle "PubIfStateVSM_MDL/Subsystem Reference/Subsystem/StateManage/LSS/LCK_LKA_LDW_ELKStateMachine3/Signal_calculate/LaneAndRe_SignalProcess/LaneRage_Handle" /begin SUB_GROUP S1548_Subsystem4 S1548_Subsystem6 /end SUB_GROUP /begin REF_CHARACTERISTIC P_VSM_LKA_State_Param_Offset /end REF_CHARACTERISTIC
 /begin REF_MEASUREMENT VSM_ERROR_LEFT VSM_ERROR_RIGHT VSM_LCK_LaneCure VSM_LeftChange_new VSM_LeftChange_old VSM_RightChange_new VSM_RightChange_old /end REF_MEASUREMENT
/end GROUP
/begin GROUP S37_Subsystem "PubIfStateVSM_MDL/Subsystem Reference/Subsystem/StateManage/Cruise/Cruise/ACC/Subsystem/ACCTJA_SM/Subsystem" /begin REF_MEASUREMENT VSM_ACC_DrvOffReq /end REF_MEASUREMENT /end GROUP
/begin GROUP S38_StandstillNoBrakeForce "PubIfStateVSM_MDL/Subsystem Reference/Subsystem/StateManage/Cruise/Cruise/ACC/Subsystem/ACC_Condotion/StandstillNoBrakeForce" /begin REF_MEASUREMENT VSM_ACCFastExitCons_StandstillNoBrakeForce /end REF_MEASUREMENT /end GROUP
/begin GROUP S653_Subsystem "PubIfStateVSM_MDL/Subsystem Reference/Subsystem/StateManage/LSS/LCK_LKA_LDW_ELKStateMachine3/ELKState_Machine/ELK/ELK_Condition/Subsystem" /begin REF_CHARACTERISTIC P_VSM_LSMC_SampleTime /end REF_CHARACTERISTIC /end GROUP
/begin GROUP S653_Subsystem1 "PubIfStateVSM_MDL/Subsystem Reference/Subsystem/StateManage/LSS/LCK_LKA_LDW_ELKStateMachine3/ELKState_Machine/ELK/ELK_Condition/Subsystem1" /begin REF_CHARACTERISTIC P_VSM_LSMC_SampleTime /end REF_CHARACTERISTIC /end GROUP
/begin GROUP S653_Subsystem10 "PubIfStateVSM_MDL/Subsystem Reference/Subsystem/StateManage/LSS/LCK_LKA_LDW_ELKStateMachine3/ELKState_Machine/ELK/ELK_Condition/Subsystem10" /begin REF_CHARACTERISTIC P_VSM_LSMC_SampleTime /end REF_CHARACTERISTIC /end GROUP
/begin GROUP S653_Subsystem11 "PubIfStateVSM_MDL/Subsystem Reference/Subsystem/StateManage/LSS/LCK_LKA_LDW_ELKStateMachine3/ELKState_Machine/ELK/ELK_Condition/Subsystem11" /begin REF_CHARACTERISTIC P_VSM_LSMC_SampleTime /end REF_CHARACTERISTIC /end GROUP
/begin GROUP S653_Subsystem12 "PubIfStateVSM_MDL/Subsystem Reference/Subsystem/StateManage/LSS/LCK_LKA_LDW_ELKStateMachine3/ELKState_Machine/ELK/ELK_Condition/Subsystem12" /begin REF_CHARACTERISTIC P_VSM_LSMC_SampleTime /end REF_CHARACTERISTIC /end GROUP
/begin GROUP S653_Subsystem15 "PubIfStateVSM_MDL/Subsystem Reference/Subsystem/StateManage/LSS/LCK_LKA_LDW_ELKStateMachine3/ELKState_Machine/ELK/ELK_Condition/Subsystem15" /begin REF_CHARACTERISTIC P_VSM_LSMC_SampleTime /end REF_CHARACTERISTIC /end GROUP
/begin GROUP S653_Subsystem17 "PubIfStateVSM_MDL/Subsystem Reference/Subsystem/StateManage/LSS/LCK_LKA_LDW_ELKStateMachine3/ELKState_Machine/ELK/ELK_Condition/Subsystem17" /begin REF_CHARACTERISTIC P_VSM_LSMC_SampleTime /end REF_CHARACTERISTIC /end GROUP
/begin GROUP S653_Subsystem4 "PubIfStateVSM_MDL/Subsystem Reference/Subsystem/StateManage/LSS/LCK_LKA_LDW_ELKStateMachine3/ELKState_Machine/ELK/ELK_Condition/Subsystem4" /begin REF_CHARACTERISTIC P_VSM_LSMC_SampleTime /end REF_CHARACTERISTIC /end GROUP
/begin GROUP S653_Subsystem5 "PubIfStateVSM_MDL/Subsystem Reference/Subsystem/StateManage/LSS/LCK_LKA_LDW_ELKStateMachine3/ELKState_Machine/ELK/ELK_Condition/Subsystem5" /begin REF_CHARACTERISTIC P_VSM_LSMC_SampleTime /end REF_CHARACTERISTIC /end GROUP
/begin GROUP S653_Subsystem6 "PubIfStateVSM_MDL/Subsystem Reference/Subsystem/StateManage/LSS/LCK_LKA_LDW_ELKStateMachine3/ELKState_Machine/ELK/ELK_Condition/Subsystem6" /begin REF_CHARACTERISTIC P_VSM_LSMC_SampleTime /end REF_CHARACTERISTIC /end GROUP
/begin GROUP S653_Subsystem7 "PubIfStateVSM_MDL/Subsystem Reference/Subsystem/StateManage/LSS/LCK_LKA_LDW_ELKStateMachine3/ELKState_Machine/ELK/ELK_Condition/Subsystem7" /begin REF_CHARACTERISTIC P_VSM_LSMC_SampleTime /end REF_CHARACTERISTIC /end GROUP
/begin GROUP S653_Subsystem8 "PubIfStateVSM_MDL/Subsystem Reference/Subsystem/StateManage/LSS/LCK_LKA_LDW_ELKStateMachine3/ELKState_Machine/ELK/ELK_Condition/Subsystem8" /begin REF_CHARACTERISTIC P_VSM_LSMC_SampleTime /end REF_CHARACTERISTIC /end GROUP
/begin GROUP S653_Subsystem9 "PubIfStateVSM_MDL/Subsystem Reference/Subsystem/StateManage/LSS/LCK_LKA_LDW_ELKStateMachine3/ELKState_Machine/ELK/ELK_Condition/Subsystem9" /begin REF_CHARACTERISTIC P_VSM_LSMC_SampleTime /end REF_CHARACTERISTIC /end GROUP
/begin GROUP S654_OnComing "PubIfStateVSM_MDL/Subsystem Reference/Subsystem/StateManage/LSS/LCK_LKA_LDW_ELKStateMachine3/ELKState_Machine/ELK/ELK_OnComing_OverTaking/OnComing"
 /begin REF_CHARACTERISTIC P_Global_IEnvironment_RefPX_Front_Bumper P_VSM_ELK_OnComing_Lateral P_VSM_ELK_OnComing_TTC /end REF_CHARACTERISTIC
 /begin REF_MEASUREMENT VSM_ELK_OnComing_LOnComing VSM_ELK_OnComing_LOut VSM_ELK_OnComing_LetfCondition VSM_ELK_OnComing_Llateral VSM_ELK_OnComing_Lttc VSM_ELK_OnComing_Lv_re VSM_ELK_OnComing_ROnComing VSM_ELK_OnComing_ROut VSM_ELK_OnComing_RightCondition VSM_ELK_OnComing_Rlateral VSM_ELK_OnComing_Rttc VSM_ELK_OnComing_Rv_re /end REF_MEASUREMENT
/end GROUP
/begin GROUP S654_OverTaking "PubIfStateVSM_MDL/Subsystem Reference/Subsystem/StateManage/LSS/LCK_LKA_LDW_ELKStateMachine3/ELKState_Machine/ELK/ELK_OnComing_OverTaking/OverTaking"
 /begin REF_CHARACTERISTIC P_Global_IEnvironment_RefPX_Front_Bumper P_Global_Vehicle_Length_m P_VSM_ELK_OverTaking_Lateral P_VSM_ELK_OverTaking_TTC /end REF_CHARACTERISTIC
 /begin REF_MEASUREMENT VSM_ELK_OverTaking_LLateral VSM_ELK_OverTaking_LOut VSM_ELK_OverTaking_LeftCondition VSM_ELK_OverTaking_RLateral VSM_ELK_OverTaking_ROut VSM_ELK_OverTaking_RightCondition VSM_ELK_OverTaking_leftcar VSM_ELK_OverTaking_rightcar /end REF_MEASUREMENT
/end GROUP
/begin GROUP S654_Subsystem "PubIfStateVSM_MDL/Subsystem Reference/Subsystem/StateManage/LSS/LCK_LKA_LDW_ELKStateMachine3/ELKState_Machine/ELK/ELK_OnComing_OverTaking/Subsystem" /begin SUB_GROUP S782_Subsystem1 S782_Subsystem4 S782_Subsystem7 /end SUB_GROUP /begin REF_CHARACTERISTIC P_Global_IEnvironment_RefPX_Front_Bumper /end REF_CHARACTERISTIC /begin REF_MEASUREMENT VSM_ELK_Lane_valid VSM_ELK_Lwidth_Valid /end REF_MEASUREMENT /end GROUP
/begin GROUP S654_Subsystem2 "PubIfStateVSM_MDL/Subsystem Reference/Subsystem/StateManage/LSS/LCK_LKA_LDW_ELKStateMachine3/ELKState_Machine/ELK/ELK_OnComing_OverTaking/Subsystem2" /begin REF_CHARACTERISTIC P_VSM_LSMC_SampleTime /end REF_CHARACTERISTIC /end GROUP
/begin GROUP S654_Subsystem3 "PubIfStateVSM_MDL/Subsystem Reference/Subsystem/StateManage/LSS/LCK_LKA_LDW_ELKStateMachine3/ELKState_Machine/ELK/ELK_OnComing_OverTaking/Subsystem3" /begin REF_CHARACTERISTIC P_VSM_LSMC_SampleTime /end REF_CHARACTERISTIC /end GROUP
/begin GROUP S845_LCK "PubIfStateVSM_MDL/Subsystem Reference/Subsystem/StateManage/LSS/LCK_LKA_LDW_ELKStateMachine3/LCK/LCK/LCK2/LCK" /begin SUB_GROUP S847_Subsystem2 S847_Subsystem3 /end SUB_GROUP
 /begin REF_CHARACTERISTIC P_VSM_LCK_A1 P_VSM_LCK_C0 P_VSM_LCK_Lanewidthswitch P_VSM_LCK_ParamA1 P_VSM_LCK_State_Param_LaneCurve P_VSM_LCK_State_Param_LaneCurve_Offset P_VSM_LCK_State_Param_LaneWidth P_VSM_LCK_State_Param_LaneWidth_Offset P_VSM_LCK_T0 P_VSM_LCK_TargetInSwitch P_VSM_LCK_Warnarea1 P_VSM_LCK_Warnarea2 P_VSM_LCK_dypreFactor /end REF_CHARACTERISTIC
 /begin REF_MEASUREMENT VSM_LCK_LaneCure_Offset VSM_LCK_LaneWidth_offset VSM_LCK_Lanewidth VSM_LCK_TargetLaneIn VSM_LCK_TargetLaneIn2 VSM_LCK_Warning VSM_LCK_d0 VSM_LCK_dy0 VSM_LCK_dypre VSM_LCK_dypreoffset VSM_LCK_preDis /end REF_MEASUREMENT
/end GROUP
/begin GROUP S845_LCK_Condition1 "PubIfStateVSM_MDL/Subsystem Reference/Subsystem/StateManage/LSS/LCK_LKA_LDW_ELKStateMachine3/LCK/LCK/LCK2/LCK_Condition1"
 /begin SUB_GROUP S848_Subsystem1 S848_Subsystem10 S848_Subsystem11 S848_Subsystem12 S848_Subsystem13 S848_Subsystem14 S848_Subsystem15 S848_Subsystem16 S848_Subsystem17 S848_Subsystem18 S848_Subsystem19 S848_Subsystem2 S848_Subsystem20 S848_Subsystem21 S848_Subsystem3 S848_Subsystem4 S848_Subsystem5 S848_Subsystem7 S848_Subsystem8 S848_Subsystem9 /end SUB_GROUP
 /begin REF_CHARACTERISTIC P_VSM_LCK_AbsEspInTime P_VSM_LCK_AccRateIn P_VSM_LCK_AccRateInTime P_VSM_LCK_AccRateOut P_VSM_LCK_AccrPelOut P_VSM_LCK_AccrPelRateOut P_VSM_LCK_BrakePressIn P_VSM_LCK_BrakePressInTime P_VSM_LCK_BrakePressOut P_VSM_LCK_DrvInputTrqValueIn P_VSM_LCK_DrvInputTrqValueInTime P_VSM_LCK_DrvInputTrqValueOut P_VSM_LCK_IdleInTime P_VSM_LCK_LCDrvInputTrqValueOut P_VSM_LCK_LCOverrideTime P_VSM_LCK_LCOverrideValue P_VSM_LCK_LanechangeSwitch P_VSM_LCK_LateralAcceIn P_VSM_LCK_LateralAcceInTime P_VSM_LCK_LateralAcceOut P_VSM_LCK_LongitudeAccIn P_VSM_LCK_LongitudeAccInTime P_VSM_LCK_LongitudeAccOut P_VSM_LCK_OverrideInTime P_VSM_LCK_OverrideTime P_VSM_LCK_OverrideValue P_VSM_LCK_State_Absesp_enable P_VSM_LCK_State_Accpedalrate_enable P_VSM_LCK_State_Breakpressure_enable P_VSM_LCK_State_DriverInputTrqValue_enable P_VSM_LCK_State_ESSSts_enable P_VSM_LCK_State_Eps_enable P_VSM_LCK_State_GEAR_enable P_VSM_LCK_State_Handson_enable P_VSM_LCK_State_IdleInTime_enable P_VSM_LCK_State_LSMLine_enable P_VSM_LCK_State_LaneChange_enable P_VSM_LCK_State_LaneCurve_enable P_VSM_LCK_State_Lane_enable P_VSM_LCK_State_LateralAcce_enable P_VSM_LCK_State_LongitudeAcc_enable P_VSM_LCK_State_Overide_enable P_VSM_LCK_State_SteerWheelAngle_enable P_VSM_LCK_State_SteerWheelSpd_enable P_VSM_LCK_State_TargetLaneIn_enable P_VSM_LCK_State_TurnLight_enable P_VSM_LCK_State_Vehspeed_enable P_VSM_LCK_State_Yawsup_enable P_VSM_LCK_SteerAngleSpdIn P_VSM_LCK_SteerAngleSpdInTime P_VSM_LCK_SteerAngleSpdOut P_VSM_LCK_SteerWheelAngleIn P_VSM_LCK_SteerWheelAngleInTime P_VSM_LCK_SteerWheelAngleOut P_VSM_LCK_YawRateIn P_VSM_LCK_YawRateInTime P_VSM_LCK_YawRateOut P_VSM_LCK_absLongitudeAccIn P_VSM_LCK_absLongitudeAccOut /end REF_CHARACTERISTIC
 /begin REF_MEASUREMENT VSM_LCK_Active2Ready VSM_LCK_Con_AbsEsp_Idle2Ready VSM_LCK_Con_AbsEsp_Ready2Idle VSM_LCK_Con_AccPedalRate_Active2Ready VSM_LCK_Con_AccPedalRate_Ready2Active VSM_LCK_Con_BrakePress_Active2Ready VSM_LCK_Con_BrakePress_Ready2Active VSM_LCK_Con_CURRENT_GEAR_Active2Ready VSM_LCK_Con_CURRENT_GEAR_Ready2Active VSM_LCK_Con_DriverInput_Active2Ready VSM_LCK_Con_DrvInputTrqValue_Ready2Active VSM_LCK_Con_ESSSts_Idle2Ready VSM_LCK_Con_ESSSts_Ready2Idle VSM_LCK_Con_EpsSta_Active2Ready VSM_LCK_Con_EpsSts_Ready2Active VSM_LCK_Con_HandsOff_Ready2Idle VSM_LCK_Con_Handson_Idle2Ready VSM_LCK_Con_InTime_Idle2Ready VSM_LCK_Con_LSMLine_Idle2Ready VSM_LCK_Con_LSMLine_Ready2Idle VSM_LCK_Con_LaneChange_Active2Ready VSM_LCK_Con_LaneChange_Ready2Active VSM_LCK_Con_LaneCurve_Idle2Ready VSM_LCK_Con_LaneCurve_Ready2Idle VSM_LCK_Con_Lane_Idle2Ready VSM_LCK_Con_Lane_Ready2Idle VSM_LCK_Con_LateralAcc_Active2Ready VSM_LCK_Con_LateralAcc_Ready2Active VSM_LCK_Con_LongitudeAcc_Active2Ready VSM_LCK_Con_LongitudeAcc_Ready2Active VSM_LCK_Con_OverRide_Active2Ready VSM_LCK_Con_OverRide_Ready2Active VSM_LCK_Con_SteerAngleSpd_Active2Ready VSM_LCK_Con_SteerAngleSpd_Ready2Active VSM_LCK_Con_SteerWheelAngle_Active2Ready VSM_LCK_Con_SteerWheelAngle_Ready2Active VSM_LCK_Con_TJALane_Idle2Ready VSM_LCK_Con_TJALane_Ready2Idle VSM_LCK_Con_TJAVehicleSpd_Idle2Ready VSM_LCK_Con_TJAVehicleSpd_Ready2Idle VSM_LCK_Con_TargetLaneIn_Idle2Ready VSM_LCK_Con_TurnLight_Active2Ready VSM_LCK_Con_TurnLight_Ready2Active VSM_LCK_Con_VehicleSpd_Idle2Ready VSM_LCK_Con_VehicleSpd_Ready2Idle VSM_LCK_Con_YawRate_Idle2Ready VSM_LCK_Con_YawRate_Ready2Idle VSM_LCK_Idle2Ready VSM_LCK_Ready2Active VSM_LCK_Ready2Idle VSM_LCK_TJAIdle2Ready VSM_LCK_TJAReady2Active VSM_LCK_TJAReady2Idle /end REF_MEASUREMENT
/end GROUP
/begin GROUP S1134_Subsystem "PubIfStateVSM_MDL/Subsystem Reference/Subsystem/StateManage/LSS/LCK_LKA_LDW_ELKStateMachine3/LCKIE/LCKIE/LCKIE_StateMachine/Subsystem" /begin REF_CHARACTERISTIC P_VSM_LCKIE_State_Off2on P_VSM_LCKIE_tcycle /end REF_CHARACTERISTIC /begin REF_MEASUREMENT VSM_LCKIE_DelayReady /end REF_MEASUREMENT /end GROUP
/begin GROUP S1134_Subsystem1 "PubIfStateVSM_MDL/Subsystem Reference/Subsystem/StateManage/LSS/LCK_LKA_LDW_ELKStateMachine3/LCKIE/LCKIE/LCKIE_StateMachine/Subsystem1" /begin REF_MEASUREMENT VSM_LCKIE_Laneoffset /end REF_MEASUREMENT /end GROUP
/begin GROUP S1135_IEStateClc "PubIfStateVSM_MDL/Subsystem Reference/Subsystem/StateManage/LSS/LCK_LKA_LDW_ELKStateMachine3/LCKIE/LCKIE/Subsystem1/IEStateClc" /begin SUB_GROUP S1146_Subsystem1 S1146_Subsystem12 S1146_Subsystem4 /end SUB_GROUP
 /begin REF_CHARACTERISTIC P_VSM_LCKIE_STATE_ORCObjenable P_VSM_LCKIE_State_CurveMax P_VSM_LCKIE_State_CurveMin P_VSM_LCKIE_State_DriverInputTrqValue_enable P_VSM_LCKIE_State_ELKObjClc P_VSM_LCKIE_State_HWASts_disable P_VSM_LCKIE_State_IEObjClc P_VSM_LCKIE_State_IFVReady P_VSM_LCKIE_State_LaneWidth_enable P_VSM_LCKIE_State_Lanecurve_enable P_VSM_LCKIE_State_OppObjClc P_VSM_LCKIE_State_Vehspeed_enable P_VSM_LCKIE_State_detaspd P_VSM_LCKIE_State_detaspd_enable P_VSM_LCKIE_State_lamb_enable P_VSM_LCKIE_State_wiper_enable /end REF_CHARACTERISTIC
 /begin REF_MEASUREMENT VSM_LCKIE_State_Active2Ready VSM_LCKIE_State_DrvInputTrqValue_Active2Ready VSM_LCKIE_State_DrvInputTrqValue_Ready2Active VSM_LCKIE_State_ELKObj_Active2Ready VSM_LCKIE_State_ELKObj_Ready2Active VSM_LCKIE_State_HWASts_Ready2Active VSM_LCKIE_State_IEObj_Active2Ready VSM_LCKIE_State_IEObj_Ready2Active VSM_LCKIE_State_IFVFail VSM_LCKIE_State_IFVReady VSM_LCKIE_State_Idel2Ready VSM_LCKIE_State_LaneWidth_Idel2Ready VSM_LCKIE_State_LaneWidth_Ready2Idel VSM_LCKIE_State_Lanecurve_Idel2Ready VSM_LCKIE_State_Lanecurve_Ready2Idel VSM_LCKIE_State_OppFrontObj_Active2Ready VSM_LCKIE_State_OppFrontObj_Ready2Active VSM_LCKIE_State_Ready2Active VSM_LCKIE_State_Ready2Idel VSM_LCKIE_State_Vehspeed_Idel2Ready VSM_LCKIE_State_Vehspeed_Ready2Idel VSM_LCKIE_State_detaspd_Idel2Ready VSM_LCKIE_State_detaspd_Ready2Idel VSM_LCKIE_State_lamb_Idel2Ready VSM_LCKIE_State_lamb_Ready2Idel VSM_LCKIE_State_wiper_Idel2Ready VSM_LCKIE_State_wiper_Ready2Idel /end REF_MEASUREMENT
/end GROUP
/begin GROUP S1135_LCKIE_SignalProcess1 "PubIfStateVSM_MDL/Subsystem Reference/Subsystem/StateManage/LSS/LCK_LKA_LDW_ELKStateMachine3/LCKIE/LCKIE/Subsystem1/LCKIE_SignalProcess1"
 /begin SUB_GROUP S1147_IE_LATC S1147_IE_Long S1147_IE_OFC S1147_IE_ORC S1147_IE_OS S1147_IE_POC /end SUB_GROUP
/end GROUP
/begin GROUP S1226_LDWSignal_calculate "PubIfStateVSM_MDL/Subsystem Reference/Subsystem/StateManage/LSS/LCK_LKA_LDW_ELKStateMachine3/LDW/LDW/LDW2/LDWSignal_calculate" /begin SUB_GROUP S1228_Subsystem1 S1228_Subsystem4 S1228_Subsystem7 /end SUB_GROUP
 /begin REF_CHARACTERISTIC P_VSM_LDW_State_Param_REWarningZoneIn P_VSM_LDW_State_Param_WarningZoneIn P_VSM_LDW_State_Param_WarningZoneOut /end REF_CHARACTERISTIC
 /begin REF_MEASUREMENT VSM_LDW_Leftwarnflag VSM_LDW_Rightwarnflag /end REF_MEASUREMENT
/end GROUP
/begin GROUP S1226_LDW_Condition "PubIfStateVSM_MDL/Subsystem Reference/Subsystem/StateManage/LSS/LCK_LKA_LDW_ELKStateMachine3/LDW/LDW/LDW2/LDW_Condition"
 /begin SUB_GROUP S1229_Subsystem S1229_Subsystem1 S1229_Subsystem10 S1229_Subsystem17 S1229_Subsystem2 S1229_Subsystem3 S1229_Subsystem4 S1229_Subsystem5 S1229_Subsystem6 S1229_Subsystem7 S1229_Subsystem8 /end SUB_GROUP
 /begin REF_CHARACTERISTIC P_VSM_LDW_AbsEspInTime P_VSM_LDW_AccPedalOut P_VSM_LDW_AccRateIn P_VSM_LDW_AccRateInTime P_VSM_LDW_AccRateOut P_VSM_LDW_BrakePressIn P_VSM_LDW_BrakePressInTime P_VSM_LDW_BrakePressOut P_VSM_LDW_LaneChangeOffset P_VSM_LDW_LaneCurveIn P_VSM_LDW_LaneCurveOut P_VSM_LDW_LateralAcceIn P_VSM_LDW_LateralAcceInTime P_VSM_LDW_LateralAcceOut P_VSM_LDW_LongitudeAccIn P_VSM_LDW_LongitudeAccInTime P_VSM_LDW_LongitudeAccOut P_VSM_LDW_State_Absesp_enable P_VSM_LDW_State_Accpedalrate_enable P_VSM_LDW_State_Breakpressure_enable P_VSM_LDW_State_ESSSts_enable P_VSM_LDW_State_Failsafe_enable P_VSM_LDW_State_GEAR_enable P_VSM_LDW_State_Headingangle_enable P_VSM_LDW_State_LaneChange_enable P_VSM_LDW_State_Lane_enable P_VSM_LDW_State_Lanecurve_enable P_VSM_LDW_State_LateralAcce_enable P_VSM_LDW_State_LongitudeAcc_enable P_VSM_LDW_State_Param_REWarningZoneIn P_VSM_LDW_State_Param_WarningZoneIn P_VSM_LDW_State_SteerWheelAngle_enable P_VSM_LDW_State_SteerWheelSpd_enable P_VSM_LDW_State_TurnLight_enable P_VSM_LDW_State_Vehspeed_enable P_VSM_LDW_State_Yawsup_enable P_VSM_LDW_SteerWheelAngleIn P_VSM_LDW_SteerWheelAngleInTime P_VSM_LDW_SteerWheelAngleOut P_VSM_LDW_SteerWheelSpdIn P_VSM_LDW_SteerWheelSpdInTime P_VSM_LDW_SteerWheelSpdOut P_VSM_LDW_TurnLightInTime P_VSM_LDW_WhelDy P_VSM_LDW_YawRateIn P_VSM_LDW_YawRateInTime P_VSM_LDW_YawRateOut P_VSM_LDW_absLongitudeAccIn P_VSM_LDW_absLongitudeAccOut /end REF_CHARACTERISTIC
 /begin REF_MEASUREMENT VSM_LDW_Active2Ready VSM_LDW_Con_AbsEsp_Idle2Ready VSM_LDW_Con_AbsEsp_Ready2Idle VSM_LDW_Con_AccPedalRate_Active2Ready VSM_LDW_Con_AccPedalRate_Ready2Active VSM_LDW_Con_BrakePressure_Active2Ready VSM_LDW_Con_BrakePressure_Ready2Active VSM_LDW_Con_CURRENT_GEAR_Active2Ready VSM_LDW_Con_CURRENT_GEAR_Ready2Active VSM_LDW_Con_ESSSts_Idle2Ready VSM_LDW_Con_ESSSts_Ready2Idle VSM_LDW_Con_Failsafe_Idle2Ready VSM_LDW_Con_Failsafe_Ready2Idle VSM_LDW_Con_Headingangle_Idle2Ready VSM_LDW_Con_Headingangle_Ready2Idle VSM_LDW_Con_LaneChange_Active2Ready VSM_LDW_Con_LaneChange_Ready2Active VSM_LDW_Con_LaneCurve_Idle2Ready VSM_LDW_Con_LaneCurve_Ready2Idle VSM_LDW_Con_Lane_Idle2Ready VSM_LDW_Con_Lane_Ready2Idle VSM_LDW_Con_LateralAcc_Active2Ready VSM_LDW_Con_LateralAcc_Ready2Active VSM_LDW_Con_LongitudeAcc_Active2Ready VSM_LDW_Con_LongitudeAcc_Ready2Active VSM_LDW_Con_SteerWheelAngle_Active2Ready VSM_LDW_Con_SteerWheelAngle_Ready2Active VSM_LDW_Con_SteerWheelSpd_Active2Ready VSM_LDW_Con_SteerWheelSpd_Ready2Active VSM_LDW_Con_TurnLight_Active2Ready VSM_LDW_Con_TurnLight_Ready2Active VSM_LDW_Con_VehicleSpeed_Idle2Ready VSM_LDW_Con_VehicleSpeed_Ready2Idle VSM_LDW_Con_YawRate_Idle2Ready VSM_LDW_Con_YawRate_Ready2Idle VSM_LDW_Idle2Ready VSM_LDW_Other2Idle VSM_LDW_Ready2Active /end REF_MEASUREMENT
/end GROUP
/begin GROUP S1226_LDW_StateMachine "PubIfStateVSM_MDL/Subsystem Reference/Subsystem/StateManage/LSS/LCK_LKA_LDW_ELKStateMachine3/LDW/LDW/LDW2/LDW_StateMachine" /begin REF_MEASUREMENT VSM_LDW_Count VSM_LDW_wCount /end REF_MEASUREMENT /end GROUP
/begin GROUP S1355_LKA "PubIfStateVSM_MDL/Subsystem Reference/Subsystem/StateManage/LSS/LCK_LKA_LDW_ELKStateMachine3/LKA/LKA/LKA2/LKA"
 /begin SUB_GROUP S1357_Subsystem1 S1357_Subsystem10 S1357_Subsystem2 S1357_Subsystem3 S1357_Subsystem4 S1357_Subsystem7 /end SUB_GROUP
 /begin REF_CHARACTERISTIC P_VSM_LKA_CurveFactor P_VSM_LKA_EndSwitch P_VSM_LKA_State_Param_AngleOffset P_VSM_LKA_State_Param_InterventionZoneIn P_VSM_LKA_State_Param_InterventionZoneOut P_VSM_LKA_State_Param_OutOffset P_VSM_LKA_State_Param_REInterventionZoneIn P_VSM_LKA_WarnInTime P_VSM_LKA_Warnarea1 P_VSM_LKA_Warnarea2 /end REF_CHARACTERISTIC
 /begin REF_MEASUREMENT VSM_LKAWarnflag VSM_LKA_End VSM_LKA_LKAactive VSM_LKA_LKAout VSM_LKA_LeftWarning VSM_LKA_RightWarning /end REF_MEASUREMENT
/end GROUP
/begin GROUP S1355_LKA_Condition "PubIfStateVSM_MDL/Subsystem Reference/Subsystem/StateManage/LSS/LCK_LKA_LDW_ELKStateMachine3/LKA/LKA/LKA2/LKA_Condition"
 /begin SUB_GROUP S1358_Subsystem1 S1358_Subsystem10 S1358_Subsystem12 S1358_Subsystem13 S1358_Subsystem15 S1358_Subsystem18 S1358_Subsystem2 S1358_Subsystem3 S1358_Subsystem4 S1358_Subsystem5 S1358_Subsystem6 S1358_Subsystem7 S1358_Subsystem8 S1358_Subsystem9 /end SUB_GROUP
 /begin REF_CHARACTERISTIC P_VSM_LKA_AbsEspInTime P_VSM_LKA_AccPedalPosnOut P_VSM_LKA_AccPedalRateOutTime P_VSM_LKA_AccRateIn P_VSM_LKA_AccRateInTime P_VSM_LKA_AccRateOut P_VSM_LKA_BrakePressIn P_VSM_LKA_BrakePressInTime P_VSM_LKA_BrakePressOut P_VSM_LKA_DriverInputTrqValueIn P_VSM_LKA_DriverInputTrqValueInTime P_VSM_LKA_DriverInputTrqValueOut P_VSM_LKA_LaneChangeOffset P_VSM_LKA_LaneCurveIn P_VSM_LKA_LaneCurveOut P_VSM_LKA_LateralAcceIn P_VSM_LKA_LateralAcceInTime P_VSM_LKA_LateralAcceOut P_VSM_LKA_LongitudeAcceIn P_VSM_LKA_LongitudeAcceOut P_VSM_LKA_OverrideInTime P_VSM_LKA_OverrideTime P_VSM_LKA_OverrideValue P_VSM_LKA_State_Absesp_enable P_VSM_LKA_State_Accpedalrate_enable P_VSM_LKA_State_Breakpressure_enable P_VSM_LKA_State_DriverInputTrqValue_enable P_VSM_LKA_State_ESSSts_enable P_VSM_LKA_State_Eps_enable P_VSM_LKA_State_Failsafe_enable P_VSM_LKA_State_GEAR_enable P_VSM_LKA_State_Headingangle_enable P_VSM_LKA_State_LaneChange_enable P_VSM_LKA_State_Lane_enable P_VSM_LKA_State_Lanecurve_enable P_VSM_LKA_State_LateralAcce_enable P_VSM_LKA_State_LongitudeAcc_enable P_VSM_LKA_State_Overide_enable P_VSM_LKA_State_Param_InterventionZoneIn P_VSM_LKA_State_Param_REInterventionZoneIn P_VSM_LKA_State_SteerWheelAngle_enable P_VSM_LKA_State_SteerWheelSpd_enable P_VSM_LKA_State_TJASts_enable P_VSM_LKA_State_TurnLight_enable P_VSM_LKA_State_Vehspeed_enable P_VSM_LKA_State_Yawsup_enable P_VSM_LKA_SteerWheelAngleIn P_VSM_LKA_SteerWheelAngleInTime P_VSM_LKA_SteerWheelAngleOut P_VSM_LKA_SteerWheelSpdIn P_VSM_LKA_SteerWheelSpdInTime P_VSM_LKA_SteerWheelSpdOut P_VSM_LKA_TurnLightInTime P_VSM_LKA_WhelDy P_VSM_LKA_YawRateIn P_VSM_LKA_YawRateInTime P_VSM_LKA_YawRateOut P_VSM_LKA_absLongitudeAcceIn P_VSM_LKA_absLongitudeAcceInTime P_VSM_LKA_absLongitudeAcceOut /end REF_CHARACTERISTIC
 /begin REF_MEASUREMENT VSM_LKA_Active2Ready VSM_LKA_Con_AbsEsp_Idle2Ready VSM_LKA_Con_AbsEsp_Ready2Idle VSM_LKA_Con_AccPedalRate_Active2Ready VSM_LKA_Con_AccPedalRate_Ready2Active VSM_LKA_Con_BrakePressure_Active2Ready VSM_LKA_Con_BrakePressure_Ready2Active VSM_LKA_Con_CURRENT_GEAR_Active2Ready VSM_LKA_Con_CURRENT_GEAR_Ready2Active VSM_LKA_Con_DriverInput_Active2Ready VSM_LKA_Con_DriverInput_Ready2Active VSM_LKA_Con_ESSSts_Active2Ready VSM_LKA_Con_ESSSts_Idle2Ready VSM_LKA_Con_ESSSts_Ready2Idle VSM_LKA_Con_EpsSta_Active2Ready VSM_LKA_Con_EpsSta_Ready2Active VSM_LKA_Con_Failsafe_Idle2Ready VSM_LKA_Con_Failsafe_Ready2Idle VSM_LKA_Con_Headingangle_Idle2Ready VSM_LKA_Con_Headingangle_Ready2Idle VSM_LKA_Con_LaneChange_Active2Ready VSM_LKA_Con_LaneChange_Ready2Active VSM_LKA_Con_LaneCurve_Idle2Ready VSM_LKA_Con_LaneCurve_Ready2Idle VSM_LKA_Con_Lane_Idle2Ready VSM_LKA_Con_Lane_Ready2Idle VSM_LKA_Con_LateralAcc_Active2Ready VSM_LKA_Con_LateralAcc_Ready2Active VSM_LKA_Con_LongitudeAcc_Active2Ready VSM_LKA_Con_LongitudeAcc_Ready2Active VSM_LKA_Con_OverRide_Active2Ready VSM_LKA_Con_Override_Ready2Active VSM_LKA_Con_SteerWheelAngle_Active2Ready VSM_LKA_Con_SteerWheelAngle_Ready2Active VSM_LKA_Con_SteerWheelSpd_Active2Ready VSM_LKA_Con_SteerWheelSpd_Ready2Active VSM_LKA_Con_TJASts_Active2Ready VSM_LKA_Con_TJASts_Ready2Active VSM_LKA_Con_TurnLight_Active2Ready VSM_LKA_Con_TurnLight_Ready2Active VSM_LKA_Con_VehicleSpeed_Idle2Ready VSM_LKA_Con_VehicleSpeed_Ready2Idle VSM_LKA_Con_YawRate_Idle2Ready VSM_LKA_Con_YawRate_Ready2Idle VSM_LKA_Idle2Ready VSM_LKA_Other2Idle VSM_LKA_Ready2Active /end REF_MEASUREMENT
/end GROUP
/begin GROUP S1355_LKA_StateMachine "PubIfStateVSM_MDL/Subsystem Reference/Subsystem/StateManage/LSS/LCK_LKA_LDW_ELKStateMachine3/LKA/LKA/LKA2/LKA_StateMachine" /begin REF_MEASUREMENT VSM_LKA_Error VSM_LKA_Warning /end REF_MEASUREMENT /end GROUP
/begin GROUP S1548_Subsystem4 "PubIfStateVSM_MDL/Subsystem Reference/Subsystem/StateManage/LSS/LCK_LKA_LDW_ELKStateMachine3/Signal_calculate/LaneAndRe_SignalProcess/LaneRage_Handle/Subsystem4" /begin REF_CHARACTERISTIC P_VSM_LSMC_SampleTime /end REF_CHARACTERISTIC /end GROUP
/begin GROUP S1548_Subsystem6 "PubIfStateVSM_MDL/Subsystem Reference/Subsystem/StateManage/LSS/LCK_LKA_LDW_ELKStateMachine3/Signal_calculate/LaneAndRe_SignalProcess/LaneRage_Handle/Subsystem6" /begin REF_CHARACTERISTIC P_VSM_LSMC_SampleTime /end REF_CHARACTERISTIC /end GROUP
/begin GROUP S782_Subsystem1 "PubIfStateVSM_MDL/Subsystem Reference/Subsystem/StateManage/LSS/LCK_LKA_LDW_ELKStateMachine3/ELKState_Machine/ELK/ELK_OnComing_OverTaking/Subsystem/Subsystem1" /begin REF_CHARACTERISTIC P_VSM_LSMC_SampleTime /end REF_CHARACTERISTIC /end GROUP
/begin GROUP S782_Subsystem4 "PubIfStateVSM_MDL/Subsystem Reference/Subsystem/StateManage/LSS/LCK_LKA_LDW_ELKStateMachine3/ELKState_Machine/ELK/ELK_OnComing_OverTaking/Subsystem/Subsystem4" /begin REF_CHARACTERISTIC P_VSM_LSMC_SampleTime /end REF_CHARACTERISTIC /end GROUP
/begin GROUP S782_Subsystem7 "PubIfStateVSM_MDL/Subsystem Reference/Subsystem/StateManage/LSS/LCK_LKA_LDW_ELKStateMachine3/ELKState_Machine/ELK/ELK_OnComing_OverTaking/Subsystem/Subsystem7" /begin REF_CHARACTERISTIC P_VSM_LSMC_SampleTime /end REF_CHARACTERISTIC /end GROUP
/begin GROUP S847_Subsystem2 "PubIfStateVSM_MDL/Subsystem Reference/Subsystem/StateManage/LSS/LCK_LKA_LDW_ELKStateMachine3/LCK/LCK/LCK2/LCK/Subsystem2" /begin REF_CHARACTERISTIC P_VSM_LSMC_SampleTime /end REF_CHARACTERISTIC /end GROUP
/begin GROUP S847_Subsystem3 "PubIfStateVSM_MDL/Subsystem Reference/Subsystem/StateManage/LSS/LCK_LKA_LDW_ELKStateMachine3/LCK/LCK/LCK2/LCK/Subsystem3" /begin REF_CHARACTERISTIC P_VSM_LSMC_SampleTime /end REF_CHARACTERISTIC /end GROUP
/begin GROUP S848_Subsystem1 "PubIfStateVSM_MDL/Subsystem Reference/Subsystem/StateManage/LSS/LCK_LKA_LDW_ELKStateMachine3/LCK/LCK/LCK2/LCK_Condition1/Subsystem1" /begin REF_CHARACTERISTIC P_VSM_LSMC_SampleTime /end REF_CHARACTERISTIC /end GROUP
/begin GROUP S848_Subsystem10 "PubIfStateVSM_MDL/Subsystem Reference/Subsystem/StateManage/LSS/LCK_LKA_LDW_ELKStateMachine3/LCK/LCK/LCK2/LCK_Condition1/Subsystem10" /begin REF_CHARACTERISTIC P_VSM_LSMC_SampleTime /end REF_CHARACTERISTIC /end GROUP
/begin GROUP S848_Subsystem11 "PubIfStateVSM_MDL/Subsystem Reference/Subsystem/StateManage/LSS/LCK_LKA_LDW_ELKStateMachine3/LCK/LCK/LCK2/LCK_Condition1/Subsystem11" /begin REF_CHARACTERISTIC P_VSM_LSMC_SampleTime /end REF_CHARACTERISTIC /end GROUP
/begin GROUP S848_Subsystem12 "PubIfStateVSM_MDL/Subsystem Reference/Subsystem/StateManage/LSS/LCK_LKA_LDW_ELKStateMachine3/LCK/LCK/LCK2/LCK_Condition1/Subsystem12" /begin REF_CHARACTERISTIC P_VSM_LSMC_SampleTime /end REF_CHARACTERISTIC /end GROUP
/begin GROUP S848_Subsystem13 "PubIfStateVSM_MDL/Subsystem Reference/Subsystem/StateManage/LSS/LCK_LKA_LDW_ELKStateMachine3/LCK/LCK/LCK2/LCK_Condition1/Subsystem13" /begin REF_CHARACTERISTIC P_VSM_LSMC_SampleTime /end REF_CHARACTERISTIC /end GROUP
/begin GROUP S848_Subsystem14 "PubIfStateVSM_MDL/Subsystem Reference/Subsystem/StateManage/LSS/LCK_LKA_LDW_ELKStateMachine3/LCK/LCK/LCK2/LCK_Condition1/Subsystem14" /begin REF_CHARACTERISTIC P_VSM_LSMC_SampleTime /end REF_CHARACTERISTIC /end GROUP
/begin GROUP S848_Subsystem15 "PubIfStateVSM_MDL/Subsystem Reference/Subsystem/StateManage/LSS/LCK_LKA_LDW_ELKStateMachine3/LCK/LCK/LCK2/LCK_Condition1/Subsystem15" /begin REF_CHARACTERISTIC P_VSM_LSMC_SampleTime /end REF_CHARACTERISTIC /end GROUP
/begin GROUP S848_Subsystem16 "PubIfStateVSM_MDL/Subsystem Reference/Subsystem/StateManage/LSS/LCK_LKA_LDW_ELKStateMachine3/LCK/LCK/LCK2/LCK_Condition1/Subsystem16" /begin REF_CHARACTERISTIC P_VSM_LSMC_SampleTime /end REF_CHARACTERISTIC /end GROUP
/begin GROUP S848_Subsystem17 "PubIfStateVSM_MDL/Subsystem Reference/Subsystem/StateManage/LSS/LCK_LKA_LDW_ELKStateMachine3/LCK/LCK/LCK2/LCK_Condition1/Subsystem17" /begin REF_CHARACTERISTIC P_VSM_LSMC_SampleTime /end REF_CHARACTERISTIC /end GROUP
/begin GROUP S848_Subsystem18 "PubIfStateVSM_MDL/Subsystem Reference/Subsystem/StateManage/LSS/LCK_LKA_LDW_ELKStateMachine3/LCK/LCK/LCK2/LCK_Condition1/Subsystem18" /begin REF_CHARACTERISTIC P_VSM_LSMC_SampleTime /end REF_CHARACTERISTIC /end GROUP
/begin GROUP S848_Subsystem19 "PubIfStateVSM_MDL/Subsystem Reference/Subsystem/StateManage/LSS/LCK_LKA_LDW_ELKStateMachine3/LCK/LCK/LCK2/LCK_Condition1/Subsystem19" /begin REF_CHARACTERISTIC P_VSM_LSMC_SampleTime /end REF_CHARACTERISTIC /end GROUP
/begin GROUP S848_Subsystem2 "PubIfStateVSM_MDL/Subsystem Reference/Subsystem/StateManage/LSS/LCK_LKA_LDW_ELKStateMachine3/LCK/LCK/LCK2/LCK_Condition1/Subsystem2" /begin REF_CHARACTERISTIC P_VSM_LSMC_SampleTime /end REF_CHARACTERISTIC /end GROUP
/begin GROUP S848_Subsystem20 "PubIfStateVSM_MDL/Subsystem Reference/Subsystem/StateManage/LSS/LCK_LKA_LDW_ELKStateMachine3/LCK/LCK/LCK2/LCK_Condition1/Subsystem20" /begin REF_CHARACTERISTIC P_VSM_LSMC_SampleTime /end REF_CHARACTERISTIC /end GROUP
/begin GROUP S848_Subsystem21 "PubIfStateVSM_MDL/Subsystem Reference/Subsystem/StateManage/LSS/LCK_LKA_LDW_ELKStateMachine3/LCK/LCK/LCK2/LCK_Condition1/Subsystem21" /begin REF_CHARACTERISTIC P_VSM_LSMC_SampleTime /end REF_CHARACTERISTIC /end GROUP
/begin GROUP S848_Subsystem3 "PubIfStateVSM_MDL/Subsystem Reference/Subsystem/StateManage/LSS/LCK_LKA_LDW_ELKStateMachine3/LCK/LCK/LCK2/LCK_Condition1/Subsystem3" /begin REF_CHARACTERISTIC P_VSM_LSMC_SampleTime /end REF_CHARACTERISTIC /end GROUP
/begin GROUP S848_Subsystem4 "PubIfStateVSM_MDL/Subsystem Reference/Subsystem/StateManage/LSS/LCK_LKA_LDW_ELKStateMachine3/LCK/LCK/LCK2/LCK_Condition1/Subsystem4" /begin REF_CHARACTERISTIC P_VSM_LSMC_SampleTime /end REF_CHARACTERISTIC /end GROUP
/begin GROUP S848_Subsystem5 "PubIfStateVSM_MDL/Subsystem Reference/Subsystem/StateManage/LSS/LCK_LKA_LDW_ELKStateMachine3/LCK/LCK/LCK2/LCK_Condition1/Subsystem5" /begin REF_CHARACTERISTIC P_VSM_LSMC_SampleTime /end REF_CHARACTERISTIC /end GROUP
/begin GROUP S848_Subsystem7 "PubIfStateVSM_MDL/Subsystem Reference/Subsystem/StateManage/LSS/LCK_LKA_LDW_ELKStateMachine3/LCK/LCK/LCK2/LCK_Condition1/Subsystem7" /begin REF_CHARACTERISTIC P_VSM_LSMC_SampleTime /end REF_CHARACTERISTIC /end GROUP
/begin GROUP S848_Subsystem8 "PubIfStateVSM_MDL/Subsystem Reference/Subsystem/StateManage/LSS/LCK_LKA_LDW_ELKStateMachine3/LCK/LCK/LCK2/LCK_Condition1/Subsystem8" /begin REF_CHARACTERISTIC P_VSM_LSMC_SampleTime /end REF_CHARACTERISTIC /end GROUP
/begin GROUP S848_Subsystem9 "PubIfStateVSM_MDL/Subsystem Reference/Subsystem/StateManage/LSS/LCK_LKA_LDW_ELKStateMachine3/LCK/LCK/LCK2/LCK_Condition1/Subsystem9" /begin REF_CHARACTERISTIC P_VSM_LSMC_SampleTime /end REF_CHARACTERISTIC /end GROUP
/begin GROUP S1146_Subsystem1 "PubIfStateVSM_MDL/Subsystem Reference/Subsystem/StateManage/LSS/LCK_LKA_LDW_ELKStateMachine3/LCKIE/LCKIE/Subsystem1/IEStateClc/Subsystem1" /begin REF_CHARACTERISTIC P_VSM_LSMC_SampleTime /end REF_CHARACTERISTIC /end GROUP
/begin GROUP S1146_Subsystem12 "PubIfStateVSM_MDL/Subsystem Reference/Subsystem/StateManage/LSS/LCK_LKA_LDW_ELKStateMachine3/LCKIE/LCKIE/Subsystem1/IEStateClc/Subsystem12" /begin REF_CHARACTERISTIC P_VSM_LSMC_SampleTime /end REF_CHARACTERISTIC /end GROUP
/begin GROUP S1146_Subsystem4 "PubIfStateVSM_MDL/Subsystem Reference/Subsystem/StateManage/LSS/LCK_LKA_LDW_ELKStateMachine3/LCKIE/LCKIE/Subsystem1/IEStateClc/Subsystem4" /begin REF_CHARACTERISTIC P_VSM_LSMC_SampleTime /end REF_CHARACTERISTIC /end GROUP
/begin GROUP S1147_IE_LATC "PubIfStateVSM_MDL/Subsystem Reference/Subsystem/StateManage/LSS/LCK_LKA_LDW_ELKStateMachine3/LCKIE/LCKIE/Subsystem1/LCKIE_SignalProcess1/IE_LATC"
 /begin REF_CHARACTERISTIC P_VSM_LCKIE_LATC_LimitDis P_VSM_LCKIE_LATC_LimitDis_BP P_VSM_LCKIE_LatC_DisOffofLanWidth P_VSM_LCKIE_LatC_DisOffofSpd P_VSM_LCKIE_LatC_DisSW P_VSM_LCKIE_LatC_LanWidth P_VSM_LCKIE_LatC_LimitDisEgoToObjSelt P_VSM_LCKIE_LatC_LimitEgoToOppLane P_VSM_LCKIE_LatC_MoveEnableDis P_VSM_LCKIE_LatC_RESafDis P_VSM_LCKIE_LatC_SafeDisofLanWidth P_VSM_LCKIE_LatC_Spd P_VSM_LCKIE_LatC_maxLimitDisREToLane P_VSM_LCKIE_LatC_minLimitDisREToLane /end REF_CHARACTERISTIC
 /begin REF_MEASUREMENT VSM_LCKIE_LatC_Counter VSM_LCKIE_LatC_Counter1 VSM_LCKIE_LatC_Counter2 VSM_LCKIE_LatC_Counter3 VSM_LCKIE_LatC_Counter4 VSM_LCKIE_LatC_Counter5 VSM_LCKIE_LatC_DetaDis VSM_LCKIE_LatC_DirectChange VSM_LCKIE_LatC_DisEgo2ObjOff VSM_LCKIE_LatC_DisREToLane VSM_LCKIE_LatC_Flg VSM_LCKIE_LatC_LatFLg VSM_LCKIE_LatC_LatMovDis VSM_LCKIE_LatC_LatWarning VSM_LCKIE_LatC_MovDirct VSM_LCKIE_LatC_MovDirct1 VSM_LCKIE_LatC_MoveDis VSM_LCKIE_LatC_ObjLatFailFlg VSM_LCKIE_LatC_SafDis VSM_LCKIE_LatC_SafeDisToLaneEdge VSM_LCKIE_LatC_latmovori VSM_LCKIE_LatC_ts /end REF_MEASUREMENT
/end GROUP
/begin GROUP S1147_IE_Long "PubIfStateVSM_MDL/Subsystem Reference/Subsystem/StateManage/LSS/LCK_LKA_LDW_ELKStateMachine3/LCKIE/LCKIE/Subsystem1/LCKIE_SignalProcess1/IE_Long"
 /begin REF_CHARACTERISTIC P_VSM_LCKIE_LongC_DetaSpd P_VSM_LCKIE_LongC_DirecChangeDis P_VSM_LCKIE_LongC_FleetOff P_VSM_LCKIE_LongC_ShutDownLongDis P_VSM_LCKIE_LongC_ShutDownTTC P_VSM_LCKIE_LongC_Spd P_VSM_LCKIE_LongC_d1 P_VSM_LCKIE_LongC_d2 P_VSM_LCKIE_LongC_maxDis P_VSM_LCKIE_LongC_minDis P_VSM_LCKIE_LongC_toff P_VSM_LCKIE_tcycle /end REF_CHARACTERISTIC
 /begin REF_MEASUREMENT VSM_LCKIE_LongC_Couter1 VSM_LCKIE_LongC_Couter2 VSM_LCKIE_LongC_Couter3 VSM_LCKIE_LongC_CouterOff VSM_LCKIE_LongC_IEReady VSM_LCKIE_LongC_LongDis VSM_LCKIE_LongC_LongDisfinal VSM_LCKIE_LongC_LongFlg VSM_LCKIE_LongC_ObjLong VSM_LCKIE_LongC_PocFlg VSM_LCKIE_LongC_d1 VSM_LCKIE_LongC_d2 /end REF_MEASUREMENT
/end GROUP
/begin GROUP S1147_IE_OFC "PubIfStateVSM_MDL/Subsystem Reference/Subsystem/StateManage/LSS/LCK_LKA_LDW_ELKStateMachine3/LCKIE/LCKIE/Subsystem1/LCKIE_SignalProcess1/IE_OFC"
 /begin REF_CHARACTERISTIC P_Global_Vehicle_Length_m P_VSM_LCKIE_OFC_ActDis P_VSM_LCKIE_OFC_DownDis P_VSM_LCKIE_OFC_DownTTC P_VSM_LCKIE_OFC_SafDis P_VSM_LCKIE_OFC_Toff /end REF_CHARACTERISTIC
 /begin REF_MEASUREMENT VSM_LCKIE_OFC_Counter VSM_LCKIE_OFC_Counter1 VSM_LCKIE_OFC_Long VSM_LCKIE_OFC_ObjTTC VSM_LCKIE_OFC_OppObjDetaSpd VSM_LCKIE_OFC_OppObjFail VSM_LCKIE_OFC_OppObjReady VSM_LCKIE_OFC_Tset /end REF_MEASUREMENT
/end GROUP
/begin GROUP S1147_IE_ORC "PubIfStateVSM_MDL/Subsystem Reference/Subsystem/StateManage/LSS/LCK_LKA_LDW_ELKStateMachine3/LCKIE/LCKIE/Subsystem1/LCKIE_SignalProcess1/IE_ORC"
 /begin REF_CHARACTERISTIC P_VSM_LCKIE_ORC_LatDis P_VSM_LCKIE_ORC_LimitDis1 P_VSM_LCKIE_ORC_LimitDis2 P_VSM_LCKIE_ORC_LimitTTC P_VSM_LCKIE_ORC_LowSpd /end REF_CHARACTERISTIC
 /begin REF_MEASUREMENT VSM_LCKIE_ORC_Counter VSM_LCKIE_ORC_ObjDetaSpd VSM_LCKIE_ORC_ObjLatPos VSM_LCKIE_ORC_ObjLong VSM_LCKIE_ORC_ObjTTC VSM_LCKIE_ORC_OppREARObjReady /end REF_MEASUREMENT
/end GROUP
/begin GROUP S1147_IE_OS "PubIfStateVSM_MDL/Subsystem Reference/Subsystem/StateManage/LSS/LCK_LKA_LDW_ELKStateMachine3/LCKIE/LCKIE/Subsystem1/LCKIE_SignalProcess1/IE_OS" /begin REF_CHARACTERISTIC P_VSM_LCKIE_ClassInput /end REF_CHARACTERISTIC
 /begin REF_MEASUREMENT VSM_LCKIE_OS_Couter VSM_LCKIE_OS_Couter1 VSM_LCKIE_OS_DetaSpd VSM_LCKIE_OS_DetaSpdSelect VSM_LCKIE_OS_DisEgo2Obj VSM_LCKIE_OS_DisEgo2ObjSelect VSM_LCKIE_OS_DisEgo2OppLane VSM_LCKIE_OS_ObjIDSelect VSM_LCKIE_OS_ObjLane VSM_LCKIE_OS_ObjSelectID VSM_LCKIE_OS_OppFObjID VSM_LCKIE_OS_OppRObjID VSM_LCKIE_OS_POSRObjID VSM_LCKIE_OS_RoadWidth VSM_LCKIE_OS_TTC /end REF_MEASUREMENT
/end GROUP
/begin GROUP S1147_IE_POC "PubIfStateVSM_MDL/Subsystem Reference/Subsystem/StateManage/LSS/LCK_LKA_LDW_ELKStateMachine3/LCKIE/LCKIE/Subsystem1/LCKIE_SignalProcess1/IE_POC"
 /begin REF_CHARACTERISTIC P_VSM_LCKIE_POC_Delaytime P_VSM_LCKIE_POC_LimitDis P_VSM_LCKIE_POC_LimitTTC P_VSM_LCKIE_POC_detaSpd P_VSM_LCKIE_tcycle /end REF_CHARACTERISTIC
 /begin REF_MEASUREMENT VSM_LCKIE_POC_Counter VSM_LCKIE_POC_Couter1 VSM_LCKIE_POC_Couter2 VSM_LCKIE_POC_LongDown VSM_LCKIE_POC_OvertakeFlg VSM_LCKIE_POC_OvertakeSpd VSM_LCKIE_POC_POCObjLong VSM_LCKIE_POC_POCObjTTC VSM_LCKIE_POC_POSID VSM_LCKIE_POC_POSObjID VSM_LCKIE_POC_delay_time /end REF_MEASUREMENT
/end GROUP
/begin GROUP S1228_Subsystem1 "PubIfStateVSM_MDL/Subsystem Reference/Subsystem/StateManage/LSS/LCK_LKA_LDW_ELKStateMachine3/LDW/LDW/LDW2/LDWSignal_calculate/Subsystem1" /begin REF_CHARACTERISTIC P_VSM_LSMC_SampleTime /end REF_CHARACTERISTIC /end GROUP
/begin GROUP S1228_Subsystem4 "PubIfStateVSM_MDL/Subsystem Reference/Subsystem/StateManage/LSS/LCK_LKA_LDW_ELKStateMachine3/LDW/LDW/LDW2/LDWSignal_calculate/Subsystem4" /begin REF_CHARACTERISTIC P_VSM_LSMC_SampleTime /end REF_CHARACTERISTIC /end GROUP
/begin GROUP S1228_Subsystem7 "PubIfStateVSM_MDL/Subsystem Reference/Subsystem/StateManage/LSS/LCK_LKA_LDW_ELKStateMachine3/LDW/LDW/LDW2/LDWSignal_calculate/Subsystem7" /begin REF_CHARACTERISTIC P_VSM_LSMC_SampleTime /end REF_CHARACTERISTIC /end GROUP
/begin GROUP S1229_Subsystem "PubIfStateVSM_MDL/Subsystem Reference/Subsystem/StateManage/LSS/LCK_LKA_LDW_ELKStateMachine3/LDW/LDW/LDW2/LDW_Condition/Subsystem" /begin REF_CHARACTERISTIC P_VSM_LSMC_SampleTime /end REF_CHARACTERISTIC /end GROUP
/begin GROUP S1229_Subsystem1 "PubIfStateVSM_MDL/Subsystem Reference/Subsystem/StateManage/LSS/LCK_LKA_LDW_ELKStateMachine3/LDW/LDW/LDW2/LDW_Condition/Subsystem1" /begin REF_CHARACTERISTIC P_VSM_LSMC_SampleTime /end REF_CHARACTERISTIC /end GROUP
/begin GROUP S1229_Subsystem10 "PubIfStateVSM_MDL/Subsystem Reference/Subsystem/StateManage/LSS/LCK_LKA_LDW_ELKStateMachine3/LDW/LDW/LDW2/LDW_Condition/Subsystem10" /begin REF_CHARACTERISTIC P_VSM_LSMC_SampleTime /end REF_CHARACTERISTIC /end GROUP
/begin GROUP S1229_Subsystem17 "PubIfStateVSM_MDL/Subsystem Reference/Subsystem/StateManage/LSS/LCK_LKA_LDW_ELKStateMachine3/LDW/LDW/LDW2/LDW_Condition/Subsystem17" /begin REF_CHARACTERISTIC P_VSM_LSMC_SampleTime /end REF_CHARACTERISTIC /end GROUP
/begin GROUP S1229_Subsystem2 "PubIfStateVSM_MDL/Subsystem Reference/Subsystem/StateManage/LSS/LCK_LKA_LDW_ELKStateMachine3/LDW/LDW/LDW2/LDW_Condition/Subsystem2" /begin REF_CHARACTERISTIC P_VSM_LSMC_SampleTime /end REF_CHARACTERISTIC /end GROUP
/begin GROUP S1229_Subsystem3 "PubIfStateVSM_MDL/Subsystem Reference/Subsystem/StateManage/LSS/LCK_LKA_LDW_ELKStateMachine3/LDW/LDW/LDW2/LDW_Condition/Subsystem3" /begin REF_CHARACTERISTIC P_VSM_LSMC_SampleTime /end REF_CHARACTERISTIC /end GROUP
/begin GROUP S1229_Subsystem4 "PubIfStateVSM_MDL/Subsystem Reference/Subsystem/StateManage/LSS/LCK_LKA_LDW_ELKStateMachine3/LDW/LDW/LDW2/LDW_Condition/Subsystem4" /begin REF_CHARACTERISTIC P_VSM_LSMC_SampleTime /end REF_CHARACTERISTIC /end GROUP
/begin GROUP S1229_Subsystem5 "PubIfStateVSM_MDL/Subsystem Reference/Subsystem/StateManage/LSS/LCK_LKA_LDW_ELKStateMachine3/LDW/LDW/LDW2/LDW_Condition/Subsystem5" /begin REF_CHARACTERISTIC P_VSM_LSMC_SampleTime /end REF_CHARACTERISTIC /end GROUP
/begin GROUP S1229_Subsystem6 "PubIfStateVSM_MDL/Subsystem Reference/Subsystem/StateManage/LSS/LCK_LKA_LDW_ELKStateMachine3/LDW/LDW/LDW2/LDW_Condition/Subsystem6" /begin REF_CHARACTERISTIC P_VSM_LSMC_SampleTime /end REF_CHARACTERISTIC /end GROUP
/begin GROUP S1229_Subsystem7 "PubIfStateVSM_MDL/Subsystem Reference/Subsystem/StateManage/LSS/LCK_LKA_LDW_ELKStateMachine3/LDW/LDW/LDW2/LDW_Condition/Subsystem7" /begin REF_CHARACTERISTIC P_VSM_LSMC_SampleTime /end REF_CHARACTERISTIC /end GROUP
/begin GROUP S1229_Subsystem8 "PubIfStateVSM_MDL/Subsystem Reference/Subsystem/StateManage/LSS/LCK_LKA_LDW_ELKStateMachine3/LDW/LDW/LDW2/LDW_Condition/Subsystem8" /begin REF_CHARACTERISTIC P_VSM_LSMC_SampleTime /end REF_CHARACTERISTIC /end GROUP
/begin GROUP S1357_Subsystem1 "PubIfStateVSM_MDL/Subsystem Reference/Subsystem/StateManage/LSS/LCK_LKA_LDW_ELKStateMachine3/LKA/LKA/LKA2/LKA/Subsystem1" /begin REF_CHARACTERISTIC P_VSM_LSMC_SampleTime /end REF_CHARACTERISTIC /end GROUP
/begin GROUP S1357_Subsystem10 "PubIfStateVSM_MDL/Subsystem Reference/Subsystem/StateManage/LSS/LCK_LKA_LDW_ELKStateMachine3/LKA/LKA/LKA2/LKA/Subsystem10" /begin REF_CHARACTERISTIC P_VSM_LSMC_SampleTime /end REF_CHARACTERISTIC /end GROUP
/begin GROUP S1357_Subsystem2 "PubIfStateVSM_MDL/Subsystem Reference/Subsystem/StateManage/LSS/LCK_LKA_LDW_ELKStateMachine3/LKA/LKA/LKA2/LKA/Subsystem2" /begin REF_CHARACTERISTIC P_VSM_LSMC_SampleTime /end REF_CHARACTERISTIC /end GROUP
/begin GROUP S1357_Subsystem3 "PubIfStateVSM_MDL/Subsystem Reference/Subsystem/StateManage/LSS/LCK_LKA_LDW_ELKStateMachine3/LKA/LKA/LKA2/LKA/Subsystem3" /begin REF_CHARACTERISTIC P_VSM_LSMC_SampleTime /end REF_CHARACTERISTIC /end GROUP
/begin GROUP S1357_Subsystem4 "PubIfStateVSM_MDL/Subsystem Reference/Subsystem/StateManage/LSS/LCK_LKA_LDW_ELKStateMachine3/LKA/LKA/LKA2/LKA/Subsystem4" /begin REF_CHARACTERISTIC P_VSM_LSMC_SampleTime /end REF_CHARACTERISTIC /end GROUP
/begin GROUP S1357_Subsystem7 "PubIfStateVSM_MDL/Subsystem Reference/Subsystem/StateManage/LSS/LCK_LKA_LDW_ELKStateMachine3/LKA/LKA/LKA2/LKA/Subsystem7" /begin REF_CHARACTERISTIC P_VSM_LSMC_SampleTime /end REF_CHARACTERISTIC /end GROUP
/begin GROUP S1358_Subsystem1 "PubIfStateVSM_MDL/Subsystem Reference/Subsystem/StateManage/LSS/LCK_LKA_LDW_ELKStateMachine3/LKA/LKA/LKA2/LKA_Condition/Subsystem1" /begin REF_CHARACTERISTIC P_VSM_LSMC_SampleTime /end REF_CHARACTERISTIC /end GROUP
/begin GROUP S1358_Subsystem10 "PubIfStateVSM_MDL/Subsystem Reference/Subsystem/StateManage/LSS/LCK_LKA_LDW_ELKStateMachine3/LKA/LKA/LKA2/LKA_Condition/Subsystem10" /begin REF_CHARACTERISTIC P_VSM_LSMC_SampleTime /end REF_CHARACTERISTIC /end GROUP
/begin GROUP S1358_Subsystem12 "PubIfStateVSM_MDL/Subsystem Reference/Subsystem/StateManage/LSS/LCK_LKA_LDW_ELKStateMachine3/LKA/LKA/LKA2/LKA_Condition/Subsystem12" /begin REF_CHARACTERISTIC P_VSM_LSMC_SampleTime /end REF_CHARACTERISTIC /end GROUP
/begin GROUP S1358_Subsystem13 "PubIfStateVSM_MDL/Subsystem Reference/Subsystem/StateManage/LSS/LCK_LKA_LDW_ELKStateMachine3/LKA/LKA/LKA2/LKA_Condition/Subsystem13" /begin REF_CHARACTERISTIC P_VSM_LSMC_SampleTime /end REF_CHARACTERISTIC /end GROUP
/begin GROUP S1358_Subsystem15 "PubIfStateVSM_MDL/Subsystem Reference/Subsystem/StateManage/LSS/LCK_LKA_LDW_ELKStateMachine3/LKA/LKA/LKA2/LKA_Condition/Subsystem15" /begin REF_CHARACTERISTIC P_VSM_LSMC_SampleTime /end REF_CHARACTERISTIC /end GROUP
/begin GROUP S1358_Subsystem18 "PubIfStateVSM_MDL/Subsystem Reference/Subsystem/StateManage/LSS/LCK_LKA_LDW_ELKStateMachine3/LKA/LKA/LKA2/LKA_Condition/Subsystem18" /begin REF_CHARACTERISTIC P_VSM_LSMC_SampleTime /end REF_CHARACTERISTIC /end GROUP
/begin GROUP S1358_Subsystem2 "PubIfStateVSM_MDL/Subsystem Reference/Subsystem/StateManage/LSS/LCK_LKA_LDW_ELKStateMachine3/LKA/LKA/LKA2/LKA_Condition/Subsystem2" /begin REF_CHARACTERISTIC P_VSM_LSMC_SampleTime /end REF_CHARACTERISTIC /end GROUP
/begin GROUP S1358_Subsystem3 "PubIfStateVSM_MDL/Subsystem Reference/Subsystem/StateManage/LSS/LCK_LKA_LDW_ELKStateMachine3/LKA/LKA/LKA2/LKA_Condition/Subsystem3" /begin REF_CHARACTERISTIC P_VSM_LSMC_SampleTime /end REF_CHARACTERISTIC /end GROUP
/begin GROUP S1358_Subsystem4 "PubIfStateVSM_MDL/Subsystem Reference/Subsystem/StateManage/LSS/LCK_LKA_LDW_ELKStateMachine3/LKA/LKA/LKA2/LKA_Condition/Subsystem4" /begin REF_CHARACTERISTIC P_VSM_LSMC_SampleTime /end REF_CHARACTERISTIC /end GROUP
/begin GROUP S1358_Subsystem5 "PubIfStateVSM_MDL/Subsystem Reference/Subsystem/StateManage/LSS/LCK_LKA_LDW_ELKStateMachine3/LKA/LKA/LKA2/LKA_Condition/Subsystem5" /begin REF_CHARACTERISTIC P_VSM_LSMC_SampleTime /end REF_CHARACTERISTIC /end GROUP
/begin GROUP S1358_Subsystem6 "PubIfStateVSM_MDL/Subsystem Reference/Subsystem/StateManage/LSS/LCK_LKA_LDW_ELKStateMachine3/LKA/LKA/LKA2/LKA_Condition/Subsystem6" /begin REF_CHARACTERISTIC P_VSM_LSMC_SampleTime /end REF_CHARACTERISTIC /end GROUP
/begin GROUP S1358_Subsystem7 "PubIfStateVSM_MDL/Subsystem Reference/Subsystem/StateManage/LSS/LCK_LKA_LDW_ELKStateMachine3/LKA/LKA/LKA2/LKA_Condition/Subsystem7" /begin REF_CHARACTERISTIC P_VSM_LSMC_SampleTime /end REF_CHARACTERISTIC /end GROUP
/begin GROUP S1358_Subsystem8 "PubIfStateVSM_MDL/Subsystem Reference/Subsystem/StateManage/LSS/LCK_LKA_LDW_ELKStateMachine3/LKA/LKA/LKA2/LKA_Condition/Subsystem8" /begin REF_CHARACTERISTIC P_VSM_LSMC_SampleTime /end REF_CHARACTERISTIC /end GROUP
/begin GROUP S1358_Subsystem9 "PubIfStateVSM_MDL/Subsystem Reference/Subsystem/StateManage/LSS/LCK_LKA_LDW_ELKStateMachine3/LKA/LKA/LKA2/LKA_Condition/Subsystem9" /begin REF_CHARACTERISTIC P_VSM_LSMC_SampleTime /end REF_CHARACTERISTIC /end GROUP
/end MODULE
/end PROJECT
