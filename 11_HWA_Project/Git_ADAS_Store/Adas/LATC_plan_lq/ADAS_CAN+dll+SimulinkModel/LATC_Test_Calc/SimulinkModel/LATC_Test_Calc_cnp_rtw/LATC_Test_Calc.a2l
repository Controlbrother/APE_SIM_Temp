/* @@@@ File written by CANAPE_VERSION 18 0 70 @@@@ */ ASAP2_VERSION 1 51
/begin PROJECT ProjectName "Project Comment Goes Here"
/begin HEADER "Header Comments go here" /end HEADER
/begin MODULE ModuleName "Module Comment Goes Here"
/begin MOD_COMMON "Mod Common Comment Here" BYTE_ORDER MSB_LAST ALIGNMENT_BYTE 1 ALIGNMENT_WORD 2 ALIGNMENT_LONG 4 ALIGNMENT_FLOAT32_IEEE 4 ALIGNMENT_FLOAT64_IEEE 8 /end MOD_COMMON
/begin IF_DATA XCP
 /begin PROTOCOL_LAYER 0x0100 0x03E8 0x2710 0x00 0x00 0x00 0x00 0x00 0xFF 0xFF BYTE_ORDER_MSB_LAST ADDRESS_GRANULARITY_BYTE OPTIONAL_CMD GET_DAQ_RESOLUTION_INFO OPTIONAL_CMD GET_DAQ_PROCESSOR_INFO OPTIONAL_CMD UPLOAD OPTIONAL_CMD SET_MTA OPTIONAL_CMD GET_COMM_MODE_INFO /end PROTOCOL_LAYER
 /begin DAQ DYNAMIC 0x00 0x01 0x00 OPTIMISATION_TYPE_DEFAULT ADDRESS_EXTENSION_FREE IDENTIFICATION_FIELD_TYPE_RELATIVE_BYTE GRANULARITY_ODT_ENTRY_SIZE_DAQ_BYTE 0xFD OVERLOAD_INDICATION_PID PRESCALER_SUPPORTED /begin TIMESTAMP_SUPPORTED 0x01 SIZE_DWORD UNIT_100US /end TIMESTAMP_SUPPORTED
  /begin EVENT "on LATC_Test_Calc calculated" "on LATC_T" 0x00 DAQ 0xFF 0x00 0x06 0x00 /end EVENT
 /end DAQ
 /begin PAG 0x00 /end PAG
 /begin PGM PGM_MODE_ABSOLUTE 0x00 0x00 /end PGM
 /begin XCP_ON_SIMULINK MODEL_NAME "LATC_Test_Calc" /end XCP_ON_SIMULINK
/end IF_DATA
/begin MOD_PAR "MOD PAR Comment Goes Here" /end MOD_PAR
/begin COMPU_METHOD LATC_Test_Calc_CM_double "Q = V" RAT_FUNC "%15.10" "" COEFFS 0 1 0 0 0 1 /end COMPU_METHOD
/begin COMPU_METHOD LATC_Test_Calc_CM_single "Q = V" RAT_FUNC "%8.6" "" COEFFS 0 1 0 0 0 1 /end COMPU_METHOD
/begin COMPU_METHOD LATC_Test_Calc_CM_uint16 "Q = V" RAT_FUNC "%5.0" "" COEFFS 0 1 0 0 0 1 /end COMPU_METHOD
/begin COMPU_METHOD LATC_Test_Calc_CM_uint8 "Q = V" RAT_FUNC "%3.0" "" COEFFS 0 1 0 0 0 1 /end COMPU_METHOD
/begin COMPU_METHOD RTTarget.ModelStepTime.CONVERSION.MICROSECOND_UNIT "Microsecond unit for model step execution time" RAT_FUNC "%.1" "µs" COEFFS 0 1 0 0 0 1 /end COMPU_METHOD
/begin MEASUREMENT LCS_AngleSlope_Cnt "" UWORD LATC_Test_Calc_CM_uint16 0 0 0 65535 ECU_ADDRESS 0xFB4DA
 /begin IF_DATA XCP
  /begin DAQ_EVENT FIXED_EVENT_LIST EVENT 0x0 /end DAQ_EVENT
 /end IF_DATA
/end MEASUREMENT
/begin MEASUREMENT LCS_AngleSlope_Flg "" UBYTE LATC_Test_Calc_CM_uint8 0 0 0 255 ECU_ADDRESS 0xFB4D8
 /begin IF_DATA XCP
  /begin DAQ_EVENT FIXED_EVENT_LIST EVENT 0x0 /end DAQ_EVENT
 /end IF_DATA
/end MEASUREMENT
/begin MEASUREMENT LCS_HoldTime "" FLOAT64_IEEE LATC_Test_Calc_CM_double 0 0 -1.79769e+308 1.79769e+308 ECU_ADDRESS 0xFB740
 /begin IF_DATA XCP
  /begin DAQ_EVENT FIXED_EVENT_LIST EVENT 0x0 /end DAQ_EVENT
 /end IF_DATA
/end MEASUREMENT
/begin MEASUREMENT LCS_IN_desLaneA1 "" FLOAT32_IEEE LATC_Test_Calc_CM_single 0 0 -3.402823466e+38 3.402823466e+38 ECU_ADDRESS 0xFB72C
 /begin IF_DATA XCP
  /begin DAQ_EVENT FIXED_EVENT_LIST EVENT 0x0 /end DAQ_EVENT
 /end IF_DATA
/end MEASUREMENT
/begin MEASUREMENT LCS_IN_desLaneA2 "" FLOAT32_IEEE LATC_Test_Calc_CM_single 0 0 -3.402823466e+38 3.402823466e+38 ECU_ADDRESS 0xFB728
 /begin IF_DATA XCP
  /begin DAQ_EVENT FIXED_EVENT_LIST EVENT 0x0 /end DAQ_EVENT
 /end IF_DATA
/end MEASUREMENT
/begin MEASUREMENT LCS_IN_desLaneA3 "" FLOAT32_IEEE LATC_Test_Calc_CM_single 0 0 -3.402823466e+38 3.402823466e+38 ECU_ADDRESS 0xFB724
 /begin IF_DATA XCP
  /begin DAQ_EVENT FIXED_EVENT_LIST EVENT 0x0 /end DAQ_EVENT
 /end IF_DATA
/end MEASUREMENT
/begin MEASUREMENT LCS_LCC_AyDtLimit "" FLOAT32_IEEE LATC_Test_Calc_CM_single 0 0 -3.402823466e+38 3.402823466e+38 ECU_ADDRESS 0xFB710
 /begin IF_DATA XCP
  /begin DAQ_EVENT FIXED_EVENT_LIST EVENT 0x0 /end DAQ_EVENT
 /end IF_DATA
/end MEASUREMENT
/begin MEASUREMENT LCS_LCC_Feedback "" FLOAT32_IEEE LATC_Test_Calc_CM_single 0 0 -3.402823466e+38 3.402823466e+38 ECU_ADDRESS 0xFB4E0
 /begin IF_DATA XCP
  /begin DAQ_EVENT FIXED_EVENT_LIST EVENT 0x0 /end DAQ_EVENT
 /end IF_DATA
/end MEASUREMENT
/begin MEASUREMENT LCS_LCC_Feedforward "" FLOAT32_IEEE LATC_Test_Calc_CM_single 0 0 -3.402823466e+38 3.402823466e+38 ECU_ADDRESS 0xFB4E4
 /begin IF_DATA XCP
  /begin DAQ_EVENT FIXED_EVENT_LIST EVENT 0x0 /end DAQ_EVENT
 /end IF_DATA
/end MEASUREMENT
/begin MEASUREMENT LCS_LCC_FinalPreviewT "" FLOAT32_IEEE LATC_Test_Calc_CM_single 0 0 -3.402823466e+38 3.402823466e+38 ECU_ADDRESS 0xFB714
 /begin IF_DATA XCP
  /begin DAQ_EVENT FIXED_EVENT_LIST EVENT 0x0 /end DAQ_EVENT
 /end IF_DATA
/end MEASUREMENT
/begin MEASUREMENT LCS_LCC_Later_error "" FLOAT32_IEEE LATC_Test_Calc_CM_single 0 0 -3.402823466e+38 3.402823466e+38 ECU_ADDRESS 0xFB4F8
 /begin IF_DATA XCP
  /begin DAQ_EVENT FIXED_EVENT_LIST EVENT 0x0 /end DAQ_EVENT
 /end IF_DATA
/end MEASUREMENT
/begin MEASUREMENT LCS_LCC_Later_error_rate "" FLOAT32_IEEE LATC_Test_Calc_CM_single 0 0 -3.402823466e+38 3.402823466e+38 ECU_ADDRESS 0xFB4F4
 /begin IF_DATA XCP
  /begin DAQ_EVENT FIXED_EVENT_LIST EVENT 0x0 /end DAQ_EVENT
 /end IF_DATA
/end MEASUREMENT
/begin MEASUREMENT LCS_LCC_Max_Lateral_Acc "" FLOAT32_IEEE LATC_Test_Calc_CM_single 0 0 -3.402823466e+38 3.402823466e+38 ECU_ADDRESS 0xFB70C
 /begin IF_DATA XCP
  /begin DAQ_EVENT FIXED_EVENT_LIST EVENT 0x0 /end DAQ_EVENT
 /end IF_DATA
/end MEASUREMENT
/begin MEASUREMENT LCS_LCC_NumTraj "" FLOAT64_IEEE LATC_Test_Calc_CM_double 0 0 -1.79769e+308 1.79769e+308 ECU_ADDRESS 0xFB730
 /begin IF_DATA XCP
  /begin DAQ_EVENT FIXED_EVENT_LIST EVENT 0x0 /end DAQ_EVENT
 /end IF_DATA
/end MEASUREMENT
/begin MEASUREMENT LCS_LCC_PlanIdex "" FLOAT64_IEEE LATC_Test_Calc_CM_double 0 0 -1.79769e+308 1.79769e+308 ECU_ADDRESS 0xFB738
 /begin IF_DATA XCP
  /begin DAQ_EVENT FIXED_EVENT_LIST EVENT 0x0 /end DAQ_EVENT
 /end IF_DATA
/end MEASUREMENT
/begin MEASUREMENT LCS_LCC_PlanTheta "" FLOAT32_IEEE LATC_Test_Calc_CM_single 0 0 -3.402823466e+38 3.402823466e+38 ECU_ADDRESS 0xFB520 MATRIX_DIM 1 40 1
 /begin IF_DATA XCP
  /begin DAQ_EVENT FIXED_EVENT_LIST EVENT 0x0 /end DAQ_EVENT
 /end IF_DATA
/end MEASUREMENT
/begin MEASUREMENT LCS_LCC_PlanX "" FLOAT32_IEEE LATC_Test_Calc_CM_single 0 0 -3.402823466e+38 3.402823466e+38 ECU_ADDRESS 0xFB660 MATRIX_DIM 1 40 1
 /begin IF_DATA XCP
  /begin DAQ_EVENT FIXED_EVENT_LIST EVENT 0x0 /end DAQ_EVENT
 /end IF_DATA
/end MEASUREMENT
/begin MEASUREMENT LCS_LCC_PlanY "" FLOAT32_IEEE LATC_Test_Calc_CM_single 0 0 -3.402823466e+38 3.402823466e+38 ECU_ADDRESS 0xFB5C0 MATRIX_DIM 1 40 1
 /begin IF_DATA XCP
  /begin DAQ_EVENT FIXED_EVENT_LIST EVENT 0x0 /end DAQ_EVENT
 /end IF_DATA
/end MEASUREMENT
/begin MEASUREMENT LCS_LCC_PreviewFac "" FLOAT32_IEEE LATC_Test_Calc_CM_single 0 0 -3.402823466e+38 3.402823466e+38 ECU_ADDRESS 0xFB718
 /begin IF_DATA XCP
  /begin DAQ_EVENT FIXED_EVENT_LIST EVENT 0x0 /end DAQ_EVENT
 /end IF_DATA
/end MEASUREMENT
/begin MEASUREMENT LCS_LCC_PreviewTheta "" FLOAT32_IEEE LATC_Test_Calc_CM_single 0 0 -3.402823466e+38 3.402823466e+38 ECU_ADDRESS 0xFB500
 /begin IF_DATA XCP
  /begin DAQ_EVENT FIXED_EVENT_LIST EVENT 0x0 /end DAQ_EVENT
 /end IF_DATA
/end MEASUREMENT
/begin MEASUREMENT LCS_LCC_PreviewX "" FLOAT32_IEEE LATC_Test_Calc_CM_single 0 0 -3.402823466e+38 3.402823466e+38 ECU_ADDRESS 0xFB508
 /begin IF_DATA XCP
  /begin DAQ_EVENT FIXED_EVENT_LIST EVENT 0x0 /end DAQ_EVENT
 /end IF_DATA
/end MEASUREMENT
/begin MEASUREMENT LCS_LCC_PreviewY "" FLOAT32_IEEE LATC_Test_Calc_CM_single 0 0 -3.402823466e+38 3.402823466e+38 ECU_ADDRESS 0xFB504
 /begin IF_DATA XCP
  /begin DAQ_EVENT FIXED_EVENT_LIST EVENT 0x0 /end DAQ_EVENT
 /end IF_DATA
/end MEASUREMENT
/begin MEASUREMENT LCS_LCC_Preview_Curve "" FLOAT32_IEEE LATC_Test_Calc_CM_single 0 0 -3.402823466e+38 3.402823466e+38 ECU_ADDRESS 0xFB720
 /begin IF_DATA XCP
  /begin DAQ_EVENT FIXED_EVENT_LIST EVENT 0x0 /end DAQ_EVENT
 /end IF_DATA
/end MEASUREMENT
/begin MEASUREMENT LCS_LCC_Preview_CurveFac "" FLOAT32_IEEE LATC_Test_Calc_CM_single 0 0 -3.402823466e+38 3.402823466e+38 ECU_ADDRESS 0xFB71C
 /begin IF_DATA XCP
  /begin DAQ_EVENT FIXED_EVENT_LIST EVENT 0x0 /end DAQ_EVENT
 /end IF_DATA
/end MEASUREMENT
/begin MEASUREMENT LCS_LCC_StateAngleSlope "" FLOAT32_IEEE LATC_Test_Calc_CM_single 0 0 -3.402823466e+38 3.402823466e+38 ECU_ADDRESS 0xFB704
 /begin IF_DATA XCP
  /begin DAQ_EVENT FIXED_EVENT_LIST EVENT 0x0 /end DAQ_EVENT
 /end IF_DATA
/end MEASUREMENT
/begin MEASUREMENT LCS_LCC_Steer_Limit "" FLOAT32_IEEE LATC_Test_Calc_CM_single 0 0 -3.402823466e+38 3.402823466e+38 ECU_ADDRESS 0xFB4DC
 /begin IF_DATA XCP
  /begin DAQ_EVENT FIXED_EVENT_LIST EVENT 0x0 /end DAQ_EVENT
 /end IF_DATA
/end MEASUREMENT
/begin MEASUREMENT LCS_LCC_TarAngle_deg "" FLOAT32_IEEE LATC_Test_Calc_CM_single 0 0 -3.402823466e+38 3.402823466e+38 ECU_ADDRESS 0xFB4E8
 /begin IF_DATA XCP
  /begin DAQ_EVENT FIXED_EVENT_LIST EVENT 0x0 /end DAQ_EVENT
 /end IF_DATA
/end MEASUREMENT
/begin MEASUREMENT LCS_LCC_heading_error "" FLOAT32_IEEE LATC_Test_Calc_CM_single 0 0 -3.402823466e+38 3.402823466e+38 ECU_ADDRESS 0xFB4F0
 /begin IF_DATA XCP
  /begin DAQ_EVENT FIXED_EVENT_LIST EVENT 0x0 /end DAQ_EVENT
 /end IF_DATA
/end MEASUREMENT
/begin MEASUREMENT LCS_LCC_heading_error_rate "" FLOAT32_IEEE LATC_Test_Calc_CM_single 0 0 -3.402823466e+38 3.402823466e+38 ECU_ADDRESS 0xFB4EC
 /begin IF_DATA XCP
  /begin DAQ_EVENT FIXED_EVENT_LIST EVENT 0x0 /end DAQ_EVENT
 /end IF_DATA
/end MEASUREMENT
/begin MEASUREMENT LCS_LCC_ref_curve "" FLOAT32_IEEE LATC_Test_Calc_CM_single 0 0 -3.402823466e+38 3.402823466e+38 ECU_ADDRESS 0xFB4FC
 /begin IF_DATA XCP
  /begin DAQ_EVENT FIXED_EVENT_LIST EVENT 0x0 /end DAQ_EVENT
 /end IF_DATA
/end MEASUREMENT
/begin MEASUREMENT LCS_LCType "" UBYTE LATC_Test_Calc_CM_uint8 0 0 0 255 ECU_ADDRESS 0xFB4D9
 /begin IF_DATA XCP
  /begin DAQ_EVENT FIXED_EVENT_LIST EVENT 0x0 /end DAQ_EVENT
 /end IF_DATA
/end MEASUREMENT
/begin MEASUREMENT LCS_ReqEPSTrgAngle "" FLOAT32_IEEE LATC_Test_Calc_CM_single 0 0 -3.402823466e+38 3.402823466e+38 ECU_ADDRESS 0xFB700
 /begin IF_DATA XCP
  /begin DAQ_EVENT FIXED_EVENT_LIST EVENT 0x0 /end DAQ_EVENT
 /end IF_DATA
/end MEASUREMENT
/begin MEASUREMENT LCS_StateActive_AngleSlope "" FLOAT32_IEEE LATC_Test_Calc_CM_single 0 0 -3.402823466e+38 3.402823466e+38 ECU_ADDRESS 0xFB708
 /begin IF_DATA XCP
  /begin DAQ_EVENT FIXED_EVENT_LIST EVENT 0x0 /end DAQ_EVENT
 /end IF_DATA
/end MEASUREMENT
/begin AXIS_PTS P_LCS_A0_Dis_BP "" 0x95080 NO_INPUT_QUANTITY Lookup2D_X_FLOAT32_IEEE 0 LATC_Test_Calc_CM_single 19 -3.4e+38 3.4e+38 DEPOSIT ABSOLUTE /end AXIS_PTS
/begin CHARACTERISTIC P_LCS_A2S_FliterTime "" VALUE 0x95078 Scalar_FLOAT32_IEEE 0 LATC_Test_Calc_CM_single -3.402823466e+38 3.402823466e+38 /end CHARACTERISTIC
/begin AXIS_PTS P_LCS_A2_Curve_BP "" 0x950D0 LCS_LCC_Preview_Curve Lookup1D_X_FLOAT32_IEEE 0 LATC_Test_Calc_CM_single 10 -3.4e+38 3.4e+38 DEPOSIT ABSOLUTE /end AXIS_PTS
/begin AXIS_PTS P_LCS_DeltaEps_SpdBp "" 0x95120 NO_INPUT_QUANTITY Lookup1D_X_FLOAT32_IEEE 0 LATC_Test_Calc_CM_single 16 -3.4e+38 3.4e+38 DEPOSIT ABSOLUTE /end AXIS_PTS
/begin CHARACTERISTIC P_LCS_LCC_AngleSlope_ELK "" CURVE 0x95160 Lookup1D_FLOAT32_IEEE 0 LATC_Test_Calc_CM_single -3.4e+38 3.4e+38
 /begin AXIS_DESCR COM_AXIS NO_INPUT_QUANTITY LATC_Test_Calc_CM_single 16 -3.4e+38 3.4e+38 DEPOSIT ABSOLUTE AXIS_PTS_REF P_LCS_preDis_spd /end AXIS_DESCR
/end CHARACTERISTIC
/begin CHARACTERISTIC P_LCS_LCC_AngleSlope_ESS "" CURVE 0x951A0 Lookup1D_FLOAT32_IEEE 0 LATC_Test_Calc_CM_single -3.4e+38 3.4e+38
 /begin AXIS_DESCR COM_AXIS NO_INPUT_QUANTITY LATC_Test_Calc_CM_single 16 -3.4e+38 3.4e+38 DEPOSIT ABSOLUTE AXIS_PTS_REF P_LCS_preDis_spd /end AXIS_DESCR
/end CHARACTERISTIC
/begin CHARACTERISTIC P_LCS_LCC_AngleSlope_LCCancle "" CURVE 0x951E0 Lookup1D_FLOAT32_IEEE 0 LATC_Test_Calc_CM_single -3.4e+38 3.4e+38
 /begin AXIS_DESCR COM_AXIS NO_INPUT_QUANTITY LATC_Test_Calc_CM_single 16 -3.4e+38 3.4e+38 DEPOSIT ABSOLUTE AXIS_PTS_REF P_LCS_preDis_spd /end AXIS_DESCR
/end CHARACTERISTIC
/begin CHARACTERISTIC P_LCS_LCC_AngleSlope_LCEco "" CURVE 0x95220 Lookup1D_FLOAT32_IEEE 0 LATC_Test_Calc_CM_single -3.4e+38 3.4e+38
 /begin AXIS_DESCR COM_AXIS NO_INPUT_QUANTITY LATC_Test_Calc_CM_single 16 -3.4e+38 3.4e+38 DEPOSIT ABSOLUTE AXIS_PTS_REF P_LCS_preDis_spd /end AXIS_DESCR
/end CHARACTERISTIC
/begin CHARACTERISTIC P_LCS_LCC_AngleSlope_LCK "" CURVE 0x95260 Lookup1D_FLOAT32_IEEE 0 LATC_Test_Calc_CM_single -3.4e+38 3.4e+38
 /begin AXIS_DESCR COM_AXIS NO_INPUT_QUANTITY LATC_Test_Calc_CM_single 16 -3.4e+38 3.4e+38 DEPOSIT ABSOLUTE AXIS_PTS_REF P_LCS_preDis_spd /end AXIS_DESCR
/end CHARACTERISTIC
/begin CHARACTERISTIC P_LCS_LCC_AngleSlope_LCKIE "" CURVE 0x952A0 Lookup1D_FLOAT32_IEEE 0 LATC_Test_Calc_CM_single -3.4e+38 3.4e+38
 /begin AXIS_DESCR COM_AXIS NO_INPUT_QUANTITY LATC_Test_Calc_CM_single 16 -3.4e+38 3.4e+38 DEPOSIT ABSOLUTE AXIS_PTS_REF P_LCS_preDis_spd /end AXIS_DESCR
/end CHARACTERISTIC
/begin CHARACTERISTIC P_LCS_LCC_AngleSlope_LCNomal "" CURVE 0x952E0 Lookup1D_FLOAT32_IEEE 0 LATC_Test_Calc_CM_single -3.4e+38 3.4e+38
 /begin AXIS_DESCR COM_AXIS NO_INPUT_QUANTITY LATC_Test_Calc_CM_single 16 -3.4e+38 3.4e+38 DEPOSIT ABSOLUTE AXIS_PTS_REF P_LCS_preDis_spd /end AXIS_DESCR
/end CHARACTERISTIC
/begin CHARACTERISTIC P_LCS_LCC_AngleSlope_LCSport "" CURVE 0x95320 Lookup1D_FLOAT32_IEEE 0 LATC_Test_Calc_CM_single -3.4e+38 3.4e+38
 /begin AXIS_DESCR COM_AXIS NO_INPUT_QUANTITY LATC_Test_Calc_CM_single 16 -3.4e+38 3.4e+38 DEPOSIT ABSOLUTE AXIS_PTS_REF P_LCS_preDis_spd /end AXIS_DESCR
/end CHARACTERISTIC
/begin CHARACTERISTIC P_LCS_LCC_AngleSlope_LKA "" CURVE 0x95360 Lookup1D_FLOAT32_IEEE 0 LATC_Test_Calc_CM_single -3.4e+38 3.4e+38
 /begin AXIS_DESCR COM_AXIS NO_INPUT_QUANTITY LATC_Test_Calc_CM_single 16 -3.4e+38 3.4e+38 DEPOSIT ABSOLUTE AXIS_PTS_REF P_LCS_preDis_spd /end AXIS_DESCR
/end CHARACTERISTIC
/begin CHARACTERISTIC P_LCS_LCC_ELK_AyDtLimit_TBL "" CURVE 0x953A0 Lookup1D_FLOAT32_IEEE 0 LATC_Test_Calc_CM_single -3.4e+38 3.4e+38
 /begin AXIS_DESCR COM_AXIS NO_INPUT_QUANTITY LATC_Test_Calc_CM_single 16 -3.4e+38 3.4e+38 DEPOSIT ABSOLUTE AXIS_PTS_REF P_LCS_preDis_spd /end AXIS_DESCR
/end CHARACTERISTIC
/begin CHARACTERISTIC P_LCS_LCC_ESS_AyDtLimit_TBL "" CURVE 0x953E0 Lookup1D_FLOAT32_IEEE 0 LATC_Test_Calc_CM_single -3.4e+38 3.4e+38
 /begin AXIS_DESCR COM_AXIS NO_INPUT_QUANTITY LATC_Test_Calc_CM_single 16 -3.4e+38 3.4e+38 DEPOSIT ABSOLUTE AXIS_PTS_REF P_LCS_preDis_spd /end AXIS_DESCR
/end CHARACTERISTIC
/begin CHARACTERISTIC P_LCS_LCC_Eco_AyDtLimit_TBL "" CURVE 0x95420 Lookup1D_FLOAT32_IEEE 0 LATC_Test_Calc_CM_single -3.4e+38 3.4e+38
 /begin AXIS_DESCR COM_AXIS NO_INPUT_QUANTITY LATC_Test_Calc_CM_single 16 -3.4e+38 3.4e+38 DEPOSIT ABSOLUTE AXIS_PTS_REF P_LCS_preDis_spd /end AXIS_DESCR
/end CHARACTERISTIC
/begin CHARACTERISTIC P_LCS_LCC_LCK_AyDtLimit_TBL "" CURVE 0x95460 Lookup1D_FLOAT32_IEEE 0 LATC_Test_Calc_CM_single -3.4e+38 3.4e+38
 /begin AXIS_DESCR COM_AXIS NO_INPUT_QUANTITY LATC_Test_Calc_CM_single 16 -3.4e+38 3.4e+38 DEPOSIT ABSOLUTE AXIS_PTS_REF P_LCS_preDis_spd /end AXIS_DESCR
/end CHARACTERISTIC
/begin CHARACTERISTIC P_LCS_LCC_LC_AyDtLimit_TBL "" CURVE 0x954A0 Lookup1D_FLOAT32_IEEE 0 LATC_Test_Calc_CM_single -3.4e+38 3.4e+38
 /begin AXIS_DESCR COM_AXIS NO_INPUT_QUANTITY LATC_Test_Calc_CM_single 16 -3.4e+38 3.4e+38 DEPOSIT ABSOLUTE AXIS_PTS_REF P_LCS_preDis_spd /end AXIS_DESCR
/end CHARACTERISTIC
/begin CHARACTERISTIC P_LCS_LCC_LC_Normal_AyDtLimit_TBL "" CURVE 0x954E0 Lookup1D_FLOAT32_IEEE 0 LATC_Test_Calc_CM_single -3.4e+38 3.4e+38
 /begin AXIS_DESCR COM_AXIS NO_INPUT_QUANTITY LATC_Test_Calc_CM_single 16 -3.4e+38 3.4e+38 DEPOSIT ABSOLUTE AXIS_PTS_REF P_LCS_preDis_spd /end AXIS_DESCR
/end CHARACTERISTIC
/begin CHARACTERISTIC P_LCS_LCC_LKA_AyDtLimit_TBL "" CURVE 0x95520 Lookup1D_FLOAT32_IEEE 0 LATC_Test_Calc_CM_single -3.4e+38 3.4e+38
 /begin AXIS_DESCR COM_AXIS NO_INPUT_QUANTITY LATC_Test_Calc_CM_single 16 -3.4e+38 3.4e+38 DEPOSIT ABSOLUTE AXIS_PTS_REF P_LCS_preDis_spd /end AXIS_DESCR
/end CHARACTERISTIC
/begin CHARACTERISTIC P_LCS_LCC_MaxLatAcc_ELK "" CURVE 0x95560 Lookup1D_FLOAT32_IEEE 0 LATC_Test_Calc_CM_single -3.4e+38 3.4e+38
 /begin AXIS_DESCR COM_AXIS NO_INPUT_QUANTITY LATC_Test_Calc_CM_single 16 -3.4e+38 3.4e+38 DEPOSIT ABSOLUTE AXIS_PTS_REF P_LCS_preDis_spd /end AXIS_DESCR
/end CHARACTERISTIC
/begin CHARACTERISTIC P_LCS_LCC_MaxLatAcc_ESS "" CURVE 0x955A0 Lookup1D_FLOAT32_IEEE 0 LATC_Test_Calc_CM_single -3.4e+38 3.4e+38
 /begin AXIS_DESCR COM_AXIS NO_INPUT_QUANTITY LATC_Test_Calc_CM_single 16 -3.4e+38 3.4e+38 DEPOSIT ABSOLUTE AXIS_PTS_REF P_LCS_preDis_spd /end AXIS_DESCR
/end CHARACTERISTIC
/begin CHARACTERISTIC P_LCS_LCC_MaxLatAcc_LCCancel "" CURVE 0x955E0 Lookup1D_FLOAT32_IEEE 0 LATC_Test_Calc_CM_single -3.4e+38 3.4e+38
 /begin AXIS_DESCR COM_AXIS NO_INPUT_QUANTITY LATC_Test_Calc_CM_single 16 -3.4e+38 3.4e+38 DEPOSIT ABSOLUTE AXIS_PTS_REF P_LCS_preDis_spd /end AXIS_DESCR
/end CHARACTERISTIC
/begin CHARACTERISTIC P_LCS_LCC_MaxLatAcc_LCEco "" CURVE 0x95620 Lookup1D_FLOAT32_IEEE 0 LATC_Test_Calc_CM_single -3.4e+38 3.4e+38
 /begin AXIS_DESCR COM_AXIS NO_INPUT_QUANTITY LATC_Test_Calc_CM_single 16 -3.4e+38 3.4e+38 DEPOSIT ABSOLUTE AXIS_PTS_REF P_LCS_preDis_spd /end AXIS_DESCR
/end CHARACTERISTIC
/begin CHARACTERISTIC P_LCS_LCC_MaxLatAcc_LCK "" CURVE 0x95660 Lookup1D_FLOAT32_IEEE 0 LATC_Test_Calc_CM_single -3.4e+38 3.4e+38
 /begin AXIS_DESCR COM_AXIS NO_INPUT_QUANTITY LATC_Test_Calc_CM_single 16 -3.4e+38 3.4e+38 DEPOSIT ABSOLUTE AXIS_PTS_REF P_LCS_preDis_spd /end AXIS_DESCR
/end CHARACTERISTIC
/begin CHARACTERISTIC P_LCS_LCC_MaxLatAcc_LCKIE "" CURVE 0x956A0 Lookup1D_FLOAT32_IEEE 0 LATC_Test_Calc_CM_single -3.4e+38 3.4e+38
 /begin AXIS_DESCR COM_AXIS NO_INPUT_QUANTITY LATC_Test_Calc_CM_single 16 -3.4e+38 3.4e+38 DEPOSIT ABSOLUTE AXIS_PTS_REF P_LCS_preDis_spd /end AXIS_DESCR
/end CHARACTERISTIC
/begin CHARACTERISTIC P_LCS_LCC_MaxLatAcc_LCNomal "" CURVE 0x956E0 Lookup1D_FLOAT32_IEEE 0 LATC_Test_Calc_CM_single -3.4e+38 3.4e+38
 /begin AXIS_DESCR COM_AXIS NO_INPUT_QUANTITY LATC_Test_Calc_CM_single 16 -3.4e+38 3.4e+38 DEPOSIT ABSOLUTE AXIS_PTS_REF P_LCS_preDis_spd /end AXIS_DESCR
/end CHARACTERISTIC
/begin CHARACTERISTIC P_LCS_LCC_MaxLatAcc_LCSport "" CURVE 0x95720 Lookup1D_FLOAT32_IEEE 0 LATC_Test_Calc_CM_single -3.4e+38 3.4e+38
 /begin AXIS_DESCR COM_AXIS NO_INPUT_QUANTITY LATC_Test_Calc_CM_single 16 -3.4e+38 3.4e+38 DEPOSIT ABSOLUTE AXIS_PTS_REF P_LCS_preDis_spd /end AXIS_DESCR
/end CHARACTERISTIC
/begin CHARACTERISTIC P_LCS_LCC_MaxLatAcc_LKA "" CURVE 0x95760 Lookup1D_FLOAT32_IEEE 0 LATC_Test_Calc_CM_single -3.4e+38 3.4e+38
 /begin AXIS_DESCR COM_AXIS NO_INPUT_QUANTITY LATC_Test_Calc_CM_single 16 -3.4e+38 3.4e+38 DEPOSIT ABSOLUTE AXIS_PTS_REF P_LCS_preDis_spd /end AXIS_DESCR
/end CHARACTERISTIC
/begin CHARACTERISTIC P_LCS_LCC_Min_Plan_Dis "" CURVE 0x957A0 Lookup1D_FLOAT32_IEEE 0 LATC_Test_Calc_CM_single -3.4e+38 3.4e+38
 /begin AXIS_DESCR COM_AXIS NO_INPUT_QUANTITY LATC_Test_Calc_CM_single 16 -3.4e+38 3.4e+38 DEPOSIT ABSOLUTE AXIS_PTS_REF P_LCS_DeltaEps_SpdBp /end AXIS_DESCR
/end CHARACTERISTIC
/begin CHARACTERISTIC P_LCS_LCC_PreCur_Min_Plan_Dis_Fac "" CURVE 0x950F8 Lookup1D_FLOAT32_IEEE 0 LATC_Test_Calc_CM_single -3.4e+38 3.4e+38
 /begin AXIS_DESCR COM_AXIS LCS_LCC_Preview_Curve LATC_Test_Calc_CM_single 10 -3.4e+38 3.4e+38 DEPOSIT ABSOLUTE AXIS_PTS_REF P_LCS_A2_Curve_BP /end AXIS_DESCR
/end CHARACTERISTIC
/begin CHARACTERISTIC P_LCS_LCC_PreViewCurve_Fac "" CURVE 0x957E0 Lookup1D_FLOAT32_IEEE 0 LATC_Test_Calc_CM_single -3.4e+38 3.4e+38
 /begin AXIS_DESCR COM_AXIS LCS_LCC_Preview_Curve LATC_Test_Calc_CM_single 10 -3.4e+38 3.4e+38 DEPOSIT ABSOLUTE AXIS_PTS_REF P_LCS_A2_Curve_BP /end AXIS_DESCR
/end CHARACTERISTIC
/begin CHARACTERISTIC P_LCS_LCC_PreViewT "" CURVE 0x95810 Lookup1D_FLOAT32_IEEE 0 LATC_Test_Calc_CM_single -3.4e+38 3.4e+38
 /begin AXIS_DESCR COM_AXIS NO_INPUT_QUANTITY LATC_Test_Calc_CM_single 16 -3.4e+38 3.4e+38 DEPOSIT ABSOLUTE AXIS_PTS_REF P_LCS_preDis_spd /end AXIS_DESCR
/end CHARACTERISTIC
/begin CHARACTERISTIC P_LCS_LCC_PreView_Fac "" MAP 0x96B80 Lookup2D_FLOAT32_IEEE 0 LATC_Test_Calc_CM_single -3.4e+38 3.4e+38
 /begin AXIS_DESCR COM_AXIS NO_INPUT_QUANTITY LATC_Test_Calc_CM_single 16 -3.4e+38 3.4e+38 DEPOSIT ABSOLUTE AXIS_PTS_REF P_LCS_preDis_spd /end AXIS_DESCR
 /begin AXIS_DESCR COM_AXIS NO_INPUT_QUANTITY LATC_Test_Calc_CM_single 19 -3.4e+38 3.4e+38 DEPOSIT ABSOLUTE AXIS_PTS_REF P_LCS_A0_Dis_BP /end AXIS_DESCR
/end CHARACTERISTIC
/begin CHARACTERISTIC P_LCS_LCC_PreView_s "" VALUE 0x9507C Scalar_FLOAT32_IEEE 0 LATC_Test_Calc_CM_single -3.402823466e+38 3.402823466e+38 /end CHARACTERISTIC
/begin CHARACTERISTIC P_LCS_LCC_Sport_AyDtLimit_TBL "" CURVE 0x95850 Lookup1D_FLOAT32_IEEE 0 LATC_Test_Calc_CM_single -3.4e+38 3.4e+38
 /begin AXIS_DESCR COM_AXIS NO_INPUT_QUANTITY LATC_Test_Calc_CM_single 16 -3.4e+38 3.4e+38 DEPOSIT ABSOLUTE AXIS_PTS_REF P_LCS_preDis_spd /end AXIS_DESCR
/end CHARACTERISTIC
/begin CHARACTERISTIC P_LCS_LCC_StateActiv_AyDtLimit "" MAP 0x95890 Lookup2D_FLOAT32_IEEE 0 LATC_Test_Calc_CM_single -3.4e+38 3.4e+38
 /begin AXIS_DESCR COM_AXIS LCS_HoldTime LATC_Test_Calc_CM_double 15 -1.7e+308 1.7e+308 DEPOSIT ABSOLUTE AXIS_PTS_REF P_LCS_StateActive_HoldTime_BP /end AXIS_DESCR
 /begin AXIS_DESCR COM_AXIS LCS_AngleSlope_Flg LATC_Test_Calc_CM_uint8 5 0 255 DEPOSIT ABSOLUTE AXIS_PTS_REF P_LCS_StateActiveFlg_BP /end AXIS_DESCR
/end CHARACTERISTIC
/begin CHARACTERISTIC P_LCS_LCC_StateActiveDelaytime "" VALUE 0x950CC Scalar_UWORD 0 LATC_Test_Calc_CM_uint16 0 65535 /end CHARACTERISTIC
/begin CHARACTERISTIC P_LCS_StateActiv_AngleSlope "" MAP 0x959C0 Lookup2D_FLOAT32_IEEE 0 LATC_Test_Calc_CM_single -3.4e+38 3.4e+38
 /begin AXIS_DESCR COM_AXIS LCS_HoldTime LATC_Test_Calc_CM_double 15 -1.7e+308 1.7e+308 DEPOSIT ABSOLUTE AXIS_PTS_REF P_LCS_StateActive_HoldTime_BP /end AXIS_DESCR
 /begin AXIS_DESCR COM_AXIS LCS_AngleSlope_Flg LATC_Test_Calc_CM_uint8 5 0 255 DEPOSIT ABSOLUTE AXIS_PTS_REF P_LCS_StateActiveFlg_BP /end AXIS_DESCR
/end CHARACTERISTIC
/begin AXIS_PTS P_LCS_StateActiveFlg_BP "" 0x95B30 LCS_AngleSlope_Flg Lookup2D_X_UBYTE 0 LATC_Test_Calc_CM_uint8 5 0 255 DEPOSIT ABSOLUTE /end AXIS_PTS
/begin AXIS_PTS P_LCS_StateActive_HoldTime_BP "" 0x95000 LCS_HoldTime Lookup2D_X_FLOAT64_IEEE 0 LATC_Test_Calc_CM_double 15 -1.7e+308 1.7e+308 DEPOSIT ABSOLUTE /end AXIS_PTS
/begin CHARACTERISTIC P_LCS_StateHold_time "" VALUE 0x95808 Scalar_UWORD 0 LATC_Test_Calc_CM_uint16 0 65535 /end CHARACTERISTIC
/begin AXIS_PTS P_LCS_preDis_spd "" 0x95AF0 NO_INPUT_QUANTITY Lookup1D_X_FLOAT32_IEEE 0 LATC_Test_Calc_CM_single 16 -3.4e+38 3.4e+38 DEPOSIT ABSOLUTE /end AXIS_PTS
/begin MEASUREMENT RTTarget.ModelExecutionCounter "Internal CANape RT-Target DLL counter" ULONG NO_COMPU_METHOD 0 0 0 4294967295 ECU_ADDRESS 0xFB4B0 FORMAT "%.1"
 /begin IF_DATA XCP
  /begin DAQ_EVENT FIXED_EVENT_LIST EVENT 0x0 /end DAQ_EVENT
 /end IF_DATA
/end MEASUREMENT
/begin MEASUREMENT RTTarget.ModelStepTime "Internal CANape RT-Target DLL model step execution time" ULONG RTTarget.ModelStepTime.CONVERSION.MICROSECOND_UNIT 0 0 0 4294967295 ECU_ADDRESS 0xA8038
 /begin IF_DATA XCP
  /begin DAQ_EVENT FIXED_EVENT_LIST EVENT 0x0 /end DAQ_EVENT
 /end IF_DATA
/end MEASUREMENT
/begin GROUP _[Parameters] "All Parameters" ROOT
 /begin REF_CHARACTERISTIC P_LCS_A0_Dis_BP P_LCS_A2S_FliterTime P_LCS_A2_Curve_BP P_LCS_DeltaEps_SpdBp P_LCS_LCC_AngleSlope_ELK P_LCS_LCC_AngleSlope_ESS P_LCS_LCC_AngleSlope_LCCancle P_LCS_LCC_AngleSlope_LCEco P_LCS_LCC_AngleSlope_LCK P_LCS_LCC_AngleSlope_LCKIE P_LCS_LCC_AngleSlope_LCNomal P_LCS_LCC_AngleSlope_LCSport P_LCS_LCC_AngleSlope_LKA P_LCS_LCC_ELK_AyDtLimit_TBL P_LCS_LCC_ESS_AyDtLimit_TBL P_LCS_LCC_Eco_AyDtLimit_TBL P_LCS_LCC_LCK_AyDtLimit_TBL P_LCS_LCC_LC_AyDtLimit_TBL P_LCS_LCC_LC_Normal_AyDtLimit_TBL P_LCS_LCC_LKA_AyDtLimit_TBL P_LCS_LCC_MaxLatAcc_ELK P_LCS_LCC_MaxLatAcc_ESS P_LCS_LCC_MaxLatAcc_LCCancel P_LCS_LCC_MaxLatAcc_LCEco P_LCS_LCC_MaxLatAcc_LCK P_LCS_LCC_MaxLatAcc_LCKIE P_LCS_LCC_MaxLatAcc_LCNomal P_LCS_LCC_MaxLatAcc_LCSport P_LCS_LCC_MaxLatAcc_LKA P_LCS_LCC_Min_Plan_Dis P_LCS_LCC_PreCur_Min_Plan_Dis_Fac P_LCS_LCC_PreViewCurve_Fac P_LCS_LCC_PreViewT P_LCS_LCC_PreView_Fac P_LCS_LCC_PreView_s P_LCS_LCC_Sport_AyDtLimit_TBL P_LCS_LCC_StateActiv_AyDtLimit P_LCS_LCC_StateActiveDelaytime P_LCS_StateActiv_AngleSlope P_LCS_StateActiveFlg_BP P_LCS_StateActive_HoldTime_BP P_LCS_StateHold_time P_LCS_preDis_spd /end REF_CHARACTERISTIC
/end GROUP
/begin GROUP _RTTarget_internals "CANape RT-Target DLL internal diagnostic objects" ROOT /begin REF_MEASUREMENT RTTarget.ModelExecutionCounter RTTarget.ModelStepTime /end REF_MEASUREMENT /end GROUP
/begin FUNCTION Gain6 "" /end FUNCTION
/begin FUNCTION Input1 "" /end FUNCTION
/begin FUNCTION Input10 "" /end FUNCTION
/begin FUNCTION Input11 "" /end FUNCTION
/begin FUNCTION Input12 "" /end FUNCTION
/begin FUNCTION Input13 "" /end FUNCTION
/begin FUNCTION Input14 "" /end FUNCTION
/begin FUNCTION Input15 "" /end FUNCTION
/begin FUNCTION Input2 "" /end FUNCTION
/begin FUNCTION Input3 "" /end FUNCTION
/begin FUNCTION Input4 "" /end FUNCTION
/begin FUNCTION Input5 "" /end FUNCTION
/begin FUNCTION Input6 "" /end FUNCTION
/begin FUNCTION Input7 "" /end FUNCTION
/begin FUNCTION Input8 "" /end FUNCTION
/begin FUNCTION Input9 "" /end FUNCTION
/begin GROUP LATC_Test_Calc "LATC_Test_Calc" ROOT /begin SUB_GROUP Root_Motion_Planning Root_SteerAngSlopeCalc /end SUB_GROUP /end GROUP
/begin FUNCTION LP_filter "" /end FUNCTION
/begin FUNCTION LP_filter1 "" /end FUNCTION
/begin FUNCTION LP_filter2 "" /end FUNCTION
/begin FUNCTION Motion_Planning "" /begin SUB_FUNCTION Motion_Planning.FrenetTrajectory /end SUB_FUNCTION /end FUNCTION
/begin FUNCTION Motion_Planning.FrenetTrajectory "" /begin SUB_FUNCTION Motion_Planning.FrenetTrajectory.Subsystem1 /end SUB_FUNCTION /end FUNCTION
/begin FUNCTION Motion_Planning.FrenetTrajectory.Subsystem1 ""
 /begin SUB_FUNCTION Motion_Planning.FrenetTrajectory.Subsystem1.2_D_Lookup_Table2 Motion_Planning.FrenetTrajectory.Subsystem1.AyDtLimit_TB Motion_Planning.FrenetTrajectory.Subsystem1.AyDtLimit_TB1 Motion_Planning.FrenetTrajectory.Subsystem1.AyDtLimit_TB2 Motion_Planning.FrenetTrajectory.Subsystem1.AyDtLimit_TB3 Motion_Planning.FrenetTrajectory.Subsystem1.AyDtLimit_TB4 Motion_Planning.FrenetTrajectory.Subsystem1.AyDtLimit_TB5 Motion_Planning.FrenetTrajectory.Subsystem1.AyDtLimit_TB6 Motion_Planning.FrenetTrajectory.Subsystem1.AyDtLimit_TB7 Motion_Planning.FrenetTrajectory.Subsystem1.AyDtLimit_TB8 Motion_Planning.FrenetTrajectory.Subsystem1.Constant1 Motion_Planning.FrenetTrajectory.Subsystem1.Constant20 Motion_Planning.FrenetTrajectory.Subsystem1.Constant28 Motion_Planning.FrenetTrajectory.Subsystem1.Direct_Lookup_Table_[n_D]1 Motion_Planning.FrenetTrajectory.Subsystem1.LP_filter Motion_Planning.FrenetTrajectory.Subsystem1.Min Motion_Planning.FrenetTrajectory.Subsystem1.Multiport_Switch1 Motion_Planning.FrenetTrajectory.Subsystem1.Output4 Motion_Planning.FrenetTrajectory.Subsystem1.Plan_Py_Fac Motion_Planning.FrenetTrajectory.Subsystem1.Preview_T_TB Motion_Planning.FrenetTrajectory.Subsystem1.Switch_Case_Action_Subsystem Motion_Planning.FrenetTrajectory.Subsystem1.Switch_Case_Action_Subsystem1 Motion_Planning.FrenetTrajectory.Subsystem1.predis_ayFac1 Motion_Planning.FrenetTrajectory.Subsystem1.predis_ayFac2 /end SUB_FUNCTION
/end FUNCTION
/begin FUNCTION Motion_Planning.FrenetTrajectory.Subsystem1.2_D_Lookup_Table2 "" /begin DEF_CHARACTERISTIC P_LCS_A0_Dis_BP P_LCS_LCC_PreView_Fac P_LCS_preDis_spd /end DEF_CHARACTERISTIC /end FUNCTION
/begin FUNCTION Motion_Planning.FrenetTrajectory.Subsystem1.AyDtLimit_TB "" /begin DEF_CHARACTERISTIC P_LCS_LCC_LCK_AyDtLimit_TBL P_LCS_preDis_spd /end DEF_CHARACTERISTIC /end FUNCTION
/begin FUNCTION Motion_Planning.FrenetTrajectory.Subsystem1.AyDtLimit_TB1 "" /begin DEF_CHARACTERISTIC P_LCS_LCC_LCK_AyDtLimit_TBL P_LCS_preDis_spd /end DEF_CHARACTERISTIC /end FUNCTION
/begin FUNCTION Motion_Planning.FrenetTrajectory.Subsystem1.AyDtLimit_TB2 "" /begin DEF_CHARACTERISTIC P_LCS_LCC_LC_Normal_AyDtLimit_TBL P_LCS_preDis_spd /end DEF_CHARACTERISTIC /end FUNCTION
/begin FUNCTION Motion_Planning.FrenetTrajectory.Subsystem1.AyDtLimit_TB3 "" /begin DEF_CHARACTERISTIC P_LCS_LCC_LKA_AyDtLimit_TBL P_LCS_preDis_spd /end DEF_CHARACTERISTIC /end FUNCTION
/begin FUNCTION Motion_Planning.FrenetTrajectory.Subsystem1.AyDtLimit_TB4 "" /begin DEF_CHARACTERISTIC P_LCS_LCC_ELK_AyDtLimit_TBL P_LCS_preDis_spd /end DEF_CHARACTERISTIC /end FUNCTION
/begin FUNCTION Motion_Planning.FrenetTrajectory.Subsystem1.AyDtLimit_TB5 "" /begin DEF_CHARACTERISTIC P_LCS_LCC_ESS_AyDtLimit_TBL P_LCS_preDis_spd /end DEF_CHARACTERISTIC /end FUNCTION
/begin FUNCTION Motion_Planning.FrenetTrajectory.Subsystem1.AyDtLimit_TB6 "" /begin DEF_CHARACTERISTIC P_LCS_LCC_Eco_AyDtLimit_TBL P_LCS_preDis_spd /end DEF_CHARACTERISTIC /end FUNCTION
/begin FUNCTION Motion_Planning.FrenetTrajectory.Subsystem1.AyDtLimit_TB7 "" /begin DEF_CHARACTERISTIC P_LCS_LCC_Sport_AyDtLimit_TBL P_LCS_preDis_spd /end DEF_CHARACTERISTIC /end FUNCTION
/begin FUNCTION Motion_Planning.FrenetTrajectory.Subsystem1.AyDtLimit_TB8 "" /begin DEF_CHARACTERISTIC P_LCS_LCC_LC_AyDtLimit_TBL P_LCS_preDis_spd /end DEF_CHARACTERISTIC /end FUNCTION
/begin FUNCTION Motion_Planning.FrenetTrajectory.Subsystem1.Constant1 "" /begin DEF_CHARACTERISTIC P_LCS_LCC_StateActiveDelaytime /end DEF_CHARACTERISTIC /end FUNCTION
/begin FUNCTION Motion_Planning.FrenetTrajectory.Subsystem1.Constant20 "" /begin DEF_CHARACTERISTIC P_LCS_A2S_FliterTime /end DEF_CHARACTERISTIC /end FUNCTION
/begin FUNCTION Motion_Planning.FrenetTrajectory.Subsystem1.Constant28 "" /begin DEF_CHARACTERISTIC P_LCS_LCC_PreView_s /end DEF_CHARACTERISTIC /end FUNCTION
/begin FUNCTION Motion_Planning.FrenetTrajectory.Subsystem1.Direct_Lookup_Table_[n_D]1 "" /end FUNCTION
/begin FUNCTION Motion_Planning.FrenetTrajectory.Subsystem1.LP_filter "" /end FUNCTION
/begin FUNCTION Motion_Planning.FrenetTrajectory.Subsystem1.Min "" /end FUNCTION
/begin FUNCTION Motion_Planning.FrenetTrajectory.Subsystem1.Multiport_Switch1 "" /end FUNCTION
/begin FUNCTION Motion_Planning.FrenetTrajectory.Subsystem1.Output4 "" /end FUNCTION
/begin FUNCTION Motion_Planning.FrenetTrajectory.Subsystem1.Plan_Py_Fac "" /begin DEF_CHARACTERISTIC P_LCS_DeltaEps_SpdBp P_LCS_LCC_Min_Plan_Dis /end DEF_CHARACTERISTIC /end FUNCTION
/begin FUNCTION Motion_Planning.FrenetTrajectory.Subsystem1.predis_ayFac1 "" /begin DEF_CHARACTERISTIC P_LCS_A2_Curve_BP P_LCS_LCC_PreViewCurve_Fac /end DEF_CHARACTERISTIC /end FUNCTION
/begin FUNCTION Motion_Planning.FrenetTrajectory.Subsystem1.predis_ayFac2 "" /begin DEF_CHARACTERISTIC P_LCS_A2_Curve_BP P_LCS_LCC_PreCur_Min_Plan_Dis_Fac /end DEF_CHARACTERISTIC /end FUNCTION
/begin FUNCTION Motion_Planning.FrenetTrajectory.Subsystem1.Preview_T_TB "" /begin DEF_CHARACTERISTIC P_LCS_LCC_PreViewT P_LCS_preDis_spd /end DEF_CHARACTERISTIC /end FUNCTION
/begin FUNCTION Motion_Planning.FrenetTrajectory.Subsystem1.Switch_Case_Action_Subsystem ""
 /begin SUB_FUNCTION Motion_Planning.FrenetTrajectory.Subsystem1.Switch_Case_Action_Subsystem.ActiveAyDtLimit_TBL Motion_Planning.FrenetTrajectory.Subsystem1.Switch_Case_Action_Subsystem.ActivePreviewT_TBL /end SUB_FUNCTION
/end FUNCTION
/begin FUNCTION Motion_Planning.FrenetTrajectory.Subsystem1.Switch_Case_Action_Subsystem.ActiveAyDtLimit_TBL ""
 /begin DEF_CHARACTERISTIC P_LCS_LCC_StateActiv_AyDtLimit P_LCS_StateActiveFlg_BP P_LCS_StateActive_HoldTime_BP /end DEF_CHARACTERISTIC
/end FUNCTION
/begin FUNCTION Motion_Planning.FrenetTrajectory.Subsystem1.Switch_Case_Action_Subsystem.ActivePreviewT_TBL "" /begin DEF_CHARACTERISTIC P_LCS_StateActiveFlg_BP P_LCS_StateActive_HoldTime_BP /end DEF_CHARACTERISTIC /end FUNCTION
/begin FUNCTION Motion_Planning.FrenetTrajectory.Subsystem1.Switch_Case_Action_Subsystem1 "" /end FUNCTION
/begin FUNCTION Output1 "" /end FUNCTION
/begin FUNCTION Output10 "" /end FUNCTION
/begin FUNCTION Output11 "" /end FUNCTION
/begin FUNCTION Output12 "" /end FUNCTION
/begin FUNCTION Output13 "" /end FUNCTION
/begin FUNCTION Output14 "" /end FUNCTION
/begin FUNCTION Output15 "" /end FUNCTION
/begin FUNCTION Output16 "" /end FUNCTION
/begin FUNCTION Output17 "" /end FUNCTION
/begin FUNCTION Output18 "" /end FUNCTION
/begin FUNCTION Output19 "" /end FUNCTION
/begin FUNCTION Output2 "" /end FUNCTION
/begin FUNCTION Output3 "" /end FUNCTION
/begin FUNCTION Output4 "" /end FUNCTION
/begin FUNCTION Output5 "" /end FUNCTION
/begin FUNCTION Output6 "" /end FUNCTION
/begin FUNCTION Output7 "" /end FUNCTION
/begin FUNCTION Output8 "" /end FUNCTION
/begin FUNCTION Output9 "" /end FUNCTION
/begin GROUP Root_Motion_Planning "LATC_Test_Calc/Motion_Planning" /begin SUB_GROUP S20_FrenetTrajectory /end SUB_GROUP /end GROUP
/begin GROUP Root_SteerAngSlopeCalc "LATC_Test_Calc/SteerAngSlopeCalc" /begin SUB_GROUP S40_Switch_Case_Action_Subsystem /end SUB_GROUP
 /begin REF_CHARACTERISTIC P_LCS_LCC_AngleSlope_ELK P_LCS_LCC_AngleSlope_ESS P_LCS_LCC_AngleSlope_LCCancle P_LCS_LCC_AngleSlope_LCEco P_LCS_LCC_AngleSlope_LCK P_LCS_LCC_AngleSlope_LCKIE P_LCS_LCC_AngleSlope_LCNomal P_LCS_LCC_AngleSlope_LCSport P_LCS_LCC_AngleSlope_LKA P_LCS_LCC_MaxLatAcc_ELK P_LCS_LCC_MaxLatAcc_ESS P_LCS_LCC_MaxLatAcc_LCCancel P_LCS_LCC_MaxLatAcc_LCEco P_LCS_LCC_MaxLatAcc_LCK P_LCS_LCC_MaxLatAcc_LCKIE P_LCS_LCC_MaxLatAcc_LCNomal P_LCS_LCC_MaxLatAcc_LCSport P_LCS_LCC_MaxLatAcc_LKA P_LCS_StateHold_time /end REF_CHARACTERISTIC
/end GROUP
/begin GROUP S20_FrenetTrajectory "LATC_Test_Calc/Motion_Planning/FrenetTrajectory" /begin SUB_GROUP S42_Subsystem1 /end SUB_GROUP /end GROUP
/begin GROUP S40_Switch_Case_Action_Subsystem "LATC_Test_Calc/SteerAngSlopeCalc/Switch Case Action Subsystem" /begin REF_CHARACTERISTIC P_LCS_StateActiv_AngleSlope /end REF_CHARACTERISTIC /end GROUP
/begin GROUP S42_Subsystem1 "LATC_Test_Calc/Motion_Planning/FrenetTrajectory/Subsystem1" /begin SUB_GROUP S44_Switch_Case_Action_Subsystem /end SUB_GROUP
 /begin REF_CHARACTERISTIC P_LCS_A2S_FliterTime P_LCS_LCC_ELK_AyDtLimit_TBL P_LCS_LCC_ESS_AyDtLimit_TBL P_LCS_LCC_Eco_AyDtLimit_TBL P_LCS_LCC_LCK_AyDtLimit_TBL P_LCS_LCC_LC_AyDtLimit_TBL P_LCS_LCC_LC_Normal_AyDtLimit_TBL P_LCS_LCC_LKA_AyDtLimit_TBL P_LCS_LCC_Min_Plan_Dis P_LCS_LCC_PreCur_Min_Plan_Dis_Fac P_LCS_LCC_PreViewCurve_Fac P_LCS_LCC_PreViewT P_LCS_LCC_PreView_Fac P_LCS_LCC_PreView_s P_LCS_LCC_Sport_AyDtLimit_TBL P_LCS_LCC_StateActiveDelaytime /end REF_CHARACTERISTIC
/end GROUP
/begin GROUP S44_Switch_Case_Action_Subsystem "LATC_Test_Calc/Motion_Planning/FrenetTrajectory/Subsystem1/Switch Case Action Subsystem" /begin REF_CHARACTERISTIC P_LCS_LCC_StateActiv_AyDtLimit /end REF_CHARACTERISTIC /end GROUP
/begin FUNCTION SteerAngSlopeCalc ""
 /begin SUB_FUNCTION SteerAngSlopeCalc.Constant2 SteerAngSlopeCalc.ELK_Active SteerAngSlopeCalc.ELK_Active1 SteerAngSlopeCalc.ESS_AES_Active SteerAngSlopeCalc.ESS_AES_Active1 SteerAngSlopeCalc.LCKIE_Active SteerAngSlopeCalc.LCKIE_Active1 SteerAngSlopeCalc.LCKIE_TO_LC_Eco SteerAngSlopeCalc.LCKIE_TO_LC_Eco1 SteerAngSlopeCalc.LCKIE_TO_LC_Nomal SteerAngSlopeCalc.LCKIE_TO_LC_Nomal1 SteerAngSlopeCalc.LCKIE_TO_LC_Sport SteerAngSlopeCalc.LCKIE_TO_LC_Sport1 SteerAngSlopeCalc.LC_Cancel SteerAngSlopeCalc.LC_Cancel1 SteerAngSlopeCalc.LKA_Active SteerAngSlopeCalc.LKA_Active1 SteerAngSlopeCalc.Merge SteerAngSlopeCalc.Multiport_Switch1 SteerAngSlopeCalc.Multiport_Switch2 SteerAngSlopeCalc.No_Function_2_LCK SteerAngSlopeCalc.No_Function_2_LCK1 SteerAngSlopeCalc.Product SteerAngSlopeCalc.Switch_Case SteerAngSlopeCalc.Switch_Case_Action_Subsystem SteerAngSlopeCalc.Switch_Case_Action_Subsystem1 SteerAngSlopeCalc.Unit_Delay3 SteerAngSlopeCalc.Unit_Delay4 /end SUB_FUNCTION
/end FUNCTION
/begin FUNCTION SteerAngSlopeCalc.Constant2 "" /begin DEF_CHARACTERISTIC P_LCS_StateHold_time /end DEF_CHARACTERISTIC /end FUNCTION
/begin FUNCTION SteerAngSlopeCalc.ELK_Active "" /begin DEF_CHARACTERISTIC P_LCS_LCC_AngleSlope_ELK P_LCS_preDis_spd /end DEF_CHARACTERISTIC /end FUNCTION
/begin FUNCTION SteerAngSlopeCalc.ELK_Active1 "" /begin DEF_CHARACTERISTIC P_LCS_LCC_MaxLatAcc_ELK P_LCS_preDis_spd /end DEF_CHARACTERISTIC /end FUNCTION
/begin FUNCTION SteerAngSlopeCalc.ESS_AES_Active "" /begin DEF_CHARACTERISTIC P_LCS_LCC_AngleSlope_ESS P_LCS_preDis_spd /end DEF_CHARACTERISTIC /end FUNCTION
/begin FUNCTION SteerAngSlopeCalc.ESS_AES_Active1 "" /begin DEF_CHARACTERISTIC P_LCS_LCC_MaxLatAcc_ESS P_LCS_preDis_spd /end DEF_CHARACTERISTIC /end FUNCTION
/begin FUNCTION SteerAngSlopeCalc.LC_Cancel "" /begin DEF_CHARACTERISTIC P_LCS_LCC_AngleSlope_LCCancle P_LCS_preDis_spd /end DEF_CHARACTERISTIC /end FUNCTION
/begin FUNCTION SteerAngSlopeCalc.LC_Cancel1 "" /begin DEF_CHARACTERISTIC P_LCS_LCC_MaxLatAcc_LCCancel P_LCS_preDis_spd /end DEF_CHARACTERISTIC /end FUNCTION
/begin FUNCTION SteerAngSlopeCalc.LCKIE_Active "" /begin DEF_CHARACTERISTIC P_LCS_LCC_AngleSlope_LCKIE P_LCS_preDis_spd /end DEF_CHARACTERISTIC /end FUNCTION
/begin FUNCTION SteerAngSlopeCalc.LCKIE_Active1 "" /begin DEF_CHARACTERISTIC P_LCS_LCC_MaxLatAcc_LCKIE P_LCS_preDis_spd /end DEF_CHARACTERISTIC /end FUNCTION
/begin FUNCTION SteerAngSlopeCalc.LCKIE_TO_LC_Eco "" /begin DEF_CHARACTERISTIC P_LCS_LCC_AngleSlope_LCEco P_LCS_preDis_spd /end DEF_CHARACTERISTIC /end FUNCTION
/begin FUNCTION SteerAngSlopeCalc.LCKIE_TO_LC_Eco1 "" /begin DEF_CHARACTERISTIC P_LCS_LCC_MaxLatAcc_LCEco P_LCS_preDis_spd /end DEF_CHARACTERISTIC /end FUNCTION
/begin FUNCTION SteerAngSlopeCalc.LCKIE_TO_LC_Nomal "" /begin DEF_CHARACTERISTIC P_LCS_LCC_AngleSlope_LCNomal P_LCS_preDis_spd /end DEF_CHARACTERISTIC /end FUNCTION
/begin FUNCTION SteerAngSlopeCalc.LCKIE_TO_LC_Nomal1 "" /begin DEF_CHARACTERISTIC P_LCS_LCC_MaxLatAcc_LCNomal P_LCS_preDis_spd /end DEF_CHARACTERISTIC /end FUNCTION
/begin FUNCTION SteerAngSlopeCalc.LCKIE_TO_LC_Sport "" /begin DEF_CHARACTERISTIC P_LCS_LCC_AngleSlope_LCSport P_LCS_preDis_spd /end DEF_CHARACTERISTIC /end FUNCTION
/begin FUNCTION SteerAngSlopeCalc.LCKIE_TO_LC_Sport1 "" /begin DEF_CHARACTERISTIC P_LCS_LCC_MaxLatAcc_LCSport P_LCS_preDis_spd /end DEF_CHARACTERISTIC /end FUNCTION
/begin FUNCTION SteerAngSlopeCalc.LKA_Active "" /begin DEF_CHARACTERISTIC P_LCS_LCC_AngleSlope_LKA P_LCS_preDis_spd /end DEF_CHARACTERISTIC /end FUNCTION
/begin FUNCTION SteerAngSlopeCalc.LKA_Active1 "" /begin DEF_CHARACTERISTIC P_LCS_LCC_MaxLatAcc_LKA P_LCS_preDis_spd /end DEF_CHARACTERISTIC /end FUNCTION
/begin FUNCTION SteerAngSlopeCalc.Merge "" /end FUNCTION
/begin FUNCTION SteerAngSlopeCalc.Multiport_Switch1 "" /end FUNCTION
/begin FUNCTION SteerAngSlopeCalc.Multiport_Switch2 "" /end FUNCTION
/begin FUNCTION SteerAngSlopeCalc.No_Function_2_LCK "" /begin DEF_CHARACTERISTIC P_LCS_LCC_AngleSlope_LCK P_LCS_preDis_spd /end DEF_CHARACTERISTIC /end FUNCTION
/begin FUNCTION SteerAngSlopeCalc.No_Function_2_LCK1 "" /begin DEF_CHARACTERISTIC P_LCS_LCC_MaxLatAcc_LCK P_LCS_preDis_spd /end DEF_CHARACTERISTIC /end FUNCTION
/begin FUNCTION SteerAngSlopeCalc.Product "" /end FUNCTION
/begin FUNCTION SteerAngSlopeCalc.Switch_Case "" /end FUNCTION
/begin FUNCTION SteerAngSlopeCalc.Switch_Case_Action_Subsystem ""
 /begin SUB_FUNCTION SteerAngSlopeCalc.Switch_Case_Action_Subsystem.LC_start_slope /end SUB_FUNCTION
/end FUNCTION
/begin FUNCTION SteerAngSlopeCalc.Switch_Case_Action_Subsystem.LC_start_slope ""
 /begin DEF_CHARACTERISTIC P_LCS_StateActiv_AngleSlope P_LCS_StateActiveFlg_BP P_LCS_StateActive_HoldTime_BP /end DEF_CHARACTERISTIC
/end FUNCTION
/begin FUNCTION SteerAngSlopeCalc.Switch_Case_Action_Subsystem1 "" /end FUNCTION
/begin FUNCTION SteerAngSlopeCalc.Unit_Delay3 "" /end FUNCTION
/begin FUNCTION SteerAngSlopeCalc.Unit_Delay4 "" /end FUNCTION
/begin FUNCTION Subsystem "" /end FUNCTION
/begin RECORD_LAYOUT Lookup1D_BOOLEAN FNC_VALUES 1 UBYTE COLUMN_DIR DIRECT /end RECORD_LAYOUT
/begin RECORD_LAYOUT Lookup1D_BYTE FNC_VALUES 1 SBYTE COLUMN_DIR DIRECT /end RECORD_LAYOUT
/begin RECORD_LAYOUT Lookup1D_FLOAT32_IEEE FNC_VALUES 1 FLOAT32_IEEE COLUMN_DIR DIRECT /end RECORD_LAYOUT
/begin RECORD_LAYOUT Lookup1D_FLOAT64_IEEE FNC_VALUES 1 FLOAT64_IEEE COLUMN_DIR DIRECT /end RECORD_LAYOUT
/begin RECORD_LAYOUT Lookup1D_SLONG FNC_VALUES 1 SLONG COLUMN_DIR DIRECT /end RECORD_LAYOUT
/begin RECORD_LAYOUT Lookup1D_UBYTE FNC_VALUES 1 UBYTE COLUMN_DIR DIRECT /end RECORD_LAYOUT
/begin RECORD_LAYOUT Lookup1D_ULONG FNC_VALUES 1 ULONG COLUMN_DIR DIRECT /end RECORD_LAYOUT
/begin RECORD_LAYOUT Lookup1D_UWORD FNC_VALUES 1 UWORD COLUMN_DIR DIRECT /end RECORD_LAYOUT
/begin RECORD_LAYOUT Lookup1D_WORD FNC_VALUES 1 SWORD COLUMN_DIR DIRECT /end RECORD_LAYOUT
/begin RECORD_LAYOUT Lookup1D_X_BOOLEAN AXIS_PTS_X 1 UBYTE INDEX_INCR DIRECT /end RECORD_LAYOUT
/begin RECORD_LAYOUT Lookup1D_X_BYTE AXIS_PTS_X 1 SBYTE INDEX_INCR DIRECT /end RECORD_LAYOUT
/begin RECORD_LAYOUT Lookup1D_X_FLOAT32_IEEE AXIS_PTS_X 1 FLOAT32_IEEE INDEX_INCR DIRECT /end RECORD_LAYOUT
/begin RECORD_LAYOUT Lookup1D_X_FLOAT64_IEEE AXIS_PTS_X 1 FLOAT64_IEEE INDEX_INCR DIRECT /end RECORD_LAYOUT
/begin RECORD_LAYOUT Lookup1D_X_LONG AXIS_PTS_X 1 SLONG INDEX_INCR DIRECT /end RECORD_LAYOUT
/begin RECORD_LAYOUT Lookup1D_X_UBYTE AXIS_PTS_X 1 UBYTE INDEX_INCR DIRECT /end RECORD_LAYOUT
/begin RECORD_LAYOUT Lookup1D_X_ULONG AXIS_PTS_X 1 ULONG INDEX_INCR DIRECT /end RECORD_LAYOUT
/begin RECORD_LAYOUT Lookup1D_X_UWORD AXIS_PTS_X 1 UWORD INDEX_INCR DIRECT /end RECORD_LAYOUT
/begin RECORD_LAYOUT Lookup1D_X_WORD AXIS_PTS_X 1 SWORD INDEX_INCR DIRECT /end RECORD_LAYOUT
/begin RECORD_LAYOUT Lookup2D_BOOLEAN FNC_VALUES 1 UBYTE COLUMN_DIR DIRECT /end RECORD_LAYOUT
/begin RECORD_LAYOUT Lookup2D_BYTE FNC_VALUES 1 SBYTE COLUMN_DIR DIRECT /end RECORD_LAYOUT
/begin RECORD_LAYOUT Lookup2D_FLOAT32_IEEE FNC_VALUES 1 FLOAT32_IEEE COLUMN_DIR DIRECT /end RECORD_LAYOUT
/begin RECORD_LAYOUT Lookup2D_FLOAT64_IEEE FNC_VALUES 1 FLOAT64_IEEE COLUMN_DIR DIRECT /end RECORD_LAYOUT
/begin RECORD_LAYOUT Lookup2D_LONG FNC_VALUES 1 SLONG COLUMN_DIR DIRECT /end RECORD_LAYOUT
/begin RECORD_LAYOUT Lookup2D_UBYTE FNC_VALUES 1 UBYTE COLUMN_DIR DIRECT /end RECORD_LAYOUT
/begin RECORD_LAYOUT Lookup2D_ULONG FNC_VALUES 1 ULONG COLUMN_DIR DIRECT /end RECORD_LAYOUT
/begin RECORD_LAYOUT Lookup2D_UWORD FNC_VALUES 1 UWORD COLUMN_DIR DIRECT /end RECORD_LAYOUT
/begin RECORD_LAYOUT Lookup2D_WORD FNC_VALUES 1 SWORD COLUMN_DIR DIRECT /end RECORD_LAYOUT
/begin RECORD_LAYOUT Lookup2D_X_BOOLEAN AXIS_PTS_X 1 UBYTE INDEX_INCR DIRECT /end RECORD_LAYOUT
/begin RECORD_LAYOUT Lookup2D_X_BYTE AXIS_PTS_X 1 SBYTE INDEX_INCR DIRECT /end RECORD_LAYOUT
/begin RECORD_LAYOUT Lookup2D_X_FLOAT32_IEEE AXIS_PTS_X 1 FLOAT32_IEEE INDEX_INCR DIRECT /end RECORD_LAYOUT
/begin RECORD_LAYOUT Lookup2D_X_FLOAT64_IEEE AXIS_PTS_X 1 FLOAT64_IEEE INDEX_INCR DIRECT /end RECORD_LAYOUT
/begin RECORD_LAYOUT Lookup2D_X_LONG AXIS_PTS_X 1 SLONG INDEX_INCR DIRECT /end RECORD_LAYOUT
/begin RECORD_LAYOUT Lookup2D_X_UBYTE AXIS_PTS_X 1 UBYTE INDEX_INCR DIRECT /end RECORD_LAYOUT
/begin RECORD_LAYOUT Lookup2D_X_ULONG AXIS_PTS_X 1 ULONG INDEX_INCR DIRECT /end RECORD_LAYOUT
/begin RECORD_LAYOUT Lookup2D_X_UWORD AXIS_PTS_X 1 UWORD INDEX_INCR DIRECT /end RECORD_LAYOUT
/begin RECORD_LAYOUT Lookup2D_X_WORD AXIS_PTS_X 1 SWORD INDEX_INCR DIRECT /end RECORD_LAYOUT
/begin RECORD_LAYOUT Scalar_BOOLEAN FNC_VALUES 1 UBYTE COLUMN_DIR DIRECT /end RECORD_LAYOUT
/begin RECORD_LAYOUT Scalar_BYTE FNC_VALUES 1 SBYTE COLUMN_DIR DIRECT /end RECORD_LAYOUT
/begin RECORD_LAYOUT Scalar_FLOAT32_IEEE FNC_VALUES 1 FLOAT32_IEEE COLUMN_DIR DIRECT /end RECORD_LAYOUT
/begin RECORD_LAYOUT Scalar_FLOAT64_IEEE FNC_VALUES 1 FLOAT64_IEEE COLUMN_DIR DIRECT /end RECORD_LAYOUT
/begin RECORD_LAYOUT Scalar_LONG FNC_VALUES 1 SLONG COLUMN_DIR DIRECT /end RECORD_LAYOUT
/begin RECORD_LAYOUT Scalar_SWORD FNC_VALUES 1 SWORD COLUMN_DIR DIRECT /end RECORD_LAYOUT
/begin RECORD_LAYOUT Scalar_UBYTE FNC_VALUES 1 UBYTE COLUMN_DIR DIRECT /end RECORD_LAYOUT
/begin RECORD_LAYOUT Scalar_ULONG FNC_VALUES 1 ULONG COLUMN_DIR DIRECT /end RECORD_LAYOUT
/begin RECORD_LAYOUT Scalar_UWORD FNC_VALUES 1 UWORD COLUMN_DIR DIRECT /end RECORD_LAYOUT
/begin RECORD_LAYOUT __UBYTE_Z FNC_VALUES 1 UBYTE ROW_DIR DIRECT /end RECORD_LAYOUT
/begin RECORD_LAYOUT __UWORD_Z FNC_VALUES 1 UWORD ROW_DIR DIRECT /end RECORD_LAYOUT
/begin RECORD_LAYOUT __ULONG_Z FNC_VALUES 1 ULONG ROW_DIR DIRECT /end RECORD_LAYOUT
/begin RECORD_LAYOUT __SBYTE_Z FNC_VALUES 1 SBYTE ROW_DIR DIRECT /end RECORD_LAYOUT
/begin RECORD_LAYOUT __SWORD_Z FNC_VALUES 1 SWORD ROW_DIR DIRECT /end RECORD_LAYOUT
/begin RECORD_LAYOUT __SLONG_Z FNC_VALUES 1 SLONG ROW_DIR DIRECT /end RECORD_LAYOUT
/begin RECORD_LAYOUT __FLOAT32_IEEE_Z FNC_VALUES 1 FLOAT32_IEEE ROW_DIR DIRECT /end RECORD_LAYOUT
/begin RECORD_LAYOUT __FLOAT64_IEEE_Z FNC_VALUES 1 FLOAT64_IEEE ROW_DIR DIRECT /end RECORD_LAYOUT
/begin RECORD_LAYOUT __UBYTE_S FNC_VALUES 1 UBYTE COLUMN_DIR DIRECT /end RECORD_LAYOUT
/begin RECORD_LAYOUT __UWORD_S FNC_VALUES 1 UWORD COLUMN_DIR DIRECT /end RECORD_LAYOUT
/begin RECORD_LAYOUT __ULONG_S FNC_VALUES 1 ULONG COLUMN_DIR DIRECT /end RECORD_LAYOUT
/begin RECORD_LAYOUT __SBYTE_S FNC_VALUES 1 SBYTE COLUMN_DIR DIRECT /end RECORD_LAYOUT
/begin RECORD_LAYOUT __SWORD_S FNC_VALUES 1 SWORD COLUMN_DIR DIRECT /end RECORD_LAYOUT
/begin RECORD_LAYOUT __SLONG_S FNC_VALUES 1 SLONG COLUMN_DIR DIRECT /end RECORD_LAYOUT
/begin RECORD_LAYOUT __FLOAT32_IEEE_S FNC_VALUES 1 FLOAT32_IEEE COLUMN_DIR DIRECT /end RECORD_LAYOUT
/begin RECORD_LAYOUT __FLOAT64_IEEE_S FNC_VALUES 1 FLOAT64_IEEE COLUMN_DIR DIRECT /end RECORD_LAYOUT
/begin RECORD_LAYOUT SSV__UBYTE_S AXIS_PTS_X 1 UBYTE INDEX_INCR DIRECT /end RECORD_LAYOUT
/begin RECORD_LAYOUT SSV__UWORD_S AXIS_PTS_X 1 UWORD INDEX_INCR DIRECT /end RECORD_LAYOUT
/begin RECORD_LAYOUT SSV__ULONG_S AXIS_PTS_X 1 ULONG INDEX_INCR DIRECT /end RECORD_LAYOUT
/begin RECORD_LAYOUT SSV__SBYTE_S AXIS_PTS_X 1 SBYTE INDEX_INCR DIRECT /end RECORD_LAYOUT
/begin RECORD_LAYOUT SSV__SWORD_S AXIS_PTS_X 1 SWORD INDEX_INCR DIRECT /end RECORD_LAYOUT
/begin RECORD_LAYOUT SSV__SLONG_S AXIS_PTS_X 1 SLONG INDEX_INCR DIRECT /end RECORD_LAYOUT
/begin RECORD_LAYOUT SSV__FLOAT32_IEEE_S AXIS_PTS_X 1 FLOAT32_IEEE INDEX_INCR DIRECT /end RECORD_LAYOUT
/begin RECORD_LAYOUT SSV__FLOAT64_IEEE_S AXIS_PTS_X 1 FLOAT64_IEEE INDEX_INCR DIRECT /end RECORD_LAYOUT
/end MODULE
/end PROJECT
